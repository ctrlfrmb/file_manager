/*-- Generated by A2L Merger 4.3.1 --*/
/* Created by DAMOS++ V5.8.20 Win7 */
ASAP2_VERSION 1 61
/begin PROJECT ZCU "ZCU"
/begin HEADER "" VERSION "ZCU" PROJECT_NO ZCU /end HEADER
/begin MODULE DIM ""
/begin MOD_PAR "ZCU" VERSION "ZCU" CUSTOMER_NO "0" USER "" PHONE_NO "" ECU "EVLBRD" CPU_TYPE "IFX" /begin MEMORY_SEGMENT CBDst0x0 "" CODE FLASH INTERN 0x0 0xe0000 -1 -1 -1 -1 -1 /end MEMORY_SEGMENT
 /begin MEMORY_SEGMENT EPILOG0x00722120 "" CODE FLASH INTERN 0x00722120 0xdee0 -1 -1 -1 -1 -1 /end MEMORY_SEGMENT
 /*
/begin MEMORY_SEGMENT Asw2Dst00400000 "" CODE FLASH INTERN 0x00400000 0x228 -1 -1 -1 -1 -1
/end MEMORY_SEGMENT
/begin MEMORY_SEGMENT Asw2EpiLogDst00400228 "" CODE FLASH INTERN 0x00400228 0x540 -1 -1 -1 -1 -1
/end MEMORY_SEGMENT
*/
 /begin MEMORY_SEGMENT Asw0Dst0x000e0000 "" CODE FLASH INTERN 0x000e0000 0x23a7c0 -1 -1 -1 -1 -1 /end MEMORY_SEGMENT
 /begin MEMORY_SEGMENT Asw0EpiLogDst0x0031a7c0 "" CODE FLASH INTERN 0x0031a7c0 0x540 -1 -1 -1 -1 -1 /end MEMORY_SEGMENT
 /begin MEMORY_SEGMENT Asw1Dst0x00400000 "" CODE FLASH INTERN 0x00400000 0x30f80 -1 -1 -1 -1 -1 /end MEMORY_SEGMENT
 /begin MEMORY_SEGMENT Asw1EpiLogDst0x00430f80 "" CODE FLASH INTERN 0x00430f80 0x540 -1 -1 -1 -1 -1 /end MEMORY_SEGMENT
 /begin MEMORY_SEGMENT Dst0x00720000 "" DATA FLASH INTERN 0x00720000 0x2120 -1 -1 -1 -1 -1
  /begin IF_DATA XCPplus 0x0102
   /begin SEGMENT 0 /* segment logical number */ 0x02 /* number of pages */ 0x00 /* address extension */ 0x00 /* compression method */ 0x00 /* encryption method */
    /begin CHECKSUM XCP_ADD_14 /* checksum: add bytes to 16bit result */ MAX_BLOCK_SIZE 0x00000400 /end CHECKSUM
    /begin PAGE 0x00 /* page number */ ECU_ACCESS_DONT_CARE XCP_READ_ACCESS_DONT_CARE XCP_WRITE_ACCESS_NOT_ALLOWED /end PAGE
    /begin PAGE 0x01 /* page number */ ECU_ACCESS_DONT_CARE XCP_READ_ACCESS_DONT_CARE XCP_WRITE_ACCESS_WITH_ECU_ONLY /end PAGE
   /end SEGMENT
  /end IF_DATA
 /end MEMORY_SEGMENT
 SYSTEM_CONSTANT "CY326_SC" "0"
 SYSTEM_CONSTANT "CY327_SY" "0"
 SYSTEM_CONSTANT "CY329_SC" "0"
 SYSTEM_CONSTANT "CYL_MAX" "4"
 SYSTEM_CONSTANT "ZERO" "0" /end MOD_PAR
/begin MOD_COMMON "" BYTE_ORDER MSB_LAST ALIGNMENT_BYTE 1 ALIGNMENT_WORD 2 ALIGNMENT_LONG 4 ALIGNMENT_INT64 4 ALIGNMENT_FLOAT32_IEEE 4 ALIGNMENT_FLOAT64_IEEE 4 DATA_SIZE 32 /end MOD_COMMON
/begin IF_DATA ASAP1B_Bypass
 /begin TP_BLOB 0x102 /* Bypass version */ 0x102 /* Blob version */ /end TP_BLOB
/end IF_DATA
/begin IF_DATA XCPplus 0x0102
 /begin PAG /* MAX_SEGMENTS */ 1 /end PAG
 /*************** start of PROTOCOL_LAYER *******************/
 /begin PROTOCOL_LAYER /* At MODULE */ 0x0102 /* XCP protocol layer version */ 1000 /* T1 [ms] */ 1000 /* T2 [ms] */ 0 /* T3 [ms] */ 0 /* T4 [ms] */ 0 /* T5 [ms] */ 0 /* T6 [ms] */ 0 /* T7 [ms] */ 255 /* MAX_CTO */ 1448 /* MAX_DTO default for DAQ and STIM */ BYTE_ORDER_MSB_LAST /* BYTE_ORDER: INTEL */ ADDRESS_GRANULARITY_BYTE /* ADDRESS_GRANULARITY */ OPTIONAL_CMD GET_COMM_MODE_INFO OPTIONAL_CMD SET_MTA OPTIONAL_CMD UPLOAD OPTIONAL_CMD SHORT_UPLOAD OPTIONAL_CMD BUILD_CHECKSUM OPTIONAL_CMD TRANSPORT_LAYER_CMD OPTIONAL_CMD DOWNLOAD OPTIONAL_CMD DOWNLOAD_NEXT OPTIONAL_CMD SHORT_DOWNLOAD OPTIONAL_CMD MODIFY_BITS OPTIONAL_CMD SET_CAL_PAGE OPTIONAL_CMD GET_CAL_PAGE OPTIONAL_CMD COPY_CAL_PAGE OPTIONAL_CMD SET_DAQ_PTR OPTIONAL_CMD WRITE_DAQ OPTIONAL_CMD SET_DAQ_LIST_MODE OPTIONAL_CMD GET_DAQ_LIST_MODE OPTIONAL_CMD START_STOP_DAQ_LIST OPTIONAL_CMD START_STOP_SYNCH OPTIONAL_CMD GET_DAQ_PROCESSOR_INFO OPTIONAL_CMD GET_DAQ_EVENT_INFO OPTIONAL_CMD FREE_DAQ OPTIONAL_CMD ALLOC_DAQ OPTIONAL_CMD ALLOC_ODT OPTIONAL_CMD ALLOC_ODT_ENTRY COMMUNICATION_MODE_SUPPORTED BLOCK /end PROTOCOL_LAYER
 /***************** end of PROTOCOL_LAYER *******************/ /********************* start of DAQ ************************/
 /begin DAQ /* DAQ supported, at MODULE*/ DYNAMIC /* DAQ_CONFIG_TYPE */ 4 /* MAX_DAQ: Total number of available DAQ lists */ 4 /* MAX_EVENT_CHANNEL: Total number of available event channels */ 0 /* MIN_DAQ: Total number of predefined DAQ lists */ OPTIMISATION_TYPE_DEFAULT /* OPTIMISATION_TYPE */ ADDRESS_EXTENSION_FREE /* ADDRESS_EXTENSION */ IDENTIFICATION_FIELD_TYPE_ABSOLUTE /* IDENTIFICATION_FIELD */ GRANULARITY_ODT_ENTRY_SIZE_DAQ_BYTE /* GRANULARITY_ODT_ENTRY_SIZE_DAQ */ 8 /* MAX_ODT_ENTRY_SIZE_DAQ: Maximum size of ODT entry */ OVERLOAD_INDICATION_EVENT /* OVERLOAD_INDICATION */ PRESCALER_SUPPORTED /******************* start of EVENT ************************/
  /begin EVENT "XcpEventChannel_10ms" "10_ms" 0 DAQ 1 10 6 0 CONSISTENCY EVENT /end EVENT
  /begin EVENT "XcpEventChannel_20ms" "20_ms" 1 DAQ 1 20 6 0 CONSISTENCY EVENT /end EVENT
  /begin EVENT "XcpEventChannel_50ms" "100_ms" 2 DAQ 1 50 6 0 CONSISTENCY EVENT /end EVENT
  /begin EVENT "XcpEventChannel_100ms" "100_ms" 3 DAQ 1 100 6 0 CONSISTENCY EVENT /end EVENT
  /begin EVENT "XcpEventChannel_1000ms" "1000_ms" 4 DAQ 1 1 9 0 CONSISTENCY EVENT /end EVENT
  /********************* end of EVENT ************************/ /end DAQ
 /********************* end of DAQ **************************/
 /begin XCP_ON_CAN /************************ start of CAN *********************/ 0x0102 /* XCP on CAN version */ CAN_ID_MASTER 0x580 /* CMD/STIM CAN-ID */ /* master -> slave */ CAN_ID_SLAVE 0x581 /* RES/ERR/EV/SERV/DAQ CAN-ID */ /* slave -> master */ /* Bit31= 1: extended identifier */ BAUDRATE 500000 /* BAUDRATE [Hz] */ SAMPLE_POINT 80 /* sample point */ /* [% complete bit time] */ SAMPLE_RATE SINGLE /* SAMPLE_RATE */ BTL_CYCLES 10 /* BTL_CYCLES */ /* [slots per bit time] */ SJW 2 /* length synchr. segment */ /* [BTL_CYCLES] */ MAX_DLC_REQUIRED MAX_BUS_LOAD 90 /* maximum available bus */ /************************* end of CAN **********************/ /*************** start of PROTOCOL_LAYER *******************/
  /begin PROTOCOL_LAYER /* At MODULE */ 0x0102 /* XCP protocol layer version */ 2000 /* T1 [ms] */ 10000 /* T2 [ms] */ 2000 /* T3 [ms] */ 2000 /* T4 [ms] */ 2000 /* T5 [ms] */ 2000 /* T6 [ms] */ 0 /* T7 [ms] */ 8 /* MAX_CTO */ 8 /* MAX_DTO default for DAQ and STIM */ BYTE_ORDER_MSB_LAST /* BYTE_ORDER: INTEL */ ADDRESS_GRANULARITY_BYTE /* ADDRESS_GRANULARITY */ OPTIONAL_CMD GET_COMM_MODE_INFO OPTIONAL_CMD SET_MTA OPTIONAL_CMD UPLOAD OPTIONAL_CMD SHORT_UPLOAD OPTIONAL_CMD BUILD_CHECKSUM OPTIONAL_CMD DOWNLOAD OPTIONAL_CMD DOWNLOAD_NEXT OPTIONAL_CMD SHORT_DOWNLOAD OPTIONAL_CMD MODIFY_BITS OPTIONAL_CMD SET_CAL_PAGE OPTIONAL_CMD GET_CAL_PAGE OPTIONAL_CMD COPY_CAL_PAGE OPTIONAL_CMD SET_DAQ_PTR OPTIONAL_CMD WRITE_DAQ OPTIONAL_CMD SET_DAQ_LIST_MODE OPTIONAL_CMD GET_DAQ_LIST_MODE OPTIONAL_CMD START_STOP_DAQ_LIST OPTIONAL_CMD START_STOP_SYNCH OPTIONAL_CMD GET_DAQ_PROCESSOR_INFO OPTIONAL_CMD GET_DAQ_EVENT_INFO OPTIONAL_CMD FREE_DAQ OPTIONAL_CMD ALLOC_DAQ OPTIONAL_CMD ALLOC_ODT OPTIONAL_CMD ALLOC_ODT_ENTRY COMMUNICATION_MODE_SUPPORTED BLOCK /end PROTOCOL_LAYER
  /***************** end of PROTOCOL_LAYER *******************/ TRANSPORT_LAYER_INSTANCE "Calibration CAN (CAN1)" /end XCP_ON_CAN
 /*************** start of UDP_IP *******************/
 /begin XCP_ON_UDP_IP 0X0102 /* XCP on UDP_IP version */ 0xC3B4 /* PORT */ ADDRESS "10.208.0.10" /* ADDRESS */ TRANSPORT_LAYER_INSTANCE "UDP_IP (port1)" /end XCP_ON_UDP_IP
 /***************** end of UDP_IP *******************/ /end IF_DATA
/*********** Start of merged CHARACTERISTIC blocks ***********/
/begin CHARACTERISTIC Tlib_LIN_Schedule_Switch_C "" VALUE 0x00720910 Val_Wu8 1 OneToOne 0.0 255.00 FORMAT "%8.2" /end CHARACTERISTIC
/begin CHARACTERISTIC Tlib_LIN2_Switch_Schedule_C "" VALUE 0x00720911 Val_Wu8 1 OneToOne 0.0 255.00 FORMAT "%8.2" /end CHARACTERISTIC
/begin CHARACTERISTIC Tlib_LIN3_Switch_Schedule_C "" VALUE 0x00720912 Val_Wu8 1 OneToOne 0.0 255.00 FORMAT "%8.2" /end CHARACTERISTIC
/begin CHARACTERISTIC Tlib_LIN4_Switch_Schedule_C "" VALUE 0x00720913 Val_Wu8 1 OneToOne 0.0 255.00 FORMAT "%8.2" /end CHARACTERISTIC
/begin CHARACTERISTIC Tlib_LIN6_Switch_Schedule_C "" VALUE 0x00720914 Val_Wu8 1 OneToOne 0.0 255.00 FORMAT "%8.2" /end CHARACTERISTIC
/begin CHARACTERISTIC Tlib_LIN7_Switch_Schedule_C "" VALUE 0x00720915 Val_Wu8 1 OneToOne 0.0 255.00 FORMAT "%8.2" /end CHARACTERISTIC
/begin CHARACTERISTIC Tlib_CanStackTst_Com_Switch_C "" VALUE 0x00720916 Val_Wu8 1 OneToOne 0.0 255.00 FORMAT "%8.2" /end CHARACTERISTIC
/begin CHARACTERISTIC Tlib_CanStackTst_Interface_Switch_C "" VALUE 0x00720917 Val_Wu8 1 OneToOne 0.0 255.00 FORMAT "%8.2" /end CHARACTERISTIC
/begin CHARACTERISTIC Tlib_FrntHvacFanSpd_ZCR_LIN2_C "" VALUE 0x00720918 Val_Wu8 1 OneToOne 0.0 255.00 FORMAT "%8.2" /end CHARACTERISTIC
/begin CHARACTERISTIC Tlib_FrntHvacFanKneeU_ZCR_LIN2_C "" VALUE 0x00720919 Val_Wu8 1 OneToOne 0.0 255.00 FORMAT "%8.2" /end CHARACTERISTIC
/begin CHARACTERISTIC Tlib_FrntHvacFanIMaxMin_ZCR_LIN2_C "" VALUE 0x0072091a Val_Wu8 1 OneToOne 0.0 255.00 FORMAT "%8.2" /end CHARACTERISTIC
/begin CHARACTERISTIC Tlib_FrntHvacFanSftyRunThd_ZCR_LIN2_C "" VALUE 0x0072091b Val_Wu8 1 OneToOne 0.0 255.00 FORMAT "%8.2" /end CHARACTERISTIC
/begin CHARACTERISTIC Tlib_FrntHvacFanIMaxMax_ZCR_LIN2_C "" VALUE 0x0072091c Val_Wu8 1 OneToOne 0.0 255.00 FORMAT "%8.2" /end CHARACTERISTIC
/begin CHARACTERISTIC Tlib_FrntHvacFanRxFrq_ZCR_LIN2_C "" VALUE 0x00720518 Val_Wu16 1 OneToOne 0.0 65535 FORMAT "%8.2" /end CHARACTERISTIC
/begin CHARACTERISTIC Tlib_FrntHvacFanSftyRunSpd_ZCR_LIN2_C "" VALUE 0x0072091d Val_Wu8 1 OneToOne 0.0 255.00 FORMAT "%8.2" /end CHARACTERISTIC
/begin CHARACTERISTIC Tlib_FrntHvacFanRamp_ZCR_LIN2_C "" VALUE 0x0072091e Val_Wu8 1 OneToOne 0.0 255.00 FORMAT "%8.2" /end CHARACTERISTIC
/begin CHARACTERISTIC Tlib_FrntHvacFanSeln_ZCR_LIN2_C "" VALUE 0x0072091f Val_Wu8 1 OneToOne 0.0 255.00 FORMAT "%8.2" /end CHARACTERISTIC
/begin CHARACTERISTIC Tlib_HfaMotBlockCmd_ZCR_LIN2_C "" VALUE 0x00720920 Val_Wu8 1 OneToOne 0.0 255.00 FORMAT "%8.2" /end CHARACTERISTIC
/begin CHARACTERISTIC Tlib_HfaMotCoilPwrOn_ZCR_LIN2_C "" VALUE 0x00720921 Val_Wu8 1 OneToOne 0.0 255.00 FORMAT "%8.2" /end CHARACTERISTIC
/begin CHARACTERISTIC Tlib_HfaMotSpdSet_ZCR_LIN2_C "" VALUE 0x00720922 Val_Wu8 1 OneToOne 0.0 255.00 FORMAT "%8.2" /end CHARACTERISTIC
/begin CHARACTERISTIC Tlib_HfaMotStrtPson_ZCR_LIN2_C "" VALUE 0x0072051a Val_Wu16 1 OneToOne 0.0 65535 FORMAT "%8.2" /end CHARACTERISTIC
/begin CHARACTERISTIC Tlib_HfaMotPsonAvl_ZCR_LIN2_C "" VALUE 0x00720923 Val_Wu8 1 OneToOne 0.0 255.00 FORMAT "%8.2" /end CHARACTERISTIC
/begin CHARACTERISTIC Tlib_HfaMotAdr_ZCR_LIN2_C "" VALUE 0x00720924 Val_Wu8 1 OneToOne 0.0 255.00 FORMAT "%8.2" /end CHARACTERISTIC
/begin CHARACTERISTIC Tlib_HfaMotUrgcUnlck_ZCR_LIN2_C "" VALUE 0x00720925 Val_Wu8 1 OneToOne 0.0 255.00 FORMAT "%8.2" /end CHARACTERISTIC
/begin CHARACTERISTIC Tlib_HfaMotClearReq_ZCR_LIN2_C "" VALUE 0x00720926 Val_Wu8 1 OneToOne 0.0 255.00 FORMAT "%8.2" /end CHARACTERISTIC
/begin CHARACTERISTIC Tlib_HfaMotDir_ZCR_LIN2_C "" VALUE 0x00720927 Val_Wu8 1 OneToOne 0.0 255.00 FORMAT "%8.2" /end CHARACTERISTIC
/begin CHARACTERISTIC Tlib_HfaMotUrgcPson_ZCR_LIN2_C "" VALUE 0x00720928 Val_Wu8 1 OneToOne 0.0 255.00 FORMAT "%8.2" /end CHARACTERISTIC
/begin CHARACTERISTIC Tlib_HfaMotMode_ZCR_LIN2_C "" VALUE 0x00720929 Val_Wu8 1 OneToOne 0.0 255.00 FORMAT "%8.2" /end CHARACTERISTIC
/begin CHARACTERISTIC Tlib_HfaMotTargtPson_ZCR_LIN2_C "" VALUE 0x0072051c Val_Wu16 1 OneToOne 0.0 65535 FORMAT "%8.2" /end CHARACTERISTIC
/begin CHARACTERISTIC Tlib_HfaMotSaveData_ZCR_LIN2_C "" VALUE 0x0072092a Val_Wu8 1 OneToOne 0.0 255.00 FORMAT "%8.2" /end CHARACTERISTIC
/begin CHARACTERISTIC Tlib_DoorPassLockSts_ZCR_CANFD5_C "" VALUE 0x0072092b Val_Wu8 1 OneToOne 0.0 255.00 FORMAT "%8.2" /end CHARACTERISTIC
/begin CHARACTERISTIC Tlib_DoorPassStsCntr4_ZCR_CANFD5_C "" VALUE 0x0072092c Val_Wu8 1 OneToOne 0.0 255.00 FORMAT "%8.2" /end CHARACTERISTIC
/begin CHARACTERISTIC Tlib_DoorPassStsDoorSts2_ZCR_CANFD5_C "" VALUE 0x0072092d Val_Wu8 1 OneToOne 0.0 255.00 FORMAT "%8.2" /end CHARACTERISTIC
/begin CHARACTERISTIC Tlib_DoorPassStsChks8_ZCR_CANFD5_C "" VALUE 0x0072092e Val_Wu8 1 OneToOne 0.0 255.00 FORMAT "%8.2" /end CHARACTERISTIC
/begin CHARACTERISTIC Tlib_DoorPassStsDataID4_ZCR_CANFD5_C "" VALUE 0x0072092f Val_Wu8 1 OneToOne 0.0 255.00 FORMAT "%8.2" /end CHARACTERISTIC
/begin CHARACTERISTIC Tlib_ActvnOfHndlDoorLi1HndlDoorLiDrvrRe_ZCR_CANFD5_C "" VALUE 0x00720930 Val_Wu8 1 OneToOne 0.0 255.00 FORMAT "%8.2" /end CHARACTERISTIC
/begin CHARACTERISTIC Tlib_ActvnOfHndlDoorLi1HndlDoorLiDrvr_ZCR_CANFD5_C "" VALUE 0x00720931 Val_Wu8 1 OneToOne 0.0 255.00 FORMAT "%8.2" /end CHARACTERISTIC
/begin CHARACTERISTIC Tlib_ActvnOfHndlDoorLi1HndlDoorLiPassRe_ZCR_CANFD5_C "" VALUE 0x00720932 Val_Wu8 1 OneToOne 0.0 255.00 FORMAT "%8.2" /end CHARACTERISTIC
/begin CHARACTERISTIC Tlib_ActvnOfHndlDoorLi1HndlDoorLiPass_ZCR_CANFD5_C "" VALUE 0x00720933 Val_Wu8 1 OneToOne 0.0 255.00 FORMAT "%8.2" /end CHARACTERISTIC
/begin CHARACTERISTIC Tlib_DoorPassHndlCmd_ZCR_CANFD5_C "" VALUE 0x00720934 Val_Wu8 1 OneToOne 0.0 255.00 FORMAT "%8.2" /end CHARACTERISTIC
/begin CHARACTERISTIC Tlib_DoorRiReHndlCmd_ZCR_CANFD5_C "" VALUE 0x00720935 Val_Wu8 1 OneToOne 0.0 255.00 FORMAT "%8.2" /end CHARACTERISTIC
/begin CHARACTERISTIC Tlib_ActvnOfIndcrIndcrOut_ZCR_CANFD5_C "" VALUE 0x00720936 Val_Wu8 1 OneToOne 0.0 255.00 FORMAT "%8.2" /end CHARACTERISTIC
/begin CHARACTERISTIC Tlib_ActvnOfIndcrChks8_ZCR_CANFD5_C "" VALUE 0x00720937 Val_Wu8 1 OneToOne 0.0 255.00 FORMAT "%8.2" /end CHARACTERISTIC
/begin CHARACTERISTIC Tlib_ActvnOfIndcrCntr4_ZCR_CANFD5_C "" VALUE 0x00720938 Val_Wu8 1 OneToOne 0.0 255.00 FORMAT "%8.2" /end CHARACTERISTIC
/begin CHARACTERISTIC Tlib_ActvnOfIndcrDataID4_ZCR_CANFD5_C "" VALUE 0x00720939 Val_Wu8 1 OneToOne 0.0 255.00 FORMAT "%8.2" /end CHARACTERISTIC
/begin CHARACTERISTIC Tlib_ActvnOfGoodByeLi_ZCR_CANFD5_C "" VALUE 0x0072093a Val_Wu8 1 OneToOne 0.0 255.00 FORMAT "%8.2" /end CHARACTERISTIC
/begin CHARACTERISTIC Tlib_CrashStsSafeSts_ZCR_CANFD5_C "" VALUE 0x0072093b Val_Wu8 1 OneToOne 0.0 255.00 FORMAT "%8.2" /end CHARACTERISTIC
/begin CHARACTERISTIC Tlib_CrashStsSafeCntr4_ZCR_CANFD5_C "" VALUE 0x0072093c Val_Wu8 1 OneToOne 0.0 255.00 FORMAT "%8.2" /end CHARACTERISTIC
/begin CHARACTERISTIC Tlib_CrashStsSafeDataID4_ZCR_CANFD5_C "" VALUE 0x0072093d Val_Wu8 1 OneToOne 0.0 255.00 FORMAT "%8.2" /end CHARACTERISTIC
/begin CHARACTERISTIC Tlib_CrashStsSafeChks8_ZCR_CANFD5_C "" VALUE 0x0072093e Val_Wu8 1 OneToOne 0.0 255.00 FORMAT "%8.2" /end CHARACTERISTIC
/begin CHARACTERISTIC Tlib_MirrDefrstAtCmd_ZCR_CANFD5_C "" VALUE 0x0072093f Val_Wu8 1 OneToOne 0.0 255.00 FORMAT "%8.2" /end CHARACTERISTIC
/begin CHARACTERISTIC Tlib_MirrDwnCmdAtPass_ZCR_CANFD5_C "" VALUE 0x00720940 Val_Wu8 1 OneToOne 0.0 255.00 FORMAT "%8.2" /end CHARACTERISTIC
/begin CHARACTERISTIC Tlib_MirrFoldCmdAtPassMirrFoldCmdTrgSrc_ZCR_CANFD5_C "" VALUE 0x00720941 Val_Wu8 1 OneToOne 0.0 255.00 FORMAT "%8.2" /end CHARACTERISTIC
/begin CHARACTERISTIC Tlib_MirrFoldCmdAtPassMirrFoldCmdTyp_ZCR_CANFD5_C "" VALUE 0x00720942 Val_Wu8 1 OneToOne 0.0 255.00 FORMAT "%8.2" /end CHARACTERISTIC
/begin CHARACTERISTIC Tlib_ListOfNodAv1_ZCR_CANFD5_C "" VALUE 0x0072048c Val_Wu32 1 OneToOne 0.0 4294967295 FORMAT "%8.2" /end CHARACTERISTIC
/begin CHARACTERISTIC Tlib_ListOfNodAv5_ZCR_CANFD5_C "" VALUE 0x00720490 Val_Wu32 1 OneToOne 0.0 4294967295 FORMAT "%8.2" /end CHARACTERISTIC
/begin CHARACTERISTIC Tlib_ListOfNodAv4_ZCR_CANFD5_C "" VALUE 0x00720494 Val_Wu32 1 OneToOne 0.0 4294967295 FORMAT "%8.2" /end CHARACTERISTIC
/begin CHARACTERISTIC Tlib_ListOfNodAv8_ZCR_CANFD5_C "" VALUE 0x00720498 Val_Wu32 1 OneToOne 0.0 4294967295 FORMAT "%8.2" /end CHARACTERISTIC
/begin CHARACTERISTIC Tlib_ListOfNodAv6_ZCR_CANFD5_C "" VALUE 0x0072049c Val_Wu32 1 OneToOne 0.0 4294967295 FORMAT "%8.2" /end CHARACTERISTIC
/begin CHARACTERISTIC Tlib_ListOfNodAv3_ZCR_CANFD5_C "" VALUE 0x007204a0 Val_Wu32 1 OneToOne 0.0 4294967295 FORMAT "%8.2" /end CHARACTERISTIC
/begin CHARACTERISTIC Tlib_ListOfNodAv2_ZCR_CANFD5_C "" VALUE 0x007204a4 Val_Wu32 1 OneToOne 0.0 4294967295 FORMAT "%8.2" /end CHARACTERISTIC
/begin CHARACTERISTIC Tlib_ListOfNodAv7_ZCR_CANFD5_C "" VALUE 0x007204a8 Val_Wu32 1 OneToOne 0.0 4294967295 FORMAT "%8.2" /end CHARACTERISTIC
/begin CHARACTERISTIC Tlib_CrashSts3_ZCR_CANFD5_C "" VALUE 0x00720943 Val_Wu8 1 OneToOne 0.0 255.00 FORMAT "%8.2" /end CHARACTERISTIC
/begin CHARACTERISTIC Tlib_CinhRiReSwt_ZCR_CANFD5_C "" VALUE 0x00720944 Val_Wu8 1 OneToOne 0.0 255.00 FORMAT "%8.2" /end CHARACTERISTIC
/begin CHARACTERISTIC Tlib_OpenRiReSwt_ZCR_CANFD5_C "" VALUE 0x00720945 Val_Wu8 1 OneToOne 0.0 255.00 FORMAT "%8.2" /end CHARACTERISTIC
/begin CHARACTERISTIC Tlib_PawlRiReSwt_ZCR_CANFD5_C "" VALUE 0x00720946 Val_Wu8 1 OneToOne 0.0 255.00 FORMAT "%8.2" /end CHARACTERISTIC
/begin CHARACTERISTIC Tlib_IndcrSts_ZCR_CANFD5_C "" VALUE 0x00720947 Val_Wu8 1 OneToOne 0.0 255.00 FORMAT "%8.2" /end CHARACTERISTIC
/begin CHARACTERISTIC Tlib_ShortDropWinPassDoor_ZCR_CANFD5_C "" VALUE 0x00720948 Val_Wu8 1 OneToOne 0.0 255.00 FORMAT "%8.2" /end CHARACTERISTIC
/begin CHARACTERISTIC Tlib_CinhRiReSts_ZCR_CANFD5_C "" VALUE 0x00720949 Val_Wu8 1 OneToOne 0.0 255.00 FORMAT "%8.2" /end CHARACTERISTIC
/begin CHARACTERISTIC Tlib_AntiPinchDsblPass_ZCR_CANFD5_C "" VALUE 0x0072094a Val_Wu8 1 OneToOne 0.0 255.00 FORMAT "%8.2" /end CHARACTERISTIC
/begin CHARACTERISTIC Tlib_AntiPinchDsblReRi_ZCR_CANFD5_C "" VALUE 0x0072094b Val_Wu8 1 OneToOne 0.0 255.00 FORMAT "%8.2" /end CHARACTERISTIC
/begin CHARACTERISTIC Tlib_ShortDropWinRiReDoor_ZCR_CANFD5_C "" VALUE 0x0072094c Val_Wu8 1 OneToOne 0.0 255.00 FORMAT "%8.2" /end CHARACTERISTIC
/begin CHARACTERISTIC Tlib_ActvnOfSwtIllmnSply_ZCR_CANFD5_C "" VALUE 0x0072094d Val_Wu8 1 OneToOne 0.0 255.00 FORMAT "%8.2" /end CHARACTERISTIC
/begin CHARACTERISTIC Tlib_DoorPassPosnToObst2Chks_ZCR_CANFD5_C "" VALUE 0x0072094e Val_Wu8 1 OneToOne 0.0 255.00 FORMAT "%8.2" /end CHARACTERISTIC
/begin CHARACTERISTIC Tlib_DoorPassPosnToObst2AngleDeg11_ZCR_CANFD5_C "" VALUE 0x0072094f Val_Wu8 1 OneToOne 0.0 255.00 FORMAT "%8.2" /end CHARACTERISTIC
/begin CHARACTERISTIC Tlib_DoorPassPosnToObst2Cntr_ZCR_CANFD5_C "" VALUE 0x00720950 Val_Wu8 1 OneToOne 0.0 255.00 FORMAT "%8.2" /end CHARACTERISTIC
/begin CHARACTERISTIC Tlib_DoorRiReLatPawlSt_ZCR_CANFD5_C "" VALUE 0x00720951 Val_Wu8 1 OneToOne 0.0 255.00 FORMAT "%8.2" /end CHARACTERISTIC
/begin CHARACTERISTIC Tlib_DoorRiReLatPosn_ZCR_CANFD5_C "" VALUE 0x00720952 Val_Wu8 1 OneToOne 0.0 255.00 FORMAT "%8.2" /end CHARACTERISTIC
/begin CHARACTERISTIC Tlib_DoorLeReSwtLockgStsHi_ZCR_CANFD5_C "" VALUE 0x00720953 Val_Wu8 1 OneToOne 0.0 255.00 FORMAT "%8.2" /end CHARACTERISTIC
/begin CHARACTERISTIC Tlib_DoorRiRePosnToObst2Chks_ZCR_CANFD5_C "" VALUE 0x00720954 Val_Wu8 1 OneToOne 0.0 255.00 FORMAT "%8.2" /end CHARACTERISTIC
/begin CHARACTERISTIC Tlib_DoorRiRePosnToObst2Cntr_ZCR_CANFD5_C "" VALUE 0x00720955 Val_Wu8 1 OneToOne 0.0 255.00 FORMAT "%8.2" /end CHARACTERISTIC
/begin CHARACTERISTIC Tlib_DoorRiRePosnToObst2AngleDeg11_ZCR_CANFD5_C "" VALUE 0x00720956 Val_Wu8 1 OneToOne 0.0 255.00 FORMAT "%8.2" /end CHARACTERISTIC
/begin CHARACTERISTIC Tlib_DoorRiReObstPos2ObjectPosY_ZCR_CANFD5_C "" VALUE 0x00720957 Val_Wu8 1 OneToOne 0.0 255.00 FORMAT "%8.2" /end CHARACTERISTIC
/begin CHARACTERISTIC Tlib_DoorRiReObstPos2Chks_ZCR_CANFD5_C "" VALUE 0x00720958 Val_Wu8 1 OneToOne 0.0 255.00 FORMAT "%8.2" /end CHARACTERISTIC
/begin CHARACTERISTIC Tlib_DoorRiReObstPos2Cntr_ZCR_CANFD5_C "" VALUE 0x00720959 Val_Wu8 1 OneToOne 0.0 255.00 FORMAT "%8.2" /end CHARACTERISTIC
/begin CHARACTERISTIC Tlib_DoorRiReObstPos2ObjectPosZ_ZCR_CANFD5_C "" VALUE 0x0072095a Val_Wu8 1 OneToOne 0.0 255.00 FORMAT "%8.2" /end CHARACTERISTIC
/begin CHARACTERISTIC Tlib_DoorRiReObstPos2ObjectPosX_ZCR_CANFD5_C "" VALUE 0x0072095b Val_Wu8 1 OneToOne 0.0 255.00 FORMAT "%8.2" /end CHARACTERISTIC
/begin CHARACTERISTIC Tlib_DoorPassObstPos2ObjectPosY_ZCR_CANFD5_C "" VALUE 0x0072095c Val_Wu8 1 OneToOne 0.0 255.00 FORMAT "%8.2" /end CHARACTERISTIC
/begin CHARACTERISTIC Tlib_DoorPassObstPos2ObjectPosX_ZCR_CANFD5_C "" VALUE 0x0072095d Val_Wu8 1 OneToOne 0.0 255.00 FORMAT "%8.2" /end CHARACTERISTIC
/begin CHARACTERISTIC Tlib_DoorPassObstPos2Cntr_ZCR_CANFD5_C "" VALUE 0x0072095e Val_Wu8 1 OneToOne 0.0 255.00 FORMAT "%8.2" /end CHARACTERISTIC
/begin CHARACTERISTIC Tlib_DoorPassObstPos2Chks_ZCR_CANFD5_C "" VALUE 0x0072095f Val_Wu8 1 OneToOne 0.0 255.00 FORMAT "%8.2" /end CHARACTERISTIC
/begin CHARACTERISTIC Tlib_DoorPassObstPos2ObjectPosZ_ZCR_CANFD5_C "" VALUE 0x00720960 Val_Wu8 1 OneToOne 0.0 255.00 FORMAT "%8.2" /end CHARACTERISTIC
/begin CHARACTERISTIC Tlib_DoorMaxOpnSetPass_ZCR_CANFD5_C "" VALUE 0x00720961 Val_Wu8 1 OneToOne 0.0 255.00 FORMAT "%8.2" /end CHARACTERISTIC
/begin CHARACTERISTIC Tlib_DoorMaxOpnSetRiRe_ZCR_CANFD5_C "" VALUE 0x00720962 Val_Wu8 1 OneToOne 0.0 255.00 FORMAT "%8.2" /end CHARACTERISTIC
/begin CHARACTERISTIC Tlib_ExtrMirrPassPosnCmdMirrPosnAdjCldLeRi_ZCR_CANFD5_C "" VALUE 0x00720963 Val_Wu8 1 OneToOne 0.0 255.00 FORMAT "%8.2" /end CHARACTERISTIC
/begin CHARACTERISTIC Tlib_ExtrMirrPassPosnCmdMirrPosnAdjCldUpDwn_ZCR_CANFD5_C "" VALUE 0x00720964 Val_Wu8 1 OneToOne 0.0 255.00 FORMAT "%8.2" /end CHARACTERISTIC
/begin CHARACTERISTIC Tlib_DoorRadarScanReqPass_ZCR_CANFD5_C "" VALUE 0x00720965 Val_Wu8 1 OneToOne 0.0 255.00 FORMAT "%8.2" /end CHARACTERISTIC
/begin CHARACTERISTIC Tlib_DoorRadarScanReqRiRe_ZCR_CANFD5_C "" VALUE 0x00720966 Val_Wu8 1 OneToOne 0.0 255.00 FORMAT "%8.2" /end CHARACTERISTIC
/begin CHARACTERISTIC Tlib_ExtrMirrPassDiSts_ZCR_CANFD5_C "" VALUE 0x00720967 Val_Wu8 1 OneToOne 0.0 255.00 FORMAT "%8.2" /end CHARACTERISTIC
/begin CHARACTERISTIC Tlib_PwrDoorManStrengthLvlSetPass_ZCR_CANFD5_C "" VALUE 0x00720968 Val_Wu8 1 OneToOne 0.0 255.00 FORMAT "%8.2" /end CHARACTERISTIC
/begin CHARACTERISTIC Tlib_ExtrMirrDimCmd_ZCR_CANFD5_C "" VALUE 0x00720969 Val_Wu8 1 OneToOne 0.0 255.00 FORMAT "%8.2" /end CHARACTERISTIC
/begin CHARACTERISTIC Tlib_PwrDoorManStrengthLvlSetRiRe_ZCR_CANFD5_C "" VALUE 0x0072096a Val_Wu8 1 OneToOne 0.0 255.00 FORMAT "%8.2" /end CHARACTERISTIC
/begin CHARACTERISTIC Tlib_DoorRiReIntrSwtLedLockgCmd_ZCR_CANFD5_C "" VALUE 0x0072096b Val_Wu8 1 OneToOne 0.0 255.00 FORMAT "%8.2" /end CHARACTERISTIC
/begin CHARACTERISTIC Tlib_CabPressPodCalc_ZCR_CANFD5_C "" VALUE 0x0072096c Val_Wu8 1 OneToOne 0.0 255.00 FORMAT "%8.2" /end CHARACTERISTIC
/begin CHARACTERISTIC Tlib_DoorPassIntrSwtLedLockgCmd_ZCR_CANFD5_C "" VALUE 0x0072096d Val_Wu8 1 OneToOne 0.0 255.00 FORMAT "%8.2" /end CHARACTERISTIC
/begin CHARACTERISTIC Tlib_DoorLeReModSts2_ZCR_CANFD5_C "" VALUE 0x0072096e Val_Wu8 1 OneToOne 0.0 255.00 FORMAT "%8.2" /end CHARACTERISTIC
/begin CHARACTERISTIC Tlib_DtcInfDoorLeRe2Boolean10_ZCR_CANFD5_C "" VALUE 0x0072096f Val_Wu8 1 OneToOne 0.0 255.00 FORMAT "%8.2" /end CHARACTERISTIC
/begin CHARACTERISTIC Tlib_DtcInfDoorLeRe2Boolean6_ZCR_CANFD5_C "" VALUE 0x00720970 Val_Wu8 1 OneToOne 0.0 255.00 FORMAT "%8.2" /end CHARACTERISTIC
/begin CHARACTERISTIC Tlib_DtcInfDoorLeRe2Boolean9_ZCR_CANFD5_C "" VALUE 0x00720971 Val_Wu8 1 OneToOne 0.0 255.00 FORMAT "%8.2" /end CHARACTERISTIC
/begin CHARACTERISTIC Tlib_DtcInfDoorLeRe2Boolean7_ZCR_CANFD5_C "" VALUE 0x00720972 Val_Wu8 1 OneToOne 0.0 255.00 FORMAT "%8.2" /end CHARACTERISTIC
/begin CHARACTERISTIC Tlib_DtcInfDoorLeRe2Boolean12_ZCR_CANFD5_C "" VALUE 0x00720973 Val_Wu8 1 OneToOne 0.0 255.00 FORMAT "%8.2" /end CHARACTERISTIC
/begin CHARACTERISTIC Tlib_DtcInfDoorLeRe2Boolean13_ZCR_CANFD5_C "" VALUE 0x00720974 Val_Wu8 1 OneToOne 0.0 255.00 FORMAT "%8.2" /end CHARACTERISTIC
/begin CHARACTERISTIC Tlib_DtcInfDoorLeRe2Boolean2_ZCR_CANFD5_C "" VALUE 0x00720975 Val_Wu8 1 OneToOne 0.0 255.00 FORMAT "%8.2" /end CHARACTERISTIC
/begin CHARACTERISTIC Tlib_DtcInfDoorLeRe2Boolean14_ZCR_CANFD5_C "" VALUE 0x00720976 Val_Wu8 1 OneToOne 0.0 255.00 FORMAT "%8.2" /end CHARACTERISTIC
/begin CHARACTERISTIC Tlib_DtcInfDoorLeRe2Boolean5_ZCR_CANFD5_C "" VALUE 0x00720977 Val_Wu8 1 OneToOne 0.0 255.00 FORMAT "%8.2" /end CHARACTERISTIC
/begin CHARACTERISTIC Tlib_DtcInfDoorLeRe2Boolean8_ZCR_CANFD5_C "" VALUE 0x00720978 Val_Wu8 1 OneToOne 0.0 255.00 FORMAT "%8.2" /end CHARACTERISTIC
/begin CHARACTERISTIC Tlib_DtcInfDoorLeRe2Boolean11_ZCR_CANFD5_C "" VALUE 0x00720979 Val_Wu8 1 OneToOne 0.0 255.00 FORMAT "%8.2" /end CHARACTERISTIC
/begin CHARACTERISTIC Tlib_DtcInfDoorLeRe2Boolean3_ZCR_CANFD5_C "" VALUE 0x0072097a Val_Wu8 1 OneToOne 0.0 255.00 FORMAT "%8.2" /end CHARACTERISTIC
/begin CHARACTERISTIC Tlib_DtcInfDoorLeRe2Boolean1_ZCR_CANFD5_C "" VALUE 0x0072097b Val_Wu8 1 OneToOne 0.0 255.00 FORMAT "%8.2" /end CHARACTERISTIC
/begin CHARACTERISTIC Tlib_DtcInfDoorLeRe2Boolean4_ZCR_CANFD5_C "" VALUE 0x0072097c Val_Wu8 1 OneToOne 0.0 255.00 FORMAT "%8.2" /end CHARACTERISTIC
/begin CHARACTERISTIC Tlib_DoorDrvrModSts2_ZCR_CANFD5_C "" VALUE 0x0072097d Val_Wu8 1 OneToOne 0.0 255.00 FORMAT "%8.2" /end CHARACTERISTIC
/begin CHARACTERISTIC Tlib_FltOfIndcrTurnOnDrvrSide_ZCR_CANFD5_C "" VALUE 0x0072097e Val_Wu8 1 OneToOne 0.0 255.00 FORMAT "%8.2" /end CHARACTERISTIC
/begin CHARACTERISTIC Tlib_ELCarCfgSgnlKey_ZCR_CANFD5_C "" VALUE 0x007204ac Val_WS32 1 OneToOne -2147483648 2147483647 FORMAT "%8.2" /end CHARACTERISTIC
/begin CHARACTERISTIC Tlib_ELCarCfgSgnlValue_ZCR_CANFD5_C "" VALUE 0x007204b0 Val_WS32 1 OneToOne -2147483648 2147483647 FORMAT "%8.2" /end CHARACTERISTIC
/begin CHARACTERISTIC Tlib_PawlLeReSwtHi_ZCR_CANFD5_C "" VALUE 0x0072097f Val_Wu8 1 OneToOne 0.0 255.00 FORMAT "%8.2" /end CHARACTERISTIC
/begin CHARACTERISTIC Tlib_OpenLeReSwtHi_ZCR_CANFD5_C "" VALUE 0x00720980 Val_Wu8 1 OneToOne 0.0 255.00 FORMAT "%8.2" /end CHARACTERISTIC
/begin CHARACTERISTIC Tlib_MirrAdjCmdAtPassMirrAdjCmdTyp_ZCR_CANFD5_C "" VALUE 0x00720981 Val_Wu8 1 OneToOne 0.0 255.00 FORMAT "%8.2" /end CHARACTERISTIC
/begin CHARACTERISTIC Tlib_MirrAdjCmdAtPassMirrAdjCmdTrgSrc_ZCR_CANFD5_C "" VALUE 0x00720982 Val_Wu8 1 OneToOne 0.0 255.00 FORMAT "%8.2" /end CHARACTERISTIC
/begin CHARACTERISTIC Tlib_PawlDrvrSwtHi_ZCR_CANFD5_C "" VALUE 0x00720983 Val_Wu8 1 OneToOne 0.0 255.00 FORMAT "%8.2" /end CHARACTERISTIC
/begin CHARACTERISTIC Tlib_CinhPassSts_ZCR_CANFD5_C "" VALUE 0x00720984 Val_Wu8 1 OneToOne 0.0 255.00 FORMAT "%8.2" /end CHARACTERISTIC
/begin CHARACTERISTIC Tlib_PawlPassSwt_ZCR_CANFD5_C "" VALUE 0x00720985 Val_Wu8 1 OneToOne 0.0 255.00 FORMAT "%8.2" /end CHARACTERISTIC
/begin CHARACTERISTIC Tlib_OpenPassSwt_ZCR_CANFD5_C "" VALUE 0x00720986 Val_Wu8 1 OneToOne 0.0 255.00 FORMAT "%8.2" /end CHARACTERISTIC
/begin CHARACTERISTIC Tlib_CinhPassSwt_ZCR_CANFD5_C "" VALUE 0x00720987 Val_Wu8 1 OneToOne 0.0 255.00 FORMAT "%8.2" /end CHARACTERISTIC
/begin CHARACTERISTIC Tlib_DoorPassLatPosn_ZCR_CANFD5_C "" VALUE 0x00720988 Val_Wu8 1 OneToOne 0.0 255.00 FORMAT "%8.2" /end CHARACTERISTIC
/begin CHARACTERISTIC Tlib_DoorPassLatPawlSt_ZCR_CANFD5_C "" VALUE 0x00720989 Val_Wu8 1 OneToOne 0.0 255.00 FORMAT "%8.2" /end CHARACTERISTIC
/begin CHARACTERISTIC Tlib_RoadInclnForPOD_ZCR_CANFD5_C "" VALUE 0x0072098a Val_Wu8 1 OneToOne 0.0 255.00 FORMAT "%8.2" /end CHARACTERISTIC
/begin CHARACTERISTIC Tlib_DtcInfDoorDrvr2Boolean3_ZCR_CANFD5_C "" VALUE 0x0072098b Val_Wu8 1 OneToOne 0.0 255.00 FORMAT "%8.2" /end CHARACTERISTIC
/begin CHARACTERISTIC Tlib_DtcInfDoorDrvr2Boolean9_ZCR_CANFD5_C "" VALUE 0x0072098c Val_Wu8 1 OneToOne 0.0 255.00 FORMAT "%8.2" /end CHARACTERISTIC
/begin CHARACTERISTIC Tlib_DtcInfDoorDrvr2Boolean11_ZCR_CANFD5_C "" VALUE 0x0072098d Val_Wu8 1 OneToOne 0.0 255.00 FORMAT "%8.2" /end CHARACTERISTIC
/begin CHARACTERISTIC Tlib_DtcInfDoorDrvr2Boolean4_ZCR_CANFD5_C "" VALUE 0x0072098e Val_Wu8 1 OneToOne 0.0 255.00 FORMAT "%8.2" /end CHARACTERISTIC
/begin CHARACTERISTIC Tlib_DtcInfDoorDrvr2Boolean10_ZCR_CANFD5_C "" VALUE 0x0072098f Val_Wu8 1 OneToOne 0.0 255.00 FORMAT "%8.2" /end CHARACTERISTIC
/begin CHARACTERISTIC Tlib_DtcInfDoorDrvr2Boolean14_ZCR_CANFD5_C "" VALUE 0x00720990 Val_Wu8 1 OneToOne 0.0 255.00 FORMAT "%8.2" /end CHARACTERISTIC
/begin CHARACTERISTIC Tlib_DtcInfDoorDrvr2Boolean7_ZCR_CANFD5_C "" VALUE 0x00720991 Val_Wu8 1 OneToOne 0.0 255.00 FORMAT "%8.2" /end CHARACTERISTIC
/begin CHARACTERISTIC Tlib_DtcInfDoorDrvr2Boolean12_ZCR_CANFD5_C "" VALUE 0x00720992 Val_Wu8 1 OneToOne 0.0 255.00 FORMAT "%8.2" /end CHARACTERISTIC
/begin CHARACTERISTIC Tlib_DtcInfDoorDrvr2Boolean13_ZCR_CANFD5_C "" VALUE 0x00720993 Val_Wu8 1 OneToOne 0.0 255.00 FORMAT "%8.2" /end CHARACTERISTIC
/begin CHARACTERISTIC Tlib_DtcInfDoorDrvr2Boolean1_ZCR_CANFD5_C "" VALUE 0x00720994 Val_Wu8 1 OneToOne 0.0 255.00 FORMAT "%8.2" /end CHARACTERISTIC
/begin CHARACTERISTIC Tlib_DtcInfDoorDrvr2Boolean8_ZCR_CANFD5_C "" VALUE 0x00720995 Val_Wu8 1 OneToOne 0.0 255.00 FORMAT "%8.2" /end CHARACTERISTIC
/begin CHARACTERISTIC Tlib_DtcInfDoorDrvr2Boolean6_ZCR_CANFD5_C "" VALUE 0x00720996 Val_Wu8 1 OneToOne 0.0 255.00 FORMAT "%8.2" /end CHARACTERISTIC
/begin CHARACTERISTIC Tlib_DtcInfDoorDrvr2Boolean5_ZCR_CANFD5_C "" VALUE 0x00720997 Val_Wu8 1 OneToOne 0.0 255.00 FORMAT "%8.2" /end CHARACTERISTIC
/begin CHARACTERISTIC Tlib_DtcInfDoorDrvr2Boolean2_ZCR_CANFD5_C "" VALUE 0x00720998 Val_Wu8 1 OneToOne 0.0 255.00 FORMAT "%8.2" /end CHARACTERISTIC
/begin CHARACTERISTIC Tlib_DoorDrvrPosn2_ZCR_CANFD5_C "" VALUE 0x00720999 Val_Wu8 1 OneToOne 0.0 255.00 FORMAT "%8.2" /end CHARACTERISTIC
/begin CHARACTERISTIC Tlib_DoorLeRePosn2_ZCR_CANFD5_C "" VALUE 0x0072099a Val_Wu8 1 OneToOne 0.0 255.00 FORMAT "%8.2" /end CHARACTERISTIC
/begin CHARACTERISTIC Tlib_DoorLeReAntiPnch2_ZCR_CANFD5_C "" VALUE 0x0072099b Val_Wu8 1 OneToOne 0.0 255.00 FORMAT "%8.2" /end CHARACTERISTIC
/begin CHARACTERISTIC Tlib_RollAgGlbForPOD_ZCR_CANFD5_C "" VALUE 0x0072099c Val_Wu8 1 OneToOne 0.0 255.00 FORMAT "%8.2" /end CHARACTERISTIC
/begin CHARACTERISTIC Tlib_ActvnOfWelcomeLi_ZCR_CANFD5_C "" VALUE 0x0072099d Val_Wu8 1 OneToOne 0.0 255.00 FORMAT "%8.2" /end CHARACTERISTIC
/begin CHARACTERISTIC Tlib_ActvnOfPudLi_ZCR_CANFD5_C "" VALUE 0x0072099e Val_Wu8 1 OneToOne 0.0 255.00 FORMAT "%8.2" /end CHARACTERISTIC
/begin CHARACTERISTIC Tlib_RollAgGlbQf_ZCR_CANFD5_C "" VALUE 0x0072099f Val_Wu8 1 OneToOne 0.0 255.00 FORMAT "%8.2" /end CHARACTERISTIC
/begin CHARACTERISTIC Tlib_RollAgGlbVal_ZCR_CANFD5_C "" VALUE 0x0072051e Val_WS16 1 OneToOne -32768 32767 FORMAT "%8.2" /end CHARACTERISTIC
/begin CHARACTERISTIC Tlib_DoorDrvrAntiPnch2_ZCR_CANFD5_C "" VALUE 0x007209a0 Val_Wu8 1 OneToOne 0.0 255.00 FORMAT "%8.2" /end CHARACTERISTIC
/begin CHARACTERISTIC Tlib_RoadInclnRoadIncln_ZCR_CANFD5_C "" VALUE 0x00720520 Val_WS16 1 OneToOne -32768 32767 FORMAT "%8.2" /end CHARACTERISTIC
/begin CHARACTERISTIC Tlib_RoadInclnQly_ZCR_CANFD5_C "" VALUE 0x007209a1 Val_Wu8 1 OneToOne 0.0 255.00 FORMAT "%8.2" /end CHARACTERISTIC
/begin CHARACTERISTIC Tlib_WinReqAtReRiWinOpenReqAtDrvr_ZCR_CANFD5_C "" VALUE 0x007209a2 Val_Wu8 1 OneToOne 0.0 255.00 FORMAT "%8.2" /end CHARACTERISTIC
/begin CHARACTERISTIC Tlib_WinReqAtReRiWMRTrgSrc_ZCR_CANFD5_C "" VALUE 0x007209a3 Val_Wu8 1 OneToOne 0.0 255.00 FORMAT "%8.2" /end CHARACTERISTIC
/begin CHARACTERISTIC Tlib_WinReqAtPassWinOpenReqAtDrvr_ZCR_CANFD5_C "" VALUE 0x007209a4 Val_Wu8 1 OneToOne 0.0 255.00 FORMAT "%8.2" /end CHARACTERISTIC
/begin CHARACTERISTIC Tlib_WinReqAtPassWMRTrgSrc_ZCR_CANFD5_C "" VALUE 0x007209a5 Val_Wu8 1 OneToOne 0.0 255.00 FORMAT "%8.2" /end CHARACTERISTIC
/begin CHARACTERISTIC Tlib_OdoMeter_ZCR_CANFD5_C "" VALUE 0x007204b4 Val_Wu32 1 OneToOne 0.0 4294967295 FORMAT "%8.2" /end CHARACTERISTIC
/begin CHARACTERISTIC Tlib_CinhDrvrStsHi_ZCR_CANFD5_C "" VALUE 0x007209a6 Val_Wu8 1 OneToOne 0.0 255.00 FORMAT "%8.2" /end CHARACTERISTIC
/begin CHARACTERISTIC Tlib_SuspPosnVertRiReQf_ZCR_CANFD5_C "" VALUE 0x007209a7 Val_Wu8 1 OneToOne 0.0 255.00 FORMAT "%8.2" /end CHARACTERISTIC
/begin CHARACTERISTIC Tlib_SuspPosnVertRiDataID4_ZCR_CANFD5_C "" VALUE 0x007209a8 Val_Wu8 1 OneToOne 0.0 255.00 FORMAT "%8.2" /end CHARACTERISTIC
/begin CHARACTERISTIC Tlib_SuspPosnVertRiChks8_ZCR_CANFD5_C "" VALUE 0x007209a9 Val_Wu8 1 OneToOne 0.0 255.00 FORMAT "%8.2" /end CHARACTERISTIC
/begin CHARACTERISTIC Tlib_SuspPosnVertRiCntr4_ZCR_CANFD5_C "" VALUE 0x007209aa Val_Wu8 1 OneToOne 0.0 255.00 FORMAT "%8.2" /end CHARACTERISTIC
/begin CHARACTERISTIC Tlib_SuspPosnVertRiRe_ZCR_CANFD5_C "" VALUE 0x00720522 Val_WS16 1 OneToOne -32768 32767 FORMAT "%8.2" /end CHARACTERISTIC
/begin CHARACTERISTIC Tlib_SuspPosnVertRiFrntQf_ZCR_CANFD5_C "" VALUE 0x007209ab Val_Wu8 1 OneToOne 0.0 255.00 FORMAT "%8.2" /end CHARACTERISTIC
/begin CHARACTERISTIC Tlib_SuspPosnVertRiFrnt_ZCR_CANFD5_C "" VALUE 0x00720524 Val_WS16 1 OneToOne -32768 32767 FORMAT "%8.2" /end CHARACTERISTIC
/begin CHARACTERISTIC Tlib_CinhLeReStsHi_ZCR_CANFD5_C "" VALUE 0x007209ac Val_Wu8 1 OneToOne 0.0 255.00 FORMAT "%8.2" /end CHARACTERISTIC
/begin CHARACTERISTIC Tlib_WinCurtReqAtReRiWinOpenReqAtDrvr_ZCR_CANFD5_C "" VALUE 0x007209ad Val_Wu8 1 OneToOne 0.0 255.00 FORMAT "%8.2" /end CHARACTERISTIC
/begin CHARACTERISTIC Tlib_WinCurtReqAtReRiWMRTrgSrc_ZCR_CANFD5_C "" VALUE 0x007209ae Val_Wu8 1 OneToOne 0.0 255.00 FORMAT "%8.2" /end CHARACTERISTIC
/begin CHARACTERISTIC Tlib_CinhDrvrSwtHi_ZCR_CANFD5_C "" VALUE 0x007209af Val_Wu8 1 OneToOne 0.0 255.00 FORMAT "%8.2" /end CHARACTERISTIC
/begin CHARACTERISTIC Tlib_OpenDrvrSwtHi_ZCR_CANFD5_C "" VALUE 0x007209b0 Val_Wu8 1 OneToOne 0.0 255.00 FORMAT "%8.2" /end CHARACTERISTIC
/begin CHARACTERISTIC Tlib_SteerWhlSnsrAg_ZCR_CANFD5_C "" VALUE 0x00720526 Val_WS16 1 OneToOne -32768 32767 FORMAT "%8.2" /end CHARACTERISTIC
/begin CHARACTERISTIC Tlib_SteerWhlSnsrAgSpd_ZCR_CANFD5_C "" VALUE 0x00720528 Val_WS16 1 OneToOne -32768 32767 FORMAT "%8.2" /end CHARACTERISTIC
/begin CHARACTERISTIC Tlib_SteerWhlSnsrChks8_ZCR_CANFD5_C "" VALUE 0x007209b1 Val_Wu8 1 OneToOne 0.0 255.00 FORMAT "%8.2" /end CHARACTERISTIC
/begin CHARACTERISTIC Tlib_SteerWhlSnsrCntr4_ZCR_CANFD5_C "" VALUE 0x007209b2 Val_Wu8 1 OneToOne 0.0 255.00 FORMAT "%8.2" /end CHARACTERISTIC
/begin CHARACTERISTIC Tlib_SteerWhlSnsrQf_ZCR_CANFD5_C "" VALUE 0x007209b3 Val_Wu8 1 OneToOne 0.0 255.00 FORMAT "%8.2" /end CHARACTERISTIC
/begin CHARACTERISTIC Tlib_SteerWhlSnsrDataID4_ZCR_CANFD5_C "" VALUE 0x007209b4 Val_Wu8 1 OneToOne 0.0 255.00 FORMAT "%8.2" /end CHARACTERISTIC
/begin CHARACTERISTIC Tlib_RainfallAmnt_ZCR_CANFD5_C "" VALUE 0x007209b5 Val_Wu8 1 OneToOne 0.0 255.00 FORMAT "%8.2" /end CHARACTERISTIC
/begin CHARACTERISTIC Tlib_CinhLeReSwtHi_ZCR_CANFD5_C "" VALUE 0x007209b6 Val_Wu8 1 OneToOne 0.0 255.00 FORMAT "%8.2" /end CHARACTERISTIC
/begin CHARACTERISTIC Tlib_SuspPosnVertLeChks8_ZCR_CANFD5_C "" VALUE 0x007209b7 Val_Wu8 1 OneToOne 0.0 255.00 FORMAT "%8.2" /end CHARACTERISTIC
/begin CHARACTERISTIC Tlib_SuspPosnVertLeCntr4_ZCR_CANFD5_C "" VALUE 0x007209b8 Val_Wu8 1 OneToOne 0.0 255.00 FORMAT "%8.2" /end CHARACTERISTIC
/begin CHARACTERISTIC Tlib_SuspPosnVertLeReQf_ZCR_CANFD5_C "" VALUE 0x007209b9 Val_Wu8 1 OneToOne 0.0 255.00 FORMAT "%8.2" /end CHARACTERISTIC
/begin CHARACTERISTIC Tlib_SuspPosnVertLeFrntQf_ZCR_CANFD5_C "" VALUE 0x007209ba Val_Wu8 1 OneToOne 0.0 255.00 FORMAT "%8.2" /end CHARACTERISTIC
/begin CHARACTERISTIC Tlib_SuspPosnVertLeDataID4_ZCR_CANFD5_C "" VALUE 0x007209bb Val_Wu8 1 OneToOne 0.0 255.00 FORMAT "%8.2" /end CHARACTERISTIC
/begin CHARACTERISTIC Tlib_SuspPosnVertLeFrnt_ZCR_CANFD5_C "" VALUE 0x0072052a Val_WS16 1 OneToOne -32768 32767 FORMAT "%8.2" /end CHARACTERISTIC
/begin CHARACTERISTIC Tlib_SuspPosnVertLeRe_ZCR_CANFD5_C "" VALUE 0x0072052c Val_WS16 1 OneToOne -32768 32767 FORMAT "%8.2" /end CHARACTERISTIC
/begin CHARACTERISTIC Tlib_ObstStrDetcnLeRe2_ZCR_CANFD5_C "" VALUE 0x007209bc Val_Wu8 1 OneToOne 0.0 255.00 FORMAT "%8.2" /end CHARACTERISTIC
/begin CHARACTERISTIC Tlib_ObstStrDetcnDrvr2_ZCR_CANFD5_C "" VALUE 0x007209bd Val_Wu8 1 OneToOne 0.0 255.00 FORMAT "%8.2" /end CHARACTERISTIC
/begin CHARACTERISTIC Tlib_DoorPassCrashUnlockCmd_ZCR_CANFD5_C "" VALUE 0x007209be Val_Wu8 1 OneToOne 0.0 255.00 FORMAT "%8.2" /end CHARACTERISTIC
/begin CHARACTERISTIC Tlib_DoorRiReCrashUnlockCmd_ZCR_CANFD5_C "" VALUE 0x007209bf Val_Wu8 1 OneToOne 0.0 255.00 FORMAT "%8.2" /end CHARACTERISTIC
/begin CHARACTERISTIC Tlib_FltOfIndcrTurnOnPassSide_ZCR_CANFD5_C "" VALUE 0x007209c0 Val_Wu8 1 OneToOne 0.0 255.00 FORMAT "%8.2" /end CHARACTERISTIC
/begin CHARACTERISTIC Tlib_HvSysRlyStsRly_ZCR_CANFD5_C "" VALUE 0x007209c1 Val_Wu8 1 OneToOne 0.0 255.00 FORMAT "%8.2" /end CHARACTERISTIC
/begin CHARACTERISTIC Tlib_HvSysRlyStsChks8_ZCR_CANFD5_C "" VALUE 0x007209c2 Val_Wu8 1 OneToOne 0.0 255.00 FORMAT "%8.2" /end CHARACTERISTIC
/begin CHARACTERISTIC Tlib_HvSysRlyStsCntr4_ZCR_CANFD5_C "" VALUE 0x007209c3 Val_Wu8 1 OneToOne 0.0 255.00 FORMAT "%8.2" /end CHARACTERISTIC
/begin CHARACTERISTIC Tlib_HvSysRlyStsDataID4_ZCR_CANFD5_C "" VALUE 0x007209c4 Val_Wu8 1 OneToOne 0.0 255.00 FORMAT "%8.2" /end CHARACTERISTIC
/begin CHARACTERISTIC Tlib_GearLvrIndcn2_ZCR_CANFD5_C "" VALUE 0x007209c5 Val_Wu8 1 OneToOne 0.0 255.00 FORMAT "%8.2" /end CHARACTERISTIC
/begin CHARACTERISTIC Tlib_GearLvrIndcnCntr4_ZCR_CANFD5_C "" VALUE 0x007209c6 Val_Wu8 1 OneToOne 0.0 255.00 FORMAT "%8.2" /end CHARACTERISTIC
/begin CHARACTERISTIC Tlib_GearLvrIndcnChks8_ZCR_CANFD5_C "" VALUE 0x007209c7 Val_Wu8 1 OneToOne 0.0 255.00 FORMAT "%8.2" /end CHARACTERISTIC
/begin CHARACTERISTIC Tlib_GearLvrIndcnDataID4_ZCR_CANFD5_C "" VALUE 0x007209c8 Val_Wu8 1 OneToOne 0.0 255.00 FORMAT "%8.2" /end CHARACTERISTIC
/begin CHARACTERISTIC Tlib_VehLVSysUZCLVehLVSysUBkp_ZCR_CANFD5_C "" VALUE 0x007209c9 Val_Wu8 1 OneToOne 0.0 255.00 FORMAT "%8.2" /end CHARACTERISTIC
/begin CHARACTERISTIC Tlib_VehLVSysUZCLVehLVSysUMai_ZCR_CANFD5_C "" VALUE 0x007209ca Val_Wu8 1 OneToOne 0.0 255.00 FORMAT "%8.2" /end CHARACTERISTIC
/begin CHARACTERISTIC Tlib_isHfa10AvlSts_VLAN204ControLow_C "" VALUE 0x007209cb Val_Wu8 1 OneToOne 0.0 255.00 FORMAT "%8.2" /end CHARACTERISTIC
/begin CHARACTERISTIC Tlib_isHfaMotTargtPson_0_VLAN204ControLow_C "" VALUE 0x0072052e Val_Wu16 1 OneToOne 0.0 65535 FORMAT "%8.2" /end CHARACTERISTIC
/begin CHARACTERISTIC Tlib_isHfa2AvlSts_VLAN204ControLow_C "" VALUE 0x007209cc Val_Wu8 1 OneToOne 0.0 255.00 FORMAT "%8.2" /end CHARACTERISTIC
/begin CHARACTERISTIC Tlib_isHfaMotMode_0_VLAN204ControLow_C "" VALUE 0x007209cd Val_Wu8 1 OneToOne 0.0 255.00 FORMAT "%8.2" /end CHARACTERISTIC
/begin CHARACTERISTIC Tlib_isGrlTrqBoostReq_VLAN204ControLow_C "" VALUE 0x007209ce Val_Wu8 1 OneToOne 0.0 255.00 FORMAT "%8.2" /end CHARACTERISTIC
/begin CHARACTERISTIC Tlib_isHfaMotSaveData_0_VLAN204ControLow_C "" VALUE 0x007209cf Val_Wu8 1 OneToOne 0.0 255.00 FORMAT "%8.2" /end CHARACTERISTIC
/begin CHARACTERISTIC Tlib_isHfa7AvlSts_VLAN204ControLow_C "" VALUE 0x007209d0 Val_Wu8 1 OneToOne 0.0 255.00 FORMAT "%8.2" /end CHARACTERISTIC
/begin CHARACTERISTIC Tlib_isHfaMotCoilPwrOn_0_VLAN204ControLow_C "" VALUE 0x007209d1 Val_Wu8 1 OneToOne 0.0 255.00 FORMAT "%8.2" /end CHARACTERISTIC
/begin CHARACTERISTIC Tlib_isHfa11ActrPosn_VLAN204ControLow_C "" VALUE 0x00720530 Val_Wu16 1 OneToOne 0.0 65535 FORMAT "%8.2" /end CHARACTERISTIC
/begin CHARACTERISTIC Tlib_isHfa5ActrPosn_VLAN204ControLow_C "" VALUE 0x00720532 Val_Wu16 1 OneToOne 0.0 65535 FORMAT "%8.2" /end CHARACTERISTIC
/begin CHARACTERISTIC Tlib_isSecRowRiFootTAmbTEstimdQf_VLAN204ControLow_C "" VALUE 0x007209d2 Val_Wu8 1 OneToOne 0.0 255.00 FORMAT "%8.2" /end CHARACTERISTIC
/begin CHARACTERISTIC Tlib_isSecRowRiFootTAmbTEstimd_VLAN204ControLow_C "" VALUE 0x00720534 Val_Wu16 1 OneToOne 0.0 65535 FORMAT "%8.2" /end CHARACTERISTIC
/begin CHARACTERISTIC Tlib_isGrlShttrDmdShttrPosnReq_VLAN204ControLow_C "" VALUE 0x007209d3 Val_Wu8 1 OneToOne 0.0 255.00 FORMAT "%8.2" /end CHARACTERISTIC
/begin CHARACTERISTIC Tlib_isGrlShttrDmdShttrCalEna_VLAN204ControLow_C "" VALUE 0x007209d4 Val_Wu8 1 OneToOne 0.0 255.00 FORMAT "%8.2" /end CHARACTERISTIC
/begin CHARACTERISTIC Tlib_isHfaf1ActrPosn_VLAN204ControLow_C "" VALUE 0x00720536 Val_Wu16 1 OneToOne 0.0 65535 FORMAT "%8.2" /end CHARACTERISTIC
/begin CHARACTERISTIC Tlib_isHfa14AvlSts_VLAN204ControLow_C "" VALUE 0x007209d5 Val_Wu8 1 OneToOne 0.0 255.00 FORMAT "%8.2" /end CHARACTERISTIC
/begin CHARACTERISTIC Tlib_isHfaf2AvlSts_VLAN204ControLow_C "" VALUE 0x007209d6 Val_Wu8 1 OneToOne 0.0 255.00 FORMAT "%8.2" /end CHARACTERISTIC
/begin CHARACTERISTIC Tlib_isHfa3ActrPosn_VLAN204ControLow_C "" VALUE 0x00720538 Val_Wu16 1 OneToOne 0.0 65535 FORMAT "%8.2" /end CHARACTERISTIC
/begin CHARACTERISTIC Tlib_isSecRowBRiVentTAmbTEstimdQf_VLAN204ControLow_C "" VALUE 0x007209d7 Val_Wu8 1 OneToOne 0.0 255.00 FORMAT "%8.2" /end CHARACTERISTIC
/begin CHARACTERISTIC Tlib_isSecRowBRiVentTAmbTEstimd_VLAN204ControLow_C "" VALUE 0x0072053a Val_Wu16 1 OneToOne 0.0 65535 FORMAT "%8.2" /end CHARACTERISTIC
/begin CHARACTERISTIC Tlib_isHfa1AvlSts_VLAN204ControLow_C "" VALUE 0x007209d8 Val_Wu8 1 OneToOne 0.0 255.00 FORMAT "%8.2" /end CHARACTERISTIC
/begin CHARACTERISTIC Tlib_isGrlAutoCalibReq_VLAN204ControLow_C "" VALUE 0x007209d9 Val_Wu8 1 OneToOne 0.0 255.00 FORMAT "%8.2" /end CHARACTERISTIC
/begin CHARACTERISTIC Tlib_isHexTFrntAmbTEstimdQf_VLAN204ControLow_C "" VALUE 0x007209da Val_Wu8 1 OneToOne 0.0 255.00 FORMAT "%8.2" /end CHARACTERISTIC
/begin CHARACTERISTIC Tlib_isHexTFrntAmbTEstimd_VLAN204ControLow_C "" VALUE 0x0072053c Val_Wu16 1 OneToOne 0.0 65535 FORMAT "%8.2" /end CHARACTERISTIC
/begin CHARACTERISTIC Tlib_isHfaMotUrgcUnlck_0_VLAN204ControLow_C "" VALUE 0x007209db Val_Wu8 1 OneToOne 0.0 255.00 FORMAT "%8.2" /end CHARACTERISTIC
/begin CHARACTERISTIC Tlib_isHfaf3AvlSts_VLAN204ControLow_C "" VALUE 0x007209dc Val_Wu8 1 OneToOne 0.0 255.00 FORMAT "%8.2" /end CHARACTERISTIC
/begin CHARACTERISTIC Tlib_isHfaMotDir_0_VLAN204ControLow_C "" VALUE 0x007209dd Val_Wu8 1 OneToOne 0.0 255.00 FORMAT "%8.2" /end CHARACTERISTIC
/begin CHARACTERISTIC Tlib_isHfa11AvlSts_VLAN204ControLow_C "" VALUE 0x007209de Val_Wu8 1 OneToOne 0.0 255.00 FORMAT "%8.2" /end CHARACTERISTIC
/begin CHARACTERISTIC Tlib_isHfaf3ActrPosn_VLAN204ControLow_C "" VALUE 0x0072053e Val_Wu16 1 OneToOne 0.0 65535 FORMAT "%8.2" /end CHARACTERISTIC
/begin CHARACTERISTIC Tlib_isEmotorCooltTOutlet_VLAN204ControLow_C "" VALUE 0x00720540 Val_Wu16 1 OneToOne 0.0 65535 FORMAT "%8.2" /end CHARACTERISTIC
/begin CHARACTERISTIC Tlib_isHfaf4AvlSts_VLAN204ControLow_C "" VALUE 0x007209df Val_Wu8 1 OneToOne 0.0 255.00 FORMAT "%8.2" /end CHARACTERISTIC
/begin CHARACTERISTIC Tlib_isHfaf4ActrPosn_VLAN204ControLow_C "" VALUE 0x00720542 Val_Wu16 1 OneToOne 0.0 65535 FORMAT "%8.2" /end CHARACTERISTIC
/begin CHARACTERISTIC Tlib_isSecRowRiVentTAmbTEstimdQf_VLAN204ControLow_C "" VALUE 0x007209e0 Val_Wu8 1 OneToOne 0.0 255.00 FORMAT "%8.2" /end CHARACTERISTIC
/begin CHARACTERISTIC Tlib_isSecRowRiVentTAmbTEstimd_VLAN204ControLow_C "" VALUE 0x00720544 Val_Wu16 1 OneToOne 0.0 65535 FORMAT "%8.2" /end CHARACTERISTIC
/begin CHARACTERISTIC Tlib_isHfa6AvlSts_VLAN204ControLow_C "" VALUE 0x007209e1 Val_Wu8 1 OneToOne 0.0 255.00 FORMAT "%8.2" /end CHARACTERISTIC
/begin CHARACTERISTIC Tlib_isHfaMotStrtPson_0_VLAN204ControLow_C "" VALUE 0x00720546 Val_Wu16 1 OneToOne 0.0 65535 FORMAT "%8.2" /end CHARACTERISTIC
/begin CHARACTERISTIC Tlib_isHfa13ActrPosn_VLAN204ControLow_C "" VALUE 0x00720548 Val_Wu16 1 OneToOne 0.0 65535 FORMAT "%8.2" /end CHARACTERISTIC
/begin CHARACTERISTIC Tlib_isFirstRowRiFootTAmbTEstimdQf_VLAN204ControLow_C "" VALUE 0x007209e2 Val_Wu8 1 OneToOne 0.0 255.00 FORMAT "%8.2" /end CHARACTERISTIC
/begin CHARACTERISTIC Tlib_isFirstRowRiFootTAmbTEstimd_VLAN204ControLow_C "" VALUE 0x0072054a Val_Wu16 1 OneToOne 0.0 65535 FORMAT "%8.2" /end CHARACTERISTIC
/begin CHARACTERISTIC Tlib_isHfaMotUrgcPson_0_VLAN204ControLow_C "" VALUE 0x007209e3 Val_Wu8 1 OneToOne 0.0 255.00 FORMAT "%8.2" /end CHARACTERISTIC
/begin CHARACTERISTIC Tlib_isFltOfBeamHiRi_VLAN204ControLow_C "" VALUE 0x007209e4 Val_Wu8 1 OneToOne 0.0 255.00 FORMAT "%8.2" /end CHARACTERISTIC
/begin CHARACTERISTIC Tlib_isFltOfBeamLoRi_VLAN204ControLow_C "" VALUE 0x007209e5 Val_Wu8 1 OneToOne 0.0 255.00 FORMAT "%8.2" /end CHARACTERISTIC
/begin CHARACTERISTIC Tlib_isEvapTFrntAmbTEstimdQf_VLAN204ControLow_C "" VALUE 0x007209e6 Val_Wu8 1 OneToOne 0.0 255.00 FORMAT "%8.2" /end CHARACTERISTIC
/begin CHARACTERISTIC Tlib_isEvapTFrntAmbTEstimd_VLAN204ControLow_C "" VALUE 0x0072054c Val_Wu16 1 OneToOne 0.0 65535 FORMAT "%8.2" /end CHARACTERISTIC
/begin CHARACTERISTIC Tlib_isHfaf6ActrPosn_VLAN204ControLow_C "" VALUE 0x0072054e Val_Wu16 1 OneToOne 0.0 65535 FORMAT "%8.2" /end CHARACTERISTIC
/begin CHARACTERISTIC Tlib_isHfar2ActrPosn_VLAN204ControLow_C "" VALUE 0x00720550 Val_Wu16 1 OneToOne 0.0 65535 FORMAT "%8.2" /end CHARACTERISTIC
/begin CHARACTERISTIC Tlib_isHfaMotBlockCmd_0_VLAN204ControLow_C "" VALUE 0x007209e7 Val_Wu8 1 OneToOne 0.0 255.00 FORMAT "%8.2" /end CHARACTERISTIC
/begin CHARACTERISTIC Tlib_isHfa4ActrPosn_VLAN204ControLow_C "" VALUE 0x00720552 Val_Wu16 1 OneToOne 0.0 65535 FORMAT "%8.2" /end CHARACTERISTIC
/begin CHARACTERISTIC Tlib_isHfaf2ActrPosn_VLAN204ControLow_C "" VALUE 0x00720554 Val_Wu16 1 OneToOne 0.0 65535 FORMAT "%8.2" /end CHARACTERISTIC
/begin CHARACTERISTIC Tlib_isHfa9ActrPosn_VLAN204ControLow_C "" VALUE 0x00720556 Val_Wu16 1 OneToOne 0.0 65535 FORMAT "%8.2" /end CHARACTERISTIC
/begin CHARACTERISTIC Tlib_isHfa13AvlSts_VLAN204ControLow_C "" VALUE 0x007209e8 Val_Wu8 1 OneToOne 0.0 255.00 FORMAT "%8.2" /end CHARACTERISTIC
/begin CHARACTERISTIC Tlib_isHfa9AvlSts_VLAN204ControLow_C "" VALUE 0x007209e9 Val_Wu8 1 OneToOne 0.0 255.00 FORMAT "%8.2" /end CHARACTERISTIC
/begin CHARACTERISTIC Tlib_isHfaMotClearReq_0_VLAN204ControLow_C "" VALUE 0x007209ea Val_Wu8 1 OneToOne 0.0 255.00 FORMAT "%8.2" /end CHARACTERISTIC
/begin CHARACTERISTIC Tlib_isHfa2ActrPosn_VLAN204ControLow_C "" VALUE 0x00720558 Val_Wu16 1 OneToOne 0.0 65535 FORMAT "%8.2" /end CHARACTERISTIC
/begin CHARACTERISTIC Tlib_isHfaf1AvlSts_VLAN204ControLow_C "" VALUE 0x007209eb Val_Wu8 1 OneToOne 0.0 255.00 FORMAT "%8.2" /end CHARACTERISTIC
/begin CHARACTERISTIC Tlib_isHfa8ActrPosn_VLAN204ControLow_C "" VALUE 0x0072055a Val_Wu16 1 OneToOne 0.0 65535 FORMAT "%8.2" /end CHARACTERISTIC
/begin CHARACTERISTIC Tlib_isHfa5AvlSts_VLAN204ControLow_C "" VALUE 0x007209ec Val_Wu8 1 OneToOne 0.0 255.00 FORMAT "%8.2" /end CHARACTERISTIC
/begin CHARACTERISTIC Tlib_isHfa4AvlSts_VLAN204ControLow_C "" VALUE 0x007209ed Val_Wu8 1 OneToOne 0.0 255.00 FORMAT "%8.2" /end CHARACTERISTIC
/begin CHARACTERISTIC Tlib_isHfa3AvlSts_VLAN204ControLow_C "" VALUE 0x007209ee Val_Wu8 1 OneToOne 0.0 255.00 FORMAT "%8.2" /end CHARACTERISTIC
/begin CHARACTERISTIC Tlib_isHfa10ActrPosn_VLAN204ControLow_C "" VALUE 0x0072055c Val_Wu16 1 OneToOne 0.0 65535 FORMAT "%8.2" /end CHARACTERISTIC
/begin CHARACTERISTIC Tlib_isHfa8AvlSts_VLAN204ControLow_C "" VALUE 0x007209ef Val_Wu8 1 OneToOne 0.0 255.00 FORMAT "%8.2" /end CHARACTERISTIC
/begin CHARACTERISTIC Tlib_isHfar1AvlSts_VLAN204ControLow_C "" VALUE 0x007209f0 Val_Wu8 1 OneToOne 0.0 255.00 FORMAT "%8.2" /end CHARACTERISTIC
/begin CHARACTERISTIC Tlib_isHfa12AvlSts_VLAN204ControLow_C "" VALUE 0x007209f1 Val_Wu8 1 OneToOne 0.0 255.00 FORMAT "%8.2" /end CHARACTERISTIC
/begin CHARACTERISTIC Tlib_isHfaMotAdr_0_VLAN204ControLow_C "" VALUE 0x007209f2 Val_Wu8 1 OneToOne 0.0 255.00 FORMAT "%8.2" /end CHARACTERISTIC
/begin CHARACTERISTIC Tlib_isHfaf5AvlSts_VLAN204ControLow_C "" VALUE 0x007209f3 Val_Wu8 1 OneToOne 0.0 255.00 FORMAT "%8.2" /end CHARACTERISTIC
/begin CHARACTERISTIC Tlib_isHfaf5ActrPosn_VLAN204ControLow_C "" VALUE 0x0072055e Val_Wu16 1 OneToOne 0.0 65535 FORMAT "%8.2" /end CHARACTERISTIC
/begin CHARACTERISTIC Tlib_isFirstRowCenRiVentTAmbTEstimd_VLAN204ControLow_C "" VALUE 0x00720560 Val_Wu16 1 OneToOne 0.0 65535 FORMAT "%8.2" /end CHARACTERISTIC
/begin CHARACTERISTIC Tlib_isFirstRowCenRiVentTAmbTEstimdQf_VLAN204ControLow_C "" VALUE 0x007209f4 Val_Wu8 1 OneToOne 0.0 255.00 FORMAT "%8.2" /end CHARACTERISTIC
/begin CHARACTERISTIC Tlib_isHfa12ActrPosn_VLAN204ControLow_C "" VALUE 0x00720562 Val_Wu16 1 OneToOne 0.0 65535 FORMAT "%8.2" /end CHARACTERISTIC
/begin CHARACTERISTIC Tlib_isHfar1ActrPosn_VLAN204ControLow_C "" VALUE 0x00720564 Val_Wu16 1 OneToOne 0.0 65535 FORMAT "%8.2" /end CHARACTERISTIC
/begin CHARACTERISTIC Tlib_isHfa1ActrPosn_VLAN204ControLow_C "" VALUE 0x00720566 Val_Wu16 1 OneToOne 0.0 65535 FORMAT "%8.2" /end CHARACTERISTIC
/begin CHARACTERISTIC Tlib_isHfaf6AvlSts_VLAN204ControLow_C "" VALUE 0x007209f5 Val_Wu8 1 OneToOne 0.0 255.00 FORMAT "%8.2" /end CHARACTERISTIC
/begin CHARACTERISTIC Tlib_isHfa6ActrPosn_VLAN204ControLow_C "" VALUE 0x00720568 Val_Wu16 1 OneToOne 0.0 65535 FORMAT "%8.2" /end CHARACTERISTIC
/begin CHARACTERISTIC Tlib_isFirstRowRiVentTAmbTEstimdQf_VLAN204ControLow_C "" VALUE 0x007209f6 Val_Wu8 1 OneToOne 0.0 255.00 FORMAT "%8.2" /end CHARACTERISTIC
/begin CHARACTERISTIC Tlib_isFirstRowRiVentTAmbTEstimd_VLAN204ControLow_C "" VALUE 0x0072056a Val_Wu16 1 OneToOne 0.0 65535 FORMAT "%8.2" /end CHARACTERISTIC
/begin CHARACTERISTIC Tlib_isHfaMotPsonAvl_0_VLAN204ControLow_C "" VALUE 0x007209f7 Val_Wu8 1 OneToOne 0.0 255.00 FORMAT "%8.2" /end CHARACTERISTIC
/begin CHARACTERISTIC Tlib_isHfaMotSpdSet_0_VLAN204ControLow_C "" VALUE 0x007209f8 Val_Wu8 1 OneToOne 0.0 255.00 FORMAT "%8.2" /end CHARACTERISTIC
/begin CHARACTERISTIC Tlib_isHfa7ActrPosn_VLAN204ControLow_C "" VALUE 0x0072056c Val_Wu16 1 OneToOne 0.0 65535 FORMAT "%8.2" /end CHARACTERISTIC
/begin CHARACTERISTIC Tlib_isHfar2AvlSts_VLAN204ControLow_C "" VALUE 0x007209f9 Val_Wu8 1 OneToOne 0.0 255.00 FORMAT "%8.2" /end CHARACTERISTIC
/begin CHARACTERISTIC Tlib_isHfa14ActrPosn_VLAN204ControLow_C "" VALUE 0x0072056e Val_Wu16 1 OneToOne 0.0 65535 FORMAT "%8.2" /end CHARACTERISTIC
/begin CHARACTERISTIC Tlib_isCmptmtFlowEstimdForRowFirstAtDefrstRi_VLAN204ControLow_C "" VALUE 0x00720570 Val_Wu16 1 OneToOne 0.0 65535 FORMAT "%8.2" /end CHARACTERISTIC
/begin CHARACTERISTIC Tlib_isCmptmtFlowEstimdForHexRe_VLAN204ControLow_C "" VALUE 0x00720572 Val_Wu16 1 OneToOne 0.0 65535 FORMAT "%8.2" /end CHARACTERISTIC
/begin CHARACTERISTIC Tlib_isCmptmtTCmpForFlowForRowSec_VLAN204ControLow_C "" VALUE 0x00720574 Val_Wu16 1 OneToOne 0.0 65535 FORMAT "%8.2" /end CHARACTERISTIC
/begin CHARACTERISTIC Tlib_isFltOfBeamLoLe_VLAN204ControLow_C "" VALUE 0x007209fa Val_Wu8 1 OneToOne 0.0 255.00 FORMAT "%8.2" /end CHARACTERISTIC
/begin CHARACTERISTIC Tlib_isCmptmtFlowEstimdForRowFirstAtDefrstLe_VLAN204ControLow_C "" VALUE 0x00720576 Val_Wu16 1 OneToOne 0.0 65535 FORMAT "%8.2" /end CHARACTERISTIC
/begin CHARACTERISTIC Tlib_isCmptmtExtrMtrlTEstimd_VLAN204ControLow_C "" VALUE 0x00720578 Val_Wu16 1 OneToOne 0.0 65535 FORMAT "%8.2" /end CHARACTERISTIC
/begin CHARACTERISTIC Tlib_isCmptmtFlowEstimdForRowThrdAtFlrLe_VLAN204ControLow_C "" VALUE 0x0072057a Val_Wu16 1 OneToOne 0.0 65535 FORMAT "%8.2" /end CHARACTERISTIC
/begin CHARACTERISTIC Tlib_isHvacTempFlapActlPosnRowThrdRi_VLAN204ControLow_C "" VALUE 0x0072057c Val_Wu16 1 OneToOne 0.0 65535 FORMAT "%8.2" /end CHARACTERISTIC
/begin CHARACTERISTIC Tlib_isReBlwActSpd_VLAN204ControLow_C "" VALUE 0x007209fb Val_Wu8 1 OneToOne 0.0 255.00 FORMAT "%8.2" /end CHARACTERISTIC
/begin CHARACTERISTIC Tlib_isCmptmtTCmpForFlowDistbnAtRowFirst_VLAN204ControLow_C "" VALUE 0x0072057e Val_Wu16 1 OneToOne 0.0 65535 FORMAT "%8.2" /end CHARACTERISTIC
/begin CHARACTERISTIC Tlib_isFanPwmReq_VLAN204ControLow_C "" VALUE 0x00720580 Val_Wu16 1 OneToOne 0.0 65535 FORMAT "%8.2" /end CHARACTERISTIC
/begin CHARACTERISTIC Tlib_isCmptmtFlowEstimdForRowThrdAtVentRi_VLAN204ControLow_C "" VALUE 0x00720582 Val_Wu16 1 OneToOne 0.0 65535 FORMAT "%8.2" /end CHARACTERISTIC
/begin CHARACTERISTIC Tlib_isHvacTempFlapActlPosnRowFirstRi_VLAN204ControLow_C "" VALUE 0x00720584 Val_Wu16 1 OneToOne 0.0 65535 FORMAT "%8.2" /end CHARACTERISTIC
/begin CHARACTERISTIC Tlib_isReBlwAvlSts_VLAN204ControLow_C "" VALUE 0x007209fc Val_Wu8 1 OneToOne 0.0 255.00 FORMAT "%8.2" /end CHARACTERISTIC
/begin CHARACTERISTIC Tlib_isCmptmtTCmpForFlowForRowFirst_VLAN204ControLow_C "" VALUE 0x00720586 Val_Wu16 1 OneToOne 0.0 65535 FORMAT "%8.2" /end CHARACTERISTIC
/begin CHARACTERISTIC Tlib_isCmptmtFlowActForRecirc_VLAN204ControLow_C "" VALUE 0x00720588 Val_Wu16 1 OneToOne 0.0 65535 FORMAT "%8.2" /end CHARACTERISTIC
/begin CHARACTERISTIC Tlib_isCmptmtFlowEstimdForRowSecAtVentRi_VLAN204ControLow_C "" VALUE 0x0072058a Val_Wu16 1 OneToOne 0.0 65535 FORMAT "%8.2" /end CHARACTERISTIC
/begin CHARACTERISTIC Tlib_isCmptmtFlowEstimdTotRe_VLAN204ControLow_C "" VALUE 0x0072058c Val_Wu16 1 OneToOne 0.0 65535 FORMAT "%8.2" /end CHARACTERISTIC
/begin CHARACTERISTIC Tlib_isCmptmtIntrMtrlTEstimd_VLAN204ControLow_C "" VALUE 0x0072058e Val_Wu16 1 OneToOne 0.0 65535 FORMAT "%8.2" /end CHARACTERISTIC
/begin CHARACTERISTIC Tlib_isCmptmtFlowEstimdForRowFirstAtFlrLe_VLAN204ControLow_C "" VALUE 0x00720590 Val_Wu16 1 OneToOne 0.0 65535 FORMAT "%8.2" /end CHARACTERISTIC
/begin CHARACTERISTIC Tlib_isCmptmtFlowReqMaxAvlRe_VLAN204ControLow_C "" VALUE 0x00720592 Val_Wu16 1 OneToOne 0.0 65535 FORMAT "%8.2" /end CHARACTERISTIC
/begin CHARACTERISTIC Tlib_isCmptmtFlowEstimdForRowFirstAtFlrRi_VLAN204ControLow_C "" VALUE 0x00720594 Val_Wu16 1 OneToOne 0.0 65535 FORMAT "%8.2" /end CHARACTERISTIC
/begin CHARACTERISTIC Tlib_isEvaprTFrntEstimd_VLAN204ControLow_C "" VALUE 0x00720596 Val_Wu16 1 OneToOne 0.0 65535 FORMAT "%8.2" /end CHARACTERISTIC
/begin CHARACTERISTIC Tlib_isFltOfBeamHiLe_VLAN204ControLow_C "" VALUE 0x007209fd Val_Wu8 1 OneToOne 0.0 255.00 FORMAT "%8.2" /end CHARACTERISTIC
/begin CHARACTERISTIC Tlib_isCmptmtFlowEstimdForRowSecAtFlrRi_VLAN204ControLow_C "" VALUE 0x00720598 Val_Wu16 1 OneToOne 0.0 65535 FORMAT "%8.2" /end CHARACTERISTIC
/begin CHARACTERISTIC Tlib_isCmptmtFlowEstimdForHexFrnt_VLAN204ControLow_C "" VALUE 0x0072059a Val_Wu16 1 OneToOne 0.0 65535 FORMAT "%8.2" /end CHARACTERISTIC
/begin CHARACTERISTIC Tlib_isHvacRecircAct_VLAN204ControLow_C "" VALUE 0x007209fe Val_Wu8 1 OneToOne 0.0 255.00 FORMAT "%8.2" /end CHARACTERISTIC
/begin CHARACTERISTIC Tlib_isCmptmtSunMtrlTEstimd_VLAN204ControLow_C "" VALUE 0x0072059c Val_Wu16 1 OneToOne 0.0 65535 FORMAT "%8.2" /end CHARACTERISTIC
/begin CHARACTERISTIC Tlib_isCmptmtFlowEstimdForRowFirstAtVentRi_VLAN204ControLow_C "" VALUE 0x0072059e Val_Wu16 1 OneToOne 0.0 65535 FORMAT "%8.2" /end CHARACTERISTIC
/begin CHARACTERISTIC Tlib_isCmptmtFlowEstimdForRowSecAtVentLe_VLAN204ControLow_C "" VALUE 0x007205a0 Val_Wu16 1 OneToOne 0.0 65535 FORMAT "%8.2" /end CHARACTERISTIC
/begin CHARACTERISTIC Tlib_isHvacTempFlapActlPosnRowSecRi_VLAN204ControLow_C "" VALUE 0x007205a2 Val_Wu16 1 OneToOne 0.0 65535 FORMAT "%8.2" /end CHARACTERISTIC
/begin CHARACTERISTIC Tlib_isEvaprTReEstimd_VLAN204ControLow_C "" VALUE 0x007205a4 Val_Wu16 1 OneToOne 0.0 65535 FORMAT "%8.2" /end CHARACTERISTIC
/begin CHARACTERISTIC Tlib_isCmptmtFlowEstimdForRowThrdAtFlrRi_VLAN204ControLow_C "" VALUE 0x007205a6 Val_Wu16 1 OneToOne 0.0 65535 FORMAT "%8.2" /end CHARACTERISTIC
/begin CHARACTERISTIC Tlib_isCmptmtFlowEstimdForRowSecAtFlrLe_VLAN204ControLow_C "" VALUE 0x007205a8 Val_Wu16 1 OneToOne 0.0 65535 FORMAT "%8.2" /end CHARACTERISTIC
/begin CHARACTERISTIC Tlib_isCmptmtFlowEstimdForRowThrdAtVentLe_VLAN204ControLow_C "" VALUE 0x007205aa Val_Wu16 1 OneToOne 0.0 65535 FORMAT "%8.2" /end CHARACTERISTIC
/begin CHARACTERISTIC Tlib_isFrntBlwAvlSts_VLAN204ControLow_C "" VALUE 0x007209ff Val_Wu8 1 OneToOne 0.0 255.00 FORMAT "%8.2" /end CHARACTERISTIC
/begin CHARACTERISTIC Tlib_isCmptmtFlowReqMaxAvlFrnt_VLAN204ControLow_C "" VALUE 0x007205ac Val_Wu16 1 OneToOne 0.0 65535 FORMAT "%8.2" /end CHARACTERISTIC
/begin CHARACTERISTIC Tlib_isHvacTempFlapActlPosnRowSecLe_VLAN204ControLow_C "" VALUE 0x007205ae Val_Wu16 1 OneToOne 0.0 65535 FORMAT "%8.2" /end CHARACTERISTIC
/begin CHARACTERISTIC Tlib_isHvacTempFlapActlPosnRowThrdLe_VLAN204ControLow_C "" VALUE 0x007205b0 Val_Wu16 1 OneToOne 0.0 65535 FORMAT "%8.2" /end CHARACTERISTIC
/begin CHARACTERISTIC Tlib_isFbForCmptmtT_VLAN204ControLow_C "" VALUE 0x007205b2 Val_Wu16 1 OneToOne 0.0 65535 FORMAT "%8.2" /end CHARACTERISTIC
/begin CHARACTERISTIC Tlib_isHvacTempFlapActlPosnRowFirstLe_VLAN204ControLow_C "" VALUE 0x007205b4 Val_Wu16 1 OneToOne 0.0 65535 FORMAT "%8.2" /end CHARACTERISTIC
/begin CHARACTERISTIC Tlib_isCmptmtFlowEstimdTotFrnt_VLAN204ControLow_C "" VALUE 0x007205b6 Val_Wu16 1 OneToOne 0.0 65535 FORMAT "%8.2" /end CHARACTERISTIC
/begin CHARACTERISTIC Tlib_isFrntBlwActSpd_VLAN204ControLow_C "" VALUE 0x00720a00 Val_Wu8 1 OneToOne 0.0 255.00 FORMAT "%8.2" /end CHARACTERISTIC
/begin CHARACTERISTIC Tlib_isCmptmtFlowEstimdForRowFirstAtVentLe_VLAN204ControLow_C "" VALUE 0x007205b8 Val_Wu16 1 OneToOne 0.0 65535 FORMAT "%8.2" /end CHARACTERISTIC
/begin CHARACTERISTIC Tlib_isElecAirVentn16ActrPosn_VLAN204ControLow_C "" VALUE 0x007205ba Val_Wu16 1 OneToOne 0.0 65535 FORMAT "%8.2" /end CHARACTERISTIC
/begin CHARACTERISTIC Tlib_isCmptmtTCmpForFlowForRowThrd_VLAN204ControLow_C "" VALUE 0x007205bc Val_Wu16 1 OneToOne 0.0 65535 FORMAT "%8.2" /end CHARACTERISTIC
/begin CHARACTERISTIC Tlib_isElecAirVentn18ActrPosn_VLAN204ControLow_C "" VALUE 0x007205be Val_Wu16 1 OneToOne 0.0 65535 FORMAT "%8.2" /end CHARACTERISTIC
/begin CHARACTERISTIC Tlib_isElecAirVentn19ActrPosn_VLAN204ControLow_C "" VALUE 0x007205c0 Val_Wu16 1 OneToOne 0.0 65535 FORMAT "%8.2" /end CHARACTERISTIC
/begin CHARACTERISTIC Tlib_isElecAirVentn17AvlSts_VLAN204ControLow_C "" VALUE 0x00720a01 Val_Wu8 1 OneToOne 0.0 255.00 FORMAT "%8.2" /end CHARACTERISTIC
/begin CHARACTERISTIC Tlib_isElecAirVentn12ActrPosn_VLAN204ControLow_C "" VALUE 0x007205c2 Val_Wu16 1 OneToOne 0.0 65535 FORMAT "%8.2" /end CHARACTERISTIC
/begin CHARACTERISTIC Tlib_isElecAirVentn9AvlSts_VLAN204ControLow_C "" VALUE 0x00720a02 Val_Wu8 1 OneToOne 0.0 255.00 FORMAT "%8.2" /end CHARACTERISTIC
/begin CHARACTERISTIC Tlib_isElecAirVentn15AvlSts_VLAN204ControLow_C "" VALUE 0x00720a03 Val_Wu8 1 OneToOne 0.0 255.00 FORMAT "%8.2" /end CHARACTERISTIC
/begin CHARACTERISTIC Tlib_isCmptmtThrdLeTEstimd_VLAN204ControLow_C "" VALUE 0x007205c4 Val_Wu16 1 OneToOne 0.0 65535 FORMAT "%8.2" /end CHARACTERISTIC
/begin CHARACTERISTIC Tlib_isElecAirVentn14AvlSts_VLAN204ControLow_C "" VALUE 0x00720a04 Val_Wu8 1 OneToOne 0.0 255.00 FORMAT "%8.2" /end CHARACTERISTIC
/begin CHARACTERISTIC Tlib_isElecAirVentn17ActrPosn_VLAN204ControLow_C "" VALUE 0x007205c6 Val_Wu16 1 OneToOne 0.0 65535 FORMAT "%8.2" /end CHARACTERISTIC
/begin CHARACTERISTIC Tlib_isCmptmtSecLeTEstimd_VLAN204ControLow_C "" VALUE 0x007205c8 Val_Wu16 1 OneToOne 0.0 65535 FORMAT "%8.2" /end CHARACTERISTIC
/begin CHARACTERISTIC Tlib_isElecAirVentn11AvlSts_VLAN204ControLow_C "" VALUE 0x00720a05 Val_Wu8 1 OneToOne 0.0 255.00 FORMAT "%8.2" /end CHARACTERISTIC
/begin CHARACTERISTIC Tlib_isElecAirVentn10AvlSts_VLAN204ControLow_C "" VALUE 0x00720a06 Val_Wu8 1 OneToOne 0.0 255.00 FORMAT "%8.2" /end CHARACTERISTIC
/begin CHARACTERISTIC Tlib_isElecAirVentn12AvlSts_VLAN204ControLow_C "" VALUE 0x00720a07 Val_Wu8 1 OneToOne 0.0 255.00 FORMAT "%8.2" /end CHARACTERISTIC
/begin CHARACTERISTIC Tlib_isElecAirVentn20AvlSts_VLAN204ControLow_C "" VALUE 0x00720a08 Val_Wu8 1 OneToOne 0.0 255.00 FORMAT "%8.2" /end CHARACTERISTIC
/begin CHARACTERISTIC Tlib_isCmptmtThrdRiTEstimd_VLAN204ControLow_C "" VALUE 0x007205ca Val_Wu16 1 OneToOne 0.0 65535 FORMAT "%8.2" /end CHARACTERISTIC
/begin CHARACTERISTIC Tlib_isCmptmtFirstRiTEstimd_VLAN204ControLow_C "" VALUE 0x007205cc Val_Wu16 1 OneToOne 0.0 65535 FORMAT "%8.2" /end CHARACTERISTIC
/begin CHARACTERISTIC Tlib_isElecAirVentn18AvlSts_VLAN204ControLow_C "" VALUE 0x00720a09 Val_Wu8 1 OneToOne 0.0 255.00 FORMAT "%8.2" /end CHARACTERISTIC
/begin CHARACTERISTIC Tlib_isElecAirVentn14ActrPosn_VLAN204ControLow_C "" VALUE 0x007205ce Val_Wu16 1 OneToOne 0.0 65535 FORMAT "%8.2" /end CHARACTERISTIC
/begin CHARACTERISTIC Tlib_isCmptmtSecRiTEstimd_VLAN204ControLow_C "" VALUE 0x007205d0 Val_Wu16 1 OneToOne 0.0 65535 FORMAT "%8.2" /end CHARACTERISTIC
/begin CHARACTERISTIC Tlib_isElecAirVentn19AvlSts_VLAN204ControLow_C "" VALUE 0x00720a0a Val_Wu8 1 OneToOne 0.0 255.00 FORMAT "%8.2" /end CHARACTERISTIC
/begin CHARACTERISTIC Tlib_isElecAirVentn13ActrPosn_VLAN204ControLow_C "" VALUE 0x007205d2 Val_Wu16 1 OneToOne 0.0 65535 FORMAT "%8.2" /end CHARACTERISTIC
/begin CHARACTERISTIC Tlib_isElecAirVentn10ActrPosn_VLAN204ControLow_C "" VALUE 0x007205d4 Val_Wu16 1 OneToOne 0.0 65535 FORMAT "%8.2" /end CHARACTERISTIC
/begin CHARACTERISTIC Tlib_isElecAirVentn16AvlSts_VLAN204ControLow_C "" VALUE 0x00720a0b Val_Wu8 1 OneToOne 0.0 255.00 FORMAT "%8.2" /end CHARACTERISTIC
/begin CHARACTERISTIC Tlib_isElecAirVentn9ActrPosn_VLAN204ControLow_C "" VALUE 0x007205d6 Val_Wu16 1 OneToOne 0.0 65535 FORMAT "%8.2" /end CHARACTERISTIC
/begin CHARACTERISTIC Tlib_isElecAirVentn13AvlSts_VLAN204ControLow_C "" VALUE 0x00720a0c Val_Wu8 1 OneToOne 0.0 255.00 FORMAT "%8.2" /end CHARACTERISTIC
/begin CHARACTERISTIC Tlib_isElecAirVentn20ActrPosn_VLAN204ControLow_C "" VALUE 0x007205d8 Val_Wu16 1 OneToOne 0.0 65535 FORMAT "%8.2" /end CHARACTERISTIC
/begin CHARACTERISTIC Tlib_isElecAirVentn11ActrPosn_VLAN204ControLow_C "" VALUE 0x007205da Val_Wu16 1 OneToOne 0.0 65535 FORMAT "%8.2" /end CHARACTERISTIC
/begin CHARACTERISTIC Tlib_isCmptmtFirstLeTEstimd_VLAN204ControLow_C "" VALUE 0x007205dc Val_Wu16 1 OneToOne 0.0 65535 FORMAT "%8.2" /end CHARACTERISTIC
/begin CHARACTERISTIC Tlib_isElecAirVentn15ActrPosn_VLAN204ControLow_C "" VALUE 0x007205de Val_Wu16 1 OneToOne 0.0 65535 FORMAT "%8.2" /end CHARACTERISTIC
/begin CHARACTERISTIC Tlib_isDfalActrPosn_VLAN204ControLow_C "" VALUE 0x00720a0d Val_Wu8 1 OneToOne 0.0 255.00 FORMAT "%8.2" /end CHARACTERISTIC
/begin CHARACTERISTIC Tlib_isDfarAvlSts_VLAN204ControLow_C "" VALUE 0x00720a0e Val_Wu8 1 OneToOne 0.0 255.00 FORMAT "%8.2" /end CHARACTERISTIC
/begin CHARACTERISTIC Tlib_isFirstRowCenLeVentTAmbTEstimdQf_VLAN204ControLow_C "" VALUE 0x00720a0f Val_Wu8 1 OneToOne 0.0 255.00 FORMAT "%8.2" /end CHARACTERISTIC
/begin CHARACTERISTIC Tlib_isFirstRowCenLeVentTAmbTEstimd_VLAN204ControLow_C "" VALUE 0x007205e0 Val_Wu16 1 OneToOne 0.0 65535 FORMAT "%8.2" /end CHARACTERISTIC
/begin CHARACTERISTIC Tlib_isDfalAvlSts_VLAN204ControLow_C "" VALUE 0x00720a10 Val_Wu8 1 OneToOne 0.0 255.00 FORMAT "%8.2" /end CHARACTERISTIC
/begin CHARACTERISTIC Tlib_isLiftAudSpkrSrvReq_VLAN204ControLow_C "" VALUE 0x00720a11 Val_Wu8 1 OneToOne 0.0 255.00 FORMAT "%8.2" /end CHARACTERISTIC
/begin CHARACTERISTIC Tlib_isFirstRowLeVentTAmbTEstimdQf_VLAN204ControLow_C "" VALUE 0x00720a12 Val_Wu8 1 OneToOne 0.0 255.00 FORMAT "%8.2" /end CHARACTERISTIC
/begin CHARACTERISTIC Tlib_isFirstRowLeVentTAmbTEstimd_VLAN204ControLow_C "" VALUE 0x007205e2 Val_Wu16 1 OneToOne 0.0 65535 FORMAT "%8.2" /end CHARACTERISTIC
/begin CHARACTERISTIC Tlib_isCNSLSldSrvReq_VLAN204ControLow_C "" VALUE 0x00720a13 Val_Wu8 1 OneToOne 0.0 255.00 FORMAT "%8.2" /end CHARACTERISTIC
/begin CHARACTERISTIC Tlib_isCmptmtTFrntAmbTEstimd_VLAN204ControLow_C "" VALUE 0x007205e4 Val_Wu16 1 OneToOne 0.0 65535 FORMAT "%8.2" /end CHARACTERISTIC
/begin CHARACTERISTIC Tlib_isCmptmtTFrntAmbTEstimdQf_VLAN204ControLow_C "" VALUE 0x00720a14 Val_Wu8 1 OneToOne 0.0 255.00 FORMAT "%8.2" /end CHARACTERISTIC
/begin CHARACTERISTIC Tlib_isCNSLLiftSrvReq_VLAN204ControLow_C "" VALUE 0x00720a15 Val_Wu8 1 OneToOne 0.0 255.00 FORMAT "%8.2" /end CHARACTERISTIC
/begin CHARACTERISTIC Tlib_isDfarActrPosn_VLAN204ControLow_C "" VALUE 0x00720a16 Val_Wu8 1 OneToOne 0.0 255.00 FORMAT "%8.2" /end CHARACTERISTIC
/begin CHARACTERISTIC Tlib_isLiftAudSpkrPosn_VLAN204ControLow_C "" VALUE 0x00720a17 Val_Wu8 1 OneToOne 0.0 255.00 FORMAT "%8.2" /end CHARACTERISTIC
/begin CHARACTERISTIC Tlib_isFirstRowLeFootTAmbTEstimdQf_VLAN204ControLow_C "" VALUE 0x00720a18 Val_Wu8 1 OneToOne 0.0 255.00 FORMAT "%8.2" /end CHARACTERISTIC
/begin CHARACTERISTIC Tlib_isFirstRowLeFootTAmbTEstimd_VLAN204ControLow_C "" VALUE 0x007205e6 Val_Wu16 1 OneToOne 0.0 65535 FORMAT "%8.2" /end CHARACTERISTIC
/begin CHARACTERISTIC Tlib_isVTMOnOffSts_VLAN204ControLow_C "" VALUE 0x00720a19 Val_Wu8 1 OneToOne 0.0 255.00 FORMAT "%8.2" /end CHARACTERISTIC
/begin CHARACTERISTIC Tlib_isVTMErrSts_VLAN204ControLow_C "" VALUE 0x00720a1a Val_Wu8 1 OneToOne 0.0 255.00 FORMAT "%8.2" /end CHARACTERISTIC
/begin CHARACTERISTIC Tlib_isVTMTSnsrQF_VLAN204ControLow_C "" VALUE 0x00720a1b Val_Wu8 1 OneToOne 0.0 255.00 FORMAT "%8.2" /end CHARACTERISTIC
/begin CHARACTERISTIC Tlib_isVTMTSnsrVal_VLAN204ControLow_C "" VALUE 0x00720a1c Val_Wu8 1 OneToOne 0.0 255.00 FORMAT "%8.2" /end CHARACTERISTIC
/begin CHARACTERISTIC Tlib_isCNSLPopupReqWarn3_VLAN204ControLow_C "" VALUE 0x00720a1d Val_Wu8 1 OneToOne 0.0 255.00 FORMAT "%8.2" /end CHARACTERISTIC
/begin CHARACTERISTIC Tlib_isCNSLPopupReqWarn0_VLAN204ControLow_C "" VALUE 0x00720a1e Val_Wu8 1 OneToOne 0.0 255.00 FORMAT "%8.2" /end CHARACTERISTIC
/begin CHARACTERISTIC Tlib_isCNSLPopupReqWarn1_VLAN204ControLow_C "" VALUE 0x00720a1f Val_Wu8 1 OneToOne 0.0 255.00 FORMAT "%8.2" /end CHARACTERISTIC
/begin CHARACTERISTIC Tlib_isCNSLPopupReqWarn2_VLAN204ControLow_C "" VALUE 0x00720a20 Val_Wu8 1 OneToOne 0.0 255.00 FORMAT "%8.2" /end CHARACTERISTIC
/begin CHARACTERISTIC Tlib_isVTMDoorOpenSts_VLAN204ControLow_C "" VALUE 0x00720a21 Val_Wu8 1 OneToOne 0.0 255.00 FORMAT "%8.2" /end CHARACTERISTIC
/begin CHARACTERISTIC Tlib_isAmbTEstimdAmbTEstimd_VLAN204ControLow_C "" VALUE 0x007205e8 Val_Wu16 1 OneToOne 0.0 65535 FORMAT "%8.2" /end CHARACTERISTIC
/begin CHARACTERISTIC Tlib_isAmbTEstimdQf_VLAN204ControLow_C "" VALUE 0x00720a22 Val_Wu8 1 OneToOne 0.0 255.00 FORMAT "%8.2" /end CHARACTERISTIC
/begin CHARACTERISTIC Tlib_isAmbienceFunctionSt_VLAN204ControLow_C "" VALUE 0x00720a23 Val_Wu8 1 OneToOne 0.0 255.00 FORMAT "%8.2" /end CHARACTERISTIC
/begin CHARACTERISTIC Tlib_isVentnMotPsonAvlZCR_VLAN204ControLow_C "" VALUE 0x00720a24 Val_Wu8 1 OneToOne 0.0 255.00 FORMAT "%8.2" /end CHARACTERISTIC
/begin CHARACTERISTIC Tlib_isVentnMotSpdSetZCR_VLAN204ControLow_C "" VALUE 0x00720a25 Val_Wu8 1 OneToOne 0.0 255.00 FORMAT "%8.2" /end CHARACTERISTIC
/begin CHARACTERISTIC Tlib_isSeatVentnFanErrBackSecRi_VLAN204ControLow_C "" VALUE 0x00720a26 Val_Wu8 1 OneToOne 0.0 255.00 FORMAT "%8.2" /end CHARACTERISTIC
/begin CHARACTERISTIC Tlib_isSeatHeatgCptErrBackFirstRi_VLAN204ControLow_C "" VALUE 0x00720a27 Val_Wu8 1 OneToOne 0.0 255.00 FORMAT "%8.2" /end CHARACTERISTIC
/begin CHARACTERISTIC Tlib_isSeatHeatgCptErrBackSecRi_VLAN204ControLow_C "" VALUE 0x00720a28 Val_Wu8 1 OneToOne 0.0 255.00 FORMAT "%8.2" /end CHARACTERISTIC
/begin CHARACTERISTIC Tlib_isSeatVentnLvlCushFirstRi_VLAN204ControLow_C "" VALUE 0x00720a29 Val_Wu8 1 OneToOne 0.0 255.00 FORMAT "%8.2" /end CHARACTERISTIC
/begin CHARACTERISTIC Tlib_isVentnMotCoilPwrOnZCR_VLAN204ControLow_C "" VALUE 0x00720a2a Val_Wu8 1 OneToOne 0.0 255.00 FORMAT "%8.2" /end CHARACTERISTIC
/begin CHARACTERISTIC Tlib_isSeatVentnFanErrCushFirstRi_VLAN204ControLow_C "" VALUE 0x00720a2b Val_Wu8 1 OneToOne 0.0 255.00 FORMAT "%8.2" /end CHARACTERISTIC
/begin CHARACTERISTIC Tlib_isSeatHeatgCptErrCushFirstRi_VLAN204ControLow_C "" VALUE 0x00720a2c Val_Wu8 1 OneToOne 0.0 255.00 FORMAT "%8.2" /end CHARACTERISTIC
/begin CHARACTERISTIC Tlib_isSeatVentnLvlBackSecRi_VLAN204ControLow_C "" VALUE 0x00720a2d Val_Wu8 1 OneToOne 0.0 255.00 FORMAT "%8.2" /end CHARACTERISTIC
/begin CHARACTERISTIC Tlib_isSeatHeatgLvlBackSecRi_VLAN204ControLow_C "" VALUE 0x00720a2e Val_Wu8 1 OneToOne 0.0 255.00 FORMAT "%8.2" /end CHARACTERISTIC
/begin CHARACTERISTIC Tlib_isVentnMotDirZCR_VLAN204ControLow_C "" VALUE 0x00720a2f Val_Wu8 1 OneToOne 0.0 255.00 FORMAT "%8.2" /end CHARACTERISTIC
/begin CHARACTERISTIC Tlib_isVentnMotAdrZCR_VLAN204ControLow_C "" VALUE 0x00720a30 Val_Wu8 1 OneToOne 0.0 255.00 FORMAT "%8.2" /end CHARACTERISTIC
/begin CHARACTERISTIC Tlib_isVentnMotSaveDataZCR_VLAN204ControLow_C "" VALUE 0x00720a31 Val_Wu8 1 OneToOne 0.0 255.00 FORMAT "%8.2" /end CHARACTERISTIC
/begin CHARACTERISTIC Tlib_isSeatHeatgCptErrCushSecRi_VLAN204ControLow_C "" VALUE 0x00720a32 Val_Wu8 1 OneToOne 0.0 255.00 FORMAT "%8.2" /end CHARACTERISTIC
/begin CHARACTERISTIC Tlib_isVentnMotUrgcPsonZCR_VLAN204ControLow_C "" VALUE 0x00720a33 Val_Wu8 1 OneToOne 0.0 255.00 FORMAT "%8.2" /end CHARACTERISTIC
/begin CHARACTERISTIC Tlib_isSeatHeatgLvlCushFirstRi_VLAN204ControLow_C "" VALUE 0x00720a34 Val_Wu8 1 OneToOne 0.0 255.00 FORMAT "%8.2" /end CHARACTERISTIC
/begin CHARACTERISTIC Tlib_isVentnMotStrtPsonZCR_VLAN204ControLow_C "" VALUE 0x007205ea Val_Wu16 1 OneToOne 0.0 65535 FORMAT "%8.2" /end CHARACTERISTIC
/begin CHARACTERISTIC Tlib_isVentnMotModeZCR_VLAN204ControLow_C "" VALUE 0x00720a35 Val_Wu8 1 OneToOne 0.0 255.00 FORMAT "%8.2" /end CHARACTERISTIC
/begin CHARACTERISTIC Tlib_isVentnMotTargtPsonZCR_VLAN204ControLow_C "" VALUE 0x007205ec Val_Wu16 1 OneToOne 0.0 65535 FORMAT "%8.2" /end CHARACTERISTIC
/begin CHARACTERISTIC Tlib_isSeatVentnLvlCushSecRi_VLAN204ControLow_C "" VALUE 0x00720a36 Val_Wu8 1 OneToOne 0.0 255.00 FORMAT "%8.2" /end CHARACTERISTIC
/begin CHARACTERISTIC Tlib_isVentnMotUrgcUnlckZCR_VLAN204ControLow_C "" VALUE 0x00720a37 Val_Wu8 1 OneToOne 0.0 255.00 FORMAT "%8.2" /end CHARACTERISTIC
/begin CHARACTERISTIC Tlib_isHfa15AvlSts_VLAN204ControLow_C "" VALUE 0x00720a38 Val_Wu8 1 OneToOne 0.0 255.00 FORMAT "%8.2" /end CHARACTERISTIC
/begin CHARACTERISTIC Tlib_isSeatVentnLvlBackFirstRi_VLAN204ControLow_C "" VALUE 0x00720a39 Val_Wu8 1 OneToOne 0.0 255.00 FORMAT "%8.2" /end CHARACTERISTIC
/begin CHARACTERISTIC Tlib_isSeatVentnFanErrBackFirstRi_VLAN204ControLow_C "" VALUE 0x00720a3a Val_Wu8 1 OneToOne 0.0 255.00 FORMAT "%8.2" /end CHARACTERISTIC
/begin CHARACTERISTIC Tlib_isSeatHeatgLvlBackFirstRi_VLAN204ControLow_C "" VALUE 0x00720a3b Val_Wu8 1 OneToOne 0.0 255.00 FORMAT "%8.2" /end CHARACTERISTIC
/begin CHARACTERISTIC Tlib_isSeatVentnFanErrCushSecRi_VLAN204ControLow_C "" VALUE 0x00720a3c Val_Wu8 1 OneToOne 0.0 255.00 FORMAT "%8.2" /end CHARACTERISTIC
/begin CHARACTERISTIC Tlib_isHfa15ActrPosn_VLAN204ControLow_C "" VALUE 0x007205ee Val_Wu16 1 OneToOne 0.0 65535 FORMAT "%8.2" /end CHARACTERISTIC
/begin CHARACTERISTIC Tlib_isVentnMotClearReqZCR_VLAN204ControLow_C "" VALUE 0x00720a3d Val_Wu8 1 OneToOne 0.0 255.00 FORMAT "%8.2" /end CHARACTERISTIC
/begin CHARACTERISTIC Tlib_isSeatHeatgLvlCushSecRi_VLAN204ControLow_C "" VALUE 0x00720a3e Val_Wu8 1 OneToOne 0.0 255.00 FORMAT "%8.2" /end CHARACTERISTIC
/begin CHARACTERISTIC Tlib_isVentnMotBlockCmdZCR_VLAN204ControLow_C "" VALUE 0x00720a3f Val_Wu8 1 OneToOne 0.0 255.00 FORMAT "%8.2" /end CHARACTERISTIC
/begin CHARACTERISTIC Tlib_isResrvdSig1ToCSC_VLAN204ControLow_C "" VALUE 0x007204b8 Val_Wu32 1 OneToOne 0.0 4294967295 FORMAT "%8.2" /end CHARACTERISTIC
/begin CHARACTERISTIC Tlib_isResrvdSig1ToZCL_VLAN204ControLow_C "" VALUE 0x007204bc Val_Wu32 1 OneToOne 0.0 4294967295 FORMAT "%8.2" /end CHARACTERISTIC
/begin CHARACTERISTIC Tlib_isResrvdSig3ToZCL_VLAN204ControLow_C "" VALUE 0x007204c0 Val_Wu32 1 OneToOne 0.0 4294967295 FORMAT "%8.2" /end CHARACTERISTIC
/begin CHARACTERISTIC Tlib_isResrvdSig3ToCSC_VLAN204ControLow_C "" VALUE 0x007204c4 Val_Wu32 1 OneToOne 0.0 4294967295 FORMAT "%8.2" /end CHARACTERISTIC
/begin CHARACTERISTIC Tlib_isResrvdSig2ToCSC_VLAN204ControLow_C "" VALUE 0x007204c8 Val_Wu32 1 OneToOne 0.0 4294967295 FORMAT "%8.2" /end CHARACTERISTIC
/begin CHARACTERISTIC Tlib_isResrvdSig2ToZCL_VLAN204ControLow_C "" VALUE 0x007204cc Val_Wu32 1 OneToOne 0.0 4294967295 FORMAT "%8.2" /end CHARACTERISTIC
/begin CHARACTERISTIC Tlib_isBkpLVBattStsLVBatteryCp_VLAN204ControLow_C "" VALUE 0x00720a40 Val_Wu8 1 OneToOne 0.0 255.00 FORMAT "%8.2" /end CHARACTERISTIC
/begin CHARACTERISTIC Tlib_isBkpLVBattStsLVBatteryU_VLAN204ControLow_C "" VALUE 0x007205f0 Val_Wu16 1 OneToOne 0.0 65535 FORMAT "%8.2" /end CHARACTERISTIC
/begin CHARACTERISTIC Tlib_isBkpLVBattStsLVBatteryI_VLAN204ControLow_C "" VALUE 0x007205f2 Val_Wu16 1 OneToOne 0.0 65535 FORMAT "%8.2" /end CHARACTERISTIC
/begin CHARACTERISTIC Tlib_isBkpLVBattStsLVBatterySOC_VLAN204ControLow_C "" VALUE 0x007205f4 Val_Wu16 1 OneToOne 0.0 65535 FORMAT "%8.2" /end CHARACTERISTIC
/begin CHARACTERISTIC Tlib_isBkpLVBattStsLVBatteryT_VLAN204ControLow_C "" VALUE 0x007205f6 Val_Wu16 1 OneToOne 0.0 65535 FORMAT "%8.2" /end CHARACTERISTIC
/begin CHARACTERISTIC Tlib_isBkpLVBattStsLVBatteryR_VLAN204ControLow_C "" VALUE 0x007205f8 Val_Wu16 1 OneToOne 0.0 65535 FORMAT "%8.2" /end CHARACTERISTIC
/begin CHARACTERISTIC Tlib_isBkpLVBattStsLVBatteryRlySts_VLAN204ControLow_C "" VALUE 0x00720a41 Val_Wu8 1 OneToOne 0.0 255.00 FORMAT "%8.2" /end CHARACTERISTIC
/begin CHARACTERISTIC Tlib_isAirClngErrSts_VLAN204ControLow_C "" VALUE 0x00720a42 Val_Wu8 1 OneToOne 0.0 255.00 FORMAT "%8.2" /end CHARACTERISTIC
/begin CHARACTERISTIC Tlib_isAirClngSts_VLAN204ControLow_C "" VALUE 0x00720a43 Val_Wu8 1 OneToOne 0.0 255.00 FORMAT "%8.2" /end CHARACTERISTIC
/begin CHARACTERISTIC Tlib_isThermalSystemRedn_VLAN204ControLow_C "" VALUE 0x00720a44 Val_Wu8 1 OneToOne 0.0 255.00 FORMAT "%8.2" /end CHARACTERISTIC
/begin CHARACTERISTIC Tlib_isGrlShttrActvSaveReq_VLAN204ControLow_C "" VALUE 0x00720a45 Val_Wu8 1 OneToOne 0.0 255.00 FORMAT "%8.2" /end CHARACTERISTIC
/begin CHARACTERISTIC Tlib_isHpcHvHeatgPwrNormDes_VLAN204ControLow_C "" VALUE 0x007205fa Val_WS16 1 OneToOne -32768 32767 FORMAT "%8.2" /end CHARACTERISTIC
/begin CHARACTERISTIC Tlib_isHpcHvCoolgPwrCritDes_VLAN204ControLow_C "" VALUE 0x007205fc Val_WS16 1 OneToOne -32768 32767 FORMAT "%8.2" /end CHARACTERISTIC
/begin CHARACTERISTIC Tlib_isHpcHvHeatgPwrCns_VLAN204ControLow_C "" VALUE 0x007205fe Val_WS16 1 OneToOne -32768 32767 FORMAT "%8.2" /end CHARACTERISTIC
/begin CHARACTERISTIC Tlib_isHpcHvHeatgPwrCritDes_VLAN204ControLow_C "" VALUE 0x00720600 Val_WS16 1 OneToOne -32768 32767 FORMAT "%8.2" /end CHARACTERISTIC
/begin CHARACTERISTIC Tlib_isHpcHvCoolgPwrNormDes_VLAN204ControLow_C "" VALUE 0x00720602 Val_WS16 1 OneToOne -32768 32767 FORMAT "%8.2" /end CHARACTERISTIC
/begin CHARACTERISTIC Tlib_isHpcHvCoolgPwrCns_VLAN204ControLow_C "" VALUE 0x00720604 Val_WS16 1 OneToOne -32768 32767 FORMAT "%8.2" /end CHARACTERISTIC
/begin CHARACTERISTIC Tlib_isPinMapFltRi1_VLAN204ControLow_C "" VALUE 0x00720a46 Val_Wu8 1 OneToOne 0.0 255.00 FORMAT "%8.2" /end CHARACTERISTIC
/begin CHARACTERISTIC Tlib_isPinMapFltRi2_VLAN204ControLow_C "" VALUE 0x00720a47 Val_Wu8 1 OneToOne 0.0 255.00 FORMAT "%8.2" /end CHARACTERISTIC
/begin CHARACTERISTIC Tlib_isAirFragChRunngStsFragRunngStsCh3_VLAN204ControLow_C "" VALUE 0x00720a48 Val_Wu8 1 OneToOne 0.0 255.00 FORMAT "%8.2" /end CHARACTERISTIC
/begin CHARACTERISTIC Tlib_isAirFragChRunngStsFragRunngStsCh2_VLAN204ControLow_C "" VALUE 0x00720a49 Val_Wu8 1 OneToOne 0.0 255.00 FORMAT "%8.2" /end CHARACTERISTIC
/begin CHARACTERISTIC Tlib_isAirFragChRunngStsFragRunngStsCh4_VLAN204ControLow_C "" VALUE 0x00720a4a Val_Wu8 1 OneToOne 0.0 255.00 FORMAT "%8.2" /end CHARACTERISTIC
/begin CHARACTERISTIC Tlib_isAirFragChRunngStsFragRunngStsCh1_VLAN204ControLow_C "" VALUE 0x00720a4b Val_Wu8 1 OneToOne 0.0 255.00 FORMAT "%8.2" /end CHARACTERISTIC
/begin CHARACTERISTIC Tlib_isAirFragChRunngStsFragRunngStsCh5_VLAN204ControLow_C "" VALUE 0x00720a4c Val_Wu8 1 OneToOne 0.0 255.00 FORMAT "%8.2" /end CHARACTERISTIC
/begin CHARACTERISTIC Tlib_isAirQlyStsOutdAirQlyQf_VLAN204ControLow_C "" VALUE 0x00720a4d Val_Wu8 1 OneToOne 0.0 255.00 FORMAT "%8.2" /end CHARACTERISTIC
/begin CHARACTERISTIC Tlib_isAirQlyStsOutdAirQly_VLAN204ControLow_C "" VALUE 0x00720a4e Val_Wu8 1 OneToOne 0.0 255.00 FORMAT "%8.2" /end CHARACTERISTIC
/begin CHARACTERISTIC Tlib_isAirFragInitSts_VLAN204ControLow_C "" VALUE 0x00720a4f Val_Wu8 1 OneToOne 0.0 255.00 FORMAT "%8.2" /end CHARACTERISTIC
/begin CHARACTERISTIC Tlib_isAirFragTypeFragTypeCh2_VLAN204ControLow_C "" VALUE 0x00720a50 Val_Wu8 1 OneToOne 0.0 255.00 FORMAT "%8.2" /end CHARACTERISTIC
/begin CHARACTERISTIC Tlib_isAirFragTypeFragTypeCh1_VLAN204ControLow_C "" VALUE 0x00720a51 Val_Wu8 1 OneToOne 0.0 255.00 FORMAT "%8.2" /end CHARACTERISTIC
/begin CHARACTERISTIC Tlib_isAirFragTypeFragTypeCh4_VLAN204ControLow_C "" VALUE 0x00720a52 Val_Wu8 1 OneToOne 0.0 255.00 FORMAT "%8.2" /end CHARACTERISTIC
/begin CHARACTERISTIC Tlib_isAirFragTypeFragTypeCh5_VLAN204ControLow_C "" VALUE 0x00720a53 Val_Wu8 1 OneToOne 0.0 255.00 FORMAT "%8.2" /end CHARACTERISTIC
/begin CHARACTERISTIC Tlib_isAirFragTypeFragTypeCh3_VLAN204ControLow_C "" VALUE 0x00720a54 Val_Wu8 1 OneToOne 0.0 255.00 FORMAT "%8.2" /end CHARACTERISTIC
/begin CHARACTERISTIC Tlib_isAirFragConcLvlSts_VLAN204ControLow_C "" VALUE 0x00720a55 Val_Wu8 1 OneToOne 0.0 255.00 FORMAT "%8.2" /end CHARACTERISTIC
/begin CHARACTERISTIC Tlib_isAirFragErrStsFragMotErrCh5_VLAN204ControLow_C "" VALUE 0x00720a56 Val_Wu8 1 OneToOne 0.0 255.00 FORMAT "%8.2" /end CHARACTERISTIC
/begin CHARACTERISTIC Tlib_isAirFragErrStsFragMotErrCh3_VLAN204ControLow_C "" VALUE 0x00720a57 Val_Wu8 1 OneToOne 0.0 255.00 FORMAT "%8.2" /end CHARACTERISTIC
/begin CHARACTERISTIC Tlib_isAirFragErrStsFragMotErrCh2_VLAN204ControLow_C "" VALUE 0x00720a58 Val_Wu8 1 OneToOne 0.0 255.00 FORMAT "%8.2" /end CHARACTERISTIC
/begin CHARACTERISTIC Tlib_isAirFragErrStsFragMotErrCh4_VLAN204ControLow_C "" VALUE 0x00720a59 Val_Wu8 1 OneToOne 0.0 255.00 FORMAT "%8.2" /end CHARACTERISTIC
/begin CHARACTERISTIC Tlib_isAirFragErrStsFragUndVoltErr_VLAN204ControLow_C "" VALUE 0x00720a5a Val_Wu8 1 OneToOne 0.0 255.00 FORMAT "%8.2" /end CHARACTERISTIC
/begin CHARACTERISTIC Tlib_isAirFragErrStsFragFanErr_VLAN204ControLow_C "" VALUE 0x00720a5b Val_Wu8 1 OneToOne 0.0 255.00 FORMAT "%8.2" /end CHARACTERISTIC
/begin CHARACTERISTIC Tlib_isAirFragErrStsFragTErr_VLAN204ControLow_C "" VALUE 0x00720a5c Val_Wu8 1 OneToOne 0.0 255.00 FORMAT "%8.2" /end CHARACTERISTIC
/begin CHARACTERISTIC Tlib_isAirFragErrStsFragMotErrCh1_VLAN204ControLow_C "" VALUE 0x00720a5d Val_Wu8 1 OneToOne 0.0 255.00 FORMAT "%8.2" /end CHARACTERISTIC
/begin CHARACTERISTIC Tlib_isAirFragErrStsFragOvrVoltErr_VLAN204ControLow_C "" VALUE 0x00720a5e Val_Wu8 1 OneToOne 0.0 255.00 FORMAT "%8.2" /end CHARACTERISTIC
/begin CHARACTERISTIC Tlib_isAirFragAvlTiStsFragCh4AvlTi_VLAN204ControLow_C "" VALUE 0x00720606 Val_Wu16 1 OneToOne 0.0 65535 FORMAT "%8.2" /end CHARACTERISTIC
/begin CHARACTERISTIC Tlib_isAirFragAvlTiStsFragCh1AvlTi_VLAN204ControLow_C "" VALUE 0x00720608 Val_Wu16 1 OneToOne 0.0 65535 FORMAT "%8.2" /end CHARACTERISTIC
/begin CHARACTERISTIC Tlib_isAirFragAvlTiStsFragCh3AvlTi_VLAN204ControLow_C "" VALUE 0x0072060a Val_Wu16 1 OneToOne 0.0 65535 FORMAT "%8.2" /end CHARACTERISTIC
/begin CHARACTERISTIC Tlib_isAirFragAvlTiStsFragCh5AvlTi_VLAN204ControLow_C "" VALUE 0x0072060c Val_Wu16 1 OneToOne 0.0 65535 FORMAT "%8.2" /end CHARACTERISTIC
/begin CHARACTERISTIC Tlib_isAirFragAvlTiStsFragCh2AvlTi_VLAN204ControLow_C "" VALUE 0x0072060e Val_Wu16 1 OneToOne 0.0 65535 FORMAT "%8.2" /end CHARACTERISTIC
/begin CHARACTERISTIC Tlib_isCircInfoDrvRi35ID_VLAN204ControLow_C "" VALUE 0x00720610 Val_Wu16 1 OneToOne 0.0 65535 FORMAT "%8.2" /end CHARACTERISTIC
/begin CHARACTERISTIC Tlib_isCircInfoDrvRi35PowerStatus_VLAN204ControLow_C "" VALUE 0x00720a5f Val_Wu8 1 OneToOne 0.0 255.00 FORMAT "%8.2" /end CHARACTERISTIC
/begin CHARACTERISTIC Tlib_isCircInfoDrvRi35Voltage_VLAN204ControLow_C "" VALUE 0x00720a60 Val_Wu8 1 OneToOne 0.0 255.00 FORMAT "%8.2" /end CHARACTERISTIC
/begin CHARACTERISTIC Tlib_isCircInfoDrvRi35Current_VLAN204ControLow_C "" VALUE 0x00720612 Val_Wu16 1 OneToOne 0.0 65535 FORMAT "%8.2" /end CHARACTERISTIC
/begin CHARACTERISTIC Tlib_isCircInfoPwrRi9CircFaultSts_VLAN204ControLow_C "" VALUE 0x00720614 Val_Wu16 1 OneToOne 0.0 65535 FORMAT "%8.2" /end CHARACTERISTIC
/begin CHARACTERISTIC Tlib_isCircInfoPwrRi9PowerSupplyID_VLAN204ControLow_C "" VALUE 0x00720616 Val_Wu16 1 OneToOne 0.0 65535 FORMAT "%8.2" /end CHARACTERISTIC
/begin CHARACTERISTIC Tlib_isCircInfoPwrRi9PowerSupplyStatus_VLAN204ControLow_C "" VALUE 0x00720a61 Val_Wu8 1 OneToOne 0.0 255.00 FORMAT "%8.2" /end CHARACTERISTIC
/begin CHARACTERISTIC Tlib_isCircInfoPwrRi9PowerSupplyVoltage_VLAN204ControLow_C "" VALUE 0x00720a62 Val_Wu8 1 OneToOne 0.0 255.00 FORMAT "%8.2" /end CHARACTERISTIC
/begin CHARACTERISTIC Tlib_isCircInfoPwrRi9Current_VLAN204ControLow_C "" VALUE 0x00720618 Val_Wu16 1 OneToOne 0.0 65535 FORMAT "%8.2" /end CHARACTERISTIC
/begin CHARACTERISTIC Tlib_isCircInfoDrvRi2ID_VLAN204ControLow_C "" VALUE 0x0072061a Val_Wu16 1 OneToOne 0.0 65535 FORMAT "%8.2" /end CHARACTERISTIC
/begin CHARACTERISTIC Tlib_isCircInfoDrvRi2Voltage_VLAN204ControLow_C "" VALUE 0x00720a63 Val_Wu8 1 OneToOne 0.0 255.00 FORMAT "%8.2" /end CHARACTERISTIC
/begin CHARACTERISTIC Tlib_isCircInfoDrvRi2Current_VLAN204ControLow_C "" VALUE 0x0072061c Val_Wu16 1 OneToOne 0.0 65535 FORMAT "%8.2" /end CHARACTERISTIC
/begin CHARACTERISTIC Tlib_isCircInfoDrvRi2PowerStatus_VLAN204ControLow_C "" VALUE 0x00720a64 Val_Wu8 1 OneToOne 0.0 255.00 FORMAT "%8.2" /end CHARACTERISTIC
/begin CHARACTERISTIC Tlib_isCircInfoPwrRi19CircFaultSts_VLAN204ControLow_C "" VALUE 0x0072061e Val_Wu16 1 OneToOne 0.0 65535 FORMAT "%8.2" /end CHARACTERISTIC
/begin CHARACTERISTIC Tlib_isCircInfoPwrRi19PowerSupplyStatus_VLAN204ControLow_C "" VALUE 0x00720a65 Val_Wu8 1 OneToOne 0.0 255.00 FORMAT "%8.2" /end CHARACTERISTIC
/begin CHARACTERISTIC Tlib_isCircInfoPwrRi19PowerSupplyID_VLAN204ControLow_C "" VALUE 0x00720620 Val_Wu16 1 OneToOne 0.0 65535 FORMAT "%8.2" /end CHARACTERISTIC
/begin CHARACTERISTIC Tlib_isCircInfoPwrRi19PowerSupplyVoltage_VLAN204ControLow_C "" VALUE 0x00720a66 Val_Wu8 1 OneToOne 0.0 255.00 FORMAT "%8.2" /end CHARACTERISTIC
/begin CHARACTERISTIC Tlib_isCircInfoPwrRi19Current_VLAN204ControLow_C "" VALUE 0x00720622 Val_Wu16 1 OneToOne 0.0 65535 FORMAT "%8.2" /end CHARACTERISTIC
/begin CHARACTERISTIC Tlib_isCircInfoPwrRi14CircFaultSts_VLAN204ControLow_C "" VALUE 0x00720624 Val_Wu16 1 OneToOne 0.0 65535 FORMAT "%8.2" /end CHARACTERISTIC
/begin CHARACTERISTIC Tlib_isCircInfoPwrRi14PowerSupplyStatus_VLAN204ControLow_C "" VALUE 0x00720a67 Val_Wu8 1 OneToOne 0.0 255.00 FORMAT "%8.2" /end CHARACTERISTIC
/begin CHARACTERISTIC Tlib_isCircInfoPwrRi14Current_VLAN204ControLow_C "" VALUE 0x00720626 Val_Wu16 1 OneToOne 0.0 65535 FORMAT "%8.2" /end CHARACTERISTIC
/begin CHARACTERISTIC Tlib_isCircInfoPwrRi14PowerSupplyID_VLAN204ControLow_C "" VALUE 0x00720628 Val_Wu16 1 OneToOne 0.0 65535 FORMAT "%8.2" /end CHARACTERISTIC
/begin CHARACTERISTIC Tlib_isCircInfoPwrRi14PowerSupplyVoltage_VLAN204ControLow_C "" VALUE 0x00720a68 Val_Wu8 1 OneToOne 0.0 255.00 FORMAT "%8.2" /end CHARACTERISTIC
/begin CHARACTERISTIC Tlib_isCircInfoDrvRi1Current_VLAN204ControLow_C "" VALUE 0x0072062a Val_Wu16 1 OneToOne 0.0 65535 FORMAT "%8.2" /end CHARACTERISTIC
/begin CHARACTERISTIC Tlib_isCircInfoDrvRi1ID_VLAN204ControLow_C "" VALUE 0x0072062c Val_Wu16 1 OneToOne 0.0 65535 FORMAT "%8.2" /end CHARACTERISTIC
/begin CHARACTERISTIC Tlib_isCircInfoDrvRi1Voltage_VLAN204ControLow_C "" VALUE 0x00720a69 Val_Wu8 1 OneToOne 0.0 255.00 FORMAT "%8.2" /end CHARACTERISTIC
/begin CHARACTERISTIC Tlib_isCircInfoDrvRi1PowerStatus_VLAN204ControLow_C "" VALUE 0x00720a6a Val_Wu8 1 OneToOne 0.0 255.00 FORMAT "%8.2" /end CHARACTERISTIC
/begin CHARACTERISTIC Tlib_isCircInfoPwrRi39Current_VLAN204ControLow_C "" VALUE 0x0072062e Val_Wu16 1 OneToOne 0.0 65535 FORMAT "%8.2" /end CHARACTERISTIC
/begin CHARACTERISTIC Tlib_isCircInfoPwrRi39PowerSupplyVoltage_VLAN204ControLow_C "" VALUE 0x00720a6b Val_Wu8 1 OneToOne 0.0 255.00 FORMAT "%8.2" /end CHARACTERISTIC
/begin CHARACTERISTIC Tlib_isCircInfoPwrRi39PowerSupplyStatus_VLAN204ControLow_C "" VALUE 0x00720a6c Val_Wu8 1 OneToOne 0.0 255.00 FORMAT "%8.2" /end CHARACTERISTIC
/begin CHARACTERISTIC Tlib_isCircInfoPwrRi39PowerSupplyID_VLAN204ControLow_C "" VALUE 0x00720630 Val_Wu16 1 OneToOne 0.0 65535 FORMAT "%8.2" /end CHARACTERISTIC
/begin CHARACTERISTIC Tlib_isCircInfoPwrRi39CircFaultSts_VLAN204ControLow_C "" VALUE 0x00720632 Val_Wu16 1 OneToOne 0.0 65535 FORMAT "%8.2" /end CHARACTERISTIC
/begin CHARACTERISTIC Tlib_isSecGrlTrqBoostReq_VLAN204ControLow_C "" VALUE 0x00720a6d Val_Wu8 1 OneToOne 0.0 255.00 FORMAT "%8.2" /end CHARACTERISTIC
/begin CHARACTERISTIC Tlib_isCircInfoDrvRi20ID_VLAN204ControLow_C "" VALUE 0x00720634 Val_Wu16 1 OneToOne 0.0 65535 FORMAT "%8.2" /end CHARACTERISTIC
/begin CHARACTERISTIC Tlib_isCircInfoDrvRi20Voltage_VLAN204ControLow_C "" VALUE 0x00720a6e Val_Wu8 1 OneToOne 0.0 255.00 FORMAT "%8.2" /end CHARACTERISTIC
/begin CHARACTERISTIC Tlib_isCircInfoDrvRi20Current_VLAN204ControLow_C "" VALUE 0x00720636 Val_Wu16 1 OneToOne 0.0 65535 FORMAT "%8.2" /end CHARACTERISTIC
/begin CHARACTERISTIC Tlib_isCircInfoDrvRi20PowerStatus_VLAN204ControLow_C "" VALUE 0x00720a6f Val_Wu8 1 OneToOne 0.0 255.00 FORMAT "%8.2" /end CHARACTERISTIC
/begin CHARACTERISTIC Tlib_isCircInfoPwrRi3PowerSupplyStatus_VLAN204ControLow_C "" VALUE 0x00720a70 Val_Wu8 1 OneToOne 0.0 255.00 FORMAT "%8.2" /end CHARACTERISTIC
/begin CHARACTERISTIC Tlib_isCircInfoPwrRi3CircFaultSts_VLAN204ControLow_C "" VALUE 0x00720638 Val_Wu16 1 OneToOne 0.0 65535 FORMAT "%8.2" /end CHARACTERISTIC
/begin CHARACTERISTIC Tlib_isCircInfoPwrRi3PowerSupplyVoltage_VLAN204ControLow_C "" VALUE 0x00720a71 Val_Wu8 1 OneToOne 0.0 255.00 FORMAT "%8.2" /end CHARACTERISTIC
/begin CHARACTERISTIC Tlib_isCircInfoPwrRi3Current_VLAN204ControLow_C "" VALUE 0x0072063a Val_Wu16 1 OneToOne 0.0 65535 FORMAT "%8.2" /end CHARACTERISTIC
/begin CHARACTERISTIC Tlib_isCircInfoPwrRi3PowerSupplyID_VLAN204ControLow_C "" VALUE 0x0072063c Val_Wu16 1 OneToOne 0.0 65535 FORMAT "%8.2" /end CHARACTERISTIC
/begin CHARACTERISTIC Tlib_isCircInfoDrvRi16ID_VLAN204ControLow_C "" VALUE 0x0072063e Val_Wu16 1 OneToOne 0.0 65535 FORMAT "%8.2" /end CHARACTERISTIC
/begin CHARACTERISTIC Tlib_isCircInfoDrvRi16Current_VLAN204ControLow_C "" VALUE 0x00720640 Val_Wu16 1 OneToOne 0.0 65535 FORMAT "%8.2" /end CHARACTERISTIC
/begin CHARACTERISTIC Tlib_isCircInfoDrvRi16PowerStatus_VLAN204ControLow_C "" VALUE 0x00720a72 Val_Wu8 1 OneToOne 0.0 255.00 FORMAT "%8.2" /end CHARACTERISTIC
/begin CHARACTERISTIC Tlib_isCircInfoDrvRi16Voltage_VLAN204ControLow_C "" VALUE 0x00720a73 Val_Wu8 1 OneToOne 0.0 255.00 FORMAT "%8.2" /end CHARACTERISTIC
/begin CHARACTERISTIC Tlib_isCircInfoPwrRi20CircFaultSts_VLAN204ControLow_C "" VALUE 0x00720642 Val_Wu16 1 OneToOne 0.0 65535 FORMAT "%8.2" /end CHARACTERISTIC
/begin CHARACTERISTIC Tlib_isCircInfoPwrRi20Current_VLAN204ControLow_C "" VALUE 0x00720644 Val_Wu16 1 OneToOne 0.0 65535 FORMAT "%8.2" /end CHARACTERISTIC
/begin CHARACTERISTIC Tlib_isCircInfoPwrRi20PowerSupplyID_VLAN204ControLow_C "" VALUE 0x00720646 Val_Wu16 1 OneToOne 0.0 65535 FORMAT "%8.2" /end CHARACTERISTIC
/begin CHARACTERISTIC Tlib_isCircInfoPwrRi20PowerSupplyStatus_VLAN204ControLow_C "" VALUE 0x00720a74 Val_Wu8 1 OneToOne 0.0 255.00 FORMAT "%8.2" /end CHARACTERISTIC
/begin CHARACTERISTIC Tlib_isCircInfoPwrRi20PowerSupplyVoltage_VLAN204ControLow_C "" VALUE 0x00720a75 Val_Wu8 1 OneToOne 0.0 255.00 FORMAT "%8.2" /end CHARACTERISTIC
/begin CHARACTERISTIC Tlib_isCircInfoDrvRi31PowerStatus_VLAN204ControLow_C "" VALUE 0x00720a76 Val_Wu8 1 OneToOne 0.0 255.00 FORMAT "%8.2" /end CHARACTERISTIC
/begin CHARACTERISTIC Tlib_isCircInfoDrvRi31ID_VLAN204ControLow_C "" VALUE 0x00720648 Val_Wu16 1 OneToOne 0.0 65535 FORMAT "%8.2" /end CHARACTERISTIC
/begin CHARACTERISTIC Tlib_isCircInfoDrvRi31Current_VLAN204ControLow_C "" VALUE 0x0072064a Val_Wu16 1 OneToOne 0.0 65535 FORMAT "%8.2" /end CHARACTERISTIC
/begin CHARACTERISTIC Tlib_isCircInfoDrvRi31Voltage_VLAN204ControLow_C "" VALUE 0x00720a77 Val_Wu8 1 OneToOne 0.0 255.00 FORMAT "%8.2" /end CHARACTERISTIC
/begin CHARACTERISTIC Tlib_isCircInfoPwrRi23PowerSupplyID_VLAN204ControLow_C "" VALUE 0x0072064c Val_Wu16 1 OneToOne 0.0 65535 FORMAT "%8.2" /end CHARACTERISTIC
/begin CHARACTERISTIC Tlib_isCircInfoPwrRi23PowerSupplyVoltage_VLAN204ControLow_C "" VALUE 0x00720a78 Val_Wu8 1 OneToOne 0.0 255.00 FORMAT "%8.2" /end CHARACTERISTIC
/begin CHARACTERISTIC Tlib_isCircInfoPwrRi23PowerSupplyStatus_VLAN204ControLow_C "" VALUE 0x00720a79 Val_Wu8 1 OneToOne 0.0 255.00 FORMAT "%8.2" /end CHARACTERISTIC
/begin CHARACTERISTIC Tlib_isCircInfoPwrRi23Current_VLAN204ControLow_C "" VALUE 0x0072064e Val_Wu16 1 OneToOne 0.0 65535 FORMAT "%8.2" /end CHARACTERISTIC
/begin CHARACTERISTIC Tlib_isCircInfoPwrRi23CircFaultSts_VLAN204ControLow_C "" VALUE 0x00720650 Val_Wu16 1 OneToOne 0.0 65535 FORMAT "%8.2" /end CHARACTERISTIC
/begin CHARACTERISTIC Tlib_isCircInfoPwrRi7PowerSupplyStatus_VLAN204ControLow_C "" VALUE 0x00720a7a Val_Wu8 1 OneToOne 0.0 255.00 FORMAT "%8.2" /end CHARACTERISTIC
/begin CHARACTERISTIC Tlib_isCircInfoPwrRi7PowerSupplyID_VLAN204ControLow_C "" VALUE 0x00720652 Val_Wu16 1 OneToOne 0.0 65535 FORMAT "%8.2" /end CHARACTERISTIC
/begin CHARACTERISTIC Tlib_isCircInfoPwrRi7PowerSupplyVoltage_VLAN204ControLow_C "" VALUE 0x00720a7b Val_Wu8 1 OneToOne 0.0 255.00 FORMAT "%8.2" /end CHARACTERISTIC
/begin CHARACTERISTIC Tlib_isCircInfoPwrRi7Current_VLAN204ControLow_C "" VALUE 0x00720654 Val_Wu16 1 OneToOne 0.0 65535 FORMAT "%8.2" /end CHARACTERISTIC
/begin CHARACTERISTIC Tlib_isCircInfoPwrRi7CircFaultSts_VLAN204ControLow_C "" VALUE 0x00720656 Val_Wu16 1 OneToOne 0.0 65535 FORMAT "%8.2" /end CHARACTERISTIC
/begin CHARACTERISTIC Tlib_isSecGrlShttrActvSaveReq_VLAN204ControLow_C "" VALUE 0x00720a7c Val_Wu8 1 OneToOne 0.0 255.00 FORMAT "%8.2" /end CHARACTERISTIC
/begin CHARACTERISTIC Tlib_isCircInfoPwrRi26CircFaultSts_VLAN204ControLow_C "" VALUE 0x00720658 Val_Wu16 1 OneToOne 0.0 65535 FORMAT "%8.2" /end CHARACTERISTIC
/begin CHARACTERISTIC Tlib_isCircInfoPwrRi26PowerSupplyStatus_VLAN204ControLow_C "" VALUE 0x00720a7d Val_Wu8 1 OneToOne 0.0 255.00 FORMAT "%8.2" /end CHARACTERISTIC
/begin CHARACTERISTIC Tlib_isCircInfoPwrRi26Current_VLAN204ControLow_C "" VALUE 0x0072065a Val_Wu16 1 OneToOne 0.0 65535 FORMAT "%8.2" /end CHARACTERISTIC
/begin CHARACTERISTIC Tlib_isCircInfoPwrRi26PowerSupplyID_VLAN204ControLow_C "" VALUE 0x0072065c Val_Wu16 1 OneToOne 0.0 65535 FORMAT "%8.2" /end CHARACTERISTIC
/begin CHARACTERISTIC Tlib_isCircInfoPwrRi26PowerSupplyVoltage_VLAN204ControLow_C "" VALUE 0x00720a7e Val_Wu8 1 OneToOne 0.0 255.00 FORMAT "%8.2" /end CHARACTERISTIC
/begin CHARACTERISTIC Tlib_isCircInfoDrvRi13PowerStatus_VLAN204ControLow_C "" VALUE 0x00720a7f Val_Wu8 1 OneToOne 0.0 255.00 FORMAT "%8.2" /end CHARACTERISTIC
/begin CHARACTERISTIC Tlib_isCircInfoDrvRi13ID_VLAN204ControLow_C "" VALUE 0x0072065e Val_Wu16 1 OneToOne 0.0 65535 FORMAT "%8.2" /end CHARACTERISTIC
/begin CHARACTERISTIC Tlib_isCircInfoDrvRi13Current_VLAN204ControLow_C "" VALUE 0x00720660 Val_Wu16 1 OneToOne 0.0 65535 FORMAT "%8.2" /end CHARACTERISTIC
/begin CHARACTERISTIC Tlib_isCircInfoDrvRi13Voltage_VLAN204ControLow_C "" VALUE 0x00720a80 Val_Wu8 1 OneToOne 0.0 255.00 FORMAT "%8.2" /end CHARACTERISTIC
/begin CHARACTERISTIC Tlib_isCircInfoDrvRi38Voltage_VLAN204ControLow_C "" VALUE 0x00720a81 Val_Wu8 1 OneToOne 0.0 255.00 FORMAT "%8.2" /end CHARACTERISTIC
/begin CHARACTERISTIC Tlib_isCircInfoDrvRi38Current_VLAN204ControLow_C "" VALUE 0x00720662 Val_Wu16 1 OneToOne 0.0 65535 FORMAT "%8.2" /end CHARACTERISTIC
/begin CHARACTERISTIC Tlib_isCircInfoDrvRi38ID_VLAN204ControLow_C "" VALUE 0x00720664 Val_Wu16 1 OneToOne 0.0 65535 FORMAT "%8.2" /end CHARACTERISTIC
/begin CHARACTERISTIC Tlib_isCircInfoDrvRi38PowerStatus_VLAN204ControLow_C "" VALUE 0x00720a82 Val_Wu8 1 OneToOne 0.0 255.00 FORMAT "%8.2" /end CHARACTERISTIC
/begin CHARACTERISTIC Tlib_isCircInfoPwrRi48PowerSupplyVoltage_VLAN204ControLow_C "" VALUE 0x00720a83 Val_Wu8 1 OneToOne 0.0 255.00 FORMAT "%8.2" /end CHARACTERISTIC
/begin CHARACTERISTIC Tlib_isCircInfoPwrRi48CircFaultSts_VLAN204ControLow_C "" VALUE 0x00720666 Val_Wu16 1 OneToOne 0.0 65535 FORMAT "%8.2" /end CHARACTERISTIC
/begin CHARACTERISTIC Tlib_isCircInfoPwrRi48Current_VLAN204ControLow_C "" VALUE 0x00720668 Val_Wu16 1 OneToOne 0.0 65535 FORMAT "%8.2" /end CHARACTERISTIC
/begin CHARACTERISTIC Tlib_isCircInfoPwrRi48PowerSupplyStatus_VLAN204ControLow_C "" VALUE 0x00720a84 Val_Wu8 1 OneToOne 0.0 255.00 FORMAT "%8.2" /end CHARACTERISTIC
/begin CHARACTERISTIC Tlib_isCircInfoPwrRi48PowerSupplyID_VLAN204ControLow_C "" VALUE 0x0072066a Val_Wu16 1 OneToOne 0.0 65535 FORMAT "%8.2" /end CHARACTERISTIC
/begin CHARACTERISTIC Tlib_isCircInfoPwrRi35PowerSupplyVoltage_VLAN204ControLow_C "" VALUE 0x00720a85 Val_Wu8 1 OneToOne 0.0 255.00 FORMAT "%8.2" /end CHARACTERISTIC
/begin CHARACTERISTIC Tlib_isCircInfoPwrRi35Current_VLAN204ControLow_C "" VALUE 0x0072066c Val_Wu16 1 OneToOne 0.0 65535 FORMAT "%8.2" /end CHARACTERISTIC
/begin CHARACTERISTIC Tlib_isCircInfoPwrRi35CircFaultSts_VLAN204ControLow_C "" VALUE 0x0072066e Val_Wu16 1 OneToOne 0.0 65535 FORMAT "%8.2" /end CHARACTERISTIC
/begin CHARACTERISTIC Tlib_isCircInfoPwrRi35PowerSupplyID_VLAN204ControLow_C "" VALUE 0x00720670 Val_Wu16 1 OneToOne 0.0 65535 FORMAT "%8.2" /end CHARACTERISTIC
/begin CHARACTERISTIC Tlib_isCircInfoPwrRi35PowerSupplyStatus_VLAN204ControLow_C "" VALUE 0x00720a86 Val_Wu8 1 OneToOne 0.0 255.00 FORMAT "%8.2" /end CHARACTERISTIC
/begin CHARACTERISTIC Tlib_isCircInfoPwrRi17PowerSupplyStatus_VLAN204ControLow_C "" VALUE 0x00720a87 Val_Wu8 1 OneToOne 0.0 255.00 FORMAT "%8.2" /end CHARACTERISTIC
/begin CHARACTERISTIC Tlib_isCircInfoPwrRi17PowerSupplyVoltage_VLAN204ControLow_C "" VALUE 0x00720a88 Val_Wu8 1 OneToOne 0.0 255.00 FORMAT "%8.2" /end CHARACTERISTIC
/begin CHARACTERISTIC Tlib_isCircInfoPwrRi17Current_VLAN204ControLow_C "" VALUE 0x00720672 Val_Wu16 1 OneToOne 0.0 65535 FORMAT "%8.2" /end CHARACTERISTIC
/begin CHARACTERISTIC Tlib_isCircInfoPwrRi17CircFaultSts_VLAN204ControLow_C "" VALUE 0x00720674 Val_Wu16 1 OneToOne 0.0 65535 FORMAT "%8.2" /end CHARACTERISTIC
/begin CHARACTERISTIC Tlib_isCircInfoPwrRi17PowerSupplyID_VLAN204ControLow_C "" VALUE 0x00720676 Val_Wu16 1 OneToOne 0.0 65535 FORMAT "%8.2" /end CHARACTERISTIC
/begin CHARACTERISTIC Tlib_isCircInfoPwrRi58PowerSupplyStatus_VLAN204ControLow_C "" VALUE 0x00720a89 Val_Wu8 1 OneToOne 0.0 255.00 FORMAT "%8.2" /end CHARACTERISTIC
/begin CHARACTERISTIC Tlib_isCircInfoPwrRi58PowerSupplyID_VLAN204ControLow_C "" VALUE 0x00720678 Val_Wu16 1 OneToOne 0.0 65535 FORMAT "%8.2" /end CHARACTERISTIC
/begin CHARACTERISTIC Tlib_isCircInfoPwrRi58CircFaultSts_VLAN204ControLow_C "" VALUE 0x0072067a Val_Wu16 1 OneToOne 0.0 65535 FORMAT "%8.2" /end CHARACTERISTIC
/begin CHARACTERISTIC Tlib_isCircInfoPwrRi58Current_VLAN204ControLow_C "" VALUE 0x0072067c Val_Wu16 1 OneToOne 0.0 65535 FORMAT "%8.2" /end CHARACTERISTIC
/begin CHARACTERISTIC Tlib_isCircInfoPwrRi58PowerSupplyVoltage_VLAN204ControLow_C "" VALUE 0x00720a8a Val_Wu8 1 OneToOne 0.0 255.00 FORMAT "%8.2" /end CHARACTERISTIC
/begin CHARACTERISTIC Tlib_isCircInfoDrvRi6ID_VLAN204ControLow_C "" VALUE 0x0072067e Val_Wu16 1 OneToOne 0.0 65535 FORMAT "%8.2" /end CHARACTERISTIC
/begin CHARACTERISTIC Tlib_isCircInfoDrvRi6PowerStatus_VLAN204ControLow_C "" VALUE 0x00720a8b Val_Wu8 1 OneToOne 0.0 255.00 FORMAT "%8.2" /end CHARACTERISTIC
/begin CHARACTERISTIC Tlib_isCircInfoDrvRi6Current_VLAN204ControLow_C "" VALUE 0x00720680 Val_Wu16 1 OneToOne 0.0 65535 FORMAT "%8.2" /end CHARACTERISTIC
/begin CHARACTERISTIC Tlib_isCircInfoDrvRi6Voltage_VLAN204ControLow_C "" VALUE 0x00720a8c Val_Wu8 1 OneToOne 0.0 255.00 FORMAT "%8.2" /end CHARACTERISTIC
/begin CHARACTERISTIC Tlib_isCircInfoDrvRi39PowerStatus_VLAN204ControLow_C "" VALUE 0x00720a8d Val_Wu8 1 OneToOne 0.0 255.00 FORMAT "%8.2" /end CHARACTERISTIC
/begin CHARACTERISTIC Tlib_isCircInfoDrvRi39Voltage_VLAN204ControLow_C "" VALUE 0x00720a8e Val_Wu8 1 OneToOne 0.0 255.00 FORMAT "%8.2" /end CHARACTERISTIC
/begin CHARACTERISTIC Tlib_isCircInfoDrvRi39Current_VLAN204ControLow_C "" VALUE 0x00720682 Val_Wu16 1 OneToOne 0.0 65535 FORMAT "%8.2" /end CHARACTERISTIC
/begin CHARACTERISTIC Tlib_isCircInfoDrvRi39ID_VLAN204ControLow_C "" VALUE 0x00720684 Val_Wu16 1 OneToOne 0.0 65535 FORMAT "%8.2" /end CHARACTERISTIC
/begin CHARACTERISTIC Tlib_isCircInfoDrvRi21Current_VLAN204ControLow_C "" VALUE 0x00720686 Val_Wu16 1 OneToOne 0.0 65535 FORMAT "%8.2" /end CHARACTERISTIC
/begin CHARACTERISTIC Tlib_isCircInfoDrvRi21ID_VLAN204ControLow_C "" VALUE 0x00720688 Val_Wu16 1 OneToOne 0.0 65535 FORMAT "%8.2" /end CHARACTERISTIC
/begin CHARACTERISTIC Tlib_isCircInfoDrvRi21PowerStatus_VLAN204ControLow_C "" VALUE 0x00720a8f Val_Wu8 1 OneToOne 0.0 255.00 FORMAT "%8.2" /end CHARACTERISTIC
/begin CHARACTERISTIC Tlib_isCircInfoDrvRi21Voltage_VLAN204ControLow_C "" VALUE 0x00720a90 Val_Wu8 1 OneToOne 0.0 255.00 FORMAT "%8.2" /end CHARACTERISTIC
/begin CHARACTERISTIC Tlib_isCircInfoPwrRi33PowerSupplyStatus_VLAN204ControLow_C "" VALUE 0x00720a91 Val_Wu8 1 OneToOne 0.0 255.00 FORMAT "%8.2" /end CHARACTERISTIC
/begin CHARACTERISTIC Tlib_isCircInfoPwrRi33Current_VLAN204ControLow_C "" VALUE 0x0072068a Val_Wu16 1 OneToOne 0.0 65535 FORMAT "%8.2" /end CHARACTERISTIC
/begin CHARACTERISTIC Tlib_isCircInfoPwrRi33PowerSupplyVoltage_VLAN204ControLow_C "" VALUE 0x00720a92 Val_Wu8 1 OneToOne 0.0 255.00 FORMAT "%8.2" /end CHARACTERISTIC
/begin CHARACTERISTIC Tlib_isCircInfoPwrRi33CircFaultSts_VLAN204ControLow_C "" VALUE 0x0072068c Val_Wu16 1 OneToOne 0.0 65535 FORMAT "%8.2" /end CHARACTERISTIC
/begin CHARACTERISTIC Tlib_isCircInfoPwrRi33PowerSupplyID_VLAN204ControLow_C "" VALUE 0x0072068e Val_Wu16 1 OneToOne 0.0 65535 FORMAT "%8.2" /end CHARACTERISTIC
/begin CHARACTERISTIC Tlib_isCircInfoDrvRi30ID_VLAN204ControLow_C "" VALUE 0x00720690 Val_Wu16 1 OneToOne 0.0 65535 FORMAT "%8.2" /end CHARACTERISTIC
/begin CHARACTERISTIC Tlib_isCircInfoDrvRi30Current_VLAN204ControLow_C "" VALUE 0x00720692 Val_Wu16 1 OneToOne 0.0 65535 FORMAT "%8.2" /end CHARACTERISTIC
/begin CHARACTERISTIC Tlib_isCircInfoDrvRi30Voltage_VLAN204ControLow_C "" VALUE 0x00720a93 Val_Wu8 1 OneToOne 0.0 255.00 FORMAT "%8.2" /end CHARACTERISTIC
/begin CHARACTERISTIC Tlib_isCircInfoDrvRi30PowerStatus_VLAN204ControLow_C "" VALUE 0x00720a94 Val_Wu8 1 OneToOne 0.0 255.00 FORMAT "%8.2" /end CHARACTERISTIC
/begin CHARACTERISTIC Tlib_isCircInfoPwrRi32PowerSupplyVoltage_VLAN204ControLow_C "" VALUE 0x00720a95 Val_Wu8 1 OneToOne 0.0 255.00 FORMAT "%8.2" /end CHARACTERISTIC
/begin CHARACTERISTIC Tlib_isCircInfoPwrRi32CircFaultSts_VLAN204ControLow_C "" VALUE 0x00720694 Val_Wu16 1 OneToOne 0.0 65535 FORMAT "%8.2" /end CHARACTERISTIC
/begin CHARACTERISTIC Tlib_isCircInfoPwrRi32Current_VLAN204ControLow_C "" VALUE 0x00720696 Val_Wu16 1 OneToOne 0.0 65535 FORMAT "%8.2" /end CHARACTERISTIC
/begin CHARACTERISTIC Tlib_isCircInfoPwrRi32PowerSupplyStatus_VLAN204ControLow_C "" VALUE 0x00720a96 Val_Wu8 1 OneToOne 0.0 255.00 FORMAT "%8.2" /end CHARACTERISTIC
/begin CHARACTERISTIC Tlib_isCircInfoPwrRi32PowerSupplyID_VLAN204ControLow_C "" VALUE 0x00720698 Val_Wu16 1 OneToOne 0.0 65535 FORMAT "%8.2" /end CHARACTERISTIC
/begin CHARACTERISTIC Tlib_isCircInfoDrvRi29Current_VLAN204ControLow_C "" VALUE 0x0072069a Val_Wu16 1 OneToOne 0.0 65535 FORMAT "%8.2" /end CHARACTERISTIC
/begin CHARACTERISTIC Tlib_isCircInfoDrvRi29Voltage_VLAN204ControLow_C "" VALUE 0x00720a97 Val_Wu8 1 OneToOne 0.0 255.00 FORMAT "%8.2" /end CHARACTERISTIC
/begin CHARACTERISTIC Tlib_isCircInfoDrvRi29ID_VLAN204ControLow_C "" VALUE 0x0072069c Val_Wu16 1 OneToOne 0.0 65535 FORMAT "%8.2" /end CHARACTERISTIC
/begin CHARACTERISTIC Tlib_isCircInfoDrvRi29PowerStatus_VLAN204ControLow_C "" VALUE 0x00720a98 Val_Wu8 1 OneToOne 0.0 255.00 FORMAT "%8.2" /end CHARACTERISTIC
/begin CHARACTERISTIC Tlib_isCircInfoPwrRi31PowerSupplyID_VLAN204ControLow_C "" VALUE 0x0072069e Val_Wu16 1 OneToOne 0.0 65535 FORMAT "%8.2" /end CHARACTERISTIC
/begin CHARACTERISTIC Tlib_isCircInfoPwrRi31CircFaultSts_VLAN204ControLow_C "" VALUE 0x007206a0 Val_Wu16 1 OneToOne 0.0 65535 FORMAT "%8.2" /end CHARACTERISTIC
/begin CHARACTERISTIC Tlib_isCircInfoPwrRi31PowerSupplyStatus_VLAN204ControLow_C "" VALUE 0x00720a99 Val_Wu8 1 OneToOne 0.0 255.00 FORMAT "%8.2" /end CHARACTERISTIC
/begin CHARACTERISTIC Tlib_isCircInfoPwrRi31Current_VLAN204ControLow_C "" VALUE 0x007206a2 Val_Wu16 1 OneToOne 0.0 65535 FORMAT "%8.2" /end CHARACTERISTIC
/begin CHARACTERISTIC Tlib_isCircInfoPwrRi31PowerSupplyVoltage_VLAN204ControLow_C "" VALUE 0x00720a9a Val_Wu8 1 OneToOne 0.0 255.00 FORMAT "%8.2" /end CHARACTERISTIC
/begin CHARACTERISTIC Tlib_isCircInfoDrvRi5PowerStatus_VLAN204ControLow_C "" VALUE 0x00720a9b Val_Wu8 1 OneToOne 0.0 255.00 FORMAT "%8.2" /end CHARACTERISTIC
/begin CHARACTERISTIC Tlib_isCircInfoDrvRi5Voltage_VLAN204ControLow_C "" VALUE 0x00720a9c Val_Wu8 1 OneToOne 0.0 255.00 FORMAT "%8.2" /end CHARACTERISTIC
/begin CHARACTERISTIC Tlib_isCircInfoDrvRi5ID_VLAN204ControLow_C "" VALUE 0x007206a4 Val_Wu16 1 OneToOne 0.0 65535 FORMAT "%8.2" /end CHARACTERISTIC
/begin CHARACTERISTIC Tlib_isCircInfoDrvRi5Current_VLAN204ControLow_C "" VALUE 0x007206a6 Val_Wu16 1 OneToOne 0.0 65535 FORMAT "%8.2" /end CHARACTERISTIC
/begin CHARACTERISTIC Tlib_isCircInfoDrvRi28Voltage_VLAN204ControLow_C "" VALUE 0x00720a9d Val_Wu8 1 OneToOne 0.0 255.00 FORMAT "%8.2" /end CHARACTERISTIC
/begin CHARACTERISTIC Tlib_isCircInfoDrvRi28Current_VLAN204ControLow_C "" VALUE 0x007206a8 Val_Wu16 1 OneToOne 0.0 65535 FORMAT "%8.2" /end CHARACTERISTIC
/begin CHARACTERISTIC Tlib_isCircInfoDrvRi28PowerStatus_VLAN204ControLow_C "" VALUE 0x00720a9e Val_Wu8 1 OneToOne 0.0 255.00 FORMAT "%8.2" /end CHARACTERISTIC
/begin CHARACTERISTIC Tlib_isCircInfoDrvRi28ID_VLAN204ControLow_C "" VALUE 0x007206aa Val_Wu16 1 OneToOne 0.0 65535 FORMAT "%8.2" /end CHARACTERISTIC
/begin CHARACTERISTIC Tlib_isCircInfoPwrRi50CircFaultSts_VLAN204ControLow_C "" VALUE 0x007206ac Val_Wu16 1 OneToOne 0.0 65535 FORMAT "%8.2" /end CHARACTERISTIC
/begin CHARACTERISTIC Tlib_isCircInfoPwrRi50PowerSupplyID_VLAN204ControLow_C "" VALUE 0x007206ae Val_Wu16 1 OneToOne 0.0 65535 FORMAT "%8.2" /end CHARACTERISTIC
/begin CHARACTERISTIC Tlib_isCircInfoPwrRi50PowerSupplyVoltage_VLAN204ControLow_C "" VALUE 0x00720a9f Val_Wu8 1 OneToOne 0.0 255.00 FORMAT "%8.2" /end CHARACTERISTIC
/begin CHARACTERISTIC Tlib_isCircInfoPwrRi50PowerSupplyStatus_VLAN204ControLow_C "" VALUE 0x00720aa0 Val_Wu8 1 OneToOne 0.0 255.00 FORMAT "%8.2" /end CHARACTERISTIC
/begin CHARACTERISTIC Tlib_isCircInfoPwrRi50Current_VLAN204ControLow_C "" VALUE 0x007206b0 Val_Wu16 1 OneToOne 0.0 65535 FORMAT "%8.2" /end CHARACTERISTIC
/begin CHARACTERISTIC Tlib_isCircInfoPwrRi11PowerSupplyStatus_VLAN204ControLow_C "" VALUE 0x00720aa1 Val_Wu8 1 OneToOne 0.0 255.00 FORMAT "%8.2" /end CHARACTERISTIC
/begin CHARACTERISTIC Tlib_isCircInfoPwrRi11PowerSupplyVoltage_VLAN204ControLow_C "" VALUE 0x00720aa2 Val_Wu8 1 OneToOne 0.0 255.00 FORMAT "%8.2" /end CHARACTERISTIC
/begin CHARACTERISTIC Tlib_isCircInfoPwrRi11Current_VLAN204ControLow_C "" VALUE 0x007206b2 Val_Wu16 1 OneToOne 0.0 65535 FORMAT "%8.2" /end CHARACTERISTIC
/begin CHARACTERISTIC Tlib_isCircInfoPwrRi11PowerSupplyID_VLAN204ControLow_C "" VALUE 0x007206b4 Val_Wu16 1 OneToOne 0.0 65535 FORMAT "%8.2" /end CHARACTERISTIC
/begin CHARACTERISTIC Tlib_isCircInfoPwrRi11CircFaultSts_VLAN204ControLow_C "" VALUE 0x007206b6 Val_Wu16 1 OneToOne 0.0 65535 FORMAT "%8.2" /end CHARACTERISTIC
/begin CHARACTERISTIC Tlib_isCircInfoDrvRi8Voltage_VLAN204ControLow_C "" VALUE 0x00720aa3 Val_Wu8 1 OneToOne 0.0 255.00 FORMAT "%8.2" /end CHARACTERISTIC
/begin CHARACTERISTIC Tlib_isCircInfoDrvRi8PowerStatus_VLAN204ControLow_C "" VALUE 0x00720aa4 Val_Wu8 1 OneToOne 0.0 255.00 FORMAT "%8.2" /end CHARACTERISTIC
/begin CHARACTERISTIC Tlib_isCircInfoDrvRi8Current_VLAN204ControLow_C "" VALUE 0x007206b8 Val_Wu16 1 OneToOne 0.0 65535 FORMAT "%8.2" /end CHARACTERISTIC
/begin CHARACTERISTIC Tlib_isCircInfoDrvRi8ID_VLAN204ControLow_C "" VALUE 0x007206ba Val_Wu16 1 OneToOne 0.0 65535 FORMAT "%8.2" /end CHARACTERISTIC
/begin CHARACTERISTIC Tlib_isCircInfoPwrRi18Current_VLAN204ControLow_C "" VALUE 0x007206bc Val_Wu16 1 OneToOne 0.0 65535 FORMAT "%8.2" /end CHARACTERISTIC
/begin CHARACTERISTIC Tlib_isCircInfoPwrRi18PowerSupplyID_VLAN204ControLow_C "" VALUE 0x007206be Val_Wu16 1 OneToOne 0.0 65535 FORMAT "%8.2" /end CHARACTERISTIC
/begin CHARACTERISTIC Tlib_isCircInfoPwrRi18CircFaultSts_VLAN204ControLow_C "" VALUE 0x007206c0 Val_Wu16 1 OneToOne 0.0 65535 FORMAT "%8.2" /end CHARACTERISTIC
/begin CHARACTERISTIC Tlib_isCircInfoPwrRi18PowerSupplyVoltage_VLAN204ControLow_C "" VALUE 0x00720aa5 Val_Wu8 1 OneToOne 0.0 255.00 FORMAT "%8.2" /end CHARACTERISTIC
/begin CHARACTERISTIC Tlib_isCircInfoPwrRi18PowerSupplyStatus_VLAN204ControLow_C "" VALUE 0x00720aa6 Val_Wu8 1 OneToOne 0.0 255.00 FORMAT "%8.2" /end CHARACTERISTIC
/begin CHARACTERISTIC Tlib_isCircInfoPwrRi43PowerSupplyStatus_VLAN204ControLow_C "" VALUE 0x00720aa7 Val_Wu8 1 OneToOne 0.0 255.00 FORMAT "%8.2" /end CHARACTERISTIC
/begin CHARACTERISTIC Tlib_isCircInfoPwrRi43PowerSupplyID_VLAN204ControLow_C "" VALUE 0x007206c2 Val_Wu16 1 OneToOne 0.0 65535 FORMAT "%8.2" /end CHARACTERISTIC
/begin CHARACTERISTIC Tlib_isCircInfoPwrRi43Current_VLAN204ControLow_C "" VALUE 0x007206c4 Val_Wu16 1 OneToOne 0.0 65535 FORMAT "%8.2" /end CHARACTERISTIC
/begin CHARACTERISTIC Tlib_isCircInfoPwrRi43CircFaultSts_VLAN204ControLow_C "" VALUE 0x007206c6 Val_Wu16 1 OneToOne 0.0 65535 FORMAT "%8.2" /end CHARACTERISTIC
/begin CHARACTERISTIC Tlib_isCircInfoPwrRi43PowerSupplyVoltage_VLAN204ControLow_C "" VALUE 0x00720aa8 Val_Wu8 1 OneToOne 0.0 255.00 FORMAT "%8.2" /end CHARACTERISTIC
/begin CHARACTERISTIC Tlib_isCircInfoPwrRi4Current_VLAN204ControLow_C "" VALUE 0x007206c8 Val_Wu16 1 OneToOne 0.0 65535 FORMAT "%8.2" /end CHARACTERISTIC
/begin CHARACTERISTIC Tlib_isCircInfoPwrRi4PowerSupplyStatus_VLAN204ControLow_C "" VALUE 0x00720aa9 Val_Wu8 1 OneToOne 0.0 255.00 FORMAT "%8.2" /end CHARACTERISTIC
/begin CHARACTERISTIC Tlib_isCircInfoPwrRi4PowerSupplyVoltage_VLAN204ControLow_C "" VALUE 0x00720aaa Val_Wu8 1 OneToOne 0.0 255.00 FORMAT "%8.2" /end CHARACTERISTIC
/begin CHARACTERISTIC Tlib_isCircInfoPwrRi4PowerSupplyID_VLAN204ControLow_C "" VALUE 0x007206ca Val_Wu16 1 OneToOne 0.0 65535 FORMAT "%8.2" /end CHARACTERISTIC
/begin CHARACTERISTIC Tlib_isCircInfoPwrRi4CircFaultSts_VLAN204ControLow_C "" VALUE 0x007206cc Val_Wu16 1 OneToOne 0.0 65535 FORMAT "%8.2" /end CHARACTERISTIC
/begin CHARACTERISTIC Tlib_isCircInfoPwrRi42CircFaultSts_VLAN204ControLow_C "" VALUE 0x007206ce Val_Wu16 1 OneToOne 0.0 65535 FORMAT "%8.2" /end CHARACTERISTIC
/begin CHARACTERISTIC Tlib_isCircInfoPwrRi42PowerSupplyID_VLAN204ControLow_C "" VALUE 0x007206d0 Val_Wu16 1 OneToOne 0.0 65535 FORMAT "%8.2" /end CHARACTERISTIC
/begin CHARACTERISTIC Tlib_isCircInfoPwrRi42Current_VLAN204ControLow_C "" VALUE 0x007206d2 Val_Wu16 1 OneToOne 0.0 65535 FORMAT "%8.2" /end CHARACTERISTIC
/begin CHARACTERISTIC Tlib_isCircInfoPwrRi42PowerSupplyStatus_VLAN204ControLow_C "" VALUE 0x00720aab Val_Wu8 1 OneToOne 0.0 255.00 FORMAT "%8.2" /end CHARACTERISTIC
/begin CHARACTERISTIC Tlib_isCircInfoPwrRi42PowerSupplyVoltage_VLAN204ControLow_C "" VALUE 0x00720aac Val_Wu8 1 OneToOne 0.0 255.00 FORMAT "%8.2" /end CHARACTERISTIC
/begin CHARACTERISTIC Tlib_isCircInfoPwrRi29Current_VLAN204ControLow_C "" VALUE 0x007206d4 Val_Wu16 1 OneToOne 0.0 65535 FORMAT "%8.2" /end CHARACTERISTIC
/begin CHARACTERISTIC Tlib_isCircInfoPwrRi29PowerSupplyStatus_VLAN204ControLow_C "" VALUE 0x00720aad Val_Wu8 1 OneToOne 0.0 255.00 FORMAT "%8.2" /end CHARACTERISTIC
/begin CHARACTERISTIC Tlib_isCircInfoPwrRi29PowerSupplyVoltage_VLAN204ControLow_C "" VALUE 0x00720aae Val_Wu8 1 OneToOne 0.0 255.00 FORMAT "%8.2" /end CHARACTERISTIC
/begin CHARACTERISTIC Tlib_isCircInfoPwrRi29PowerSupplyID_VLAN204ControLow_C "" VALUE 0x007206d6 Val_Wu16 1 OneToOne 0.0 65535 FORMAT "%8.2" /end CHARACTERISTIC
/begin CHARACTERISTIC Tlib_isCircInfoPwrRi29CircFaultSts_VLAN204ControLow_C "" VALUE 0x007206d8 Val_Wu16 1 OneToOne 0.0 65535 FORMAT "%8.2" /end CHARACTERISTIC
/begin CHARACTERISTIC Tlib_isCircInfoPwrRi47PowerSupplyVoltage_VLAN204ControLow_C "" VALUE 0x00720aaf Val_Wu8 1 OneToOne 0.0 255.00 FORMAT "%8.2" /end CHARACTERISTIC
/begin CHARACTERISTIC Tlib_isCircInfoPwrRi47PowerSupplyStatus_VLAN204ControLow_C "" VALUE 0x00720ab0 Val_Wu8 1 OneToOne 0.0 255.00 FORMAT "%8.2" /end CHARACTERISTIC
/begin CHARACTERISTIC Tlib_isCircInfoPwrRi47Current_VLAN204ControLow_C "" VALUE 0x007206da Val_Wu16 1 OneToOne 0.0 65535 FORMAT "%8.2" /end CHARACTERISTIC
/begin CHARACTERISTIC Tlib_isCircInfoPwrRi47PowerSupplyID_VLAN204ControLow_C "" VALUE 0x007206dc Val_Wu16 1 OneToOne 0.0 65535 FORMAT "%8.2" /end CHARACTERISTIC
/begin CHARACTERISTIC Tlib_isCircInfoPwrRi47CircFaultSts_VLAN204ControLow_C "" VALUE 0x007206de Val_Wu16 1 OneToOne 0.0 65535 FORMAT "%8.2" /end CHARACTERISTIC
/begin CHARACTERISTIC Tlib_isCircInfoDrvRi27Current_VLAN204ControLow_C "" VALUE 0x007206e0 Val_Wu16 1 OneToOne 0.0 65535 FORMAT "%8.2" /end CHARACTERISTIC
/begin CHARACTERISTIC Tlib_isCircInfoDrvRi27ID_VLAN204ControLow_C "" VALUE 0x007206e2 Val_Wu16 1 OneToOne 0.0 65535 FORMAT "%8.2" /end CHARACTERISTIC
/begin CHARACTERISTIC Tlib_isCircInfoDrvRi27PowerStatus_VLAN204ControLow_C "" VALUE 0x00720ab1 Val_Wu8 1 OneToOne 0.0 255.00 FORMAT "%8.2" /end CHARACTERISTIC
/begin CHARACTERISTIC Tlib_isCircInfoDrvRi27Voltage_VLAN204ControLow_C "" VALUE 0x00720ab2 Val_Wu8 1 OneToOne 0.0 255.00 FORMAT "%8.2" /end CHARACTERISTIC
/begin CHARACTERISTIC Tlib_isCircInfoDrvRi11Current_VLAN204ControLow_C "" VALUE 0x007206e4 Val_Wu16 1 OneToOne 0.0 65535 FORMAT "%8.2" /end CHARACTERISTIC
/begin CHARACTERISTIC Tlib_isCircInfoDrvRi11ID_VLAN204ControLow_C "" VALUE 0x007206e6 Val_Wu16 1 OneToOne 0.0 65535 FORMAT "%8.2" /end CHARACTERISTIC
/begin CHARACTERISTIC Tlib_isCircInfoDrvRi11Voltage_VLAN204ControLow_C "" VALUE 0x00720ab3 Val_Wu8 1 OneToOne 0.0 255.00 FORMAT "%8.2" /end CHARACTERISTIC
/begin CHARACTERISTIC Tlib_isCircInfoDrvRi11PowerStatus_VLAN204ControLow_C "" VALUE 0x00720ab4 Val_Wu8 1 OneToOne 0.0 255.00 FORMAT "%8.2" /end CHARACTERISTIC
/begin CHARACTERISTIC Tlib_isCircInfoPwrRi51PowerSupplyID_VLAN204ControLow_C "" VALUE 0x007206e8 Val_Wu16 1 OneToOne 0.0 65535 FORMAT "%8.2" /end CHARACTERISTIC
/begin CHARACTERISTIC Tlib_isCircInfoPwrRi51PowerSupplyVoltage_VLAN204ControLow_C "" VALUE 0x00720ab5 Val_Wu8 1 OneToOne 0.0 255.00 FORMAT "%8.2" /end CHARACTERISTIC
/begin CHARACTERISTIC Tlib_isCircInfoPwrRi51CircFaultSts_VLAN204ControLow_C "" VALUE 0x007206ea Val_Wu16 1 OneToOne 0.0 65535 FORMAT "%8.2" /end CHARACTERISTIC
/begin CHARACTERISTIC Tlib_isCircInfoPwrRi51PowerSupplyStatus_VLAN204ControLow_C "" VALUE 0x00720ab6 Val_Wu8 1 OneToOne 0.0 255.00 FORMAT "%8.2" /end CHARACTERISTIC
/begin CHARACTERISTIC Tlib_isCircInfoPwrRi51Current_VLAN204ControLow_C "" VALUE 0x007206ec Val_Wu16 1 OneToOne 0.0 65535 FORMAT "%8.2" /end CHARACTERISTIC
/begin CHARACTERISTIC Tlib_isCircInfoPwrRi5Current_VLAN204ControLow_C "" VALUE 0x007206ee Val_Wu16 1 OneToOne 0.0 65535 FORMAT "%8.2" /end CHARACTERISTIC
/begin CHARACTERISTIC Tlib_isCircInfoPwrRi5PowerSupplyStatus_VLAN204ControLow_C "" VALUE 0x00720ab7 Val_Wu8 1 OneToOne 0.0 255.00 FORMAT "%8.2" /end CHARACTERISTIC
/begin CHARACTERISTIC Tlib_isCircInfoPwrRi5CircFaultSts_VLAN204ControLow_C "" VALUE 0x007206f0 Val_Wu16 1 OneToOne 0.0 65535 FORMAT "%8.2" /end CHARACTERISTIC
/begin CHARACTERISTIC Tlib_isCircInfoPwrRi5PowerSupplyVoltage_VLAN204ControLow_C "" VALUE 0x00720ab8 Val_Wu8 1 OneToOne 0.0 255.00 FORMAT "%8.2" /end CHARACTERISTIC
/begin CHARACTERISTIC Tlib_isCircInfoPwrRi5PowerSupplyID_VLAN204ControLow_C "" VALUE 0x007206f2 Val_Wu16 1 OneToOne 0.0 65535 FORMAT "%8.2" /end CHARACTERISTIC
/begin CHARACTERISTIC Tlib_isCircInfoDrvRi17Current_VLAN204ControLow_C "" VALUE 0x007206f4 Val_Wu16 1 OneToOne 0.0 65535 FORMAT "%8.2" /end CHARACTERISTIC
/begin CHARACTERISTIC Tlib_isCircInfoDrvRi17ID_VLAN204ControLow_C "" VALUE 0x007206f6 Val_Wu16 1 OneToOne 0.0 65535 FORMAT "%8.2" /end CHARACTERISTIC
/begin CHARACTERISTIC Tlib_isCircInfoDrvRi17Voltage_VLAN204ControLow_C "" VALUE 0x00720ab9 Val_Wu8 1 OneToOne 0.0 255.00 FORMAT "%8.2" /end CHARACTERISTIC
/begin CHARACTERISTIC Tlib_isCircInfoDrvRi17PowerStatus_VLAN204ControLow_C "" VALUE 0x00720aba Val_Wu8 1 OneToOne 0.0 255.00 FORMAT "%8.2" /end CHARACTERISTIC
/begin CHARACTERISTIC Tlib_isCircInfoDrvRi22Voltage_VLAN204ControLow_C "" VALUE 0x00720abb Val_Wu8 1 OneToOne 0.0 255.00 FORMAT "%8.2" /end CHARACTERISTIC
/begin CHARACTERISTIC Tlib_isCircInfoDrvRi22Current_VLAN204ControLow_C "" VALUE 0x007206f8 Val_Wu16 1 OneToOne 0.0 65535 FORMAT "%8.2" /end CHARACTERISTIC
/begin CHARACTERISTIC Tlib_isCircInfoDrvRi22ID_VLAN204ControLow_C "" VALUE 0x007206fa Val_Wu16 1 OneToOne 0.0 65535 FORMAT "%8.2" /end CHARACTERISTIC
/begin CHARACTERISTIC Tlib_isCircInfoDrvRi22PowerStatus_VLAN204ControLow_C "" VALUE 0x00720abc Val_Wu8 1 OneToOne 0.0 255.00 FORMAT "%8.2" /end CHARACTERISTIC
/begin CHARACTERISTIC Tlib_isCircInfoDrvRi40Voltage_VLAN204ControLow_C "" VALUE 0x00720abd Val_Wu8 1 OneToOne 0.0 255.00 FORMAT "%8.2" /end CHARACTERISTIC
/begin CHARACTERISTIC Tlib_isCircInfoDrvRi40Current_VLAN204ControLow_C "" VALUE 0x007206fc Val_Wu16 1 OneToOne 0.0 65535 FORMAT "%8.2" /end CHARACTERISTIC
/begin CHARACTERISTIC Tlib_isCircInfoDrvRi40PowerStatus_VLAN204ControLow_C "" VALUE 0x00720abe Val_Wu8 1 OneToOne 0.0 255.00 FORMAT "%8.2" /end CHARACTERISTIC
/begin CHARACTERISTIC Tlib_isCircInfoDrvRi40ID_VLAN204ControLow_C "" VALUE 0x007206fe Val_Wu16 1 OneToOne 0.0 65535 FORMAT "%8.2" /end CHARACTERISTIC
/begin CHARACTERISTIC Tlib_isCircInfoPwrRi12PowerSupplyID_VLAN204ControLow_C "" VALUE 0x00720700 Val_Wu16 1 OneToOne 0.0 65535 FORMAT "%8.2" /end CHARACTERISTIC
/begin CHARACTERISTIC Tlib_isCircInfoPwrRi12PowerSupplyVoltage_VLAN204ControLow_C "" VALUE 0x00720abf Val_Wu8 1 OneToOne 0.0 255.00 FORMAT "%8.2" /end CHARACTERISTIC
/begin CHARACTERISTIC Tlib_isCircInfoPwrRi12Current_VLAN204ControLow_C "" VALUE 0x00720702 Val_Wu16 1 OneToOne 0.0 65535 FORMAT "%8.2" /end CHARACTERISTIC
/begin CHARACTERISTIC Tlib_isCircInfoPwrRi12CircFaultSts_VLAN204ControLow_C "" VALUE 0x00720704 Val_Wu16 1 OneToOne 0.0 65535 FORMAT "%8.2" /end CHARACTERISTIC
/begin CHARACTERISTIC Tlib_isCircInfoPwrRi12PowerSupplyStatus_VLAN204ControLow_C "" VALUE 0x00720ac0 Val_Wu8 1 OneToOne 0.0 255.00 FORMAT "%8.2" /end CHARACTERISTIC
/begin CHARACTERISTIC Tlib_isCircInfoPwrRi41PowerSupplyVoltage_VLAN204ControLow_C "" VALUE 0x00720ac1 Val_Wu8 1 OneToOne 0.0 255.00 FORMAT "%8.2" /end CHARACTERISTIC
/begin CHARACTERISTIC Tlib_isCircInfoPwrRi41PowerSupplyStatus_VLAN204ControLow_C "" VALUE 0x00720ac2 Val_Wu8 1 OneToOne 0.0 255.00 FORMAT "%8.2" /end CHARACTERISTIC
/begin CHARACTERISTIC Tlib_isCircInfoPwrRi41CircFaultSts_VLAN204ControLow_C "" VALUE 0x00720706 Val_Wu16 1 OneToOne 0.0 65535 FORMAT "%8.2" /end CHARACTERISTIC
/begin CHARACTERISTIC Tlib_isCircInfoPwrRi41PowerSupplyID_VLAN204ControLow_C "" VALUE 0x00720708 Val_Wu16 1 OneToOne 0.0 65535 FORMAT "%8.2" /end CHARACTERISTIC
/begin CHARACTERISTIC Tlib_isCircInfoPwrRi41Current_VLAN204ControLow_C "" VALUE 0x0072070a Val_Wu16 1 OneToOne 0.0 65535 FORMAT "%8.2" /end CHARACTERISTIC
/begin CHARACTERISTIC Tlib_isSecGrlAutoCalibReq_VLAN204ControLow_C "" VALUE 0x00720ac3 Val_Wu8 1 OneToOne 0.0 255.00 FORMAT "%8.2" /end CHARACTERISTIC
/begin CHARACTERISTIC Tlib_isCircInfoPwrRi1PowerSupplyID_VLAN204ControLow_C "" VALUE 0x0072070c Val_Wu16 1 OneToOne 0.0 65535 FORMAT "%8.2" /end CHARACTERISTIC
/begin CHARACTERISTIC Tlib_isCircInfoPwrRi1PowerSupplyStatus_VLAN204ControLow_C "" VALUE 0x00720ac4 Val_Wu8 1 OneToOne 0.0 255.00 FORMAT "%8.2" /end CHARACTERISTIC
/begin CHARACTERISTIC Tlib_isCircInfoPwrRi1Current_VLAN204ControLow_C "" VALUE 0x0072070e Val_Wu16 1 OneToOne 0.0 65535 FORMAT "%8.2" /end CHARACTERISTIC
/begin CHARACTERISTIC Tlib_isCircInfoPwrRi1CircFaultSts_VLAN204ControLow_C "" VALUE 0x00720710 Val_Wu16 1 OneToOne 0.0 65535 FORMAT "%8.2" /end CHARACTERISTIC
/begin CHARACTERISTIC Tlib_isCircInfoPwrRi1PowerSupplyVoltage_VLAN204ControLow_C "" VALUE 0x00720ac5 Val_Wu8 1 OneToOne 0.0 255.00 FORMAT "%8.2" /end CHARACTERISTIC
/begin CHARACTERISTIC Tlib_isCircInfoDrvRi15ID_VLAN204ControLow_C "" VALUE 0x00720712 Val_Wu16 1 OneToOne 0.0 65535 FORMAT "%8.2" /end CHARACTERISTIC
/begin CHARACTERISTIC Tlib_isCircInfoDrvRi15Voltage_VLAN204ControLow_C "" VALUE 0x00720ac6 Val_Wu8 1 OneToOne 0.0 255.00 FORMAT "%8.2" /end CHARACTERISTIC
/begin CHARACTERISTIC Tlib_isCircInfoDrvRi15Current_VLAN204ControLow_C "" VALUE 0x00720714 Val_Wu16 1 OneToOne 0.0 65535 FORMAT "%8.2" /end CHARACTERISTIC
/begin CHARACTERISTIC Tlib_isCircInfoDrvRi15PowerStatus_VLAN204ControLow_C "" VALUE 0x00720ac7 Val_Wu8 1 OneToOne 0.0 255.00 FORMAT "%8.2" /end CHARACTERISTIC
/begin CHARACTERISTIC Tlib_isCircInfoPwrRi13Current_VLAN204ControLow_C "" VALUE 0x00720716 Val_Wu16 1 OneToOne 0.0 65535 FORMAT "%8.2" /end CHARACTERISTIC
/begin CHARACTERISTIC Tlib_isCircInfoPwrRi13PowerSupplyID_VLAN204ControLow_C "" VALUE 0x00720718 Val_Wu16 1 OneToOne 0.0 65535 FORMAT "%8.2" /end CHARACTERISTIC
/begin CHARACTERISTIC Tlib_isCircInfoPwrRi13PowerSupplyVoltage_VLAN204ControLow_C "" VALUE 0x00720ac8 Val_Wu8 1 OneToOne 0.0 255.00 FORMAT "%8.2" /end CHARACTERISTIC
/begin CHARACTERISTIC Tlib_isCircInfoPwrRi13PowerSupplyStatus_VLAN204ControLow_C "" VALUE 0x00720ac9 Val_Wu8 1 OneToOne 0.0 255.00 FORMAT "%8.2" /end CHARACTERISTIC
/begin CHARACTERISTIC Tlib_isCircInfoPwrRi13CircFaultSts_VLAN204ControLow_C "" VALUE 0x0072071a Val_Wu16 1 OneToOne 0.0 65535 FORMAT "%8.2" /end CHARACTERISTIC
/begin CHARACTERISTIC Tlib_isCircInfoDrvRi32Current_VLAN204ControLow_C "" VALUE 0x0072071c Val_Wu16 1 OneToOne 0.0 65535 FORMAT "%8.2" /end CHARACTERISTIC
/begin CHARACTERISTIC Tlib_isCircInfoDrvRi32ID_VLAN204ControLow_C "" VALUE 0x0072071e Val_Wu16 1 OneToOne 0.0 65535 FORMAT "%8.2" /end CHARACTERISTIC
/begin CHARACTERISTIC Tlib_isCircInfoDrvRi32PowerStatus_VLAN204ControLow_C "" VALUE 0x00720aca Val_Wu8 1 OneToOne 0.0 255.00 FORMAT "%8.2" /end CHARACTERISTIC
/begin CHARACTERISTIC Tlib_isCircInfoDrvRi32Voltage_VLAN204ControLow_C "" VALUE 0x00720acb Val_Wu8 1 OneToOne 0.0 255.00 FORMAT "%8.2" /end CHARACTERISTIC
/begin CHARACTERISTIC Tlib_isCircInfoPwrRi44CircFaultSts_VLAN204ControLow_C "" VALUE 0x00720720 Val_Wu16 1 OneToOne 0.0 65535 FORMAT "%8.2" /end CHARACTERISTIC
/begin CHARACTERISTIC Tlib_isCircInfoPwrRi44PowerSupplyStatus_VLAN204ControLow_C "" VALUE 0x00720acc Val_Wu8 1 OneToOne 0.0 255.00 FORMAT "%8.2" /end CHARACTERISTIC
/begin CHARACTERISTIC Tlib_isCircInfoPwrRi44PowerSupplyID_VLAN204ControLow_C "" VALUE 0x00720722 Val_Wu16 1 OneToOne 0.0 65535 FORMAT "%8.2" /end CHARACTERISTIC
/begin CHARACTERISTIC Tlib_isCircInfoPwrRi44PowerSupplyVoltage_VLAN204ControLow_C "" VALUE 0x00720acd Val_Wu8 1 OneToOne 0.0 255.00 FORMAT "%8.2" /end CHARACTERISTIC
/begin CHARACTERISTIC Tlib_isCircInfoPwrRi44Current_VLAN204ControLow_C "" VALUE 0x00720724 Val_Wu16 1 OneToOne 0.0 65535 FORMAT "%8.2" /end CHARACTERISTIC
/begin CHARACTERISTIC Tlib_isCircInfoPwrRi56CircFaultSts_VLAN204ControLow_C "" VALUE 0x00720726 Val_Wu16 1 OneToOne 0.0 65535 FORMAT "%8.2" /end CHARACTERISTIC
/begin CHARACTERISTIC Tlib_isCircInfoPwrRi56PowerSupplyVoltage_VLAN204ControLow_C "" VALUE 0x00720ace Val_Wu8 1 OneToOne 0.0 255.00 FORMAT "%8.2" /end CHARACTERISTIC
/begin CHARACTERISTIC Tlib_isCircInfoPwrRi56Current_VLAN204ControLow_C "" VALUE 0x00720728 Val_Wu16 1 OneToOne 0.0 65535 FORMAT "%8.2" /end CHARACTERISTIC
/begin CHARACTERISTIC Tlib_isCircInfoPwrRi56PowerSupplyStatus_VLAN204ControLow_C "" VALUE 0x00720acf Val_Wu8 1 OneToOne 0.0 255.00 FORMAT "%8.2" /end CHARACTERISTIC
/begin CHARACTERISTIC Tlib_isCircInfoPwrRi56PowerSupplyID_VLAN204ControLow_C "" VALUE 0x0072072a Val_Wu16 1 OneToOne 0.0 65535 FORMAT "%8.2" /end CHARACTERISTIC
/begin CHARACTERISTIC Tlib_isCircInfoPwrRi59CircFaultSts_VLAN204ControLow_C "" VALUE 0x0072072c Val_Wu16 1 OneToOne 0.0 65535 FORMAT "%8.2" /end CHARACTERISTIC
/begin CHARACTERISTIC Tlib_isCircInfoPwrRi59PowerSupplyID_VLAN204ControLow_C "" VALUE 0x0072072e Val_Wu16 1 OneToOne 0.0 65535 FORMAT "%8.2" /end CHARACTERISTIC
/begin CHARACTERISTIC Tlib_isCircInfoPwrRi59PowerSupplyStatus_VLAN204ControLow_C "" VALUE 0x00720ad0 Val_Wu8 1 OneToOne 0.0 255.00 FORMAT "%8.2" /end CHARACTERISTIC
/begin CHARACTERISTIC Tlib_isCircInfoPwrRi59Current_VLAN204ControLow_C "" VALUE 0x00720730 Val_Wu16 1 OneToOne 0.0 65535 FORMAT "%8.2" /end CHARACTERISTIC
/begin CHARACTERISTIC Tlib_isCircInfoPwrRi59PowerSupplyVoltage_VLAN204ControLow_C "" VALUE 0x00720ad1 Val_Wu8 1 OneToOne 0.0 255.00 FORMAT "%8.2" /end CHARACTERISTIC
/begin CHARACTERISTIC Tlib_isCircInfoPwrRi34Current_VLAN204ControLow_C "" VALUE 0x00720732 Val_Wu16 1 OneToOne 0.0 65535 FORMAT "%8.2" /end CHARACTERISTIC
/begin CHARACTERISTIC Tlib_isCircInfoPwrRi34CircFaultSts_VLAN204ControLow_C "" VALUE 0x00720734 Val_Wu16 1 OneToOne 0.0 65535 FORMAT "%8.2" /end CHARACTERISTIC
/begin CHARACTERISTIC Tlib_isCircInfoPwrRi34PowerSupplyStatus_VLAN204ControLow_C "" VALUE 0x00720ad2 Val_Wu8 1 OneToOne 0.0 255.00 FORMAT "%8.2" /end CHARACTERISTIC
/begin CHARACTERISTIC Tlib_isCircInfoPwrRi34PowerSupplyID_VLAN204ControLow_C "" VALUE 0x00720736 Val_Wu16 1 OneToOne 0.0 65535 FORMAT "%8.2" /end CHARACTERISTIC
/begin CHARACTERISTIC Tlib_isCircInfoPwrRi34PowerSupplyVoltage_VLAN204ControLow_C "" VALUE 0x00720ad3 Val_Wu8 1 OneToOne 0.0 255.00 FORMAT "%8.2" /end CHARACTERISTIC
/begin CHARACTERISTIC Tlib_isCircInfoPwrRi60PowerSupplyVoltage_VLAN204ControLow_C "" VALUE 0x00720ad4 Val_Wu8 1 OneToOne 0.0 255.00 FORMAT "%8.2" /end CHARACTERISTIC
/begin CHARACTERISTIC Tlib_isCircInfoPwrRi60PowerSupplyID_VLAN204ControLow_C "" VALUE 0x00720738 Val_Wu16 1 OneToOne 0.0 65535 FORMAT "%8.2" /end CHARACTERISTIC
/begin CHARACTERISTIC Tlib_isCircInfoPwrRi60CircFaultSts_VLAN204ControLow_C "" VALUE 0x0072073a Val_Wu16 1 OneToOne 0.0 65535 FORMAT "%8.2" /end CHARACTERISTIC
/begin CHARACTERISTIC Tlib_isCircInfoPwrRi60Current_VLAN204ControLow_C "" VALUE 0x0072073c Val_Wu16 1 OneToOne 0.0 65535 FORMAT "%8.2" /end CHARACTERISTIC
/begin CHARACTERISTIC Tlib_isCircInfoPwrRi60PowerSupplyStatus_VLAN204ControLow_C "" VALUE 0x00720ad5 Val_Wu8 1 OneToOne 0.0 255.00 FORMAT "%8.2" /end CHARACTERISTIC
/begin CHARACTERISTIC Tlib_isCircInfoPwrRi24PowerSupplyVoltage_VLAN204ControLow_C "" VALUE 0x00720ad6 Val_Wu8 1 OneToOne 0.0 255.00 FORMAT "%8.2" /end CHARACTERISTIC
/begin CHARACTERISTIC Tlib_isCircInfoPwrRi24CircFaultSts_VLAN204ControLow_C "" VALUE 0x0072073e Val_Wu16 1 OneToOne 0.0 65535 FORMAT "%8.2" /end CHARACTERISTIC
/begin CHARACTERISTIC Tlib_isCircInfoPwrRi24Current_VLAN204ControLow_C "" VALUE 0x00720740 Val_Wu16 1 OneToOne 0.0 65535 FORMAT "%8.2" /end CHARACTERISTIC
/begin CHARACTERISTIC Tlib_isCircInfoPwrRi24PowerSupplyStatus_VLAN204ControLow_C "" VALUE 0x00720ad7 Val_Wu8 1 OneToOne 0.0 255.00 FORMAT "%8.2" /end CHARACTERISTIC
/begin CHARACTERISTIC Tlib_isCircInfoPwrRi24PowerSupplyID_VLAN204ControLow_C "" VALUE 0x00720742 Val_Wu16 1 OneToOne 0.0 65535 FORMAT "%8.2" /end CHARACTERISTIC
/begin CHARACTERISTIC Tlib_isCircInfoPwrRi52PowerSupplyVoltage_VLAN204ControLow_C "" VALUE 0x00720ad8 Val_Wu8 1 OneToOne 0.0 255.00 FORMAT "%8.2" /end CHARACTERISTIC
/begin CHARACTERISTIC Tlib_isCircInfoPwrRi52Current_VLAN204ControLow_C "" VALUE 0x00720744 Val_Wu16 1 OneToOne 0.0 65535 FORMAT "%8.2" /end CHARACTERISTIC
/begin CHARACTERISTIC Tlib_isCircInfoPwrRi52PowerSupplyID_VLAN204ControLow_C "" VALUE 0x00720746 Val_Wu16 1 OneToOne 0.0 65535 FORMAT "%8.2" /end CHARACTERISTIC
/begin CHARACTERISTIC Tlib_isCircInfoPwrRi52PowerSupplyStatus_VLAN204ControLow_C "" VALUE 0x00720ad9 Val_Wu8 1 OneToOne 0.0 255.00 FORMAT "%8.2" /end CHARACTERISTIC
/begin CHARACTERISTIC Tlib_isCircInfoPwrRi52CircFaultSts_VLAN204ControLow_C "" VALUE 0x00720748 Val_Wu16 1 OneToOne 0.0 65535 FORMAT "%8.2" /end CHARACTERISTIC
/begin CHARACTERISTIC Tlib_isCircInfoDrvRi23PowerStatus_VLAN204ControLow_C "" VALUE 0x00720ada Val_Wu8 1 OneToOne 0.0 255.00 FORMAT "%8.2" /end CHARACTERISTIC
/begin CHARACTERISTIC Tlib_isCircInfoDrvRi23ID_VLAN204ControLow_C "" VALUE 0x0072074a Val_Wu16 1 OneToOne 0.0 65535 FORMAT "%8.2" /end CHARACTERISTIC
/begin CHARACTERISTIC Tlib_isCircInfoDrvRi23Current_VLAN204ControLow_C "" VALUE 0x0072074c Val_Wu16 1 OneToOne 0.0 65535 FORMAT "%8.2" /end CHARACTERISTIC
/begin CHARACTERISTIC Tlib_isCircInfoDrvRi23Voltage_VLAN204ControLow_C "" VALUE 0x00720adb Val_Wu8 1 OneToOne 0.0 255.00 FORMAT "%8.2" /end CHARACTERISTIC
/begin CHARACTERISTIC Tlib_isCircInfoDrvRi9Voltage_VLAN204ControLow_C "" VALUE 0x00720adc Val_Wu8 1 OneToOne 0.0 255.00 FORMAT "%8.2" /end CHARACTERISTIC
/begin CHARACTERISTIC Tlib_isCircInfoDrvRi9ID_VLAN204ControLow_C "" VALUE 0x0072074e Val_Wu16 1 OneToOne 0.0 65535 FORMAT "%8.2" /end CHARACTERISTIC
/begin CHARACTERISTIC Tlib_isCircInfoDrvRi9PowerStatus_VLAN204ControLow_C "" VALUE 0x00720add Val_Wu8 1 OneToOne 0.0 255.00 FORMAT "%8.2" /end CHARACTERISTIC
/begin CHARACTERISTIC Tlib_isCircInfoDrvRi9Current_VLAN204ControLow_C "" VALUE 0x00720750 Val_Wu16 1 OneToOne 0.0 65535 FORMAT "%8.2" /end CHARACTERISTIC
/begin CHARACTERISTIC Tlib_isCircInfoDrvRi37ID_VLAN204ControLow_C "" VALUE 0x00720752 Val_Wu16 1 OneToOne 0.0 65535 FORMAT "%8.2" /end CHARACTERISTIC
/begin CHARACTERISTIC Tlib_isCircInfoDrvRi37Current_VLAN204ControLow_C "" VALUE 0x00720754 Val_Wu16 1 OneToOne 0.0 65535 FORMAT "%8.2" /end CHARACTERISTIC
/begin CHARACTERISTIC Tlib_isCircInfoDrvRi37PowerStatus_VLAN204ControLow_C "" VALUE 0x00720ade Val_Wu8 1 OneToOne 0.0 255.00 FORMAT "%8.2" /end CHARACTERISTIC
/begin CHARACTERISTIC Tlib_isCircInfoDrvRi37Voltage_VLAN204ControLow_C "" VALUE 0x00720adf Val_Wu8 1 OneToOne 0.0 255.00 FORMAT "%8.2" /end CHARACTERISTIC
/begin CHARACTERISTIC Tlib_isCircInfoDrvRi3Voltage_VLAN204ControLow_C "" VALUE 0x00720ae0 Val_Wu8 1 OneToOne 0.0 255.00 FORMAT "%8.2" /end CHARACTERISTIC
/begin CHARACTERISTIC Tlib_isCircInfoDrvRi3Current_VLAN204ControLow_C "" VALUE 0x00720756 Val_Wu16 1 OneToOne 0.0 65535 FORMAT "%8.2" /end CHARACTERISTIC
/begin CHARACTERISTIC Tlib_isCircInfoDrvRi3ID_VLAN204ControLow_C "" VALUE 0x00720758 Val_Wu16 1 OneToOne 0.0 65535 FORMAT "%8.2" /end CHARACTERISTIC
/begin CHARACTERISTIC Tlib_isCircInfoDrvRi3PowerStatus_VLAN204ControLow_C "" VALUE 0x00720ae1 Val_Wu8 1 OneToOne 0.0 255.00 FORMAT "%8.2" /end CHARACTERISTIC
/begin CHARACTERISTIC Tlib_isCircInfoDrvRi25Current_VLAN204ControLow_C "" VALUE 0x0072075a Val_Wu16 1 OneToOne 0.0 65535 FORMAT "%8.2" /end CHARACTERISTIC
/begin CHARACTERISTIC Tlib_isCircInfoDrvRi25ID_VLAN204ControLow_C "" VALUE 0x0072075c Val_Wu16 1 OneToOne 0.0 65535 FORMAT "%8.2" /end CHARACTERISTIC
/begin CHARACTERISTIC Tlib_isCircInfoDrvRi25Voltage_VLAN204ControLow_C "" VALUE 0x00720ae2 Val_Wu8 1 OneToOne 0.0 255.00 FORMAT "%8.2" /end CHARACTERISTIC
/begin CHARACTERISTIC Tlib_isCircInfoDrvRi25PowerStatus_VLAN204ControLow_C "" VALUE 0x00720ae3 Val_Wu8 1 OneToOne 0.0 255.00 FORMAT "%8.2" /end CHARACTERISTIC
/begin CHARACTERISTIC Tlib_isCircInfoPwrRi49PowerSupplyID_VLAN204ControLow_C "" VALUE 0x0072075e Val_Wu16 1 OneToOne 0.0 65535 FORMAT "%8.2" /end CHARACTERISTIC
/begin CHARACTERISTIC Tlib_isCircInfoPwrRi49PowerSupplyVoltage_VLAN204ControLow_C "" VALUE 0x00720ae4 Val_Wu8 1 OneToOne 0.0 255.00 FORMAT "%8.2" /end CHARACTERISTIC
/begin CHARACTERISTIC Tlib_isCircInfoPwrRi49Current_VLAN204ControLow_C "" VALUE 0x00720760 Val_Wu16 1 OneToOne 0.0 65535 FORMAT "%8.2" /end CHARACTERISTIC
/begin CHARACTERISTIC Tlib_isCircInfoPwrRi49CircFaultSts_VLAN204ControLow_C "" VALUE 0x00720762 Val_Wu16 1 OneToOne 0.0 65535 FORMAT "%8.2" /end CHARACTERISTIC
/begin CHARACTERISTIC Tlib_isCircInfoPwrRi49PowerSupplyStatus_VLAN204ControLow_C "" VALUE 0x00720ae5 Val_Wu8 1 OneToOne 0.0 255.00 FORMAT "%8.2" /end CHARACTERISTIC
/begin CHARACTERISTIC Tlib_isCircInfoPwrRi28Current_VLAN204ControLow_C "" VALUE 0x00720764 Val_Wu16 1 OneToOne 0.0 65535 FORMAT "%8.2" /end CHARACTERISTIC
/begin CHARACTERISTIC Tlib_isCircInfoPwrRi28PowerSupplyStatus_VLAN204ControLow_C "" VALUE 0x00720ae6 Val_Wu8 1 OneToOne 0.0 255.00 FORMAT "%8.2" /end CHARACTERISTIC
/begin CHARACTERISTIC Tlib_isCircInfoPwrRi28PowerSupplyID_VLAN204ControLow_C "" VALUE 0x00720766 Val_Wu16 1 OneToOne 0.0 65535 FORMAT "%8.2" /end CHARACTERISTIC
/begin CHARACTERISTIC Tlib_isCircInfoPwrRi28CircFaultSts_VLAN204ControLow_C "" VALUE 0x00720768 Val_Wu16 1 OneToOne 0.0 65535 FORMAT "%8.2" /end CHARACTERISTIC
/begin CHARACTERISTIC Tlib_isCircInfoPwrRi28PowerSupplyVoltage_VLAN204ControLow_C "" VALUE 0x00720ae7 Val_Wu8 1 OneToOne 0.0 255.00 FORMAT "%8.2" /end CHARACTERISTIC
/begin CHARACTERISTIC Tlib_isCircInfoDrvRi10Current_VLAN204ControLow_C "" VALUE 0x0072076a Val_Wu16 1 OneToOne 0.0 65535 FORMAT "%8.2" /end CHARACTERISTIC
/begin CHARACTERISTIC Tlib_isCircInfoDrvRi10ID_VLAN204ControLow_C "" VALUE 0x0072076c Val_Wu16 1 OneToOne 0.0 65535 FORMAT "%8.2" /end CHARACTERISTIC
/begin CHARACTERISTIC Tlib_isCircInfoDrvRi10PowerStatus_VLAN204ControLow_C "" VALUE 0x00720ae8 Val_Wu8 1 OneToOne 0.0 255.00 FORMAT "%8.2" /end CHARACTERISTIC
/begin CHARACTERISTIC Tlib_isCircInfoDrvRi10Voltage_VLAN204ControLow_C "" VALUE 0x00720ae9 Val_Wu8 1 OneToOne 0.0 255.00 FORMAT "%8.2" /end CHARACTERISTIC
/begin CHARACTERISTIC Tlib_isCircInfoDrvRi34Current_VLAN204ControLow_C "" VALUE 0x0072076e Val_Wu16 1 OneToOne 0.0 65535 FORMAT "%8.2" /end CHARACTERISTIC
/begin CHARACTERISTIC Tlib_isCircInfoDrvRi34Voltage_VLAN204ControLow_C "" VALUE 0x00720aea Val_Wu8 1 OneToOne 0.0 255.00 FORMAT "%8.2" /end CHARACTERISTIC
/begin CHARACTERISTIC Tlib_isCircInfoDrvRi34ID_VLAN204ControLow_C "" VALUE 0x00720770 Val_Wu16 1 OneToOne 0.0 65535 FORMAT "%8.2" /end CHARACTERISTIC
/begin CHARACTERISTIC Tlib_isCircInfoDrvRi34PowerStatus_VLAN204ControLow_C "" VALUE 0x00720aeb Val_Wu8 1 OneToOne 0.0 255.00 FORMAT "%8.2" /end CHARACTERISTIC
/begin CHARACTERISTIC Tlib_isCircInfoDrvRi12Current_VLAN204ControLow_C "" VALUE 0x00720772 Val_Wu16 1 OneToOne 0.0 65535 FORMAT "%8.2" /end CHARACTERISTIC
/begin CHARACTERISTIC Tlib_isCircInfoDrvRi12ID_VLAN204ControLow_C "" VALUE 0x00720774 Val_Wu16 1 OneToOne 0.0 65535 FORMAT "%8.2" /end CHARACTERISTIC
/begin CHARACTERISTIC Tlib_isCircInfoDrvRi12PowerStatus_VLAN204ControLow_C "" VALUE 0x00720aec Val_Wu8 1 OneToOne 0.0 255.00 FORMAT "%8.2" /end CHARACTERISTIC
/begin CHARACTERISTIC Tlib_isCircInfoDrvRi12Voltage_VLAN204ControLow_C "" VALUE 0x00720aed Val_Wu8 1 OneToOne 0.0 255.00 FORMAT "%8.2" /end CHARACTERISTIC
/begin CHARACTERISTIC Tlib_isCircInfoPwrRi57PowerSupplyID_VLAN204ControLow_C "" VALUE 0x00720776 Val_Wu16 1 OneToOne 0.0 65535 FORMAT "%8.2" /end CHARACTERISTIC
/begin CHARACTERISTIC Tlib_isCircInfoPwrRi57PowerSupplyStatus_VLAN204ControLow_C "" VALUE 0x00720aee Val_Wu8 1 OneToOne 0.0 255.00 FORMAT "%8.2" /end CHARACTERISTIC
/begin CHARACTERISTIC Tlib_isCircInfoPwrRi57PowerSupplyVoltage_VLAN204ControLow_C "" VALUE 0x00720aef Val_Wu8 1 OneToOne 0.0 255.00 FORMAT "%8.2" /end CHARACTERISTIC
/begin CHARACTERISTIC Tlib_isCircInfoPwrRi57Current_VLAN204ControLow_C "" VALUE 0x00720778 Val_Wu16 1 OneToOne 0.0 65535 FORMAT "%8.2" /end CHARACTERISTIC
/begin CHARACTERISTIC Tlib_isCircInfoPwrRi57CircFaultSts_VLAN204ControLow_C "" VALUE 0x0072077a Val_Wu16 1 OneToOne 0.0 65535 FORMAT "%8.2" /end CHARACTERISTIC
/begin CHARACTERISTIC Tlib_isCircInfoPwrRi6PowerSupplyVoltage_VLAN204ControLow_C "" VALUE 0x00720af0 Val_Wu8 1 OneToOne 0.0 255.00 FORMAT "%8.2" /end CHARACTERISTIC
/begin CHARACTERISTIC Tlib_isCircInfoPwrRi6PowerSupplyStatus_VLAN204ControLow_C "" VALUE 0x00720af1 Val_Wu8 1 OneToOne 0.0 255.00 FORMAT "%8.2" /end CHARACTERISTIC
/begin CHARACTERISTIC Tlib_isCircInfoPwrRi6PowerSupplyID_VLAN204ControLow_C "" VALUE 0x0072077c Val_Wu16 1 OneToOne 0.0 65535 FORMAT "%8.2" /end CHARACTERISTIC
/begin CHARACTERISTIC Tlib_isCircInfoPwrRi6CircFaultSts_VLAN204ControLow_C "" VALUE 0x0072077e Val_Wu16 1 OneToOne 0.0 65535 FORMAT "%8.2" /end CHARACTERISTIC
/begin CHARACTERISTIC Tlib_isCircInfoPwrRi6Current_VLAN204ControLow_C "" VALUE 0x00720780 Val_Wu16 1 OneToOne 0.0 65535 FORMAT "%8.2" /end CHARACTERISTIC
/begin CHARACTERISTIC Tlib_isCircInfoDrvRi33ID_VLAN204ControLow_C "" VALUE 0x00720782 Val_Wu16 1 OneToOne 0.0 65535 FORMAT "%8.2" /end CHARACTERISTIC
/begin CHARACTERISTIC Tlib_isCircInfoDrvRi33Current_VLAN204ControLow_C "" VALUE 0x00720784 Val_Wu16 1 OneToOne 0.0 65535 FORMAT "%8.2" /end CHARACTERISTIC
/begin CHARACTERISTIC Tlib_isCircInfoDrvRi33PowerStatus_VLAN204ControLow_C "" VALUE 0x00720af2 Val_Wu8 1 OneToOne 0.0 255.00 FORMAT "%8.2" /end CHARACTERISTIC
/begin CHARACTERISTIC Tlib_isCircInfoDrvRi33Voltage_VLAN204ControLow_C "" VALUE 0x00720af3 Val_Wu8 1 OneToOne 0.0 255.00 FORMAT "%8.2" /end CHARACTERISTIC
/begin CHARACTERISTIC Tlib_isCircInfoDrvRi18PowerStatus_VLAN204ControLow_C "" VALUE 0x00720af4 Val_Wu8 1 OneToOne 0.0 255.00 FORMAT "%8.2" /end CHARACTERISTIC
/begin CHARACTERISTIC Tlib_isCircInfoDrvRi18Current_VLAN204ControLow_C "" VALUE 0x00720786 Val_Wu16 1 OneToOne 0.0 65535 FORMAT "%8.2" /end CHARACTERISTIC
/begin CHARACTERISTIC Tlib_isCircInfoDrvRi18ID_VLAN204ControLow_C "" VALUE 0x00720788 Val_Wu16 1 OneToOne 0.0 65535 FORMAT "%8.2" /end CHARACTERISTIC
/begin CHARACTERISTIC Tlib_isCircInfoDrvRi18Voltage_VLAN204ControLow_C "" VALUE 0x00720af5 Val_Wu8 1 OneToOne 0.0 255.00 FORMAT "%8.2" /end CHARACTERISTIC
/begin CHARACTERISTIC Tlib_isCircInfoDrvRi19Voltage_VLAN204ControLow_C "" VALUE 0x00720af6 Val_Wu8 1 OneToOne 0.0 255.00 FORMAT "%8.2" /end CHARACTERISTIC
/begin CHARACTERISTIC Tlib_isCircInfoDrvRi19PowerStatus_VLAN204ControLow_C "" VALUE 0x00720af7 Val_Wu8 1 OneToOne 0.0 255.00 FORMAT "%8.2" /end CHARACTERISTIC
/begin CHARACTERISTIC Tlib_isCircInfoDrvRi19ID_VLAN204ControLow_C "" VALUE 0x0072078a Val_Wu16 1 OneToOne 0.0 65535 FORMAT "%8.2" /end CHARACTERISTIC
/begin CHARACTERISTIC Tlib_isCircInfoDrvRi19Current_VLAN204ControLow_C "" VALUE 0x0072078c Val_Wu16 1 OneToOne 0.0 65535 FORMAT "%8.2" /end CHARACTERISTIC
/begin CHARACTERISTIC Tlib_isCircInfoPwrRi46Current_VLAN204ControLow_C "" VALUE 0x0072078e Val_Wu16 1 OneToOne 0.0 65535 FORMAT "%8.2" /end CHARACTERISTIC
/begin CHARACTERISTIC Tlib_isCircInfoPwrRi46PowerSupplyID_VLAN204ControLow_C "" VALUE 0x00720790 Val_Wu16 1 OneToOne 0.0 65535 FORMAT "%8.2" /end CHARACTERISTIC
/begin CHARACTERISTIC Tlib_isCircInfoPwrRi46CircFaultSts_VLAN204ControLow_C "" VALUE 0x00720792 Val_Wu16 1 OneToOne 0.0 65535 FORMAT "%8.2" /end CHARACTERISTIC
/begin CHARACTERISTIC Tlib_isCircInfoPwrRi46PowerSupplyVoltage_VLAN204ControLow_C "" VALUE 0x00720af8 Val_Wu8 1 OneToOne 0.0 255.00 FORMAT "%8.2" /end CHARACTERISTIC
/begin CHARACTERISTIC Tlib_isCircInfoPwrRi46PowerSupplyStatus_VLAN204ControLow_C "" VALUE 0x00720af9 Val_Wu8 1 OneToOne 0.0 255.00 FORMAT "%8.2" /end CHARACTERISTIC
/begin CHARACTERISTIC Tlib_isCircInfoPwrRi55Current_VLAN204ControLow_C "" VALUE 0x00720794 Val_Wu16 1 OneToOne 0.0 65535 FORMAT "%8.2" /end CHARACTERISTIC
/begin CHARACTERISTIC Tlib_isCircInfoPwrRi55PowerSupplyID_VLAN204ControLow_C "" VALUE 0x00720796 Val_Wu16 1 OneToOne 0.0 65535 FORMAT "%8.2" /end CHARACTERISTIC
/begin CHARACTERISTIC Tlib_isCircInfoPwrRi55PowerSupplyVoltage_VLAN204ControLow_C "" VALUE 0x00720afa Val_Wu8 1 OneToOne 0.0 255.00 FORMAT "%8.2" /end CHARACTERISTIC
/begin CHARACTERISTIC Tlib_isCircInfoPwrRi55PowerSupplyStatus_VLAN204ControLow_C "" VALUE 0x00720afb Val_Wu8 1 OneToOne 0.0 255.00 FORMAT "%8.2" /end CHARACTERISTIC
/begin CHARACTERISTIC Tlib_isCircInfoPwrRi55CircFaultSts_VLAN204ControLow_C "" VALUE 0x00720798 Val_Wu16 1 OneToOne 0.0 65535 FORMAT "%8.2" /end CHARACTERISTIC
/begin CHARACTERISTIC Tlib_isSecGrlShttrDmdShttrCalEna_VLAN204ControLow_C "" VALUE 0x00720afc Val_Wu8 1 OneToOne 0.0 255.00 FORMAT "%8.2" /end CHARACTERISTIC
/begin CHARACTERISTIC Tlib_isSecGrlShttrDmdShttrPosnReq_VLAN204ControLow_C "" VALUE 0x00720afd Val_Wu8 1 OneToOne 0.0 255.00 FORMAT "%8.2" /end CHARACTERISTIC
/begin CHARACTERISTIC Tlib_isCircInfoPwrRi38Current_VLAN204ControLow_C "" VALUE 0x0072079a Val_Wu16 1 OneToOne 0.0 65535 FORMAT "%8.2" /end CHARACTERISTIC
/begin CHARACTERISTIC Tlib_isCircInfoPwrRi38PowerSupplyStatus_VLAN204ControLow_C "" VALUE 0x00720afe Val_Wu8 1 OneToOne 0.0 255.00 FORMAT "%8.2" /end CHARACTERISTIC
/begin CHARACTERISTIC Tlib_isCircInfoPwrRi38PowerSupplyID_VLAN204ControLow_C "" VALUE 0x0072079c Val_Wu16 1 OneToOne 0.0 65535 FORMAT "%8.2" /end CHARACTERISTIC
/begin CHARACTERISTIC Tlib_isCircInfoPwrRi38CircFaultSts_VLAN204ControLow_C "" VALUE 0x0072079e Val_Wu16 1 OneToOne 0.0 65535 FORMAT "%8.2" /end CHARACTERISTIC
/begin CHARACTERISTIC Tlib_isCircInfoPwrRi38PowerSupplyVoltage_VLAN204ControLow_C "" VALUE 0x00720aff Val_Wu8 1 OneToOne 0.0 255.00 FORMAT "%8.2" /end CHARACTERISTIC
/begin CHARACTERISTIC Tlib_isCircInfoPwrRi16PowerSupplyID_VLAN204ControLow_C "" VALUE 0x007207a0 Val_Wu16 1 OneToOne 0.0 65535 FORMAT "%8.2" /end CHARACTERISTIC
/begin CHARACTERISTIC Tlib_isCircInfoPwrRi16PowerSupplyStatus_VLAN204ControLow_C "" VALUE 0x00720b00 Val_Wu8 1 OneToOne 0.0 255.00 FORMAT "%8.2" /end CHARACTERISTIC
/begin CHARACTERISTIC Tlib_isCircInfoPwrRi16PowerSupplyVoltage_VLAN204ControLow_C "" VALUE 0x00720b01 Val_Wu8 1 OneToOne 0.0 255.00 FORMAT "%8.2" /end CHARACTERISTIC
/begin CHARACTERISTIC Tlib_isCircInfoPwrRi16CircFaultSts_VLAN204ControLow_C "" VALUE 0x007207a2 Val_Wu16 1 OneToOne 0.0 65535 FORMAT "%8.2" /end CHARACTERISTIC
/begin CHARACTERISTIC Tlib_isCircInfoPwrRi16Current_VLAN204ControLow_C "" VALUE 0x007207a4 Val_Wu16 1 OneToOne 0.0 65535 FORMAT "%8.2" /end CHARACTERISTIC
/begin CHARACTERISTIC Tlib_isCircInfoDrvRi36Current_VLAN204ControLow_C "" VALUE 0x007207a6 Val_Wu16 1 OneToOne 0.0 65535 FORMAT "%8.2" /end CHARACTERISTIC
/begin CHARACTERISTIC Tlib_isCircInfoDrvRi36Voltage_VLAN204ControLow_C "" VALUE 0x00720b02 Val_Wu8 1 OneToOne 0.0 255.00 FORMAT "%8.2" /end CHARACTERISTIC
/begin CHARACTERISTIC Tlib_isCircInfoDrvRi36ID_VLAN204ControLow_C "" VALUE 0x007207a8 Val_Wu16 1 OneToOne 0.0 65535 FORMAT "%8.2" /end CHARACTERISTIC
/begin CHARACTERISTIC Tlib_isCircInfoDrvRi36PowerStatus_VLAN204ControLow_C "" VALUE 0x00720b03 Val_Wu8 1 OneToOne 0.0 255.00 FORMAT "%8.2" /end CHARACTERISTIC
/begin CHARACTERISTIC Tlib_isCircInfoPwrRi54PowerSupplyID_VLAN204ControLow_C "" VALUE 0x007207aa Val_Wu16 1 OneToOne 0.0 65535 FORMAT "%8.2" /end CHARACTERISTIC
/begin CHARACTERISTIC Tlib_isCircInfoPwrRi54PowerSupplyVoltage_VLAN204ControLow_C "" VALUE 0x00720b04 Val_Wu8 1 OneToOne 0.0 255.00 FORMAT "%8.2" /end CHARACTERISTIC
/begin CHARACTERISTIC Tlib_isCircInfoPwrRi54CircFaultSts_VLAN204ControLow_C "" VALUE 0x007207ac Val_Wu16 1 OneToOne 0.0 65535 FORMAT "%8.2" /end CHARACTERISTIC
/begin CHARACTERISTIC Tlib_isCircInfoPwrRi54PowerSupplyStatus_VLAN204ControLow_C "" VALUE 0x00720b05 Val_Wu8 1 OneToOne 0.0 255.00 FORMAT "%8.2" /end CHARACTERISTIC
/begin CHARACTERISTIC Tlib_isCircInfoPwrRi54Current_VLAN204ControLow_C "" VALUE 0x007207ae Val_Wu16 1 OneToOne 0.0 65535 FORMAT "%8.2" /end CHARACTERISTIC
/begin CHARACTERISTIC Tlib_isCircInfoPwrRi25Current_VLAN204ControLow_C "" VALUE 0x007207b0 Val_Wu16 1 OneToOne 0.0 65535 FORMAT "%8.2" /end CHARACTERISTIC
/begin CHARACTERISTIC Tlib_isCircInfoPwrRi25PowerSupplyVoltage_VLAN204ControLow_C "" VALUE 0x00720b06 Val_Wu8 1 OneToOne 0.0 255.00 FORMAT "%8.2" /end CHARACTERISTIC
/begin CHARACTERISTIC Tlib_isCircInfoPwrRi25CircFaultSts_VLAN204ControLow_C "" VALUE 0x007207b2 Val_Wu16 1 OneToOne 0.0 65535 FORMAT "%8.2" /end CHARACTERISTIC
/begin CHARACTERISTIC Tlib_isCircInfoPwrRi25PowerSupplyID_VLAN204ControLow_C "" VALUE 0x007207b4 Val_Wu16 1 OneToOne 0.0 65535 FORMAT "%8.2" /end CHARACTERISTIC
/begin CHARACTERISTIC Tlib_isCircInfoPwrRi25PowerSupplyStatus_VLAN204ControLow_C "" VALUE 0x00720b07 Val_Wu8 1 OneToOne 0.0 255.00 FORMAT "%8.2" /end CHARACTERISTIC
/begin CHARACTERISTIC Tlib_isCircInfoPwrRi21Current_VLAN204ControLow_C "" VALUE 0x007207b6 Val_Wu16 1 OneToOne 0.0 65535 FORMAT "%8.2" /end CHARACTERISTIC
/begin CHARACTERISTIC Tlib_isCircInfoPwrRi21PowerSupplyStatus_VLAN204ControLow_C "" VALUE 0x00720b08 Val_Wu8 1 OneToOne 0.0 255.00 FORMAT "%8.2" /end CHARACTERISTIC
/begin CHARACTERISTIC Tlib_isCircInfoPwrRi21CircFaultSts_VLAN204ControLow_C "" VALUE 0x007207b8 Val_Wu16 1 OneToOne 0.0 65535 FORMAT "%8.2" /end CHARACTERISTIC
/begin CHARACTERISTIC Tlib_isCircInfoPwrRi21PowerSupplyVoltage_VLAN204ControLow_C "" VALUE 0x00720b09 Val_Wu8 1 OneToOne 0.0 255.00 FORMAT "%8.2" /end CHARACTERISTIC
/begin CHARACTERISTIC Tlib_isCircInfoPwrRi21PowerSupplyID_VLAN204ControLow_C "" VALUE 0x007207ba Val_Wu16 1 OneToOne 0.0 65535 FORMAT "%8.2" /end CHARACTERISTIC
/begin CHARACTERISTIC Tlib_isCircInfoPwrRi22Current_VLAN204ControLow_C "" VALUE 0x007207bc Val_Wu16 1 OneToOne 0.0 65535 FORMAT "%8.2" /end CHARACTERISTIC
/begin CHARACTERISTIC Tlib_isCircInfoPwrRi22PowerSupplyID_VLAN204ControLow_C "" VALUE 0x007207be Val_Wu16 1 OneToOne 0.0 65535 FORMAT "%8.2" /end CHARACTERISTIC
/begin CHARACTERISTIC Tlib_isCircInfoPwrRi22PowerSupplyVoltage_VLAN204ControLow_C "" VALUE 0x00720b0a Val_Wu8 1 OneToOne 0.0 255.00 FORMAT "%8.2" /end CHARACTERISTIC
/begin CHARACTERISTIC Tlib_isCircInfoPwrRi22PowerSupplyStatus_VLAN204ControLow_C "" VALUE 0x00720b0b Val_Wu8 1 OneToOne 0.0 255.00 FORMAT "%8.2" /end CHARACTERISTIC
/begin CHARACTERISTIC Tlib_isCircInfoPwrRi22CircFaultSts_VLAN204ControLow_C "" VALUE 0x007207c0 Val_Wu16 1 OneToOne 0.0 65535 FORMAT "%8.2" /end CHARACTERISTIC
/begin CHARACTERISTIC Tlib_isCircInfoPwrRi8PowerSupplyVoltage_VLAN204ControLow_C "" VALUE 0x00720b0c Val_Wu8 1 OneToOne 0.0 255.00 FORMAT "%8.2" /end CHARACTERISTIC
/begin CHARACTERISTIC Tlib_isCircInfoPwrRi8PowerSupplyStatus_VLAN204ControLow_C "" VALUE 0x00720b0d Val_Wu8 1 OneToOne 0.0 255.00 FORMAT "%8.2" /end CHARACTERISTIC
/begin CHARACTERISTIC Tlib_isCircInfoPwrRi8PowerSupplyID_VLAN204ControLow_C "" VALUE 0x007207c2 Val_Wu16 1 OneToOne 0.0 65535 FORMAT "%8.2" /end CHARACTERISTIC
/begin CHARACTERISTIC Tlib_isCircInfoPwrRi8Current_VLAN204ControLow_C "" VALUE 0x007207c4 Val_Wu16 1 OneToOne 0.0 65535 FORMAT "%8.2" /end CHARACTERISTIC
/begin CHARACTERISTIC Tlib_isCircInfoPwrRi8CircFaultSts_VLAN204ControLow_C "" VALUE 0x007207c6 Val_Wu16 1 OneToOne 0.0 65535 FORMAT "%8.2" /end CHARACTERISTIC
/begin CHARACTERISTIC Tlib_isCircInfoPwrRi30CircFaultSts_VLAN204ControLow_C "" VALUE 0x007207c8 Val_Wu16 1 OneToOne 0.0 65535 FORMAT "%8.2" /end CHARACTERISTIC
/begin CHARACTERISTIC Tlib_isCircInfoPwrRi30PowerSupplyID_VLAN204ControLow_C "" VALUE 0x007207ca Val_Wu16 1 OneToOne 0.0 65535 FORMAT "%8.2" /end CHARACTERISTIC
/begin CHARACTERISTIC Tlib_isCircInfoPwrRi30PowerSupplyVoltage_VLAN204ControLow_C "" VALUE 0x00720b0e Val_Wu8 1 OneToOne 0.0 255.00 FORMAT "%8.2" /end CHARACTERISTIC
/begin CHARACTERISTIC Tlib_isCircInfoPwrRi30Current_VLAN204ControLow_C "" VALUE 0x007207cc Val_Wu16 1 OneToOne 0.0 65535 FORMAT "%8.2" /end CHARACTERISTIC
/begin CHARACTERISTIC Tlib_isCircInfoPwrRi30PowerSupplyStatus_VLAN204ControLow_C "" VALUE 0x00720b0f Val_Wu8 1 OneToOne 0.0 255.00 FORMAT "%8.2" /end CHARACTERISTIC
/begin CHARACTERISTIC Tlib_isCircInfoPwrRi36Current_VLAN204ControLow_C "" VALUE 0x007207ce Val_Wu16 1 OneToOne 0.0 65535 FORMAT "%8.2" /end CHARACTERISTIC
/begin CHARACTERISTIC Tlib_isCircInfoPwrRi36CircFaultSts_VLAN204ControLow_C "" VALUE 0x007207d0 Val_Wu16 1 OneToOne 0.0 65535 FORMAT "%8.2" /end CHARACTERISTIC
/begin CHARACTERISTIC Tlib_isCircInfoPwrRi36PowerSupplyVoltage_VLAN204ControLow_C "" VALUE 0x00720b10 Val_Wu8 1 OneToOne 0.0 255.00 FORMAT "%8.2" /end CHARACTERISTIC
/begin CHARACTERISTIC Tlib_isCircInfoPwrRi36PowerSupplyStatus_VLAN204ControLow_C "" VALUE 0x00720b11 Val_Wu8 1 OneToOne 0.0 255.00 FORMAT "%8.2" /end CHARACTERISTIC
/begin CHARACTERISTIC Tlib_isCircInfoPwrRi36PowerSupplyID_VLAN204ControLow_C "" VALUE 0x007207d2 Val_Wu16 1 OneToOne 0.0 65535 FORMAT "%8.2" /end CHARACTERISTIC
/begin CHARACTERISTIC Tlib_isCircInfoDrvRi7Current_VLAN204ControLow_C "" VALUE 0x007207d4 Val_Wu16 1 OneToOne 0.0 65535 FORMAT "%8.2" /end CHARACTERISTIC
/begin CHARACTERISTIC Tlib_isCircInfoDrvRi7ID_VLAN204ControLow_C "" VALUE 0x007207d6 Val_Wu16 1 OneToOne 0.0 65535 FORMAT "%8.2" /end CHARACTERISTIC
/begin CHARACTERISTIC Tlib_isCircInfoDrvRi7Voltage_VLAN204ControLow_C "" VALUE 0x00720b12 Val_Wu8 1 OneToOne 0.0 255.00 FORMAT "%8.2" /end CHARACTERISTIC
/begin CHARACTERISTIC Tlib_isCircInfoDrvRi7PowerStatus_VLAN204ControLow_C "" VALUE 0x00720b13 Val_Wu8 1 OneToOne 0.0 255.00 FORMAT "%8.2" /end CHARACTERISTIC
/begin CHARACTERISTIC Tlib_isCircInfoPwrRi27PowerSupplyID_VLAN204ControLow_C "" VALUE 0x007207d8 Val_Wu16 1 OneToOne 0.0 65535 FORMAT "%8.2" /end CHARACTERISTIC
/begin CHARACTERISTIC Tlib_isCircInfoPwrRi27PowerSupplyVoltage_VLAN204ControLow_C "" VALUE 0x00720b14 Val_Wu8 1 OneToOne 0.0 255.00 FORMAT "%8.2" /end CHARACTERISTIC
/begin CHARACTERISTIC Tlib_isCircInfoPwrRi27CircFaultSts_VLAN204ControLow_C "" VALUE 0x007207da Val_Wu16 1 OneToOne 0.0 65535 FORMAT "%8.2" /end CHARACTERISTIC
/begin CHARACTERISTIC Tlib_isCircInfoPwrRi27Current_VLAN204ControLow_C "" VALUE 0x007207dc Val_Wu16 1 OneToOne 0.0 65535 FORMAT "%8.2" /end CHARACTERISTIC
/begin CHARACTERISTIC Tlib_isCircInfoPwrRi27PowerSupplyStatus_VLAN204ControLow_C "" VALUE 0x00720b15 Val_Wu8 1 OneToOne 0.0 255.00 FORMAT "%8.2" /end CHARACTERISTIC
/begin CHARACTERISTIC Tlib_isCircInfoPwrRi45CircFaultSts_VLAN204ControLow_C "" VALUE 0x007207de Val_Wu16 1 OneToOne 0.0 65535 FORMAT "%8.2" /end CHARACTERISTIC
/begin CHARACTERISTIC Tlib_isCircInfoPwrRi45Current_VLAN204ControLow_C "" VALUE 0x007207e0 Val_Wu16 1 OneToOne 0.0 65535 FORMAT "%8.2" /end CHARACTERISTIC
/begin CHARACTERISTIC Tlib_isCircInfoPwrRi45PowerSupplyVoltage_VLAN204ControLow_C "" VALUE 0x00720b16 Val_Wu8 1 OneToOne 0.0 255.00 FORMAT "%8.2" /end CHARACTERISTIC
/begin CHARACTERISTIC Tlib_isCircInfoPwrRi45PowerSupplyStatus_VLAN204ControLow_C "" VALUE 0x00720b17 Val_Wu8 1 OneToOne 0.0 255.00 FORMAT "%8.2" /end CHARACTERISTIC
/begin CHARACTERISTIC Tlib_isCircInfoPwrRi45PowerSupplyID_VLAN204ControLow_C "" VALUE 0x007207e2 Val_Wu16 1 OneToOne 0.0 65535 FORMAT "%8.2" /end CHARACTERISTIC
/begin CHARACTERISTIC Tlib_isCircInfoPwrRi10PowerSupplyStatus_VLAN204ControLow_C "" VALUE 0x00720b18 Val_Wu8 1 OneToOne 0.0 255.00 FORMAT "%8.2" /end CHARACTERISTIC
/begin CHARACTERISTIC Tlib_isCircInfoPwrRi10PowerSupplyVoltage_VLAN204ControLow_C "" VALUE 0x00720b19 Val_Wu8 1 OneToOne 0.0 255.00 FORMAT "%8.2" /end CHARACTERISTIC
/begin CHARACTERISTIC Tlib_isCircInfoPwrRi10CircFaultSts_VLAN204ControLow_C "" VALUE 0x007207e4 Val_Wu16 1 OneToOne 0.0 65535 FORMAT "%8.2" /end CHARACTERISTIC
/begin CHARACTERISTIC Tlib_isCircInfoPwrRi10PowerSupplyID_VLAN204ControLow_C "" VALUE 0x007207e6 Val_Wu16 1 OneToOne 0.0 65535 FORMAT "%8.2" /end CHARACTERISTIC
/begin CHARACTERISTIC Tlib_isCircInfoPwrRi10Current_VLAN204ControLow_C "" VALUE 0x007207e8 Val_Wu16 1 OneToOne 0.0 65535 FORMAT "%8.2" /end CHARACTERISTIC
/begin CHARACTERISTIC Tlib_isCircInfoDrvRi24Current_VLAN204ControLow_C "" VALUE 0x007207ea Val_Wu16 1 OneToOne 0.0 65535 FORMAT "%8.2" /end CHARACTERISTIC
/begin CHARACTERISTIC Tlib_isCircInfoDrvRi24ID_VLAN204ControLow_C "" VALUE 0x007207ec Val_Wu16 1 OneToOne 0.0 65535 FORMAT "%8.2" /end CHARACTERISTIC
/begin CHARACTERISTIC Tlib_isCircInfoDrvRi24PowerStatus_VLAN204ControLow_C "" VALUE 0x00720b1a Val_Wu8 1 OneToOne 0.0 255.00 FORMAT "%8.2" /end CHARACTERISTIC
/begin CHARACTERISTIC Tlib_isCircInfoDrvRi24Voltage_VLAN204ControLow_C "" VALUE 0x00720b1b Val_Wu8 1 OneToOne 0.0 255.00 FORMAT "%8.2" /end CHARACTERISTIC
/begin CHARACTERISTIC Tlib_isCircInfoDrvRi14PowerStatus_VLAN204ControLow_C "" VALUE 0x00720b1c Val_Wu8 1 OneToOne 0.0 255.00 FORMAT "%8.2" /end CHARACTERISTIC
/begin CHARACTERISTIC Tlib_isCircInfoDrvRi14ID_VLAN204ControLow_C "" VALUE 0x007207ee Val_Wu16 1 OneToOne 0.0 65535 FORMAT "%8.2" /end CHARACTERISTIC
/begin CHARACTERISTIC Tlib_isCircInfoDrvRi14Current_VLAN204ControLow_C "" VALUE 0x007207f0 Val_Wu16 1 OneToOne 0.0 65535 FORMAT "%8.2" /end CHARACTERISTIC
/begin CHARACTERISTIC Tlib_isCircInfoDrvRi14Voltage_VLAN204ControLow_C "" VALUE 0x00720b1d Val_Wu8 1 OneToOne 0.0 255.00 FORMAT "%8.2" /end CHARACTERISTIC
/begin CHARACTERISTIC Tlib_isCircInfoPwrRi15PowerSupplyStatus_VLAN204ControLow_C "" VALUE 0x00720b1e Val_Wu8 1 OneToOne 0.0 255.00 FORMAT "%8.2" /end CHARACTERISTIC
/begin CHARACTERISTIC Tlib_isCircInfoPwrRi15Current_VLAN204ControLow_C "" VALUE 0x007207f2 Val_Wu16 1 OneToOne 0.0 65535 FORMAT "%8.2" /end CHARACTERISTIC
/begin CHARACTERISTIC Tlib_isCircInfoPwrRi15PowerSupplyVoltage_VLAN204ControLow_C "" VALUE 0x00720b1f Val_Wu8 1 OneToOne 0.0 255.00 FORMAT "%8.2" /end CHARACTERISTIC
/begin CHARACTERISTIC Tlib_isCircInfoPwrRi15PowerSupplyID_VLAN204ControLow_C "" VALUE 0x007207f4 Val_Wu16 1 OneToOne 0.0 65535 FORMAT "%8.2" /end CHARACTERISTIC
/begin CHARACTERISTIC Tlib_isCircInfoPwrRi15CircFaultSts_VLAN204ControLow_C "" VALUE 0x007207f6 Val_Wu16 1 OneToOne 0.0 65535 FORMAT "%8.2" /end CHARACTERISTIC
/begin CHARACTERISTIC Tlib_isCircInfoPwrRi2PowerSupplyStatus_VLAN204ControLow_C "" VALUE 0x00720b20 Val_Wu8 1 OneToOne 0.0 255.00 FORMAT "%8.2" /end CHARACTERISTIC
/begin CHARACTERISTIC Tlib_isCircInfoPwrRi2Current_VLAN204ControLow_C "" VALUE 0x007207f8 Val_Wu16 1 OneToOne 0.0 65535 FORMAT "%8.2" /end CHARACTERISTIC
/begin CHARACTERISTIC Tlib_isCircInfoPwrRi2PowerSupplyVoltage_VLAN204ControLow_C "" VALUE 0x00720b21 Val_Wu8 1 OneToOne 0.0 255.00 FORMAT "%8.2" /end CHARACTERISTIC
/begin CHARACTERISTIC Tlib_isCircInfoPwrRi2CircFaultSts_VLAN204ControLow_C "" VALUE 0x007207fa Val_Wu16 1 OneToOne 0.0 65535 FORMAT "%8.2" /end CHARACTERISTIC
/begin CHARACTERISTIC Tlib_isCircInfoPwrRi2PowerSupplyID_VLAN204ControLow_C "" VALUE 0x007207fc Val_Wu16 1 OneToOne 0.0 65535 FORMAT "%8.2" /end CHARACTERISTIC
/begin CHARACTERISTIC Tlib_isCircInfoPwrRi40Current_VLAN204ControLow_C "" VALUE 0x007207fe Val_Wu16 1 OneToOne 0.0 65535 FORMAT "%8.2" /end CHARACTERISTIC
/begin CHARACTERISTIC Tlib_isCircInfoPwrRi40PowerSupplyVoltage_VLAN204ControLow_C "" VALUE 0x00720b22 Val_Wu8 1 OneToOne 0.0 255.00 FORMAT "%8.2" /end CHARACTERISTIC
/begin CHARACTERISTIC Tlib_isCircInfoPwrRi40PowerSupplyID_VLAN204ControLow_C "" VALUE 0x00720800 Val_Wu16 1 OneToOne 0.0 65535 FORMAT "%8.2" /end CHARACTERISTIC
/begin CHARACTERISTIC Tlib_isCircInfoPwrRi40PowerSupplyStatus_VLAN204ControLow_C "" VALUE 0x00720b23 Val_Wu8 1 OneToOne 0.0 255.00 FORMAT "%8.2" /end CHARACTERISTIC
/begin CHARACTERISTIC Tlib_isCircInfoPwrRi40CircFaultSts_VLAN204ControLow_C "" VALUE 0x00720802 Val_Wu16 1 OneToOne 0.0 65535 FORMAT "%8.2" /end CHARACTERISTIC
/begin CHARACTERISTIC Tlib_isCircInfoPwrRi37PowerSupplyStatus_VLAN204ControLow_C "" VALUE 0x00720b24 Val_Wu8 1 OneToOne 0.0 255.00 FORMAT "%8.2" /end CHARACTERISTIC
/begin CHARACTERISTIC Tlib_isCircInfoPwrRi37PowerSupplyVoltage_VLAN204ControLow_C "" VALUE 0x00720b25 Val_Wu8 1 OneToOne 0.0 255.00 FORMAT "%8.2" /end CHARACTERISTIC
/begin CHARACTERISTIC Tlib_isCircInfoPwrRi37PowerSupplyID_VLAN204ControLow_C "" VALUE 0x00720804 Val_Wu16 1 OneToOne 0.0 65535 FORMAT "%8.2" /end CHARACTERISTIC
/begin CHARACTERISTIC Tlib_isCircInfoPwrRi37CircFaultSts_VLAN204ControLow_C "" VALUE 0x00720806 Val_Wu16 1 OneToOne 0.0 65535 FORMAT "%8.2" /end CHARACTERISTIC
/begin CHARACTERISTIC Tlib_isCircInfoPwrRi37Current_VLAN204ControLow_C "" VALUE 0x00720808 Val_Wu16 1 OneToOne 0.0 65535 FORMAT "%8.2" /end CHARACTERISTIC
/begin CHARACTERISTIC Tlib_isCircInfoDrvRi4Current_VLAN204ControLow_C "" VALUE 0x0072080a Val_Wu16 1 OneToOne 0.0 65535 FORMAT "%8.2" /end CHARACTERISTIC
/begin CHARACTERISTIC Tlib_isCircInfoDrvRi4ID_VLAN204ControLow_C "" VALUE 0x0072080c Val_Wu16 1 OneToOne 0.0 65535 FORMAT "%8.2" /end CHARACTERISTIC
/begin CHARACTERISTIC Tlib_isCircInfoDrvRi4Voltage_VLAN204ControLow_C "" VALUE 0x00720b26 Val_Wu8 1 OneToOne 0.0 255.00 FORMAT "%8.2" /end CHARACTERISTIC
/begin CHARACTERISTIC Tlib_isCircInfoDrvRi4PowerStatus_VLAN204ControLow_C "" VALUE 0x00720b27 Val_Wu8 1 OneToOne 0.0 255.00 FORMAT "%8.2" /end CHARACTERISTIC
/begin CHARACTERISTIC Tlib_isCircInfoPwrRi53PowerSupplyVoltage_VLAN204ControLow_C "" VALUE 0x00720b28 Val_Wu8 1 OneToOne 0.0 255.00 FORMAT "%8.2" /end CHARACTERISTIC
/begin CHARACTERISTIC Tlib_isCircInfoPwrRi53CircFaultSts_VLAN204ControLow_C "" VALUE 0x0072080e Val_Wu16 1 OneToOne 0.0 65535 FORMAT "%8.2" /end CHARACTERISTIC
/begin CHARACTERISTIC Tlib_isCircInfoPwrRi53PowerSupplyStatus_VLAN204ControLow_C "" VALUE 0x00720b29 Val_Wu8 1 OneToOne 0.0 255.00 FORMAT "%8.2" /end CHARACTERISTIC
/begin CHARACTERISTIC Tlib_isCircInfoPwrRi53PowerSupplyID_VLAN204ControLow_C "" VALUE 0x00720810 Val_Wu16 1 OneToOne 0.0 65535 FORMAT "%8.2" /end CHARACTERISTIC
/begin CHARACTERISTIC Tlib_isCircInfoPwrRi53Current_VLAN204ControLow_C "" VALUE 0x00720812 Val_Wu16 1 OneToOne 0.0 65535 FORMAT "%8.2" /end CHARACTERISTIC
/begin CHARACTERISTIC Tlib_isCircInfoDrvRi26PowerStatus_VLAN204ControLow_C "" VALUE 0x00720b2a Val_Wu8 1 OneToOne 0.0 255.00 FORMAT "%8.2" /end CHARACTERISTIC
/begin CHARACTERISTIC Tlib_isCircInfoDrvRi26Current_VLAN204ControLow_C "" VALUE 0x00720814 Val_Wu16 1 OneToOne 0.0 65535 FORMAT "%8.2" /end CHARACTERISTIC
/begin CHARACTERISTIC Tlib_isCircInfoDrvRi26Voltage_VLAN204ControLow_C "" VALUE 0x00720b2b Val_Wu8 1 OneToOne 0.0 255.00 FORMAT "%8.2" /end CHARACTERISTIC
/begin CHARACTERISTIC Tlib_isCircInfoDrvRi26ID_VLAN204ControLow_C "" VALUE 0x00720816 Val_Wu16 1 OneToOne 0.0 65535 FORMAT "%8.2" /end CHARACTERISTIC
/begin CHARACTERISTIC Tlib_isOnBdCircFlwEstmd_VLAN204ControLow_C "" VALUE 0x00720818 Val_Wu16 1 OneToOne 0.0 65535 FORMAT "%8.2" /end CHARACTERISTIC
/begin CHARACTERISTIC Tlib_isHctvCmdVlvSpdLvlReq_VLAN204ControLow_C "" VALUE 0x00720b2c Val_Wu8 1 OneToOne 0.0 255.00 FORMAT "%8.2" /end CHARACTERISTIC
/begin CHARACTERISTIC Tlib_isHctvCmdVlvHeatdReq_VLAN204ControLow_C "" VALUE 0x00720b2d Val_Wu8 1 OneToOne 0.0 255.00 FORMAT "%8.2" /end CHARACTERISTIC
/begin CHARACTERISTIC Tlib_isHctvCmdVlvCalibReq_VLAN204ControLow_C "" VALUE 0x00720b2e Val_Wu8 1 OneToOne 0.0 255.00 FORMAT "%8.2" /end CHARACTERISTIC
/begin CHARACTERISTIC Tlib_isHctvCmdVlvPosn1_VLAN204ControLow_C "" VALUE 0x0072081a Val_Wu16 1 OneToOne 0.0 65535 FORMAT "%8.2" /end CHARACTERISTIC
/begin CHARACTERISTIC Tlib_isHctvCmdVlvActvSaveReq_VLAN204ControLow_C "" VALUE 0x00720b2f Val_Wu8 1 OneToOne 0.0 255.00 FORMAT "%8.2" /end CHARACTERISTIC
/begin CHARACTERISTIC Tlib_isHctvCmdVlvMovEna_VLAN204ControLow_C "" VALUE 0x00720b30 Val_Wu8 1 OneToOne 0.0 255.00 FORMAT "%8.2" /end CHARACTERISTIC
/begin CHARACTERISTIC Tlib_isHvBattPmpCmdCooltPmpSpdReq_VLAN204ControLow_C "" VALUE 0x00720b31 Val_Wu8 1 OneToOne 0.0 255.00 FORMAT "%8.2" /end CHARACTERISTIC
/begin CHARACTERISTIC Tlib_isHvBattPmpCmdCooltPmpPostRunReq_VLAN204ControLow_C "" VALUE 0x00720b32 Val_Wu8 1 OneToOne 0.0 255.00 FORMAT "%8.2" /end CHARACTERISTIC
/begin CHARACTERISTIC Tlib_isCcvmCmdVlvSpdLvlReq_VLAN204ControLow_C "" VALUE 0x00720b33 Val_Wu8 1 OneToOne 0.0 255.00 FORMAT "%8.2" /end CHARACTERISTIC
/begin CHARACTERISTIC Tlib_isCcvmCmdVlvCalibReq_VLAN204ControLow_C "" VALUE 0x00720b34 Val_Wu8 1 OneToOne 0.0 255.00 FORMAT "%8.2" /end CHARACTERISTIC
/begin CHARACTERISTIC Tlib_isCcvmCmdVlvHeatdReq_VLAN204ControLow_C "" VALUE 0x00720b35 Val_Wu8 1 OneToOne 0.0 255.00 FORMAT "%8.2" /end CHARACTERISTIC
/begin CHARACTERISTIC Tlib_isCcvmCmdVlvMovEna_VLAN204ControLow_C "" VALUE 0x00720b36 Val_Wu8 1 OneToOne 0.0 255.00 FORMAT "%8.2" /end CHARACTERISTIC
/begin CHARACTERISTIC Tlib_isCcvmCmdVlvPosn1_VLAN204ControLow_C "" VALUE 0x0072081c Val_Wu16 1 OneToOne 0.0 65535 FORMAT "%8.2" /end CHARACTERISTIC
/begin CHARACTERISTIC Tlib_isCcvmCmdVlvActvSaveReq_VLAN204ControLow_C "" VALUE 0x00720b37 Val_Wu8 1 OneToOne 0.0 255.00 FORMAT "%8.2" /end CHARACTERISTIC
/begin CHARACTERISTIC Tlib_isCcvPosReqDftPos_VLAN204ControLow_C "" VALUE 0x0072081e Val_Wu16 1 OneToOne 0.0 65535 FORMAT "%8.2" /end CHARACTERISTIC
/begin CHARACTERISTIC Tlib_isCcvPosReqPosReq_VLAN204ControLow_C "" VALUE 0x00720820 Val_Wu16 1 OneToOne 0.0 65535 FORMAT "%8.2" /end CHARACTERISTIC
/begin CHARACTERISTIC Tlib_isCcvPosReqRstPos_VLAN204ControLow_C "" VALUE 0x00720b38 Val_Wu8 1 OneToOne 0.0 255.00 FORMAT "%8.2" /end CHARACTERISTIC
/begin CHARACTERISTIC Tlib_isCcvPosReqReqEnad_VLAN204ControLow_C "" VALUE 0x00720b39 Val_Wu8 1 OneToOne 0.0 255.00 FORMAT "%8.2" /end CHARACTERISTIC
/begin CHARACTERISTIC Tlib_isCcvPosReqTrqReq_VLAN204ControLow_C "" VALUE 0x00720b3a Val_Wu8 1 OneToOne 0.0 255.00 FORMAT "%8.2" /end CHARACTERISTIC
/begin CHARACTERISTIC Tlib_isHeatrPmpCmdCooltPmpSpdReq_VLAN204ControLow_C "" VALUE 0x00720b3b Val_Wu8 1 OneToOne 0.0 255.00 FORMAT "%8.2" /end CHARACTERISTIC
/begin CHARACTERISTIC Tlib_isHeatrPmpCmdCooltPmpPostRunReq_VLAN204ControLow_C "" VALUE 0x00720b3c Val_Wu8 1 OneToOne 0.0 255.00 FORMAT "%8.2" /end CHARACTERISTIC
/begin CHARACTERISTIC Tlib_isBltLockStAtPassBltLockSts_VLAN204ControLow_C "" VALUE 0x00720b3d Val_Wu8 1 OneToOne 0.0 255.00 FORMAT "%8.2" /end CHARACTERISTIC
/begin CHARACTERISTIC Tlib_isBltLockStAtPassBltLockSt1_VLAN204ControLow_C "" VALUE 0x00720b3e Val_Wu8 1 OneToOne 0.0 255.00 FORMAT "%8.2" /end CHARACTERISTIC
/begin CHARACTERISTIC Tlib_isPassSeatRotAngleDegQf1_VLAN204ControLow_C "" VALUE 0x00720b3f Val_Wu8 1 OneToOne 0.0 255.00 FORMAT "%8.2" /end CHARACTERISTIC
/begin CHARACTERISTIC Tlib_isPassSeatRotAngleDegCamSnsrPosePitchAg_VLAN204ControLow_C "" VALUE 0x00720822 Val_Wu16 1 OneToOne 0.0 65535 FORMAT "%8.2" /end CHARACTERISTIC
/begin CHARACTERISTIC Tlib_isBattRlyReqSec_0_VLAN204ControLow_C "" VALUE 0x00720b40 Val_Wu8 1 OneToOne 0.0 255.00 FORMAT "%8.2" /end CHARACTERISTIC
/begin CHARACTERISTIC Tlib_isWhlFailrSts_VLAN204ControLow_C "" VALUE 0x00720b41 Val_Wu8 1 OneToOne 0.0 255.00 FORMAT "%8.2" /end CHARACTERISTIC
/begin CHARACTERISTIC Tlib_isTiltMtnMovmt_VLAN204ControLow_C "" VALUE 0x00720b42 Val_Wu8 1 OneToOne 0.0 255.00 FORMAT "%8.2" /end CHARACTERISTIC
/begin CHARACTERISTIC Tlib_isRoofDispSlidingSrvConditionSts_VLAN204ControLow_C "" VALUE 0x00720b43 Val_Wu8 1 OneToOne 0.0 255.00 FORMAT "%8.2" /end CHARACTERISTIC
/begin CHARACTERISTIC Tlib_isElSPLwarn_VLAN204ControLow_C "" VALUE 0x00720b44 Val_Wu8 1 OneToOne 0.0 255.00 FORMAT "%8.2" /end CHARACTERISTIC
/begin CHARACTERISTIC Tlib_isTeleMtnMovmt_VLAN204ControLow_C "" VALUE 0x00720b45 Val_Wu8 1 OneToOne 0.0 255.00 FORMAT "%8.2" /end CHARACTERISTIC
/begin CHARACTERISTIC Tlib_isRoofDispFoldingSrvConditionSts_VLAN204ControLow_C "" VALUE 0x00720b46 Val_Wu8 1 OneToOne 0.0 255.00 FORMAT "%8.2" /end CHARACTERISTIC
/begin CHARACTERISTIC Tlib_isRoofDispFoldingProtection_VLAN204ControLow_C "" VALUE 0x00720b47 Val_Wu8 1 OneToOne 0.0 255.00 FORMAT "%8.2" /end CHARACTERISTIC
/begin CHARACTERISTIC Tlib_isCSDRotSrvReq_VLAN204ControLow_C "" VALUE 0x00720b48 Val_Wu8 1 OneToOne 0.0 255.00 FORMAT "%8.2" /end CHARACTERISTIC
/begin CHARACTERISTIC Tlib_isHvCabinThermPwrCns_VLAN204ControLow_C "" VALUE 0x00720824 Val_WS16 1 OneToOne -32768 32767 FORMAT "%8.2" /end CHARACTERISTIC
/begin CHARACTERISTIC Tlib_isElecSidePedlLeftSrvConditionSts_VLAN204ControLow_C "" VALUE 0x00720b49 Val_Wu8 1 OneToOne 0.0 255.00 FORMAT "%8.2" /end CHARACTERISTIC
/begin CHARACTERISTIC Tlib_isElecSidePedlRightSrvConditionSts_VLAN204ControLow_C "" VALUE 0x00720b4a Val_Wu8 1 OneToOne 0.0 255.00 FORMAT "%8.2" /end CHARACTERISTIC
/begin CHARACTERISTIC Tlib_isElSPRwarn_VLAN204ControLow_C "" VALUE 0x00720b4b Val_Wu8 1 OneToOne 0.0 255.00 FORMAT "%8.2" /end CHARACTERISTIC
/begin CHARACTERISTIC Tlib_isSteerWhlPosnAng_VLAN204ControLow_C "" VALUE 0x00720826 Val_Wu16 1 OneToOne 0.0 65535 FORMAT "%8.2" /end CHARACTERISTIC
/begin CHARACTERISTIC Tlib_isSteerWhlPosnX_VLAN204ControLow_C "" VALUE 0x00720828 Val_Wu16 1 OneToOne 0.0 65535 FORMAT "%8.2" /end CHARACTERISTIC
/begin CHARACTERISTIC Tlib_isRoofDispSlidingProtection_VLAN204ControLow_C "" VALUE 0x00720b4c Val_Wu8 1 OneToOne 0.0 255.00 FORMAT "%8.2" /end CHARACTERISTIC
/begin CHARACTERISTIC Tlib_DoorPassAntiPnch2_LowPowerCANFD_C "" VALUE 0x00720b4d Val_Wu8 1 OneToOne 0.0 255.00 FORMAT "%8.2" /end CHARACTERISTIC
/begin CHARACTERISTIC Tlib_ObstStrDetcnRiRe2_LowPowerCANFD_C "" VALUE 0x00720b4e Val_Wu8 1 OneToOne 0.0 255.00 FORMAT "%8.2" /end CHARACTERISTIC
/begin CHARACTERISTIC Tlib_StsOfLedFrntPosnLampRi_LowPowerCANFD_C "" VALUE 0x00720b4f Val_Wu8 1 OneToOne 0.0 255.00 FORMAT "%8.2" /end CHARACTERISTIC
/begin CHARACTERISTIC Tlib_ObstStrDetcnPass2_LowPowerCANFD_C "" VALUE 0x00720b50 Val_Wu8 1 OneToOne 0.0 255.00 FORMAT "%8.2" /end CHARACTERISTIC
/begin CHARACTERISTIC Tlib_DoorPassModSts2_LowPowerCANFD_C "" VALUE 0x00720b51 Val_Wu8 1 OneToOne 0.0 255.00 FORMAT "%8.2" /end CHARACTERISTIC
/begin CHARACTERISTIC Tlib_StsOfLedCornrgLampRi_LowPowerCANFD_C "" VALUE 0x00720b52 Val_Wu8 1 OneToOne 0.0 255.00 FORMAT "%8.2" /end CHARACTERISTIC
/begin CHARACTERISTIC Tlib_DoorRiReModSts2_LowPowerCANFD_C "" VALUE 0x00720b53 Val_Wu8 1 OneToOne 0.0 255.00 FORMAT "%8.2" /end CHARACTERISTIC
/begin CHARACTERISTIC Tlib_DoorRiReAntiPnch2_LowPowerCANFD_C "" VALUE 0x00720b54 Val_Wu8 1 OneToOne 0.0 255.00 FORMAT "%8.2" /end CHARACTERISTIC
/begin CHARACTERISTIC Tlib_DtcInfDoorPass2Boolean11_LowPowerCANFD_C "" VALUE 0x00720b55 Val_Wu8 1 OneToOne 0.0 255.00 FORMAT "%8.2" /end CHARACTERISTIC
/begin CHARACTERISTIC Tlib_DtcInfDoorPass2Boolean6_LowPowerCANFD_C "" VALUE 0x00720b56 Val_Wu8 1 OneToOne 0.0 255.00 FORMAT "%8.2" /end CHARACTERISTIC
/begin CHARACTERISTIC Tlib_DtcInfDoorPass2Boolean10_LowPowerCANFD_C "" VALUE 0x00720b57 Val_Wu8 1 OneToOne 0.0 255.00 FORMAT "%8.2" /end CHARACTERISTIC
/begin CHARACTERISTIC Tlib_DtcInfDoorPass2Boolean13_LowPowerCANFD_C "" VALUE 0x00720b58 Val_Wu8 1 OneToOne 0.0 255.00 FORMAT "%8.2" /end CHARACTERISTIC
/begin CHARACTERISTIC Tlib_DtcInfDoorPass2Boolean5_LowPowerCANFD_C "" VALUE 0x00720b59 Val_Wu8 1 OneToOne 0.0 255.00 FORMAT "%8.2" /end CHARACTERISTIC
/begin CHARACTERISTIC Tlib_DtcInfDoorPass2Boolean9_LowPowerCANFD_C "" VALUE 0x00720b5a Val_Wu8 1 OneToOne 0.0 255.00 FORMAT "%8.2" /end CHARACTERISTIC
/begin CHARACTERISTIC Tlib_DtcInfDoorPass2Boolean14_LowPowerCANFD_C "" VALUE 0x00720b5b Val_Wu8 1 OneToOne 0.0 255.00 FORMAT "%8.2" /end CHARACTERISTIC
/begin CHARACTERISTIC Tlib_DtcInfDoorPass2Boolean7_LowPowerCANFD_C "" VALUE 0x00720b5c Val_Wu8 1 OneToOne 0.0 255.00 FORMAT "%8.2" /end CHARACTERISTIC
/begin CHARACTERISTIC Tlib_DtcInfDoorPass2Boolean12_LowPowerCANFD_C "" VALUE 0x00720b5d Val_Wu8 1 OneToOne 0.0 255.00 FORMAT "%8.2" /end CHARACTERISTIC
/begin CHARACTERISTIC Tlib_DtcInfDoorPass2Boolean3_LowPowerCANFD_C "" VALUE 0x00720b5e Val_Wu8 1 OneToOne 0.0 255.00 FORMAT "%8.2" /end CHARACTERISTIC
/begin CHARACTERISTIC Tlib_DtcInfDoorPass2Boolean1_LowPowerCANFD_C "" VALUE 0x00720b5f Val_Wu8 1 OneToOne 0.0 255.00 FORMAT "%8.2" /end CHARACTERISTIC
/begin CHARACTERISTIC Tlib_DtcInfDoorPass2Boolean8_LowPowerCANFD_C "" VALUE 0x00720b60 Val_Wu8 1 OneToOne 0.0 255.00 FORMAT "%8.2" /end CHARACTERISTIC
/begin CHARACTERISTIC Tlib_DtcInfDoorPass2Boolean2_LowPowerCANFD_C "" VALUE 0x00720b61 Val_Wu8 1 OneToOne 0.0 255.00 FORMAT "%8.2" /end CHARACTERISTIC
/begin CHARACTERISTIC Tlib_DtcInfDoorPass2Boolean4_LowPowerCANFD_C "" VALUE 0x00720b62 Val_Wu8 1 OneToOne 0.0 255.00 FORMAT "%8.2" /end CHARACTERISTIC
/begin CHARACTERISTIC Tlib_StsOfLedDaytiRunngLampRi_LowPowerCANFD_C "" VALUE 0x00720b63 Val_Wu8 1 OneToOne 0.0 255.00 FORMAT "%8.2" /end CHARACTERISTIC
/begin CHARACTERISTIC Tlib_DoorRiRePosn2_LowPowerCANFD_C "" VALUE 0x00720b64 Val_Wu8 1 OneToOne 0.0 255.00 FORMAT "%8.2" /end CHARACTERISTIC
/begin CHARACTERISTIC Tlib_StsOfLedLoBeamRi_LowPowerCANFD_C "" VALUE 0x00720b65 Val_Wu8 1 OneToOne 0.0 255.00 FORMAT "%8.2" /end CHARACTERISTIC
/begin CHARACTERISTIC Tlib_StsOfFrntSideMkrLampRi2_LowPowerCANFD_C "" VALUE 0x00720b66 Val_Wu8 1 OneToOne 0.0 255.00 FORMAT "%8.2" /end CHARACTERISTIC
/begin CHARACTERISTIC Tlib_StsOfWelGbyFrntRi_LowPowerCANFD_C "" VALUE 0x00720b67 Val_Wu8 1 OneToOne 0.0 255.00 FORMAT "%8.2" /end CHARACTERISTIC
/begin CHARACTERISTIC Tlib_DoorPassPosn2_LowPowerCANFD_C "" VALUE 0x00720b68 Val_Wu8 1 OneToOne 0.0 255.00 FORMAT "%8.2" /end CHARACTERISTIC
/begin CHARACTERISTIC Tlib_StsOfLedHiBeamRi_LowPowerCANFD_C "" VALUE 0x00720b69 Val_Wu8 1 OneToOne 0.0 255.00 FORMAT "%8.2" /end CHARACTERISTIC
/begin CHARACTERISTIC Tlib_StsOfLedFrntFogLampRi_LowPowerCANFD_C "" VALUE 0x00720b6a Val_Wu8 1 OneToOne 0.0 255.00 FORMAT "%8.2" /end CHARACTERISTIC
/begin CHARACTERISTIC Tlib_DtcInfDoorRiRe2Boolean4_LowPowerCANFD_C "" VALUE 0x00720b6b Val_Wu8 1 OneToOne 0.0 255.00 FORMAT "%8.2" /end CHARACTERISTIC
/begin CHARACTERISTIC Tlib_DtcInfDoorRiRe2Boolean6_LowPowerCANFD_C "" VALUE 0x00720b6c Val_Wu8 1 OneToOne 0.0 255.00 FORMAT "%8.2" /end CHARACTERISTIC
/begin CHARACTERISTIC Tlib_DtcInfDoorRiRe2Boolean5_LowPowerCANFD_C "" VALUE 0x00720b6d Val_Wu8 1 OneToOne 0.0 255.00 FORMAT "%8.2" /end CHARACTERISTIC
/begin CHARACTERISTIC Tlib_DtcInfDoorRiRe2Boolean3_LowPowerCANFD_C "" VALUE 0x00720b6e Val_Wu8 1 OneToOne 0.0 255.00 FORMAT "%8.2" /end CHARACTERISTIC
/begin CHARACTERISTIC Tlib_DtcInfDoorRiRe2Boolean14_LowPowerCANFD_C "" VALUE 0x00720b6f Val_Wu8 1 OneToOne 0.0 255.00 FORMAT "%8.2" /end CHARACTERISTIC
/begin CHARACTERISTIC Tlib_DtcInfDoorRiRe2Boolean13_LowPowerCANFD_C "" VALUE 0x00720b70 Val_Wu8 1 OneToOne 0.0 255.00 FORMAT "%8.2" /end CHARACTERISTIC
/begin CHARACTERISTIC Tlib_DtcInfDoorRiRe2Boolean7_LowPowerCANFD_C "" VALUE 0x00720b71 Val_Wu8 1 OneToOne 0.0 255.00 FORMAT "%8.2" /end CHARACTERISTIC
/begin CHARACTERISTIC Tlib_DtcInfDoorRiRe2Boolean1_LowPowerCANFD_C "" VALUE 0x00720b72 Val_Wu8 1 OneToOne 0.0 255.00 FORMAT "%8.2" /end CHARACTERISTIC
/begin CHARACTERISTIC Tlib_DtcInfDoorRiRe2Boolean12_LowPowerCANFD_C "" VALUE 0x00720b73 Val_Wu8 1 OneToOne 0.0 255.00 FORMAT "%8.2" /end CHARACTERISTIC
/begin CHARACTERISTIC Tlib_DtcInfDoorRiRe2Boolean11_LowPowerCANFD_C "" VALUE 0x00720b74 Val_Wu8 1 OneToOne 0.0 255.00 FORMAT "%8.2" /end CHARACTERISTIC
/begin CHARACTERISTIC Tlib_DtcInfDoorRiRe2Boolean8_LowPowerCANFD_C "" VALUE 0x00720b75 Val_Wu8 1 OneToOne 0.0 255.00 FORMAT "%8.2" /end CHARACTERISTIC
/begin CHARACTERISTIC Tlib_DtcInfDoorRiRe2Boolean10_LowPowerCANFD_C "" VALUE 0x00720b76 Val_Wu8 1 OneToOne 0.0 255.00 FORMAT "%8.2" /end CHARACTERISTIC
/begin CHARACTERISTIC Tlib_DtcInfDoorRiRe2Boolean2_LowPowerCANFD_C "" VALUE 0x00720b77 Val_Wu8 1 OneToOne 0.0 255.00 FORMAT "%8.2" /end CHARACTERISTIC
/begin CHARACTERISTIC Tlib_DtcInfDoorRiRe2Boolean9_LowPowerCANFD_C "" VALUE 0x00720b78 Val_Wu8 1 OneToOne 0.0 255.00 FORMAT "%8.2" /end CHARACTERISTIC
/begin CHARACTERISTIC Tlib_DoorFrntRiAcsKeylsSts_LowPowerCANFD_C "" VALUE 0x00720b79 Val_Wu8 1 OneToOne 0.0 255.00 FORMAT "%8.2" /end CHARACTERISTIC
/begin CHARACTERISTIC Tlib_DoorFrntRiAcsKeylsReq_LowPowerCANFD_C "" VALUE 0x00720b7a Val_Wu8 1 OneToOne 0.0 255.00 FORMAT "%8.2" /end CHARACTERISTIC
/begin CHARACTERISTIC Tlib_CinhPassSwt_LowPowerCANFD_C "" VALUE 0x00720b7b Val_Wu8 1 OneToOne 0.0 255.00 FORMAT "%8.2" /end CHARACTERISTIC
/begin CHARACTERISTIC Tlib_PawlPassSwt_LowPowerCANFD_C "" VALUE 0x00720b7c Val_Wu8 1 OneToOne 0.0 255.00 FORMAT "%8.2" /end CHARACTERISTIC
/begin CHARACTERISTIC Tlib_WinPosnStsAtPass_LowPowerCANFD_C "" VALUE 0x00720b7d Val_Wu8 1 OneToOne 0.0 255.00 FORMAT "%8.2" /end CHARACTERISTIC
/begin CHARACTERISTIC Tlib_WinFailrStsAtPass_LowPowerCANFD_C "" VALUE 0x00720b7e Val_Wu8 1 OneToOne 0.0 255.00 FORMAT "%8.2" /end CHARACTERISTIC
/begin CHARACTERISTIC Tlib_DoorRiReCrashUnlockCmd_LowPowerCANFD_C "" VALUE 0x00720b7f Val_Wu8 1 OneToOne 0.0 255.00 FORMAT "%8.2" /end CHARACTERISTIC
/begin CHARACTERISTIC Tlib_ShortDropWinPassSts_LowPowerCANFD_C "" VALUE 0x00720b80 Val_Wu8 1 OneToOne 0.0 255.00 FORMAT "%8.2" /end CHARACTERISTIC
/begin CHARACTERISTIC Tlib_FltOfRePosnLampRi_LowPowerCANFD_C "" VALUE 0x00720b81 Val_Wu8 1 OneToOne 0.0 255.00 FORMAT "%8.2" /end CHARACTERISTIC
/begin CHARACTERISTIC Tlib_GlvBoxIntrSwtSts_LowPowerCANFD_C "" VALUE 0x00720b82 Val_Wu8 1 OneToOne 0.0 255.00 FORMAT "%8.2" /end CHARACTERISTIC
/begin CHARACTERISTIC Tlib_FltOfFrntPosnLampRi_LowPowerCANFD_C "" VALUE 0x00720b83 Val_Wu8 1 OneToOne 0.0 255.00 FORMAT "%8.2" /end CHARACTERISTIC
/begin CHARACTERISTIC Tlib_SwtHzrdWarnLi_LowPowerCANFD_C "" VALUE 0x00720b84 Val_Wu8 1 OneToOne 0.0 255.00 FORMAT "%8.2" /end CHARACTERISTIC
/begin CHARACTERISTIC Tlib_FltOfFrntPosnLampLe_LowPowerCANFD_C "" VALUE 0x00720b85 Val_Wu8 1 OneToOne 0.0 255.00 FORMAT "%8.2" /end CHARACTERISTIC
/begin CHARACTERISTIC Tlib_FltOfRePosnLampLe_LowPowerCANFD_C "" VALUE 0x00720b86 Val_Wu8 1 OneToOne 0.0 255.00 FORMAT "%8.2" /end CHARACTERISTIC
/begin CHARACTERISTIC Tlib_PwrSplyStsRiGroup3Boolean1_LowPowerCANFD_C "" VALUE 0x00720b87 Val_Wu8 1 OneToOne 0.0 255.00 FORMAT "%8.2" /end CHARACTERISTIC
/begin CHARACTERISTIC Tlib_PwrSplyStsRiGroup3Boolean6_LowPowerCANFD_C "" VALUE 0x00720b88 Val_Wu8 1 OneToOne 0.0 255.00 FORMAT "%8.2" /end CHARACTERISTIC
/begin CHARACTERISTIC Tlib_PwrSplyStsRiGroup3Boolean9_LowPowerCANFD_C "" VALUE 0x00720b89 Val_Wu8 1 OneToOne 0.0 255.00 FORMAT "%8.2" /end CHARACTERISTIC
/begin CHARACTERISTIC Tlib_PwrSplyStsRiGroup3Boolean10_LowPowerCANFD_C "" VALUE 0x00720b8a Val_Wu8 1 OneToOne 0.0 255.00 FORMAT "%8.2" /end CHARACTERISTIC
/begin CHARACTERISTIC Tlib_PwrSplyStsRiGroup3Boolean3_LowPowerCANFD_C "" VALUE 0x00720b8b Val_Wu8 1 OneToOne 0.0 255.00 FORMAT "%8.2" /end CHARACTERISTIC
/begin CHARACTERISTIC Tlib_PwrSplyStsRiGroup3Boolean2_LowPowerCANFD_C "" VALUE 0x00720b8c Val_Wu8 1 OneToOne 0.0 255.00 FORMAT "%8.2" /end CHARACTERISTIC
/begin CHARACTERISTIC Tlib_PwrSplyStsRiGroup3Boolean5_LowPowerCANFD_C "" VALUE 0x00720b8d Val_Wu8 1 OneToOne 0.0 255.00 FORMAT "%8.2" /end CHARACTERISTIC
/begin CHARACTERISTIC Tlib_PwrSplyStsRiGroup3Boolean8_LowPowerCANFD_C "" VALUE 0x00720b8e Val_Wu8 1 OneToOne 0.0 255.00 FORMAT "%8.2" /end CHARACTERISTIC
/begin CHARACTERISTIC Tlib_PwrSplyStsRiGroup3Boolean7_LowPowerCANFD_C "" VALUE 0x00720b8f Val_Wu8 1 OneToOne 0.0 255.00 FORMAT "%8.2" /end CHARACTERISTIC
/begin CHARACTERISTIC Tlib_PwrSplyStsRiGroup3Boolean4_LowPowerCANFD_C "" VALUE 0x00720b90 Val_Wu8 1 OneToOne 0.0 255.00 FORMAT "%8.2" /end CHARACTERISTIC
/begin CHARACTERISTIC Tlib_PwrSplyStsRiGroup2Boolean2_LowPowerCANFD_C "" VALUE 0x00720b91 Val_Wu8 1 OneToOne 0.0 255.00 FORMAT "%8.2" /end CHARACTERISTIC
/begin CHARACTERISTIC Tlib_PwrSplyStsRiGroup2Boolean9_LowPowerCANFD_C "" VALUE 0x00720b92 Val_Wu8 1 OneToOne 0.0 255.00 FORMAT "%8.2" /end CHARACTERISTIC
/begin CHARACTERISTIC Tlib_PwrSplyStsRiGroup2Boolean10_LowPowerCANFD_C "" VALUE 0x00720b93 Val_Wu8 1 OneToOne 0.0 255.00 FORMAT "%8.2" /end CHARACTERISTIC
/begin CHARACTERISTIC Tlib_PwrSplyStsRiGroup2Boolean6_LowPowerCANFD_C "" VALUE 0x00720b94 Val_Wu8 1 OneToOne 0.0 255.00 FORMAT "%8.2" /end CHARACTERISTIC
/begin CHARACTERISTIC Tlib_PwrSplyStsRiGroup2Boolean4_LowPowerCANFD_C "" VALUE 0x00720b95 Val_Wu8 1 OneToOne 0.0 255.00 FORMAT "%8.2" /end CHARACTERISTIC
/begin CHARACTERISTIC Tlib_PwrSplyStsRiGroup2Boolean1_LowPowerCANFD_C "" VALUE 0x00720b96 Val_Wu8 1 OneToOne 0.0 255.00 FORMAT "%8.2" /end CHARACTERISTIC
/begin CHARACTERISTIC Tlib_PwrSplyStsRiGroup2Boolean8_LowPowerCANFD_C "" VALUE 0x00720b97 Val_Wu8 1 OneToOne 0.0 255.00 FORMAT "%8.2" /end CHARACTERISTIC
/begin CHARACTERISTIC Tlib_PwrSplyStsRiGroup2Boolean3_LowPowerCANFD_C "" VALUE 0x00720b98 Val_Wu8 1 OneToOne 0.0 255.00 FORMAT "%8.2" /end CHARACTERISTIC
/begin CHARACTERISTIC Tlib_PwrSplyStsRiGroup2Boolean5_LowPowerCANFD_C "" VALUE 0x00720b99 Val_Wu8 1 OneToOne 0.0 255.00 FORMAT "%8.2" /end CHARACTERISTIC
/begin CHARACTERISTIC Tlib_PwrSplyStsRiGroup2Boolean7_LowPowerCANFD_C "" VALUE 0x00720b9a Val_Wu8 1 OneToOne 0.0 255.00 FORMAT "%8.2" /end CHARACTERISTIC
/begin CHARACTERISTIC Tlib_PwrSplyStsRiGroup6Boolean9_LowPowerCANFD_C "" VALUE 0x00720b9b Val_Wu8 1 OneToOne 0.0 255.00 FORMAT "%8.2" /end CHARACTERISTIC
/begin CHARACTERISTIC Tlib_PwrSplyStsRiGroup6Boolean6_LowPowerCANFD_C "" VALUE 0x00720b9c Val_Wu8 1 OneToOne 0.0 255.00 FORMAT "%8.2" /end CHARACTERISTIC
/begin CHARACTERISTIC Tlib_PwrSplyStsRiGroup6Boolean5_LowPowerCANFD_C "" VALUE 0x00720b9d Val_Wu8 1 OneToOne 0.0 255.00 FORMAT "%8.2" /end CHARACTERISTIC
/begin CHARACTERISTIC Tlib_PwrSplyStsRiGroup6Boolean4_LowPowerCANFD_C "" VALUE 0x00720b9e Val_Wu8 1 OneToOne 0.0 255.00 FORMAT "%8.2" /end CHARACTERISTIC
/begin CHARACTERISTIC Tlib_PwrSplyStsRiGroup6Boolean3_LowPowerCANFD_C "" VALUE 0x00720b9f Val_Wu8 1 OneToOne 0.0 255.00 FORMAT "%8.2" /end CHARACTERISTIC
/begin CHARACTERISTIC Tlib_PwrSplyStsRiGroup6Boolean10_LowPowerCANFD_C "" VALUE 0x00720ba0 Val_Wu8 1 OneToOne 0.0 255.00 FORMAT "%8.2" /end CHARACTERISTIC
/begin CHARACTERISTIC Tlib_PwrSplyStsRiGroup6Boolean7_LowPowerCANFD_C "" VALUE 0x00720ba1 Val_Wu8 1 OneToOne 0.0 255.00 FORMAT "%8.2" /end CHARACTERISTIC
/begin CHARACTERISTIC Tlib_PwrSplyStsRiGroup6Boolean1_LowPowerCANFD_C "" VALUE 0x00720ba2 Val_Wu8 1 OneToOne 0.0 255.00 FORMAT "%8.2" /end CHARACTERISTIC
/begin CHARACTERISTIC Tlib_PwrSplyStsRiGroup6Boolean2_LowPowerCANFD_C "" VALUE 0x00720ba3 Val_Wu8 1 OneToOne 0.0 255.00 FORMAT "%8.2" /end CHARACTERISTIC
/begin CHARACTERISTIC Tlib_PwrSplyStsRiGroup6Boolean8_LowPowerCANFD_C "" VALUE 0x00720ba4 Val_Wu8 1 OneToOne 0.0 255.00 FORMAT "%8.2" /end CHARACTERISTIC
/begin CHARACTERISTIC Tlib_PwrSplyStsRiGroup1Boolean10_LowPowerCANFD_C "" VALUE 0x00720ba5 Val_Wu8 1 OneToOne 0.0 255.00 FORMAT "%8.2" /end CHARACTERISTIC
/begin CHARACTERISTIC Tlib_PwrSplyStsRiGroup1Boolean3_LowPowerCANFD_C "" VALUE 0x00720ba6 Val_Wu8 1 OneToOne 0.0 255.00 FORMAT "%8.2" /end CHARACTERISTIC
/begin CHARACTERISTIC Tlib_PwrSplyStsRiGroup1Boolean5_LowPowerCANFD_C "" VALUE 0x00720ba7 Val_Wu8 1 OneToOne 0.0 255.00 FORMAT "%8.2" /end CHARACTERISTIC
/begin CHARACTERISTIC Tlib_PwrSplyStsRiGroup1Boolean1_LowPowerCANFD_C "" VALUE 0x00720ba8 Val_Wu8 1 OneToOne 0.0 255.00 FORMAT "%8.2" /end CHARACTERISTIC
/begin CHARACTERISTIC Tlib_PwrSplyStsRiGroup1Boolean8_LowPowerCANFD_C "" VALUE 0x00720ba9 Val_Wu8 1 OneToOne 0.0 255.00 FORMAT "%8.2" /end CHARACTERISTIC
/begin CHARACTERISTIC Tlib_PwrSplyStsRiGroup1Boolean9_LowPowerCANFD_C "" VALUE 0x00720baa Val_Wu8 1 OneToOne 0.0 255.00 FORMAT "%8.2" /end CHARACTERISTIC
/begin CHARACTERISTIC Tlib_PwrSplyStsRiGroup1Boolean4_LowPowerCANFD_C "" VALUE 0x00720bab Val_Wu8 1 OneToOne 0.0 255.00 FORMAT "%8.2" /end CHARACTERISTIC
/begin CHARACTERISTIC Tlib_PwrSplyStsRiGroup1Boolean2_LowPowerCANFD_C "" VALUE 0x00720bac Val_Wu8 1 OneToOne 0.0 255.00 FORMAT "%8.2" /end CHARACTERISTIC
/begin CHARACTERISTIC Tlib_PwrSplyStsRiGroup1Boolean6_LowPowerCANFD_C "" VALUE 0x00720bad Val_Wu8 1 OneToOne 0.0 255.00 FORMAT "%8.2" /end CHARACTERISTIC
/begin CHARACTERISTIC Tlib_PwrSplyStsRiGroup1Boolean7_LowPowerCANFD_C "" VALUE 0x00720bae Val_Wu8 1 OneToOne 0.0 255.00 FORMAT "%8.2" /end CHARACTERISTIC
/begin CHARACTERISTIC Tlib_PwrSplyStsRiGroup5Boolean8_LowPowerCANFD_C "" VALUE 0x00720baf Val_Wu8 1 OneToOne 0.0 255.00 FORMAT "%8.2" /end CHARACTERISTIC
/begin CHARACTERISTIC Tlib_PwrSplyStsRiGroup5Boolean5_LowPowerCANFD_C "" VALUE 0x00720bb0 Val_Wu8 1 OneToOne 0.0 255.00 FORMAT "%8.2" /end CHARACTERISTIC
/begin CHARACTERISTIC Tlib_PwrSplyStsRiGroup5Boolean4_LowPowerCANFD_C "" VALUE 0x00720bb1 Val_Wu8 1 OneToOne 0.0 255.00 FORMAT "%8.2" /end CHARACTERISTIC
/begin CHARACTERISTIC Tlib_PwrSplyStsRiGroup5Boolean7_LowPowerCANFD_C "" VALUE 0x00720bb2 Val_Wu8 1 OneToOne 0.0 255.00 FORMAT "%8.2" /end CHARACTERISTIC
/begin CHARACTERISTIC Tlib_PwrSplyStsRiGroup5Boolean10_LowPowerCANFD_C "" VALUE 0x00720bb3 Val_Wu8 1 OneToOne 0.0 255.00 FORMAT "%8.2" /end CHARACTERISTIC
/begin CHARACTERISTIC Tlib_PwrSplyStsRiGroup5Boolean2_LowPowerCANFD_C "" VALUE 0x00720bb4 Val_Wu8 1 OneToOne 0.0 255.00 FORMAT "%8.2" /end CHARACTERISTIC
/begin CHARACTERISTIC Tlib_PwrSplyStsRiGroup5Boolean1_LowPowerCANFD_C "" VALUE 0x00720bb5 Val_Wu8 1 OneToOne 0.0 255.00 FORMAT "%8.2" /end CHARACTERISTIC
/begin CHARACTERISTIC Tlib_PwrSplyStsRiGroup5Boolean3_LowPowerCANFD_C "" VALUE 0x00720bb6 Val_Wu8 1 OneToOne 0.0 255.00 FORMAT "%8.2" /end CHARACTERISTIC
/begin CHARACTERISTIC Tlib_PwrSplyStsRiGroup5Boolean6_LowPowerCANFD_C "" VALUE 0x00720bb7 Val_Wu8 1 OneToOne 0.0 255.00 FORMAT "%8.2" /end CHARACTERISTIC
/begin CHARACTERISTIC Tlib_PwrSplyStsRiGroup5Boolean9_LowPowerCANFD_C "" VALUE 0x00720bb8 Val_Wu8 1 OneToOne 0.0 255.00 FORMAT "%8.2" /end CHARACTERISTIC
/begin CHARACTERISTIC Tlib_PwrSplyStsRiGroup4Boolean3_LowPowerCANFD_C "" VALUE 0x00720bb9 Val_Wu8 1 OneToOne 0.0 255.00 FORMAT "%8.2" /end CHARACTERISTIC
/begin CHARACTERISTIC Tlib_PwrSplyStsRiGroup4Boolean2_LowPowerCANFD_C "" VALUE 0x00720bba Val_Wu8 1 OneToOne 0.0 255.00 FORMAT "%8.2" /end CHARACTERISTIC
/begin CHARACTERISTIC Tlib_PwrSplyStsRiGroup4Boolean6_LowPowerCANFD_C "" VALUE 0x00720bbb Val_Wu8 1 OneToOne 0.0 255.00 FORMAT "%8.2" /end CHARACTERISTIC
/begin CHARACTERISTIC Tlib_PwrSplyStsRiGroup4Boolean7_LowPowerCANFD_C "" VALUE 0x00720bbc Val_Wu8 1 OneToOne 0.0 255.00 FORMAT "%8.2" /end CHARACTERISTIC
/begin CHARACTERISTIC Tlib_PwrSplyStsRiGroup4Boolean9_LowPowerCANFD_C "" VALUE 0x00720bbd Val_Wu8 1 OneToOne 0.0 255.00 FORMAT "%8.2" /end CHARACTERISTIC
/begin CHARACTERISTIC Tlib_PwrSplyStsRiGroup4Boolean10_LowPowerCANFD_C "" VALUE 0x00720bbe Val_Wu8 1 OneToOne 0.0 255.00 FORMAT "%8.2" /end CHARACTERISTIC
/begin CHARACTERISTIC Tlib_PwrSplyStsRiGroup4Boolean1_LowPowerCANFD_C "" VALUE 0x00720bbf Val_Wu8 1 OneToOne 0.0 255.00 FORMAT "%8.2" /end CHARACTERISTIC
/begin CHARACTERISTIC Tlib_PwrSplyStsRiGroup4Boolean8_LowPowerCANFD_C "" VALUE 0x00720bc0 Val_Wu8 1 OneToOne 0.0 255.00 FORMAT "%8.2" /end CHARACTERISTIC
/begin CHARACTERISTIC Tlib_PwrSplyStsRiGroup4Boolean4_LowPowerCANFD_C "" VALUE 0x00720bc1 Val_Wu8 1 OneToOne 0.0 255.00 FORMAT "%8.2" /end CHARACTERISTIC
/begin CHARACTERISTIC Tlib_PwrSplyStsRiGroup4Boolean5_LowPowerCANFD_C "" VALUE 0x00720bc2 Val_Wu8 1 OneToOne 0.0 255.00 FORMAT "%8.2" /end CHARACTERISTIC
/begin CHARACTERISTIC Tlib_ExtrMirrPassAntiPlaySts_LowPowerCANFD_C "" VALUE 0x00720bc3 Val_Wu8 1 OneToOne 0.0 255.00 FORMAT "%8.2" /end CHARACTERISTIC
/begin CHARACTERISTIC Tlib_ExtrMirrPassPosnStsMirrPosnAdjCldUpDwn_LowPowerCANFD_C "" VALUE 0x00720bc4 Val_Wu8 1 OneToOne 0.0 255.00 FORMAT "%8.2" /end CHARACTERISTIC
/begin CHARACTERISTIC Tlib_ExtrMirrPassPosnStsMirrPosnAdjCldLeRi_LowPowerCANFD_C "" VALUE 0x00720bc5 Val_Wu8 1 OneToOne 0.0 255.00 FORMAT "%8.2" /end CHARACTERISTIC
/begin CHARACTERISTIC Tlib_WinPassAutoUpDiSts_LowPowerCANFD_C "" VALUE 0x00720bc6 Val_Wu8 1 OneToOne 0.0 255.00 FORMAT "%8.2" /end CHARACTERISTIC
/begin CHARACTERISTIC Tlib_ExtrMirrPassAdjSts_LowPowerCANFD_C "" VALUE 0x00720bc7 Val_Wu8 1 OneToOne 0.0 255.00 FORMAT "%8.2" /end CHARACTERISTIC
/begin CHARACTERISTIC Tlib_ExtrMirrPassSrchSts_LowPowerCANFD_C "" VALUE 0x00720bc8 Val_Wu8 1 OneToOne 0.0 255.00 FORMAT "%8.2" /end CHARACTERISTIC
/begin CHARACTERISTIC Tlib_AmbTRawAmbTEstimd_LowPowerCANFD_C "" VALUE 0x0072082a Val_Wu16 1 OneToOne 0.0 65535 FORMAT "%8.2" /end CHARACTERISTIC
/begin CHARACTERISTIC Tlib_AmbTRawAmbTEstimdQf_LowPowerCANFD_C "" VALUE 0x00720bc9 Val_Wu8 1 OneToOne 0.0 255.00 FORMAT "%8.2" /end CHARACTERISTIC
/begin CHARACTERISTIC Tlib_ShortDropWinReRiStsHi_LowPowerCANFD_C "" VALUE 0x00720bca Val_Wu8 1 OneToOne 0.0 255.00 FORMAT "%8.2" /end CHARACTERISTIC
/begin CHARACTERISTIC Tlib_FltOfReTurnIndcrRi_LowPowerCANFD_C "" VALUE 0x00720bcb Val_Wu8 1 OneToOne 0.0 255.00 FORMAT "%8.2" /end CHARACTERISTIC
/begin CHARACTERISTIC Tlib_FltOfFrntTurnIndcrRi_LowPowerCANFD_C "" VALUE 0x00720bcc Val_Wu8 1 OneToOne 0.0 255.00 FORMAT "%8.2" /end CHARACTERISTIC
/begin CHARACTERISTIC Tlib_TwliBriSts_LowPowerCANFD_C "" VALUE 0x00720bcd Val_Wu8 1 OneToOne 0.0 255.00 FORMAT "%8.2" /end CHARACTERISTIC
/begin CHARACTERISTIC Tlib_HoodSwt4_LowPowerCANFD_C "" VALUE 0x00720bce Val_Wu8 1 OneToOne 0.0 255.00 FORMAT "%8.2" /end CHARACTERISTIC
/begin CHARACTERISTIC Tlib_HoodSwt3_LowPowerCANFD_C "" VALUE 0x00720bcf Val_Wu8 1 OneToOne 0.0 255.00 FORMAT "%8.2" /end CHARACTERISTIC
/begin CHARACTERISTIC Tlib_DoorRiReLatPawlStHi_LowPowerCANFD_C "" VALUE 0x00720bd0 Val_Wu8 1 OneToOne 0.0 255.00 FORMAT "%8.2" /end CHARACTERISTIC
/begin CHARACTERISTIC Tlib_WinCurtAntiPinchStsAtReRiHi_LowPowerCANFD_C "" VALUE 0x00720bd1 Val_Wu8 1 OneToOne 0.0 255.00 FORMAT "%8.2" /end CHARACTERISTIC
/begin CHARACTERISTIC Tlib_ActrStopReazonAtReRiWinHi_LowPowerCANFD_C "" VALUE 0x00720bd2 Val_Wu8 1 OneToOne 0.0 255.00 FORMAT "%8.2" /end CHARACTERISTIC
/begin CHARACTERISTIC Tlib_DoorRiRe2Swt1DplyHndlHi_LowPowerCANFD_C "" VALUE 0x00720bd3 Val_Wu8 1 OneToOne 0.0 255.00 FORMAT "%8.2" /end CHARACTERISTIC
/begin CHARACTERISTIC Tlib_DoorRiRe2Swt2DplyHndlHi_LowPowerCANFD_C "" VALUE 0x00720bd4 Val_Wu8 1 OneToOne 0.0 255.00 FORMAT "%8.2" /end CHARACTERISTIC
/begin CHARACTERISTIC Tlib_WinCurtFailrStsAtReRiHi_LowPowerCANFD_C "" VALUE 0x00720bd5 Val_Wu8 1 OneToOne 0.0 255.00 FORMAT "%8.2" /end CHARACTERISTIC
/begin CHARACTERISTIC Tlib_IceBreakDoorRiReActvHi_LowPowerCANFD_C "" VALUE 0x00720bd6 Val_Wu8 1 OneToOne 0.0 255.00 FORMAT "%8.2" /end CHARACTERISTIC
/begin CHARACTERISTIC Tlib_OpenPassSwtHi_LowPowerCANFD_C "" VALUE 0x00720bd7 Val_Wu8 1 OneToOne 0.0 255.00 FORMAT "%8.2" /end CHARACTERISTIC
/begin CHARACTERISTIC Tlib_DoorOpenerPassSts2_LowPowerCANFD_C "" VALUE 0x00720bd8 Val_Wu8 1 OneToOne 0.0 255.00 FORMAT "%8.2" /end CHARACTERISTIC
/begin CHARACTERISTIC Tlib_AntiPinchDsblStsReRiHi_LowPowerCANFD_C "" VALUE 0x00720bd9 Val_Wu8 1 OneToOne 0.0 255.00 FORMAT "%8.2" /end CHARACTERISTIC
/begin CHARACTERISTIC Tlib_WinMovStsAtReRiHi_LowPowerCANFD_C "" VALUE 0x00720bda Val_Wu8 1 OneToOne 0.0 255.00 FORMAT "%8.2" /end CHARACTERISTIC
/begin CHARACTERISTIC Tlib_FRDoorStopReazon_LowPowerCANFD_C "" VALUE 0x00720bdb Val_Wu8 1 OneToOne 0.0 255.00 FORMAT "%8.2" /end CHARACTERISTIC
/begin CHARACTERISTIC Tlib_OpenRiReSwtHi_LowPowerCANFD_C "" VALUE 0x00720bdc Val_Wu8 1 OneToOne 0.0 255.00 FORMAT "%8.2" /end CHARACTERISTIC
/begin CHARACTERISTIC Tlib_WinCurtMovStsAtReRiHi_LowPowerCANFD_C "" VALUE 0x00720bdd Val_Wu8 1 OneToOne 0.0 255.00 FORMAT "%8.2" /end CHARACTERISTIC
/begin CHARACTERISTIC Tlib_RRDoorStopReazon_LowPowerCANFD_C "" VALUE 0x00720bde Val_Wu8 1 OneToOne 0.0 255.00 FORMAT "%8.2" /end CHARACTERISTIC
/begin CHARACTERISTIC Tlib_DoorOpenerRiReSts2_LowPowerCANFD_C "" VALUE 0x00720bdf Val_Wu8 1 OneToOne 0.0 255.00 FORMAT "%8.2" /end CHARACTERISTIC
/begin CHARACTERISTIC Tlib_PwrDoorManStrengthLvlStsRiRe_LowPowerCANFD_C "" VALUE 0x00720be0 Val_Wu8 1 OneToOne 0.0 255.00 FORMAT "%8.2" /end CHARACTERISTIC
/begin CHARACTERISTIC Tlib_StsOfLedFrntTurnIndcrRiChks8_LowPowerCANFD_C "" VALUE 0x00720be1 Val_Wu8 1 OneToOne 0.0 255.00 FORMAT "%8.2" /end CHARACTERISTIC
/begin CHARACTERISTIC Tlib_StsOfLedFrntTurnIndcrRiDataID4_LowPowerCANFD_C "" VALUE 0x00720be2 Val_Wu8 1 OneToOne 0.0 255.00 FORMAT "%8.2" /end CHARACTERISTIC
/begin CHARACTERISTIC Tlib_StsOfLedFrntTurnIndcrRiDevSts4_LowPowerCANFD_C "" VALUE 0x00720be3 Val_Wu8 1 OneToOne 0.0 255.00 FORMAT "%8.2" /end CHARACTERISTIC
/begin CHARACTERISTIC Tlib_StsOfLedFrntTurnIndcrRiCntr4_LowPowerCANFD_C "" VALUE 0x00720be4 Val_Wu8 1 OneToOne 0.0 255.00 FORMAT "%8.2" /end CHARACTERISTIC
/begin CHARACTERISTIC Tlib_AntiPinchStsAtPass_LowPowerCANFD_C "" VALUE 0x00720be5 Val_Wu8 1 OneToOne 0.0 255.00 FORMAT "%8.2" /end CHARACTERISTIC
/begin CHARACTERISTIC Tlib_SecOpenWaitPass_LowPowerCANFD_C "" VALUE 0x00720be6 Val_Wu8 1 OneToOne 0.0 255.00 FORMAT "%8.2" /end CHARACTERISTIC
/begin CHARACTERISTIC Tlib_AntiPinchDsblStsPass_LowPowerCANFD_C "" VALUE 0x00720be7 Val_Wu8 1 OneToOne 0.0 255.00 FORMAT "%8.2" /end CHARACTERISTIC
/begin CHARACTERISTIC Tlib_MirrXAdjPosnAtPass_LowPowerCANFD_C "" VALUE 0x00720be8 Val_Wu8 1 OneToOne 0.0 255.00 FORMAT "%8.2" /end CHARACTERISTIC
/begin CHARACTERISTIC Tlib_MirrYAdjPosnAtPass_LowPowerCANFD_C "" VALUE 0x00720be9 Val_Wu8 1 OneToOne 0.0 255.00 FORMAT "%8.2" /end CHARACTERISTIC
/begin CHARACTERISTIC Tlib_SecOpenWaitRiRe_LowPowerCANFD_C "" VALUE 0x00720bea Val_Wu8 1 OneToOne 0.0 255.00 FORMAT "%8.2" /end CHARACTERISTIC
/begin CHARACTERISTIC Tlib_WinReRiAutoUpDiStsHi_LowPowerCANFD_C "" VALUE 0x00720beb Val_Wu8 1 OneToOne 0.0 255.00 FORMAT "%8.2" /end CHARACTERISTIC
/begin CHARACTERISTIC Tlib_DoorPassOpenReqOutdSwt1_LowPowerCANFD_C "" VALUE 0x00720bec Val_Wu8 1 OneToOne 0.0 255.00 FORMAT "%8.2" /end CHARACTERISTIC
/begin CHARACTERISTIC Tlib_CinhRiReStsHi_LowPowerCANFD_C "" VALUE 0x00720bed Val_Wu8 1 OneToOne 0.0 255.00 FORMAT "%8.2" /end CHARACTERISTIC
/begin CHARACTERISTIC Tlib_DoorPassLatPosn_LowPowerCANFD_C "" VALUE 0x00720bee Val_Wu8 1 OneToOne 0.0 255.00 FORMAT "%8.2" /end CHARACTERISTIC
/begin CHARACTERISTIC Tlib_DoorPassOpenReqInsdSwt2_LowPowerCANFD_C "" VALUE 0x00720bef Val_Wu8 1 OneToOne 0.0 255.00 FORMAT "%8.2" /end CHARACTERISTIC
/begin CHARACTERISTIC Tlib_DoorPassOpenReqInsdSwt1_LowPowerCANFD_C "" VALUE 0x00720bf0 Val_Wu8 1 OneToOne 0.0 255.00 FORMAT "%8.2" /end CHARACTERISTIC
/begin CHARACTERISTIC Tlib_WinPosnStsAtReRiHi_LowPowerCANFD_C "" VALUE 0x00720bf1 Val_Wu8 1 OneToOne 0.0 255.00 FORMAT "%8.2" /end CHARACTERISTIC
/begin CHARACTERISTIC Tlib_AntiPinchStsAtReRiHi_LowPowerCANFD_C "" VALUE 0x00720bf2 Val_Wu8 1 OneToOne 0.0 255.00 FORMAT "%8.2" /end CHARACTERISTIC
/begin CHARACTERISTIC Tlib_CinhRiReSwtHi_LowPowerCANFD_C "" VALUE 0x00720bf3 Val_Wu8 1 OneToOne 0.0 255.00 FORMAT "%8.2" /end CHARACTERISTIC
/begin CHARACTERISTIC Tlib_WinCurtPosnStsAtReRiHi_LowPowerCANFD_C "" VALUE 0x00720bf4 Val_Wu8 1 OneToOne 0.0 255.00 FORMAT "%8.2" /end CHARACTERISTIC
/begin CHARACTERISTIC Tlib_FltOfIndcrTurnOnPassSide_LowPowerCANFD_C "" VALUE 0x00720bf5 Val_Wu8 1 OneToOne 0.0 255.00 FORMAT "%8.2" /end CHARACTERISTIC
/begin CHARACTERISTIC Tlib_DoorPassOpenReqOutdSwt2_LowPowerCANFD_C "" VALUE 0x00720bf6 Val_Wu8 1 OneToOne 0.0 255.00 FORMAT "%8.2" /end CHARACTERISTIC
/begin CHARACTERISTIC Tlib_PawlRiReSwtHi_LowPowerCANFD_C "" VALUE 0x00720bf7 Val_Wu8 1 OneToOne 0.0 255.00 FORMAT "%8.2" /end CHARACTERISTIC
/begin CHARACTERISTIC Tlib_DoorRiReLatPosnHi_LowPowerCANFD_C "" VALUE 0x00720bf8 Val_Wu8 1 OneToOne 0.0 255.00 FORMAT "%8.2" /end CHARACTERISTIC
/begin CHARACTERISTIC Tlib_MirrFoldStsAtPass_LowPowerCANFD_C "" VALUE 0x00720bf9 Val_Wu8 1 OneToOne 0.0 255.00 FORMAT "%8.2" /end CHARACTERISTIC
/begin CHARACTERISTIC Tlib_ActrStopReazonAtPassWin_LowPowerCANFD_C "" VALUE 0x00720bfa Val_Wu8 1 OneToOne 0.0 255.00 FORMAT "%8.2" /end CHARACTERISTIC
/begin CHARACTERISTIC Tlib_WinMovStsAtPass_LowPowerCANFD_C "" VALUE 0x00720bfb Val_Wu8 1 OneToOne 0.0 255.00 FORMAT "%8.2" /end CHARACTERISTIC
/begin CHARACTERISTIC Tlib_ActMirrStopReazonAtPassMirrStopReazonX_LowPowerCANFD_C "" VALUE 0x00720bfc Val_Wu8 1 OneToOne 0.0 255.00 FORMAT "%8.2" /end CHARACTERISTIC
/begin CHARACTERISTIC Tlib_ActMirrStopReazonAtPassMirrStopReazonY_LowPowerCANFD_C "" VALUE 0x00720bfd Val_Wu8 1 OneToOne 0.0 255.00 FORMAT "%8.2" /end CHARACTERISTIC
/begin CHARACTERISTIC Tlib_RowFrstPassODSSts_LowPowerCANFD_C "" VALUE 0x00720bfe Val_Wu8 1 OneToOne 0.0 255.00 FORMAT "%8.2" /end CHARACTERISTIC
/begin CHARACTERISTIC Tlib_SecRiSeatODSSts_LowPowerCANFD_C "" VALUE 0x00720bff Val_Wu8 1 OneToOne 0.0 255.00 FORMAT "%8.2" /end CHARACTERISTIC
/begin CHARACTERISTIC Tlib_NRRSwtHzrdWarnLiOfExteriorLightsHazard_LowPowerCANFD_C "" VALUE 0x00720c00 Val_Wu8 1 OneToOne 0.0 255.00 FORMAT "%8.2" /end CHARACTERISTIC
/begin CHARACTERISTIC Tlib_NRRRightHoodSnsrIfOfLocking_LowPowerCANFD_C "" VALUE 0x00720c01 Val_Wu8 1 OneToOne 0.0 255.00 FORMAT "%8.2" /end CHARACTERISTIC
/begin CHARACTERISTIC Tlib_NRROhxIceOfOhxDiece_LowPowerCANFD_C "" VALUE 0x00720c02 Val_Wu8 1 OneToOne 0.0 255.00 FORMAT "%8.2" /end CHARACTERISTIC
/begin CHARACTERISTIC Tlib_NRROhxIceOfOhxIceMonitoring_LowPowerCANFD_C "" VALUE 0x00720c03 Val_Wu8 1 OneToOne 0.0 255.00 FORMAT "%8.2" /end CHARACTERISTIC
/begin CHARACTERISTIC Tlib_NRRDoorPassOpenOutdSwtIf1OfLocking_LowPowerCANFD_C "" VALUE 0x00720c04 Val_Wu8 1 OneToOne 0.0 255.00 FORMAT "%8.2" /end CHARACTERISTIC
/begin CHARACTERISTIC Tlib_NRRDoorPassOpenInsdSwtIf1OfLocking_LowPowerCANFD_C "" VALUE 0x00720c05 Val_Wu8 1 OneToOne 0.0 255.00 FORMAT "%8.2" /end CHARACTERISTIC
/begin CHARACTERISTIC Tlib_NRRDoorPassOpenOutdSwtIf2OfLocking_LowPowerCANFD_C "" VALUE 0x00720c06 Val_Wu8 1 OneToOne 0.0 255.00 FORMAT "%8.2" /end CHARACTERISTIC
/begin CHARACTERISTIC Tlib_NRRDoorPassSnsrIfOfLocking_LowPowerCANFD_C "" VALUE 0x00720c07 Val_Wu8 1 OneToOne 0.0 255.00 FORMAT "%8.2" /end CHARACTERISTIC
/begin CHARACTERISTIC Tlib_NRRDoorPassOpenInsdSwtIf2OfLocking_LowPowerCANFD_C "" VALUE 0x00720c08 Val_Wu8 1 OneToOne 0.0 255.00 FORMAT "%8.2" /end CHARACTERISTIC
/begin CHARACTERISTIC Tlib_NRRSecBattMgrOfBkpLVIntelligentCharge_LowPowerCANFD_C "" VALUE 0x00720c09 Val_Wu8 1 OneToOne 0.0 255.00 FORMAT "%8.2" /end CHARACTERISTIC
/begin CHARACTERISTIC Tlib_NRRDoorFrntRiHndlSnsrIfOfLocking_LowPowerCANFD_C "" VALUE 0x00720c0a Val_Wu8 1 OneToOne 0.0 255.00 FORMAT "%8.2" /end CHARACTERISTIC
/begin CHARACTERISTIC Tlib_NRRWinCtrlPassOfRemoteWMRStatusReport_LowPowerCANFD_C "" VALUE 0x00720c0b Val_Wu8 1 OneToOne 0.0 255.00 FORMAT "%8.2" /end CHARACTERISTIC
/begin CHARACTERISTIC Tlib_HoodRelsRightFailCinchOverTimed_LowPowerCANFD_C "" VALUE 0x00720c0c Val_Wu8 1 OneToOne 0.0 255.00 FORMAT "%8.2" /end CHARACTERISTIC
/begin CHARACTERISTIC Tlib_HoodRelsRightFailMechRels_LowPowerCANFD_C "" VALUE 0x00720c0d Val_Wu8 1 OneToOne 0.0 255.00 FORMAT "%8.2" /end CHARACTERISTIC
/begin CHARACTERISTIC Tlib_HoodRelsRightFailFailure1_LowPowerCANFD_C "" VALUE 0x00720c0e Val_Wu8 1 OneToOne 0.0 255.00 FORMAT "%8.2" /end CHARACTERISTIC
/begin CHARACTERISTIC Tlib_TrReqFromSwtIntr_LowPowerCANFD_C "" VALUE 0x00720c0f Val_Wu8 1 OneToOne 0.0 255.00 FORMAT "%8.2" /end CHARACTERISTIC
/begin CHARACTERISTIC Tlib_DoorPassSwtIntrLockgReq_LowPowerCANFD_C "" VALUE 0x00720c10 Val_Wu8 1 OneToOne 0.0 255.00 FORMAT "%8.2" /end CHARACTERISTIC
/begin CHARACTERISTIC Tlib_OpenPassSwt_LowPowerCANFD_C "" VALUE 0x00720c11 Val_Wu8 1 OneToOne 0.0 255.00 FORMAT "%8.2" /end CHARACTERISTIC
/begin CHARACTERISTIC Tlib_WinFailrStsAtReRiHi_LowPowerCANFD_C "" VALUE 0x00720c12 Val_Wu8 1 OneToOne 0.0 255.00 FORMAT "%8.2" /end CHARACTERISTIC
/begin CHARACTERISTIC Tlib_DoorRiReSwtLockgStsHi_LowPowerCANFD_C "" VALUE 0x00720c13 Val_Wu8 1 OneToOne 0.0 255.00 FORMAT "%8.2" /end CHARACTERISTIC
/begin CHARACTERISTIC Tlib_WindowLearnStAtReRiHi_LowPowerCANFD_C "" VALUE 0x00720c14 Val_Wu8 1 OneToOne 0.0 255.00 FORMAT "%8.2" /end CHARACTERISTIC
/begin CHARACTERISTIC Tlib_DoorPassHndlSts_LowPowerCANFD_C "" VALUE 0x00720c15 Val_Wu8 1 OneToOne 0.0 255.00 FORMAT "%8.2" /end CHARACTERISTIC
/begin CHARACTERISTIC Tlib_IceBreakDoorPassActv_LowPowerCANFD_C "" VALUE 0x00720c16 Val_Wu8 1 OneToOne 0.0 255.00 FORMAT "%8.2" /end CHARACTERISTIC
/begin CHARACTERISTIC Tlib_ObstStrRiRe_LowPowerCANFD_C "" VALUE 0x00720c17 Val_Wu8 1 OneToOne 0.0 255.00 FORMAT "%8.2" /end CHARACTERISTIC
/begin CHARACTERISTIC Tlib_CinhPassSts_LowPowerCANFD_C "" VALUE 0x00720c18 Val_Wu8 1 OneToOne 0.0 255.00 FORMAT "%8.2" /end CHARACTERISTIC
/begin CHARACTERISTIC Tlib_CinhPassSwtHi_LowPowerCANFD_C "" VALUE 0x00720c19 Val_Wu8 1 OneToOne 0.0 255.00 FORMAT "%8.2" /end CHARACTERISTIC
/begin CHARACTERISTIC Tlib_WinDiagcAtReRiHiOpenCirc_LowPowerCANFD_C "" VALUE 0x00720c1a Val_Wu8 1 OneToOne 0.0 255.00 FORMAT "%8.2" /end CHARACTERISTIC
/begin CHARACTERISTIC Tlib_WinDiagcAtReRiHivoltageoutofrange_LowPowerCANFD_C "" VALUE 0x00720c1b Val_Wu8 1 OneToOne 0.0 255.00 FORMAT "%8.2" /end CHARACTERISTIC
/begin CHARACTERISTIC Tlib_WinDiagcAtReRiHiOverCurrent_LowPowerCANFD_C "" VALUE 0x00720c1c Val_Wu8 1 OneToOne 0.0 255.00 FORMAT "%8.2" /end CHARACTERISTIC
/begin CHARACTERISTIC Tlib_WinDiagcAtReRiHiIntElecFailr_LowPowerCANFD_C "" VALUE 0x00720c1d Val_Wu8 1 OneToOne 0.0 255.00 FORMAT "%8.2" /end CHARACTERISTIC
/begin CHARACTERISTIC Tlib_WinDiagcAtReRiHiRipplefault_LowPowerCANFD_C "" VALUE 0x00720c1e Val_Wu8 1 OneToOne 0.0 255.00 FORMAT "%8.2" /end CHARACTERISTIC
/begin CHARACTERISTIC Tlib_WinDiagcAtReRiHiOverTemperature_LowPowerCANFD_C "" VALUE 0x00720c1f Val_Wu8 1 OneToOne 0.0 255.00 FORMAT "%8.2" /end CHARACTERISTIC
/begin CHARACTERISTIC Tlib_WinDiagcAtReRiHiMeclFailr_LowPowerCANFD_C "" VALUE 0x00720c20 Val_Wu8 1 OneToOne 0.0 255.00 FORMAT "%8.2" /end CHARACTERISTIC
/begin CHARACTERISTIC Tlib_WinDiagcAtReRiHiMissCal_LowPowerCANFD_C "" VALUE 0x00720c21 Val_Wu8 1 OneToOne 0.0 255.00 FORMAT "%8.2" /end CHARACTERISTIC
/begin CHARACTERISTIC Tlib_CinhPassStsHi_LowPowerCANFD_C "" VALUE 0x00720c22 Val_Wu8 1 OneToOne 0.0 255.00 FORMAT "%8.2" /end CHARACTERISTIC
/begin CHARACTERISTIC Tlib_PawlPassSwtHi_LowPowerCANFD_C "" VALUE 0x00720c23 Val_Wu8 1 OneToOne 0.0 255.00 FORMAT "%8.2" /end CHARACTERISTIC
/begin CHARACTERISTIC Tlib_ObstStrPass_LowPowerCANFD_C "" VALUE 0x00720c24 Val_Wu8 1 OneToOne 0.0 255.00 FORMAT "%8.2" /end CHARACTERISTIC
/begin CHARACTERISTIC Tlib_MirrDwnStsAtPass_LowPowerCANFD_C "" VALUE 0x00720c25 Val_Wu8 1 OneToOne 0.0 255.00 FORMAT "%8.2" /end CHARACTERISTIC
/begin CHARACTERISTIC Tlib_SecLVPwrSplyErrStsChks8_LowPowerCANFD_C "" VALUE 0x00720c26 Val_Wu8 1 OneToOne 0.0 255.00 FORMAT "%8.2" /end CHARACTERISTIC
/begin CHARACTERISTIC Tlib_SecLVPwrSplyErrStsDataID4_LowPowerCANFD_C "" VALUE 0x00720c27 Val_Wu8 1 OneToOne 0.0 255.00 FORMAT "%8.2" /end CHARACTERISTIC
/begin CHARACTERISTIC Tlib_SecLVPwrSplyErrStsCntr4_LowPowerCANFD_C "" VALUE 0x00720c28 Val_Wu8 1 OneToOne 0.0 255.00 FORMAT "%8.2" /end CHARACTERISTIC
/begin CHARACTERISTIC Tlib_SecLVPwrSplyErrStsSts_LowPowerCANFD_C "" VALUE 0x0072082c Val_Wu16 1 OneToOne 0.0 65535 FORMAT "%8.2" /end CHARACTERISTIC
/begin CHARACTERISTIC Tlib_DoorRiReOpenReqOutdSwtHi2_LowPowerCANFD_C "" VALUE 0x00720c29 Val_Wu8 1 OneToOne 0.0 255.00 FORMAT "%8.2" /end CHARACTERISTIC
/begin CHARACTERISTIC Tlib_NRRDoorRiReOpenOutdSwtIfHi2OfLocking_LowPowerCANFD_C "" VALUE 0x00720c2a Val_Wu8 1 OneToOne 0.0 255.00 FORMAT "%8.2" /end CHARACTERISTIC
/begin CHARACTERISTIC Tlib_NRRDoorRiReOpenInsdSwtIfHi2OfLocking_LowPowerCANFD_C "" VALUE 0x00720c2b Val_Wu8 1 OneToOne 0.0 255.00 FORMAT "%8.2" /end CHARACTERISTIC
/begin CHARACTERISTIC Tlib_DoorRiReOpenReqInsdSwtHi2_LowPowerCANFD_C "" VALUE 0x00720c2c Val_Wu8 1 OneToOne 0.0 255.00 FORMAT "%8.2" /end CHARACTERISTIC
/begin CHARACTERISTIC Tlib_NRRDoorRiReOpenInsdSwtIfHi1OfLocking_LowPowerCANFD_C "" VALUE 0x00720c2d Val_Wu8 1 OneToOne 0.0 255.00 FORMAT "%8.2" /end CHARACTERISTIC
/begin CHARACTERISTIC Tlib_NRRDoorRiReSnsrIfHiOfLocking_LowPowerCANFD_C "" VALUE 0x00720c2e Val_Wu8 1 OneToOne 0.0 255.00 FORMAT "%8.2" /end CHARACTERISTIC
/begin CHARACTERISTIC Tlib_DoorRiReOpenReqInsdSwtHi1_LowPowerCANFD_C "" VALUE 0x00720c2f Val_Wu8 1 OneToOne 0.0 255.00 FORMAT "%8.2" /end CHARACTERISTIC
/begin CHARACTERISTIC Tlib_DoorPassLockSts_LowPowerCANFD_C "" VALUE 0x00720c30 Val_Wu8 1 OneToOne 0.0 255.00 FORMAT "%8.2" /end CHARACTERISTIC
/begin CHARACTERISTIC Tlib_DoorPassStsDataID4_LowPowerCANFD_C "" VALUE 0x00720c31 Val_Wu8 1 OneToOne 0.0 255.00 FORMAT "%8.2" /end CHARACTERISTIC
/begin CHARACTERISTIC Tlib_DoorPassStsCntr4_LowPowerCANFD_C "" VALUE 0x00720c32 Val_Wu8 1 OneToOne 0.0 255.00 FORMAT "%8.2" /end CHARACTERISTIC
/begin CHARACTERISTIC Tlib_DoorPassStsDoorSts2_LowPowerCANFD_C "" VALUE 0x00720c33 Val_Wu8 1 OneToOne 0.0 255.00 FORMAT "%8.2" /end CHARACTERISTIC
/begin CHARACTERISTIC Tlib_DoorPassStsChks8_LowPowerCANFD_C "" VALUE 0x00720c34 Val_Wu8 1 OneToOne 0.0 255.00 FORMAT "%8.2" /end CHARACTERISTIC
/begin CHARACTERISTIC Tlib_CrashSts3_LowPowerCANFD_C "" VALUE 0x00720c35 Val_Wu8 1 OneToOne 0.0 255.00 FORMAT "%8.2" /end CHARACTERISTIC
/begin CHARACTERISTIC Tlib_ActvnOfWaitMode_ZCR_CANFD1_C "" VALUE 0x00720c36 Val_Wu8 1 OneToOne 0.0 255.00 FORMAT "%8.2" /end CHARACTERISTIC
/begin CHARACTERISTIC Tlib_ActvnOfLiForComity_ZCR_CANFD1_C "" VALUE 0x00720c37 Val_Wu8 1 OneToOne 0.0 255.00 FORMAT "%8.2" /end CHARACTERISTIC
/begin CHARACTERISTIC Tlib_ActvnOfAhbc_ZCR_CANFD1_C "" VALUE 0x00720c38 Val_Wu8 1 OneToOne 0.0 255.00 FORMAT "%8.2" /end CHARACTERISTIC
/begin CHARACTERISTIC Tlib_CameraStsforAHBC_ZCR_CANFD1_C "" VALUE 0x00720c39 Val_Wu8 1 OneToOne 0.0 255.00 FORMAT "%8.2" /end CHARACTERISTIC
/begin CHARACTERISTIC Tlib_IndcrPatCmd1WdTiOn_ZCR_CANFD1_C "" VALUE 0x0072082e Val_Wu16 1 OneToOne 0.0 65535 FORMAT "%8.2" /end CHARACTERISTIC
/begin CHARACTERISTIC Tlib_IndcrPatCmd1WdTiOff_ZCR_CANFD1_C "" VALUE 0x00720830 Val_Wu16 1 OneToOne 0.0 65535 FORMAT "%8.2" /end CHARACTERISTIC
/begin CHARACTERISTIC Tlib_ActnOfLedFrntFogLamp_ZCR_CANFD1_C "" VALUE 0x00720c3a Val_Wu8 1 OneToOne 0.0 255.00 FORMAT "%8.2" /end CHARACTERISTIC
/begin CHARACTERISTIC Tlib_ActnOfLedPosnLampDyn_ZCR_CANFD1_C "" VALUE 0x00720c3b Val_Wu8 1 OneToOne 0.0 255.00 FORMAT "%8.2" /end CHARACTERISTIC
/begin CHARACTERISTIC Tlib_LitArea_ZCR_CANFD1_C "" VALUE 0x00720c3c Val_Wu8 1 OneToOne 0.0 255.00 FORMAT "%8.2" /end CHARACTERISTIC
/begin CHARACTERISTIC Tlib_TooManyCars_ZCR_CANFD1_C "" VALUE 0x00720c3d Val_Wu8 1 OneToOne 0.0 255.00 FORMAT "%8.2" /end CHARACTERISTIC
/begin CHARACTERISTIC Tlib_ActvnOfAhl_ZCR_CANFD1_C "" VALUE 0x00720c3e Val_Wu8 1 OneToOne 0.0 255.00 FORMAT "%8.2" /end CHARACTERISTIC
/begin CHARACTERISTIC Tlib_ActvnOfADB_ZCR_CANFD1_C "" VALUE 0x00720c3f Val_Wu8 1 OneToOne 0.0 255.00 FORMAT "%8.2" /end CHARACTERISTIC
/begin CHARACTERISTIC Tlib_ActvnOfDbl_ZCR_CANFD1_C "" VALUE 0x00720c40 Val_Wu8 1 OneToOne 0.0 255.00 FORMAT "%8.2" /end CHARACTERISTIC
/*********** Start of merged FUNCTION blocks ***********/ /*********** Start of merged FUNCTION blocks ***********/
/begin FUNCTION XcpAppl "4200.2.0  XCP Calibration Protocol Applikation" FUNCTION_VERSION "4200.2.0" /end FUNCTION
/begin COMPU_METHOD OneToOne "" RAT_FUNC "%6.2" "-" COEFFS 0 1 0 0 0 1 /end COMPU_METHOD
/*********** Start of merged RECORD_LAYOUT blocks ***********/
/begin RECORD_LAYOUT DefaultValueRecordLayout_boolean FNC_VALUES 1 UBYTE COLUMN_DIR DIRECT STATIC_RECORD_LAYOUT /end RECORD_LAYOUT
/begin RECORD_LAYOUT DefaultValueRecordLayout_uint16 FNC_VALUES 1 UWORD COLUMN_DIR DIRECT STATIC_RECORD_LAYOUT /end RECORD_LAYOUT
/begin RECORD_LAYOUT DefaultValueRecordLayout_uint8 FNC_VALUES 1 UBYTE COLUMN_DIR DIRECT STATIC_RECORD_LAYOUT /end RECORD_LAYOUT
/begin RECORD_LAYOUT DefaultValueRecordLayout_uint32 FNC_VALUES 1 ULONG COLUMN_DIR DIRECT STATIC_RECORD_LAYOUT /end RECORD_LAYOUT
/*********** End of merged RECORD_LAYOUT blocks ***********/
/begin RECORD_LAYOUT KwbUb FNC_VALUES 1 UBYTE COLUMN_DIR DIRECT /end RECORD_LAYOUT
/begin RECORD_LAYOUT KwUb FNC_VALUES 1 UBYTE COLUMN_DIR DIRECT /end RECORD_LAYOUT
/begin RECORD_LAYOUT Val_WS16 FNC_VALUES 1 SWORD COLUMN_DIR DIRECT /end RECORD_LAYOUT
/begin RECORD_LAYOUT Val_WS32 FNC_VALUES 1 SLONG COLUMN_DIR DIRECT /end RECORD_LAYOUT
/begin RECORD_LAYOUT Val_Wu16 FNC_VALUES 1 UWORD COLUMN_DIR DIRECT /end RECORD_LAYOUT
/begin RECORD_LAYOUT Val_Wu32 FNC_VALUES 1 ULONG COLUMN_DIR DIRECT /end RECORD_LAYOUT
/begin RECORD_LAYOUT Val_Wu8 FNC_VALUES 1 UBYTE COLUMN_DIR DIRECT /end RECORD_LAYOUT
/*********** End of merged UNIT blocks ***********/
/end MODULE
/end PROJECT
