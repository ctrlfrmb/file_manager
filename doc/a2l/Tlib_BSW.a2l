ASAP2_VERSION 1 61
/begin PROJECT ZCU "ZCU"
/begin HEADER "" VERSION "ZCU" PROJECT_NO ZCU /end HEADER
/begin MODULE DIM ""
/begin MOD_COMMON "" BYTE_ORDER MSB_LAST ALIGNMENT_BYTE 1 ALIGNMENT_WORD 2 ALIGNMENT_LONG 4 ALIGNMENT_INT64 4 ALIGNMENT_FLOAT32_IEEE 4 ALIGNMENT_FLOAT64_IEEE 4 DATA_SIZE 32 /end MOD_COMMON
/begin CHARACTERISTIC Tlib_IndcrNoSeq_ZCR_CANFD1_C "" VALUE 0x00720c41 Val_Wu8 1 OneToOne 0.0 255.00 FORMAT "%8.2" /end CHARACTERISTIC
/begin CHARACTERISTIC Tlib_ActvnOfAfs_ZCR_CANFD1_C "" VALUE 0x00720c42 Val_Wu8 1 OneToOne 0.0 255.00 FORMAT "%8.2" /end CHARACTERISTIC
/begin CHARACTERISTIC Tlib_ActvnOfTouristMod_ZCR_CANFD1_C "" VALUE 0x00720c43 Val_Wu8 1 OneToOne 0.0 255.00 FORMAT "%8.2" /end CHARACTERISTIC
/begin CHARACTERISTIC Tlib_ActnOfLedGrilleLampDyn_ZCR_CANFD1_C "" VALUE 0x00720c44 Val_Wu8 1 OneToOne 0.0 255.00 FORMAT "%8.2" /end CHARACTERISTIC
/begin CHARACTERISTIC Tlib_ActvnOfCarLoctr_ZCR_CANFD1_C "" VALUE 0x00720c45 Val_Wu8 1 OneToOne 0.0 255.00 FORMAT "%8.2" /end CHARACTERISTIC
/begin CHARACTERISTIC Tlib_ActnOfLedGrilleLamp_ZCR_CANFD1_C "" VALUE 0x00720c46 Val_Wu8 1 OneToOne 0.0 255.00 FORMAT "%8.2" /end CHARACTERISTIC
/begin CHARACTERISTIC Tlib_ActnOfLedHiBeam_ZCR_CANFD1_C "" VALUE 0x00720c47 Val_Wu8 1 OneToOne 0.0 255.00 FORMAT "%8.2" /end CHARACTERISTIC
/begin CHARACTERISTIC Tlib_ActnOfLedDaytiRunngLamp_ZCR_CANFD1_C "" VALUE 0x00720c48 Val_Wu8 1 OneToOne 0.0 255.00 FORMAT "%8.2" /end CHARACTERISTIC
/begin CHARACTERISTIC Tlib_ActvnOfGoodByeLi_ZCR_CANFD1_C "" VALUE 0x00720c49 Val_Wu8 1 OneToOne 0.0 255.00 FORMAT "%8.2" /end CHARACTERISTIC
/begin CHARACTERISTIC Tlib_ActnOfLedRiLogoLampDyn_ZCR_CANFD1_C "" VALUE 0x00720c4a Val_Wu8 1 OneToOne 0.0 255.00 FORMAT "%8.2" /end CHARACTERISTIC
/begin CHARACTERISTIC Tlib_ActvnOfLiForWait_ZCR_CANFD1_C "" VALUE 0x00720c4b Val_Wu8 1 OneToOne 0.0 255.00 FORMAT "%8.2" /end CHARACTERISTIC
/begin CHARACTERISTIC Tlib_ActnOfLedRiLogoLamp_ZCR_CANFD1_C "" VALUE 0x00720c4c Val_Wu8 1 OneToOne 0.0 255.00 FORMAT "%8.2" /end CHARACTERISTIC
/begin CHARACTERISTIC Tlib_ActvnOfLiForSpkr_ZCR_CANFD1_C "" VALUE 0x00720c4d Val_Wu8 1 OneToOne 0.0 255.00 FORMAT "%8.2" /end CHARACTERISTIC
/begin CHARACTERISTIC Tlib_ActnOfLedCornrgLampRi_ZCR_CANFD1_C "" VALUE 0x00720c4e Val_Wu8 1 OneToOne 0.0 255.00 FORMAT "%8.2" /end CHARACTERISTIC
/begin CHARACTERISTIC Tlib_ActvnOfIndcrIndcrOut_ZCR_CANFD1_C "" VALUE 0x00720c4f Val_Wu8 1 OneToOne 0.0 255.00 FORMAT "%8.2" /end CHARACTERISTIC
/begin CHARACTERISTIC Tlib_ActvnOfIndcrCntr4_ZCR_CANFD1_C "" VALUE 0x00720c50 Val_Wu8 1 OneToOne 0.0 255.00 FORMAT "%8.2" /end CHARACTERISTIC
/begin CHARACTERISTIC Tlib_ActvnOfIndcrChks8_ZCR_CANFD1_C "" VALUE 0x00720c51 Val_Wu8 1 OneToOne 0.0 255.00 FORMAT "%8.2" /end CHARACTERISTIC
/begin CHARACTERISTIC Tlib_ActvnOfIndcrDataID4_ZCR_CANFD1_C "" VALUE 0x00720c52 Val_Wu8 1 OneToOne 0.0 255.00 FORMAT "%8.2" /end CHARACTERISTIC
/begin CHARACTERISTIC Tlib_ActvnOfHomeSafe_ZCR_CANFD1_C "" VALUE 0x00720c53 Val_Wu8 1 OneToOne 0.0 255.00 FORMAT "%8.2" /end CHARACTERISTIC
/begin CHARACTERISTIC Tlib_ActnOfLedLoBeamDataID4_ZCR_CANFD1_C "" VALUE 0x00720c54 Val_Wu8 1 OneToOne 0.0 255.00 FORMAT "%8.2" /end CHARACTERISTIC
/begin CHARACTERISTIC Tlib_ActnOfLedLoBeamOnOffSafe1_ZCR_CANFD1_C "" VALUE 0x00720c55 Val_Wu8 1 OneToOne 0.0 255.00 FORMAT "%8.2" /end CHARACTERISTIC
/begin CHARACTERISTIC Tlib_ActnOfLedLoBeamChks8_ZCR_CANFD1_C "" VALUE 0x00720c56 Val_Wu8 1 OneToOne 0.0 255.00 FORMAT "%8.2" /end CHARACTERISTIC
/begin CHARACTERISTIC Tlib_ActnOfLedLoBeamCntr4_ZCR_CANFD1_C "" VALUE 0x00720c57 Val_Wu8 1 OneToOne 0.0 255.00 FORMAT "%8.2" /end CHARACTERISTIC
/begin CHARACTERISTIC Tlib_ActnOfLedFrntCrossLamp_ZCR_CANFD1_C "" VALUE 0x00720c58 Val_Wu8 1 OneToOne 0.0 255.00 FORMAT "%8.2" /end CHARACTERISTIC
/begin CHARACTERISTIC Tlib_ActvnOfApproach_ZCR_CANFD1_C "" VALUE 0x00720c59 Val_Wu8 1 OneToOne 0.0 255.00 FORMAT "%8.2" /end CHARACTERISTIC
/begin CHARACTERISTIC Tlib_ActnOfLedFrntCrossLampDyn_ZCR_CANFD1_C "" VALUE 0x00720c5a Val_Wu8 1 OneToOne 0.0 255.00 FORMAT "%8.2" /end CHARACTERISTIC
/begin CHARACTERISTIC Tlib_LvlgSwtSetReq_ZCR_CANFD1_C "" VALUE 0x00720c5b Val_Wu8 1 OneToOne 0.0 255.00 FORMAT "%8.2" /end CHARACTERISTIC
/begin CHARACTERISTIC Tlib_ActnOfLedPosnLampChks8_ZCR_CANFD1_C "" VALUE 0x00720c5c Val_Wu8 1 OneToOne 0.0 255.00 FORMAT "%8.2" /end CHARACTERISTIC
/begin CHARACTERISTIC Tlib_ActnOfLedPosnLampCntr4_ZCR_CANFD1_C "" VALUE 0x00720c5d Val_Wu8 1 OneToOne 0.0 255.00 FORMAT "%8.2" /end CHARACTERISTIC
/begin CHARACTERISTIC Tlib_ActnOfLedPosnLampDataID4_ZCR_CANFD1_C "" VALUE 0x00720c5e Val_Wu8 1 OneToOne 0.0 255.00 FORMAT "%8.2" /end CHARACTERISTIC
/begin CHARACTERISTIC Tlib_ActnOfLedPosnLampOnOffSafe1_ZCR_CANFD1_C "" VALUE 0x00720c5f Val_Wu8 1 OneToOne 0.0 255.00 FORMAT "%8.2" /end CHARACTERISTIC
/begin CHARACTERISTIC Tlib_WelcomeGoodbyeSetReq_ZCR_CANFD1_C "" VALUE 0x00720c60 Val_Wu8 1 OneToOne 0.0 255.00 FORMAT "%8.2" /end CHARACTERISTIC
/begin CHARACTERISTIC Tlib_VehObjforADB4AdbVertAg_ZCR_CANFD1_C "" VALUE 0x00720c61 Val_Wu8 1 OneToOne 0.0 255.00 FORMAT "%8.2" /end CHARACTERISTIC
/begin CHARACTERISTIC Tlib_VehObjforADB4AdbHozlAgRi_ZCR_CANFD1_C "" VALUE 0x00720832 Val_Wu16 1 OneToOne 0.0 65535 FORMAT "%8.2" /end CHARACTERISTIC
/begin CHARACTERISTIC Tlib_VehObjforADB4AdbObjHozlAgSpdRi_ZCR_CANFD1_C "" VALUE 0x00720834 Val_Wu16 1 OneToOne 0.0 65535 FORMAT "%8.2" /end CHARACTERISTIC
/begin CHARACTERISTIC Tlib_VehObjforADB4AdbClassn_ZCR_CANFD1_C "" VALUE 0x00720c62 Val_Wu8 1 OneToOne 0.0 255.00 FORMAT "%8.2" /end CHARACTERISTIC
/begin CHARACTERISTIC Tlib_VehObjforADB4AdbHozlAgLe_ZCR_CANFD1_C "" VALUE 0x00720836 Val_Wu16 1 OneToOne 0.0 65535 FORMAT "%8.2" /end CHARACTERISTIC
/begin CHARACTERISTIC Tlib_VehObjforADB4AdbAbsDist_ZCR_CANFD1_C "" VALUE 0x00720838 Val_Wu16 1 OneToOne 0.0 65535 FORMAT "%8.2" /end CHARACTERISTIC
/begin CHARACTERISTIC Tlib_VehObjforADB4AdbObjHozlAgSpdLe_ZCR_CANFD1_C "" VALUE 0x0072083a Val_Wu16 1 OneToOne 0.0 65535 FORMAT "%8.2" /end CHARACTERISTIC
/begin CHARACTERISTIC Tlib_VehObjforADB4AdbTrkInfo_ZCR_CANFD1_C "" VALUE 0x00720c63 Val_Wu8 1 OneToOne 0.0 255.00 FORMAT "%8.2" /end CHARACTERISTIC
/begin CHARACTERISTIC Tlib_VehObjforADB4AdbObjDir_ZCR_CANFD1_C "" VALUE 0x00720c64 Val_Wu8 1 OneToOne 0.0 255.00 FORMAT "%8.2" /end CHARACTERISTIC
/begin CHARACTERISTIC Tlib_VehObjforADB1AdbAbsDist_ZCR_CANFD1_C "" VALUE 0x0072083c Val_Wu16 1 OneToOne 0.0 65535 FORMAT "%8.2" /end CHARACTERISTIC
/begin CHARACTERISTIC Tlib_VehObjforADB1AdbHozlAgRi_ZCR_CANFD1_C "" VALUE 0x0072083e Val_Wu16 1 OneToOne 0.0 65535 FORMAT "%8.2" /end CHARACTERISTIC
/begin CHARACTERISTIC Tlib_VehObjforADB1AdbHozlAgLe_ZCR_CANFD1_C "" VALUE 0x00720840 Val_Wu16 1 OneToOne 0.0 65535 FORMAT "%8.2" /end CHARACTERISTIC
/begin CHARACTERISTIC Tlib_VehObjforADB1AdbObjHozlAgSpdRi_ZCR_CANFD1_C "" VALUE 0x00720842 Val_Wu16 1 OneToOne 0.0 65535 FORMAT "%8.2" /end CHARACTERISTIC
/begin CHARACTERISTIC Tlib_VehObjforADB1AdbTrkInfo_ZCR_CANFD1_C "" VALUE 0x00720c65 Val_Wu8 1 OneToOne 0.0 255.00 FORMAT "%8.2" /end CHARACTERISTIC
/begin CHARACTERISTIC Tlib_VehObjforADB1AdbVertAg_ZCR_CANFD1_C "" VALUE 0x00720c66 Val_Wu8 1 OneToOne 0.0 255.00 FORMAT "%8.2" /end CHARACTERISTIC
/begin CHARACTERISTIC Tlib_VehObjforADB1AdbClassn_ZCR_CANFD1_C "" VALUE 0x00720c67 Val_Wu8 1 OneToOne 0.0 255.00 FORMAT "%8.2" /end CHARACTERISTIC
/begin CHARACTERISTIC Tlib_VehObjforADB1AdbObjHozlAgSpdLe_ZCR_CANFD1_C "" VALUE 0x00720844 Val_Wu16 1 OneToOne 0.0 65535 FORMAT "%8.2" /end CHARACTERISTIC
/begin CHARACTERISTIC Tlib_VehObjforADB1AdbObjDir_ZCR_CANFD1_C "" VALUE 0x00720c68 Val_Wu8 1 OneToOne 0.0 255.00 FORMAT "%8.2" /end CHARACTERISTIC
/begin CHARACTERISTIC Tlib_VehObjforADB2AdbTrkInfo_ZCR_CANFD1_C "" VALUE 0x00720c69 Val_Wu8 1 OneToOne 0.0 255.00 FORMAT "%8.2" /end CHARACTERISTIC
/begin CHARACTERISTIC Tlib_VehObjforADB2AdbObjHozlAgSpdLe_ZCR_CANFD1_C "" VALUE 0x00720846 Val_Wu16 1 OneToOne 0.0 65535 FORMAT "%8.2" /end CHARACTERISTIC
/begin CHARACTERISTIC Tlib_VehObjforADB2AdbClassn_ZCR_CANFD1_C "" VALUE 0x00720c6a Val_Wu8 1 OneToOne 0.0 255.00 FORMAT "%8.2" /end CHARACTERISTIC
/begin CHARACTERISTIC Tlib_VehObjforADB2AdbVertAg_ZCR_CANFD1_C "" VALUE 0x00720c6b Val_Wu8 1 OneToOne 0.0 255.00 FORMAT "%8.2" /end CHARACTERISTIC
/begin CHARACTERISTIC Tlib_VehObjforADB2AdbObjDir_ZCR_CANFD1_C "" VALUE 0x00720c6c Val_Wu8 1 OneToOne 0.0 255.00 FORMAT "%8.2" /end CHARACTERISTIC
/begin CHARACTERISTIC Tlib_VehObjforADB2AdbAbsDist_ZCR_CANFD1_C "" VALUE 0x00720848 Val_Wu16 1 OneToOne 0.0 65535 FORMAT "%8.2" /end CHARACTERISTIC
/begin CHARACTERISTIC Tlib_VehObjforADB2AdbHozlAgLe_ZCR_CANFD1_C "" VALUE 0x0072084a Val_Wu16 1 OneToOne 0.0 65535 FORMAT "%8.2" /end CHARACTERISTIC
/begin CHARACTERISTIC Tlib_VehObjforADB2AdbHozlAgRi_ZCR_CANFD1_C "" VALUE 0x0072084c Val_Wu16 1 OneToOne 0.0 65535 FORMAT "%8.2" /end CHARACTERISTIC
/begin CHARACTERISTIC Tlib_VehObjforADB2AdbObjHozlAgSpdRi_ZCR_CANFD1_C "" VALUE 0x0072084e Val_Wu16 1 OneToOne 0.0 65535 FORMAT "%8.2" /end CHARACTERISTIC
/begin CHARACTERISTIC Tlib_VehObjforADB3AdbTrkInfo_ZCR_CANFD1_C "" VALUE 0x00720c6d Val_Wu8 1 OneToOne 0.0 255.00 FORMAT "%8.2" /end CHARACTERISTIC
/begin CHARACTERISTIC Tlib_VehObjforADB3AdbClassn_ZCR_CANFD1_C "" VALUE 0x00720c6e Val_Wu8 1 OneToOne 0.0 255.00 FORMAT "%8.2" /end CHARACTERISTIC
/begin CHARACTERISTIC Tlib_VehObjforADB3AdbHozlAgRi_ZCR_CANFD1_C "" VALUE 0x00720850 Val_Wu16 1 OneToOne 0.0 65535 FORMAT "%8.2" /end CHARACTERISTIC
/begin CHARACTERISTIC Tlib_VehObjforADB3AdbObjHozlAgSpdLe_ZCR_CANFD1_C "" VALUE 0x00720852 Val_Wu16 1 OneToOne 0.0 65535 FORMAT "%8.2" /end CHARACTERISTIC
/begin CHARACTERISTIC Tlib_VehObjforADB3AdbHozlAgLe_ZCR_CANFD1_C "" VALUE 0x00720854 Val_Wu16 1 OneToOne 0.0 65535 FORMAT "%8.2" /end CHARACTERISTIC
/begin CHARACTERISTIC Tlib_VehObjforADB3AdbVertAg_ZCR_CANFD1_C "" VALUE 0x00720c6f Val_Wu8 1 OneToOne 0.0 255.00 FORMAT "%8.2" /end CHARACTERISTIC
/begin CHARACTERISTIC Tlib_VehObjforADB3AdbObjDir_ZCR_CANFD1_C "" VALUE 0x00720c70 Val_Wu8 1 OneToOne 0.0 255.00 FORMAT "%8.2" /end CHARACTERISTIC
/begin CHARACTERISTIC Tlib_VehObjforADB3AdbAbsDist_ZCR_CANFD1_C "" VALUE 0x00720856 Val_Wu16 1 OneToOne 0.0 65535 FORMAT "%8.2" /end CHARACTERISTIC
/begin CHARACTERISTIC Tlib_VehObjforADB3AdbObjHozlAgSpdRi_ZCR_CANFD1_C "" VALUE 0x00720858 Val_Wu16 1 OneToOne 0.0 65535 FORMAT "%8.2" /end CHARACTERISTIC
/begin CHARACTERISTIC Tlib_VehObjforADB5AdbClassn_ZCR_CANFD1_C "" VALUE 0x00720c71 Val_Wu8 1 OneToOne 0.0 255.00 FORMAT "%8.2" /end CHARACTERISTIC
/begin CHARACTERISTIC Tlib_VehObjforADB5AdbTrkInfo_ZCR_CANFD1_C "" VALUE 0x00720c72 Val_Wu8 1 OneToOne 0.0 255.00 FORMAT "%8.2" /end CHARACTERISTIC
/begin CHARACTERISTIC Tlib_VehObjforADB5AdbObjDir_ZCR_CANFD1_C "" VALUE 0x00720c73 Val_Wu8 1 OneToOne 0.0 255.00 FORMAT "%8.2" /end CHARACTERISTIC
/begin CHARACTERISTIC Tlib_VehObjforADB5AdbVertAg_ZCR_CANFD1_C "" VALUE 0x00720c74 Val_Wu8 1 OneToOne 0.0 255.00 FORMAT "%8.2" /end CHARACTERISTIC
/begin CHARACTERISTIC Tlib_VehObjforADB5AdbAbsDist_ZCR_CANFD1_C "" VALUE 0x0072085a Val_Wu16 1 OneToOne 0.0 65535 FORMAT "%8.2" /end CHARACTERISTIC
/begin CHARACTERISTIC Tlib_VehObjforADB5AdbHozlAgLe_ZCR_CANFD1_C "" VALUE 0x0072085c Val_Wu16 1 OneToOne 0.0 65535 FORMAT "%8.2" /end CHARACTERISTIC
/begin CHARACTERISTIC Tlib_VehObjforADB5AdbObjHozlAgSpdLe_ZCR_CANFD1_C "" VALUE 0x0072085e Val_Wu16 1 OneToOne 0.0 65535 FORMAT "%8.2" /end CHARACTERISTIC
/begin CHARACTERISTIC Tlib_VehObjforADB5AdbObjHozlAgSpdRi_ZCR_CANFD1_C "" VALUE 0x00720860 Val_Wu16 1 OneToOne 0.0 65535 FORMAT "%8.2" /end CHARACTERISTIC
/begin CHARACTERISTIC Tlib_VehObjforADB5AdbHozlAgRi_ZCR_CANFD1_C "" VALUE 0x00720862 Val_Wu16 1 OneToOne 0.0 65535 FORMAT "%8.2" /end CHARACTERISTIC
/begin CHARACTERISTIC Tlib_OutdBriSts_ZCR_CANFD1_C "" VALUE 0x00720c75 Val_Wu8 1 OneToOne 0.0 255.00 FORMAT "%8.2" /end CHARACTERISTIC
/begin CHARACTERISTIC Tlib_OutdBriChks8_ZCR_CANFD1_C "" VALUE 0x00720c76 Val_Wu8 1 OneToOne 0.0 255.00 FORMAT "%8.2" /end CHARACTERISTIC
/begin CHARACTERISTIC Tlib_OutdBriDataID4_ZCR_CANFD1_C "" VALUE 0x00720c77 Val_Wu8 1 OneToOne 0.0 255.00 FORMAT "%8.2" /end CHARACTERISTIC
/begin CHARACTERISTIC Tlib_OutdBriCntr4_ZCR_CANFD1_C "" VALUE 0x00720c78 Val_Wu8 1 OneToOne 0.0 255.00 FORMAT "%8.2" /end CHARACTERISTIC
/begin CHARACTERISTIC Tlib_BrkPedlrRatQf_ZCR_CANFD1_C "" VALUE 0x00720c79 Val_Wu8 1 OneToOne 0.0 255.00 FORMAT "%8.2" /end CHARACTERISTIC
/begin CHARACTERISTIC Tlib_BrkPedlrRatPerc_ZCR_CANFD1_C "" VALUE 0x00720864 Val_Wu16 1 OneToOne 0.0 65535 FORMAT "%8.2" /end CHARACTERISTIC
/begin CHARACTERISTIC Tlib_IndcrSts_ZCR_CANFD1_C "" VALUE 0x00720c7a Val_Wu8 1 OneToOne 0.0 255.00 FORMAT "%8.2" /end CHARACTERISTIC
/begin CHARACTERISTIC Tlib_SteerWhlSnsrAg_ZCR_CANFD1_C "" VALUE 0x00720866 Val_WS16 1 OneToOne -32768 32767 FORMAT "%8.2" /end CHARACTERISTIC
/begin CHARACTERISTIC Tlib_SteerWhlSnsrAgSpd_ZCR_CANFD1_C "" VALUE 0x00720868 Val_WS16 1 OneToOne -32768 32767 FORMAT "%8.2" /end CHARACTERISTIC
/begin CHARACTERISTIC Tlib_SteerWhlSnsrQf_ZCR_CANFD1_C "" VALUE 0x00720c7b Val_Wu8 1 OneToOne 0.0 255.00 FORMAT "%8.2" /end CHARACTERISTIC
/begin CHARACTERISTIC Tlib_SteerWhlSnsrChks8_ZCR_CANFD1_C "" VALUE 0x00720c7c Val_Wu8 1 OneToOne 0.0 255.00 FORMAT "%8.2" /end CHARACTERISTIC
/begin CHARACTERISTIC Tlib_SteerWhlSnsrDataID4_ZCR_CANFD1_C "" VALUE 0x00720c7d Val_Wu8 1 OneToOne 0.0 255.00 FORMAT "%8.2" /end CHARACTERISTIC
/begin CHARACTERISTIC Tlib_SteerWhlSnsrCntr4_ZCR_CANFD1_C "" VALUE 0x00720c7e Val_Wu8 1 OneToOne 0.0 255.00 FORMAT "%8.2" /end CHARACTERISTIC
/begin CHARACTERISTIC Tlib_ActvnOfWelcomeLi_ZCR_CANFD1_C "" VALUE 0x00720c7f Val_Wu8 1 OneToOne 0.0 255.00 FORMAT "%8.2" /end CHARACTERISTIC
/begin CHARACTERISTIC Tlib_VehModMngtGlbSafeChks8_ZCR_CANFD1_C "" VALUE 0x00720c80 Val_Wu8 1 OneToOne 0.0 255.00 FORMAT "%8.2" /end CHARACTERISTIC
/begin CHARACTERISTIC Tlib_VehModMngtGlbSafePwrLvlElecSubtyp_ZCR_CANFD1_C "" VALUE 0x00720c81 Val_Wu8 1 OneToOne 0.0 255.00 FORMAT "%8.2" /end CHARACTERISTIC
/begin CHARACTERISTIC Tlib_VehModMngtGlbSafeEgyLvlElecSubtyp_ZCR_CANFD1_C "" VALUE 0x00720c82 Val_Wu8 1 OneToOne 0.0 255.00 FORMAT "%8.2" /end CHARACTERISTIC
/begin CHARACTERISTIC Tlib_VehModMngtGlbSafeCarModSubtypWdCarModSubtyp_ZCR_CANFD1_C "" VALUE 0x00720c83 Val_Wu8 1 OneToOne 0.0 255.00 FORMAT "%8.2" /end CHARACTERISTIC
/begin CHARACTERISTIC Tlib_VehModMngtGlbSafeDataID4_ZCR_CANFD1_C "" VALUE 0x00720c84 Val_Wu8 1 OneToOne 0.0 255.00 FORMAT "%8.2" /end CHARACTERISTIC
/begin CHARACTERISTIC Tlib_VehModMngtGlbSafeCarModSts_ZCR_CANFD1_C "" VALUE 0x00720c85 Val_Wu8 1 OneToOne 0.0 255.00 FORMAT "%8.2" /end CHARACTERISTIC
/begin CHARACTERISTIC Tlib_VehModMngtGlbSafeEgyLvlElecMai_ZCR_CANFD1_C "" VALUE 0x00720c86 Val_Wu8 1 OneToOne 0.0 255.00 FORMAT "%8.2" /end CHARACTERISTIC
/begin CHARACTERISTIC Tlib_VehModMngtGlbSafePwrModSts_ZCR_CANFD1_C "" VALUE 0x00720c87 Val_Wu8 1 OneToOne 0.0 255.00 FORMAT "%8.2" /end CHARACTERISTIC
/begin CHARACTERISTIC Tlib_VehModMngtGlbSafeCntr4_ZCR_CANFD1_C "" VALUE 0x00720c88 Val_Wu8 1 OneToOne 0.0 255.00 FORMAT "%8.2" /end CHARACTERISTIC
/begin CHARACTERISTIC Tlib_VehModMngtGlbSafePwrLvlElecMai_ZCR_CANFD1_C "" VALUE 0x00720c89 Val_Wu8 1 OneToOne 0.0 255.00 FORMAT "%8.2" /end CHARACTERISTIC
/begin CHARACTERISTIC Tlib_VehModMngtGlbSafeFltEgyCnsWdSts_ZCR_CANFD1_C "" VALUE 0x00720c8a Val_Wu8 1 OneToOne 0.0 255.00 FORMAT "%8.2" /end CHARACTERISTIC
/begin CHARACTERISTIC Tlib_ActvnOfHDZebra_ZCR_CANFD1_C "" VALUE 0x00720c8b Val_Wu8 1 OneToOne 0.0 255.00 FORMAT "%8.2" /end CHARACTERISTIC
/begin CHARACTERISTIC Tlib_AmbTRawAmbTEstimdQf_ZCR_CANFD1_C "" VALUE 0x00720c8c Val_Wu8 1 OneToOne 0.0 255.00 FORMAT "%8.2" /end CHARACTERISTIC
/begin CHARACTERISTIC Tlib_AmbTRawAmbTEstimd_ZCR_CANFD1_C "" VALUE 0x0072086a Val_Wu16 1 OneToOne 0.0 65535 FORMAT "%8.2" /end CHARACTERISTIC
/begin CHARACTERISTIC Tlib_ActvnOfHDLaneLine_ZCR_CANFD1_C "" VALUE 0x00720c8d Val_Wu8 1 OneToOne 0.0 255.00 FORMAT "%8.2" /end CHARACTERISTIC
/begin CHARACTERISTIC Tlib_BrkPedlSnsrQf_ZCR_CANFD1_C "" VALUE 0x00720c8e Val_Wu8 1 OneToOne 0.0 255.00 FORMAT "%8.2" /end CHARACTERISTIC
/begin CHARACTERISTIC Tlib_BrkPedlSnsrSt_ZCR_CANFD1_C "" VALUE 0x00720c8f Val_Wu8 1 OneToOne 0.0 255.00 FORMAT "%8.2" /end CHARACTERISTIC
/begin CHARACTERISTIC Tlib_BrkPedlSnsrDataID4_ZCR_CANFD1_C "" VALUE 0x00720c90 Val_Wu8 1 OneToOne 0.0 255.00 FORMAT "%8.2" /end CHARACTERISTIC
/begin CHARACTERISTIC Tlib_BrkPedlSnsrChks8_ZCR_CANFD1_C "" VALUE 0x00720c91 Val_Wu8 1 OneToOne 0.0 255.00 FORMAT "%8.2" /end CHARACTERISTIC
/begin CHARACTERISTIC Tlib_BrkPedlSnsrCntr4_ZCR_CANFD1_C "" VALUE 0x00720c92 Val_Wu8 1 OneToOne 0.0 255.00 FORMAT "%8.2" /end CHARACTERISTIC
/begin CHARACTERISTIC Tlib_AccrPedlRatAccrPedlRat_ZCR_CANFD1_C "" VALUE 0x0072086c Val_Wu16 1 OneToOne 0.0 65535 FORMAT "%8.2" /end CHARACTERISTIC
/begin CHARACTERISTIC Tlib_AccrPedlRatDataID4_ZCR_CANFD1_C "" VALUE 0x00720c93 Val_Wu8 1 OneToOne 0.0 255.00 FORMAT "%8.2" /end CHARACTERISTIC
/begin CHARACTERISTIC Tlib_AccrPedlRatCntr4_ZCR_CANFD1_C "" VALUE 0x00720c94 Val_Wu8 1 OneToOne 0.0 255.00 FORMAT "%8.2" /end CHARACTERISTIC
/begin CHARACTERISTIC Tlib_AccrPedlRatChks8_ZCR_CANFD1_C "" VALUE 0x00720c95 Val_Wu8 1 OneToOne 0.0 255.00 FORMAT "%8.2" /end CHARACTERISTIC
/begin CHARACTERISTIC Tlib_YawRateReqdByDrvr_ZCR_CANFD1_C "" VALUE 0x0072086e Val_WS16 1 OneToOne -32768 32767 FORMAT "%8.2" /end CHARACTERISTIC
/begin CHARACTERISTIC Tlib_WipgInfoWiprInWipgAr_ZCR_CANFD1_C "" VALUE 0x00720c96 Val_Wu8 1 OneToOne 0.0 255.00 FORMAT "%8.2" /end CHARACTERISTIC
/begin CHARACTERISTIC Tlib_WipgInfoWiprActv_ZCR_CANFD1_C "" VALUE 0x00720c97 Val_Wu8 1 OneToOne 0.0 255.00 FORMAT "%8.2" /end CHARACTERISTIC
/begin CHARACTERISTIC Tlib_WipgInfoWipgSpdInfo_ZCR_CANFD1_C "" VALUE 0x00720c98 Val_Wu8 1 OneToOne 0.0 255.00 FORMAT "%8.2" /end CHARACTERISTIC
/begin CHARACTERISTIC Tlib_OdoMeter_ZCR_CANFD1_C "" VALUE 0x007204d0 Val_Wu32 1 OneToOne 0.0 4294967295 FORMAT "%8.2" /end CHARACTERISTIC
/begin CHARACTERISTIC Tlib_TrafficSignForADB2AdbHozlAgRi_ZCR_CANFD1_C "" VALUE 0x00720870 Val_Wu16 1 OneToOne 0.0 65535 FORMAT "%8.2" /end CHARACTERISTIC
/begin CHARACTERISTIC Tlib_TrafficSignForADB2AdbVertAgBot_ZCR_CANFD1_C "" VALUE 0x00720872 Val_Wu16 1 OneToOne 0.0 65535 FORMAT "%8.2" /end CHARACTERISTIC
/begin CHARACTERISTIC Tlib_TrafficSignForADB2AdbVertAgTop_ZCR_CANFD1_C "" VALUE 0x00720874 Val_Wu16 1 OneToOne 0.0 65535 FORMAT "%8.2" /end CHARACTERISTIC
/begin CHARACTERISTIC Tlib_TrafficSignForADB2AdbAbsDist_ZCR_CANFD1_C "" VALUE 0x00720876 Val_Wu16 1 OneToOne 0.0 65535 FORMAT "%8.2" /end CHARACTERISTIC
/begin CHARACTERISTIC Tlib_TrafficSignForADB2AdbHozlAgLe_ZCR_CANFD1_C "" VALUE 0x00720878 Val_Wu16 1 OneToOne 0.0 65535 FORMAT "%8.2" /end CHARACTERISTIC
/begin CHARACTERISTIC Tlib_TrafficSignForADB2AdbTrkInfo_ZCR_CANFD1_C "" VALUE 0x00720c99 Val_Wu8 1 OneToOne 0.0 255.00 FORMAT "%8.2" /end CHARACTERISTIC
/begin CHARACTERISTIC Tlib_TrafficSignForADB2AdbDetdQly_ZCR_CANFD1_C "" VALUE 0x00720c9a Val_Wu8 1 OneToOne 0.0 255.00 FORMAT "%8.2" /end CHARACTERISTIC
/begin CHARACTERISTIC Tlib_TrafficSignForADB1AdbHozlAgLe_ZCR_CANFD1_C "" VALUE 0x0072087a Val_Wu16 1 OneToOne 0.0 65535 FORMAT "%8.2" /end CHARACTERISTIC
/begin CHARACTERISTIC Tlib_TrafficSignForADB1AdbHozlAgRi_ZCR_CANFD1_C "" VALUE 0x0072087c Val_Wu16 1 OneToOne 0.0 65535 FORMAT "%8.2" /end CHARACTERISTIC
/begin CHARACTERISTIC Tlib_TrafficSignForADB1AdbVertAgTop_ZCR_CANFD1_C "" VALUE 0x0072087e Val_Wu16 1 OneToOne 0.0 65535 FORMAT "%8.2" /end CHARACTERISTIC
/begin CHARACTERISTIC Tlib_TrafficSignForADB1AdbDetdQly_ZCR_CANFD1_C "" VALUE 0x00720c9b Val_Wu8 1 OneToOne 0.0 255.00 FORMAT "%8.2" /end CHARACTERISTIC
/begin CHARACTERISTIC Tlib_TrafficSignForADB1AdbAbsDist_ZCR_CANFD1_C "" VALUE 0x00720880 Val_Wu16 1 OneToOne 0.0 65535 FORMAT "%8.2" /end CHARACTERISTIC
/begin CHARACTERISTIC Tlib_TrafficSignForADB1AdbTrkInfo_ZCR_CANFD1_C "" VALUE 0x00720c9c Val_Wu8 1 OneToOne 0.0 255.00 FORMAT "%8.2" /end CHARACTERISTIC
/begin CHARACTERISTIC Tlib_TrafficSignForADB1AdbVertAgBot_ZCR_CANFD1_C "" VALUE 0x00720882 Val_Wu16 1 OneToOne 0.0 65535 FORMAT "%8.2" /end CHARACTERISTIC
/begin CHARACTERISTIC Tlib_VehSpdLgtQf_ZCR_CANFD1_C "" VALUE 0x00720c9d Val_Wu8 1 OneToOne 0.0 255.00 FORMAT "%8.2" /end CHARACTERISTIC
/begin CHARACTERISTIC Tlib_VehSpdLgtA_ZCR_CANFD1_C "" VALUE 0x00720884 Val_Wu16 1 OneToOne 0.0 65535 FORMAT "%8.2" /end CHARACTERISTIC
/begin CHARACTERISTIC Tlib_VehSpdLgtChks8_ZCR_CANFD1_C "" VALUE 0x00720c9e Val_Wu8 1 OneToOne 0.0 255.00 FORMAT "%8.2" /end CHARACTERISTIC
/begin CHARACTERISTIC Tlib_VehSpdLgtDataID4_ZCR_CANFD1_C "" VALUE 0x00720c9f Val_Wu8 1 OneToOne 0.0 255.00 FORMAT "%8.2" /end CHARACTERISTIC
/begin CHARACTERISTIC Tlib_VehSpdLgtCntr4_ZCR_CANFD1_C "" VALUE 0x00720ca0 Val_Wu8 1 OneToOne 0.0 255.00 FORMAT "%8.2" /end CHARACTERISTIC
/begin CHARACTERISTIC Tlib_VehObjforAHBAdbClassnQly_ZCR_CANFD1_C "" VALUE 0x00720ca1 Val_Wu8 1 OneToOne 0.0 255.00 FORMAT "%8.2" /end CHARACTERISTIC
/begin CHARACTERISTIC Tlib_VehObjforAHBAdbVertAg_ZCR_CANFD1_C "" VALUE 0x00720ca2 Val_Wu8 1 OneToOne 0.0 255.00 FORMAT "%8.2" /end CHARACTERISTIC
/begin CHARACTERISTIC Tlib_VehObjforAHBAdbObjHozlAgSpd_ZCR_CANFD1_C "" VALUE 0x00720886 Val_Wu16 1 OneToOne 0.0 65535 FORMAT "%8.2" /end CHARACTERISTIC
/begin CHARACTERISTIC Tlib_VehObjforAHBAdbAbsDist_ZCR_CANFD1_C "" VALUE 0x00720888 Val_Wu16 1 OneToOne 0.0 65535 FORMAT "%8.2" /end CHARACTERISTIC
/begin CHARACTERISTIC Tlib_VehObjforAHBAdbHozlAg_ZCR_CANFD1_C "" VALUE 0x0072088a Val_Wu16 1 OneToOne 0.0 65535 FORMAT "%8.2" /end CHARACTERISTIC
/begin CHARACTERISTIC Tlib_VehObjforAHBAdbObjVertAgSpd_ZCR_CANFD1_C "" VALUE 0x0072088c Val_Wu16 1 OneToOne 0.0 65535 FORMAT "%8.2" /end CHARACTERISTIC
/begin CHARACTERISTIC Tlib_VehObjforAHBAdbTrkInfo_ZCR_CANFD1_C "" VALUE 0x00720ca3 Val_Wu8 1 OneToOne 0.0 255.00 FORMAT "%8.2" /end CHARACTERISTIC
/begin CHARACTERISTIC Tlib_VehObjforAHBAdbDetdQly_ZCR_CANFD1_C "" VALUE 0x00720ca4 Val_Wu8 1 OneToOne 0.0 255.00 FORMAT "%8.2" /end CHARACTERISTIC
/begin CHARACTERISTIC Tlib_VehObjforAHBAdbObjDir_ZCR_CANFD1_C "" VALUE 0x00720ca5 Val_Wu8 1 OneToOne 0.0 255.00 FORMAT "%8.2" /end CHARACTERISTIC
/begin CHARACTERISTIC Tlib_VehObjforAHBAdbClassn_ZCR_CANFD1_C "" VALUE 0x00720ca6 Val_Wu8 1 OneToOne 0.0 255.00 FORMAT "%8.2" /end CHARACTERISTIC
/begin CHARACTERISTIC Tlib_VehObjforADB6AdbAbsDist_ZCR_CANFD1_C "" VALUE 0x0072088e Val_Wu16 1 OneToOne 0.0 65535 FORMAT "%8.2" /end CHARACTERISTIC
/begin CHARACTERISTIC Tlib_VehObjforADB6AdbObjHozlAgSpdRi_ZCR_CANFD1_C "" VALUE 0x00720890 Val_Wu16 1 OneToOne 0.0 65535 FORMAT "%8.2" /end CHARACTERISTIC
/begin CHARACTERISTIC Tlib_VehObjforADB6AdbHozlAgLe_ZCR_CANFD1_C "" VALUE 0x00720892 Val_Wu16 1 OneToOne 0.0 65535 FORMAT "%8.2" /end CHARACTERISTIC
/begin CHARACTERISTIC Tlib_VehObjforADB6AdbObjDir_ZCR_CANFD1_C "" VALUE 0x00720ca7 Val_Wu8 1 OneToOne 0.0 255.00 FORMAT "%8.2" /end CHARACTERISTIC
/begin CHARACTERISTIC Tlib_VehObjforADB6AdbVertAg_ZCR_CANFD1_C "" VALUE 0x00720ca8 Val_Wu8 1 OneToOne 0.0 255.00 FORMAT "%8.2" /end CHARACTERISTIC
/begin CHARACTERISTIC Tlib_VehObjforADB6AdbHozlAgRi_ZCR_CANFD1_C "" VALUE 0x00720894 Val_Wu16 1 OneToOne 0.0 65535 FORMAT "%8.2" /end CHARACTERISTIC
/begin CHARACTERISTIC Tlib_VehObjforADB6AdbClassn_ZCR_CANFD1_C "" VALUE 0x00720ca9 Val_Wu8 1 OneToOne 0.0 255.00 FORMAT "%8.2" /end CHARACTERISTIC
/begin CHARACTERISTIC Tlib_VehObjforADB6AdbObjHozlAgSpdLe_ZCR_CANFD1_C "" VALUE 0x00720896 Val_Wu16 1 OneToOne 0.0 65535 FORMAT "%8.2" /end CHARACTERISTIC
/begin CHARACTERISTIC Tlib_VehObjforADB6AdbTrkInfo_ZCR_CANFD1_C "" VALUE 0x00720caa Val_Wu8 1 OneToOne 0.0 255.00 FORMAT "%8.2" /end CHARACTERISTIC
/begin CHARACTERISTIC Tlib_SuspPosnVertAgSuspPosnVertAg_ZCR_CANFD1_C "" VALUE 0x00720898 Val_WS16 1 OneToOne -32768 32767 FORMAT "%8.2" /end CHARACTERISTIC
/begin CHARACTERISTIC Tlib_SuspPosnVertAgGenQf_ZCR_CANFD1_C "" VALUE 0x00720cab Val_Wu8 1 OneToOne 0.0 255.00 FORMAT "%8.2" /end CHARACTERISTIC
/begin CHARACTERISTIC Tlib_VehObjforADB7AdbAbsDist_ZCR_CANFD1_C "" VALUE 0x0072089a Val_Wu16 1 OneToOne 0.0 65535 FORMAT "%8.2" /end CHARACTERISTIC
/begin CHARACTERISTIC Tlib_VehObjforADB7AdbObjDir_ZCR_CANFD1_C "" VALUE 0x00720cac Val_Wu8 1 OneToOne 0.0 255.00 FORMAT "%8.2" /end CHARACTERISTIC
/begin CHARACTERISTIC Tlib_VehObjforADB7AdbTrkInfo_ZCR_CANFD1_C "" VALUE 0x00720cad Val_Wu8 1 OneToOne 0.0 255.00 FORMAT "%8.2" /end CHARACTERISTIC
/begin CHARACTERISTIC Tlib_VehObjforADB7AdbHozlAgLe_ZCR_CANFD1_C "" VALUE 0x0072089c Val_Wu16 1 OneToOne 0.0 65535 FORMAT "%8.2" /end CHARACTERISTIC
/begin CHARACTERISTIC Tlib_VehObjforADB7AdbHozlAgRi_ZCR_CANFD1_C "" VALUE 0x0072089e Val_Wu16 1 OneToOne 0.0 65535 FORMAT "%8.2" /end CHARACTERISTIC
/begin CHARACTERISTIC Tlib_VehObjforADB7AdbObjHozlAgSpdLe_ZCR_CANFD1_C "" VALUE 0x007208a0 Val_Wu16 1 OneToOne 0.0 65535 FORMAT "%8.2" /end CHARACTERISTIC
/begin CHARACTERISTIC Tlib_VehObjforADB7AdbClassn_ZCR_CANFD1_C "" VALUE 0x00720cae Val_Wu8 1 OneToOne 0.0 255.00 FORMAT "%8.2" /end CHARACTERISTIC
/begin CHARACTERISTIC Tlib_VehObjforADB7AdbVertAg_ZCR_CANFD1_C "" VALUE 0x00720caf Val_Wu8 1 OneToOne 0.0 255.00 FORMAT "%8.2" /end CHARACTERISTIC
/begin CHARACTERISTIC Tlib_VehObjforADB7AdbObjHozlAgSpdRi_ZCR_CANFD1_C "" VALUE 0x007208a2 Val_Wu16 1 OneToOne 0.0 65535 FORMAT "%8.2" /end CHARACTERISTIC
/begin CHARACTERISTIC Tlib_SuspPosnVertLvlRe_ZCR_CANFD1_C "" VALUE 0x007208a4 Val_WS16 1 OneToOne -32768 32767 FORMAT "%8.2" /end CHARACTERISTIC
/begin CHARACTERISTIC Tlib_SuspPosnVertLvlReQf_ZCR_CANFD1_C "" VALUE 0x00720cb0 Val_Wu8 1 OneToOne 0.0 255.00 FORMAT "%8.2" /end CHARACTERISTIC
/begin CHARACTERISTIC Tlib_SuspPosnVertLvlFrntQf_ZCR_CANFD1_C "" VALUE 0x00720cb1 Val_Wu8 1 OneToOne 0.0 255.00 FORMAT "%8.2" /end CHARACTERISTIC
/begin CHARACTERISTIC Tlib_SuspPosnVertLvlFrnt_ZCR_CANFD1_C "" VALUE 0x007208a6 Val_WS16 1 OneToOne -32768 32767 FORMAT "%8.2" /end CHARACTERISTIC
/begin CHARACTERISTIC Tlib_VehObjforADB8AdbHozlAgRi_ZCR_CANFD1_C "" VALUE 0x007208a8 Val_Wu16 1 OneToOne 0.0 65535 FORMAT "%8.2" /end CHARACTERISTIC
/begin CHARACTERISTIC Tlib_VehObjforADB8AdbVertAg_ZCR_CANFD1_C "" VALUE 0x00720cb2 Val_Wu8 1 OneToOne 0.0 255.00 FORMAT "%8.2" /end CHARACTERISTIC
/begin CHARACTERISTIC Tlib_VehObjforADB8AdbAbsDist_ZCR_CANFD1_C "" VALUE 0x007208aa Val_Wu16 1 OneToOne 0.0 65535 FORMAT "%8.2" /end CHARACTERISTIC
/begin CHARACTERISTIC Tlib_VehObjforADB8AdbClassn_ZCR_CANFD1_C "" VALUE 0x00720cb3 Val_Wu8 1 OneToOne 0.0 255.00 FORMAT "%8.2" /end CHARACTERISTIC
/begin CHARACTERISTIC Tlib_VehObjforADB8AdbObjHozlAgSpdRi_ZCR_CANFD1_C "" VALUE 0x007208ac Val_Wu16 1 OneToOne 0.0 65535 FORMAT "%8.2" /end CHARACTERISTIC
/begin CHARACTERISTIC Tlib_VehObjforADB8AdbObjHozlAgSpdLe_ZCR_CANFD1_C "" VALUE 0x007208ae Val_Wu16 1 OneToOne 0.0 65535 FORMAT "%8.2" /end CHARACTERISTIC
/begin CHARACTERISTIC Tlib_VehObjforADB8AdbTrkInfo_ZCR_CANFD1_C "" VALUE 0x00720cb4 Val_Wu8 1 OneToOne 0.0 255.00 FORMAT "%8.2" /end CHARACTERISTIC
/begin CHARACTERISTIC Tlib_VehObjforADB8AdbObjDir_ZCR_CANFD1_C "" VALUE 0x00720cb5 Val_Wu8 1 OneToOne 0.0 255.00 FORMAT "%8.2" /end CHARACTERISTIC
/begin CHARACTERISTIC Tlib_VehObjforADB8AdbHozlAgLe_ZCR_CANFD1_C "" VALUE 0x007208b0 Val_Wu16 1 OneToOne 0.0 65535 FORMAT "%8.2" /end CHARACTERISTIC
/begin CHARACTERISTIC Tlib_LiGroupPwrReqSmtLED1_ZCR_CANFD1_C "" VALUE 0x00720cb6 Val_Wu8 1 OneToOne 0.0 255.00 FORMAT "%8.2" /end CHARACTERISTIC
/begin CHARACTERISTIC Tlib_LiGroupPwrReqALMGroup1_ZCR_CANFD1_C "" VALUE 0x00720cb7 Val_Wu8 1 OneToOne 0.0 255.00 FORMAT "%8.2" /end CHARACTERISTIC
/begin CHARACTERISTIC Tlib_LiGroupPwrReqALMGroup2_ZCR_CANFD1_C "" VALUE 0x00720cb8 Val_Wu8 1 OneToOne 0.0 255.00 FORMAT "%8.2" /end CHARACTERISTIC
/begin CHARACTERISTIC Tlib_LiGroupPwrReqSmtLED2_ZCR_CANFD1_C "" VALUE 0x00720cb9 Val_Wu8 1 OneToOne 0.0 255.00 FORMAT "%8.2" /end CHARACTERISTIC
/begin CHARACTERISTIC Tlib_LiGroupPwrReqHCMR1_ZCR_CANFD1_C "" VALUE 0x00720cba Val_Wu8 1 OneToOne 0.0 255.00 FORMAT "%8.2" /end CHARACTERISTIC
/begin CHARACTERISTIC Tlib_LiGroupPwrReqCbnIntr_ZCR_CANFD1_C "" VALUE 0x00720cbb Val_Wu8 1 OneToOne 0.0 255.00 FORMAT "%8.2" /end CHARACTERISTIC
/begin CHARACTERISTIC Tlib_LiGroupPwrReqFCSI_ZCR_CANFD1_C "" VALUE 0x00720cbc Val_Wu8 1 OneToOne 0.0 255.00 FORMAT "%8.2" /end CHARACTERISTIC
/begin CHARACTERISTIC Tlib_LiGroupPwrReqOHC_ZCR_CANFD1_C "" VALUE 0x00720cbd Val_Wu8 1 OneToOne 0.0 255.00 FORMAT "%8.2" /end CHARACTERISTIC
/begin CHARACTERISTIC Tlib_LiGroupPwrReqRCM1_ZCR_CANFD1_C "" VALUE 0x00720cbe Val_Wu8 1 OneToOne 0.0 255.00 FORMAT "%8.2" /end CHARACTERISTIC
/begin CHARACTERISTIC Tlib_LiGroupPwrReqCLML_ZCR_CANFD1_C "" VALUE 0x00720cbf Val_Wu8 1 OneToOne 0.0 255.00 FORMAT "%8.2" /end CHARACTERISTIC
/begin CHARACTERISTIC Tlib_LiGroupPwrReqCLMR_ZCR_CANFD1_C "" VALUE 0x00720cc0 Val_Wu8 1 OneToOne 0.0 255.00 FORMAT "%8.2" /end CHARACTERISTIC
/begin CHARACTERISTIC Tlib_LiGroupPwrReqHCML2_ZCR_CANFD1_C "" VALUE 0x00720cc1 Val_Wu8 1 OneToOne 0.0 255.00 FORMAT "%8.2" /end CHARACTERISTIC
/begin CHARACTERISTIC Tlib_LiGroupPwrReqLiResd1_ZCR_CANFD1_C "" VALUE 0x00720cc2 Val_Wu8 1 OneToOne 0.0 255.00 FORMAT "%8.2" /end CHARACTERISTIC
/begin CHARACTERISTIC Tlib_LiGroupPwrReqLiResd2_ZCR_CANFD1_C "" VALUE 0x00720cc3 Val_Wu8 1 OneToOne 0.0 255.00 FORMAT "%8.2" /end CHARACTERISTIC
/begin CHARACTERISTIC Tlib_LiGroupPwrReqHCMR2_ZCR_CANFD1_C "" VALUE 0x00720cc4 Val_Wu8 1 OneToOne 0.0 255.00 FORMAT "%8.2" /end CHARACTERISTIC
/begin CHARACTERISTIC Tlib_LiGroupPwrReqHCML1_ZCR_CANFD1_C "" VALUE 0x00720cc5 Val_Wu8 1 OneToOne 0.0 255.00 FORMAT "%8.2" /end CHARACTERISTIC
/begin CHARACTERISTIC Tlib_LiGroupPwrReqRCM2_ZCR_CANFD1_C "" VALUE 0x00720cc6 Val_Wu8 1 OneToOne 0.0 255.00 FORMAT "%8.2" /end CHARACTERISTIC
/begin CHARACTERISTIC Tlib_LiGroupPwrReqLiResd3_ZCR_CANFD1_C "" VALUE 0x00720cc7 Val_Wu8 1 OneToOne 0.0 255.00 FORMAT "%8.2" /end CHARACTERISTIC
/begin CHARACTERISTIC Tlib_LiGroupPwrReqLiResd4_ZCR_CANFD1_C "" VALUE 0x00720cc8 Val_Wu8 1 OneToOne 0.0 255.00 FORMAT "%8.2" /end CHARACTERISTIC
/begin CHARACTERISTIC Tlib_LiGroupPwrReqChks8_ZCR_CANFD1_C "" VALUE 0x00720cc9 Val_Wu8 1 OneToOne 0.0 255.00 FORMAT "%8.2" /end CHARACTERISTIC
/begin CHARACTERISTIC Tlib_LiGroupPwrReqDataID4_ZCR_CANFD1_C "" VALUE 0x00720cca Val_Wu8 1 OneToOne 0.0 255.00 FORMAT "%8.2" /end CHARACTERISTIC
/begin CHARACTERISTIC Tlib_LiGroupPwrReqCntr4_ZCR_CANFD1_C "" VALUE 0x00720ccb Val_Wu8 1 OneToOne 0.0 255.00 FORMAT "%8.2" /end CHARACTERISTIC
/begin CHARACTERISTIC Tlib_GearLvrIndcn2_ZCR_CANFD1_C "" VALUE 0x00720ccc Val_Wu8 1 OneToOne 0.0 255.00 FORMAT "%8.2" /end CHARACTERISTIC
/begin CHARACTERISTIC Tlib_GearLvrIndcnDataID4_ZCR_CANFD1_C "" VALUE 0x00720ccd Val_Wu8 1 OneToOne 0.0 255.00 FORMAT "%8.2" /end CHARACTERISTIC
/begin CHARACTERISTIC Tlib_GearLvrIndcnCntr4_ZCR_CANFD1_C "" VALUE 0x00720cce Val_Wu8 1 OneToOne 0.0 255.00 FORMAT "%8.2" /end CHARACTERISTIC
/begin CHARACTERISTIC Tlib_GearLvrIndcnChks8_ZCR_CANFD1_C "" VALUE 0x00720ccf Val_Wu8 1 OneToOne 0.0 255.00 FORMAT "%8.2" /end CHARACTERISTIC
/begin CHARACTERISTIC Tlib_UtcTiGlbUtcTiVal_ZCR_CANFD1_C "" VALUE 0x007204d4 Val_Wu32 1 OneToOne 0.0 4294967295 FORMAT "%8.2" /end CHARACTERISTIC
/begin CHARACTERISTIC Tlib_UtcTiGlbDataValid_ZCR_CANFD1_C "" VALUE 0x00720cd0 Val_Wu8 1 OneToOne 0.0 255.00 FORMAT "%8.2" /end CHARACTERISTIC
/begin CHARACTERISTIC Tlib_VehLVSysUZCLVehLVSysUBkp_ZCR_CANFD1_C "" VALUE 0x00720cd1 Val_Wu8 1 OneToOne 0.0 255.00 FORMAT "%8.2" /end CHARACTERISTIC
/begin CHARACTERISTIC Tlib_VehLVSysUZCLVehLVSysUMai_ZCR_CANFD1_C "" VALUE 0x00720cd2 Val_Wu8 1 OneToOne 0.0 255.00 FORMAT "%8.2" /end CHARACTERISTIC
/begin CHARACTERISTIC Tlib_HvSysRlyStsChks8_ZCR_CANFD1_C "" VALUE 0x00720cd3 Val_Wu8 1 OneToOne 0.0 255.00 FORMAT "%8.2" /end CHARACTERISTIC
/begin CHARACTERISTIC Tlib_HvSysRlyStsCntr4_ZCR_CANFD1_C "" VALUE 0x00720cd4 Val_Wu8 1 OneToOne 0.0 255.00 FORMAT "%8.2" /end CHARACTERISTIC
/begin CHARACTERISTIC Tlib_HvSysRlyStsDataID4_ZCR_CANFD1_C "" VALUE 0x00720cd5 Val_Wu8 1 OneToOne 0.0 255.00 FORMAT "%8.2" /end CHARACTERISTIC
/begin CHARACTERISTIC Tlib_HvSysRlyStsRly_ZCR_CANFD1_C "" VALUE 0x00720cd6 Val_Wu8 1 OneToOne 0.0 255.00 FORMAT "%8.2" /end CHARACTERISTIC
/begin CHARACTERISTIC Tlib_ReHvacFanSpd_ZCR_LIN3_C "" VALUE 0x00720cd7 Val_Wu8 1 OneToOne 0.0 255.00 FORMAT "%8.2" /end CHARACTERISTIC
/begin CHARACTERISTIC Tlib_ReHvacFanKneeU_ZCR_LIN3_C "" VALUE 0x00720cd8 Val_Wu8 1 OneToOne 0.0 255.00 FORMAT "%8.2" /end CHARACTERISTIC
/begin CHARACTERISTIC Tlib_ReHvacFanIMaxMax_ZCR_LIN3_C "" VALUE 0x00720cd9 Val_Wu8 1 OneToOne 0.0 255.00 FORMAT "%8.2" /end CHARACTERISTIC
/begin CHARACTERISTIC Tlib_ReHvacFanRxFrq_ZCR_LIN3_C "" VALUE 0x007208b2 Val_Wu16 1 OneToOne 0.0 65535 FORMAT "%8.2" /end CHARACTERISTIC
/begin CHARACTERISTIC Tlib_ReHvacFanRamp_ZCR_LIN3_C "" VALUE 0x00720cda Val_Wu8 1 OneToOne 0.0 255.00 FORMAT "%8.2" /end CHARACTERISTIC
/begin CHARACTERISTIC Tlib_ReHvacFanIMaxMin_ZCR_LIN3_C "" VALUE 0x00720cdb Val_Wu8 1 OneToOne 0.0 255.00 FORMAT "%8.2" /end CHARACTERISTIC
/begin CHARACTERISTIC Tlib_ReHvacFanSftyRunSpd_ZCR_LIN3_C "" VALUE 0x00720cdc Val_Wu8 1 OneToOne 0.0 255.00 FORMAT "%8.2" /end CHARACTERISTIC
/begin CHARACTERISTIC Tlib_ReHvacFanSeln_ZCR_LIN3_C "" VALUE 0x00720cdd Val_Wu8 1 OneToOne 0.0 255.00 FORMAT "%8.2" /end CHARACTERISTIC
/begin CHARACTERISTIC Tlib_ReHvacFanSftyRunThd_ZCR_LIN3_C "" VALUE 0x00720cde Val_Wu8 1 OneToOne 0.0 255.00 FORMAT "%8.2" /end CHARACTERISTIC
/begin CHARACTERISTIC Tlib_AFUConcReq_ZCR_LIN3_C "" VALUE 0x00720cdf Val_Wu8 1 OneToOne 0.0 255.00 FORMAT "%8.2" /end CHARACTERISTIC
/begin CHARACTERISTIC Tlib_AIUActn_ZCR_LIN3_C "" VALUE 0x00720ce0 Val_Wu8 1 OneToOne 0.0 255.00 FORMAT "%8.2" /end CHARACTERISTIC
/begin CHARACTERISTIC Tlib_HfaMotMode_ZCR_LIN3_C "" VALUE 0x00720ce1 Val_Wu8 1 OneToOne 0.0 255.00 FORMAT "%8.2" /end CHARACTERISTIC
/begin CHARACTERISTIC Tlib_HfaMotBlockCmd_ZCR_LIN3_C "" VALUE 0x00720ce2 Val_Wu8 1 OneToOne 0.0 255.00 FORMAT "%8.2" /end CHARACTERISTIC
/begin CHARACTERISTIC Tlib_HfaMotUrgcPson_ZCR_LIN3_C "" VALUE 0x00720ce3 Val_Wu8 1 OneToOne 0.0 255.00 FORMAT "%8.2" /end CHARACTERISTIC
/begin CHARACTERISTIC Tlib_HfaMotCoilPwrOn_ZCR_LIN3_C "" VALUE 0x00720ce4 Val_Wu8 1 OneToOne 0.0 255.00 FORMAT "%8.2" /end CHARACTERISTIC
/begin CHARACTERISTIC Tlib_HfaMotPsonAvl_ZCR_LIN3_C "" VALUE 0x00720ce5 Val_Wu8 1 OneToOne 0.0 255.00 FORMAT "%8.2" /end CHARACTERISTIC
/begin CHARACTERISTIC Tlib_HfaMotStrtPson_ZCR_LIN3_C "" VALUE 0x007208b4 Val_Wu16 1 OneToOne 0.0 65535 FORMAT "%8.2" /end CHARACTERISTIC
/begin CHARACTERISTIC Tlib_HfaMotSaveData_ZCR_LIN3_C "" VALUE 0x00720ce6 Val_Wu8 1 OneToOne 0.0 255.00 FORMAT "%8.2" /end CHARACTERISTIC
/begin CHARACTERISTIC Tlib_HfaMotAdr_ZCR_LIN3_C "" VALUE 0x00720ce7 Val_Wu8 1 OneToOne 0.0 255.00 FORMAT "%8.2" /end CHARACTERISTIC
/begin CHARACTERISTIC Tlib_HfaMotUrgcUnlck_ZCR_LIN3_C "" VALUE 0x00720ce8 Val_Wu8 1 OneToOne 0.0 255.00 FORMAT "%8.2" /end CHARACTERISTIC
/begin CHARACTERISTIC Tlib_HfaMotClearReq_ZCR_LIN3_C "" VALUE 0x00720ce9 Val_Wu8 1 OneToOne 0.0 255.00 FORMAT "%8.2" /end CHARACTERISTIC
/begin CHARACTERISTIC Tlib_HfaMotTargtPson_ZCR_LIN3_C "" VALUE 0x007208b6 Val_Wu16 1 OneToOne 0.0 65535 FORMAT "%8.2" /end CHARACTERISTIC
/begin CHARACTERISTIC Tlib_HfaMotDir_ZCR_LIN3_C "" VALUE 0x00720cea Val_Wu8 1 OneToOne 0.0 255.00 FORMAT "%8.2" /end CHARACTERISTIC
/begin CHARACTERISTIC Tlib_HfaMotSpdSet_ZCR_LIN3_C "" VALUE 0x00720ceb Val_Wu8 1 OneToOne 0.0 255.00 FORMAT "%8.2" /end CHARACTERISTIC
/begin CHARACTERISTIC Tlib_AFUChReqFragRunngStsCh3_ZCR_LIN3_C "" VALUE 0x00720cec Val_Wu8 1 OneToOne 0.0 255.00 FORMAT "%8.2" /end CHARACTERISTIC
/begin CHARACTERISTIC Tlib_AFUChReqFragRunngStsCh5_ZCR_LIN3_C "" VALUE 0x00720ced Val_Wu8 1 OneToOne 0.0 255.00 FORMAT "%8.2" /end CHARACTERISTIC
/begin CHARACTERISTIC Tlib_AFUChReqFragRunngStsCh2_ZCR_LIN3_C "" VALUE 0x00720cee Val_Wu8 1 OneToOne 0.0 255.00 FORMAT "%8.2" /end CHARACTERISTIC
/begin CHARACTERISTIC Tlib_AFUChReqFragRunngStsCh1_ZCR_LIN3_C "" VALUE 0x00720cef Val_Wu8 1 OneToOne 0.0 255.00 FORMAT "%8.2" /end CHARACTERISTIC
/begin CHARACTERISTIC Tlib_AFUChReqFragRunngStsCh4_ZCR_LIN3_C "" VALUE 0x00720cf0 Val_Wu8 1 OneToOne 0.0 255.00 FORMAT "%8.2" /end CHARACTERISTIC
/begin CHARACTERISTIC Tlib_isClimateHeatStatusFbRe_VLAN201BE_C "" VALUE 0x00720cf1 Val_Wu8 1 OneToOne 0.0 255.00 FORMAT "%8.2" /end CHARACTERISTIC
/begin CHARACTERISTIC Tlib_isHvBattThermReqFb_VLAN201BE_C "" VALUE 0x00720cf2 Val_Wu8 1 OneToOne 0.0 255.00 FORMAT "%8.2" /end CHARACTERISTIC
/begin CHARACTERISTIC Tlib_isFrntEDCircFlwEstmd_VLAN201BE_C "" VALUE 0x007208b8 Val_Wu16 1 OneToOne 0.0 65535 FORMAT "%8.2" /end CHARACTERISTIC
/begin CHARACTERISTIC Tlib_isRearEDCircFlwEstmd_VLAN201BE_C "" VALUE 0x007208ba Val_Wu16 1 OneToOne 0.0 65535 FORMAT "%8.2" /end CHARACTERISTIC
/begin CHARACTERISTIC Tlib_isClimateHeatStatusFbFrnt_VLAN201BE_C "" VALUE 0x00720cf3 Val_Wu8 1 OneToOne 0.0 255.00 FORMAT "%8.2" /end CHARACTERISTIC
/begin CHARACTERISTIC Tlib_isClimateCoolStatusFbRe_VLAN201BE_C "" VALUE 0x00720cf4 Val_Wu8 1 OneToOne 0.0 255.00 FORMAT "%8.2" /end CHARACTERISTIC
/begin CHARACTERISTIC Tlib_isRearRiEDCircFlwEstmd_VLAN201BE_C "" VALUE 0x007208bc Val_Wu16 1 OneToOne 0.0 65535 FORMAT "%8.2" /end CHARACTERISTIC
/begin CHARACTERISTIC Tlib_isHvBattCircFlwEstmd_VLAN201BE_C "" VALUE 0x007208be Val_Wu16 1 OneToOne 0.0 65535 FORMAT "%8.2" /end CHARACTERISTIC
/begin CHARACTERISTIC Tlib_isClimateCoolStatusFbFrnt_VLAN201BE_C "" VALUE 0x00720cf5 Val_Wu8 1 OneToOne 0.0 255.00 FORMAT "%8.2" /end CHARACTERISTIC
/begin CHARACTERISTIC Tlib_isHvBattThermPwrCns_VLAN201BE_C "" VALUE 0x007208c0 Val_WS16 1 OneToOne -32768 32767 FORMAT "%8.2" /end CHARACTERISTIC
/begin CHARACTERISTIC Tlib_isCscCircFlwEstmd_VLAN201BE_C "" VALUE 0x007208c2 Val_Wu16 1 OneToOne 0.0 65535 FORMAT "%8.2" /end CHARACTERISTIC
/begin CHARACTERISTIC Tlib_isAirTFromHeatgEstimdFrntBoolean_VLAN201BE_C "" VALUE 0x00720cf6 Val_Wu8 1 OneToOne 0.0 255.00 FORMAT "%8.2" /end CHARACTERISTIC
/begin CHARACTERISTIC Tlib_isAirTFromHeatgEstimdFrntThermT_VLAN201BE_C "" VALUE 0x007208c4 Val_Wu16 1 OneToOne 0.0 65535 FORMAT "%8.2" /end CHARACTERISTIC
/begin CHARACTERISTIC Tlib_isAirTFromHeatgEstimdReBoolean_VLAN201BE_C "" VALUE 0x00720cf7 Val_Wu8 1 OneToOne 0.0 255.00 FORMAT "%8.2" /end CHARACTERISTIC
/begin CHARACTERISTIC Tlib_isAirTFromHeatgEstimdReThermT_VLAN201BE_C "" VALUE 0x007208c6 Val_Wu16 1 OneToOne 0.0 65535 FORMAT "%8.2" /end CHARACTERISTIC
/begin CHARACTERISTIC Tlib_isIntPm25VluFrmClima_VLAN201BE_C "" VALUE 0x007208c8 Val_Wu16 1 OneToOne 0.0 65535 FORMAT "%8.2" /end CHARACTERISTIC
/begin CHARACTERISTIC Tlib_isFrntRiEDCircFlwEstmd_VLAN201BE_C "" VALUE 0x007208ca Val_Wu16 1 OneToOne 0.0 65535 FORMAT "%8.2" /end CHARACTERISTIC
/begin CHARACTERISTIC Tlib_isCompartmentRecirculationReqOnOff_VLAN201BE_C "" VALUE 0x00720cf8 Val_Wu8 1 OneToOne 0.0 255.00 FORMAT "%8.2" /end CHARACTERISTIC
/begin CHARACTERISTIC Tlib_isCompartmentRecirculationReqHvacPercent_VLAN201BE_C "" VALUE 0x00720cf9 Val_Wu8 1 OneToOne 0.0 255.00 FORMAT "%8.2" /end CHARACTERISTIC
/begin CHARACTERISTIC Tlib_isZCRPwrSplyErrStsDataID4_VLAN201BE_C "" VALUE 0x00720cfa Val_Wu8 1 OneToOne 0.0 255.00 FORMAT "%8.2" /end CHARACTERISTIC
/begin CHARACTERISTIC Tlib_isZCRPwrSplyErrStsCntr4_VLAN201BE_C "" VALUE 0x00720cfb Val_Wu8 1 OneToOne 0.0 255.00 FORMAT "%8.2" /end CHARACTERISTIC
/begin CHARACTERISTIC Tlib_isZCRPwrSplyErrStsSts_VLAN201BE_C "" VALUE 0x007208cc Val_Wu16 1 OneToOne 0.0 65535 FORMAT "%8.2" /end CHARACTERISTIC
/begin CHARACTERISTIC Tlib_isZCRPwrSplyErrStsChks8_VLAN201BE_C "" VALUE 0x00720cfc Val_Wu8 1 OneToOne 0.0 255.00 FORMAT "%8.2" /end CHARACTERISTIC
/begin CHARACTERISTIC Tlib_isIntPm25StsFrmClima_VLAN201BE_C "" VALUE 0x00720cfd Val_Wu8 1 OneToOne 0.0 255.00 FORMAT "%8.2" /end CHARACTERISTIC
/begin CHARACTERISTIC Tlib_isPassSeatPosPercGroupSeatPosSldPerc_0_VLAN201BE_C "" VALUE 0x007208ce Val_Wu16 1 OneToOne 0.0 65535 FORMAT "%8.2" /end CHARACTERISTIC
/begin CHARACTERISTIC Tlib_isPassSeatPosPercGroupSeatPosHeiQF_0_VLAN201BE_C "" VALUE 0x00720cfe Val_Wu8 1 OneToOne 0.0 255.00 FORMAT "%8.2" /end CHARACTERISTIC
/begin CHARACTERISTIC Tlib_isPassSeatPosPercGroupSeatPosFrntHeiQF_0_VLAN201BE_C "" VALUE 0x00720cff Val_Wu8 1 OneToOne 0.0 255.00 FORMAT "%8.2" /end CHARACTERISTIC
/begin CHARACTERISTIC Tlib_isPassSeatPosPercGroupSeatPosHeiPerc_0_VLAN201BE_C "" VALUE 0x007208d0 Val_Wu16 1 OneToOne 0.0 65535 FORMAT "%8.2" /end CHARACTERISTIC
/begin CHARACTERISTIC Tlib_isPassSeatPosPercGroupSeatPosFrntHeiPerc_0_VLAN201BE_C "" VALUE 0x007208d2 Val_Wu16 1 OneToOne 0.0 65535 FORMAT "%8.2" /end CHARACTERISTIC
/begin CHARACTERISTIC Tlib_isPassSeatPosPercGroupSeatPosSldQF_0_VLAN201BE_C "" VALUE 0x00720d00 Val_Wu8 1 OneToOne 0.0 255.00 FORMAT "%8.2" /end CHARACTERISTIC
/begin CHARACTERISTIC Tlib_isFrntHeatPwrReq_VLAN205ControlMid_C "" VALUE 0x00720d01 Val_Wu8 1 OneToOne 0.0 255.00 FORMAT "%8.2" /end CHARACTERISTIC
/begin CHARACTERISTIC Tlib_isFrntHeatModEnad_VLAN205ControlMid_C "" VALUE 0x00720d02 Val_Wu8 1 OneToOne 0.0 255.00 FORMAT "%8.2" /end CHARACTERISTIC
/begin CHARACTERISTIC Tlib_isRearRiHeatModEnad_VLAN205ControlMid_C "" VALUE 0x00720d03 Val_Wu8 1 OneToOne 0.0 255.00 FORMAT "%8.2" /end CHARACTERISTIC
/begin CHARACTERISTIC Tlib_isFrntRiHeatPwrReq_VLAN205ControlMid_C "" VALUE 0x00720d04 Val_Wu8 1 OneToOne 0.0 255.00 FORMAT "%8.2" /end CHARACTERISTIC
/begin CHARACTERISTIC Tlib_isRearHeatModEnad_VLAN205ControlMid_C "" VALUE 0x00720d05 Val_Wu8 1 OneToOne 0.0 255.00 FORMAT "%8.2" /end CHARACTERISTIC
/begin CHARACTERISTIC Tlib_isRearHeatPwrReq_VLAN205ControlMid_C "" VALUE 0x00720d06 Val_Wu8 1 OneToOne 0.0 255.00 FORMAT "%8.2" /end CHARACTERISTIC
/begin CHARACTERISTIC Tlib_isRearRiHeatPwrReq_VLAN205ControlMid_C "" VALUE 0x00720d07 Val_Wu8 1 OneToOne 0.0 255.00 FORMAT "%8.2" /end CHARACTERISTIC
/begin CHARACTERISTIC Tlib_isFrntRiHeatModEnad_VLAN205ControlMid_C "" VALUE 0x00720d08 Val_Wu8 1 OneToOne 0.0 255.00 FORMAT "%8.2" /end CHARACTERISTIC
/begin CHARACTERISTIC Tlib_isSecVehICns_VLAN205ControlMid_C "" VALUE 0x007208d4 Val_Wu16 1 OneToOne 0.0 65535 FORMAT "%8.2" /end CHARACTERISTIC
/begin CHARACTERISTIC Tlib_isSecPwrAvlDelta_VLAN205ControlMid_C "" VALUE 0x007208d6 Val_WS16 1 OneToOne -32768 32767 FORMAT "%8.2" /end CHARACTERISTIC
/begin CHARACTERISTIC Tlib_isSecBattSnsrComFlt_VLAN205ControlMid_C "" VALUE 0x00720d09 Val_Wu8 1 OneToOne 0.0 255.00 FORMAT "%8.2" /end CHARACTERISTIC
/begin CHARACTERISTIC Tlib_isHornSts_VLAN205ControlMid_C "" VALUE 0x00720d0a Val_Wu8 1 OneToOne 0.0 255.00 FORMAT "%8.2" /end CHARACTERISTIC
/begin CHARACTERISTIC Tlib_isPassWinSwtReq_VLAN205ControlMid_C "" VALUE 0x00720d0b Val_Wu8 1 OneToOne 0.0 255.00 FORMAT "%8.2" /end CHARACTERISTIC
/begin CHARACTERISTIC Tlib_isRowFrstPassODSnsrSts_VLAN205ControlMid_C "" VALUE 0x00720d0c Val_Wu8 1 OneToOne 0.0 255.00 FORMAT "%8.2" /end CHARACTERISTIC
/begin CHARACTERISTIC Tlib_isDcDcCircFlwEstmd_VLAN205ControlMid_C "" VALUE 0x007208d8 Val_Wu16 1 OneToOne 0.0 65535 FORMAT "%8.2" /end CHARACTERISTIC
/begin CHARACTERISTIC Tlib_isChrgnUReqSec_VLAN205ControlMid_C "" VALUE 0x00720d0d Val_Wu8 1 OneToOne 0.0 255.00 FORMAT "%8.2" /end CHARACTERISTIC
/begin CHARACTERISTIC Tlib_isDoorPassCinFailMechRels_VLAN205ControlMid_C "" VALUE 0x00720d0e Val_Wu8 1 OneToOne 0.0 255.00 FORMAT "%8.2" /end CHARACTERISTIC
/begin CHARACTERISTIC Tlib_isDoorPassCinFailCinchOverTimed_VLAN205ControlMid_C "" VALUE 0x00720d0f Val_Wu8 1 OneToOne 0.0 255.00 FORMAT "%8.2" /end CHARACTERISTIC
/begin CHARACTERISTIC Tlib_isDoorPassCinFailFailure1_VLAN205ControlMid_C "" VALUE 0x00720d10 Val_Wu8 1 OneToOne 0.0 255.00 FORMAT "%8.2" /end CHARACTERISTIC
/begin CHARACTERISTIC Tlib_isDoorPassRelsFailFailure1_VLAN205ControlMid_C "" VALUE 0x00720d11 Val_Wu8 1 OneToOne 0.0 255.00 FORMAT "%8.2" /end CHARACTERISTIC
/begin CHARACTERISTIC Tlib_isDoorPassRelsFailCinchOverTimed_VLAN205ControlMid_C "" VALUE 0x00720d12 Val_Wu8 1 OneToOne 0.0 255.00 FORMAT "%8.2" /end CHARACTERISTIC
/begin CHARACTERISTIC Tlib_isDoorPassRelsFailMechRels_VLAN205ControlMid_C "" VALUE 0x00720d13 Val_Wu8 1 OneToOne 0.0 255.00 FORMAT "%8.2" /end CHARACTERISTIC
/begin CHARACTERISTIC Tlib_isDoorPassCinhIntFailInfCinchRestFlt_VLAN205ControlMid_C "" VALUE 0x00720d14 Val_Wu8 1 OneToOne 0.0 255.00 FORMAT "%8.2" /end CHARACTERISTIC
/begin CHARACTERISTIC Tlib_isDoorPassCinhIntFailInfCinchFlt1_VLAN205ControlMid_C "" VALUE 0x00720d15 Val_Wu8 1 OneToOne 0.0 255.00 FORMAT "%8.2" /end CHARACTERISTIC
/begin CHARACTERISTIC Tlib_isXMirrorMotDiagcAtPassVccOutOfRng_VLAN205ControlMid_C "" VALUE 0x00720d16 Val_Wu8 1 OneToOne 0.0 255.00 FORMAT "%8.2" /end CHARACTERISTIC
/begin CHARACTERISTIC Tlib_isXMirrorMotDiagcAtPassOverT_VLAN205ControlMid_C "" VALUE 0x00720d17 Val_Wu8 1 OneToOne 0.0 255.00 FORMAT "%8.2" /end CHARACTERISTIC
/begin CHARACTERISTIC Tlib_isXMirrorMotDiagcAtPassXposSnsrShoToGnd_VLAN205ControlMid_C "" VALUE 0x00720d18 Val_Wu8 1 OneToOne 0.0 255.00 FORMAT "%8.2" /end CHARACTERISTIC
/begin CHARACTERISTIC Tlib_isXMirrorMotDiagcAtPassXposSnsrShoBattOrOpen_VLAN205ControlMid_C "" VALUE 0x00720d19 Val_Wu8 1 OneToOne 0.0 255.00 FORMAT "%8.2" /end CHARACTERISTIC
/begin CHARACTERISTIC Tlib_isXMirrorMotDiagcAtPassXMotShoBattOrOpen_VLAN205ControlMid_C "" VALUE 0x00720d1a Val_Wu8 1 OneToOne 0.0 255.00 FORMAT "%8.2" /end CHARACTERISTIC
/begin CHARACTERISTIC Tlib_isXMirrorMotDiagcAtPassXMotShoToGnd_VLAN205ControlMid_C "" VALUE 0x00720d1b Val_Wu8 1 OneToOne 0.0 255.00 FORMAT "%8.2" /end CHARACTERISTIC
/begin CHARACTERISTIC Tlib_isPassHedrHozlMotSts_VLAN205ControlMid_C "" VALUE 0x00720d1c Val_Wu8 1 OneToOne 0.0 255.00 FORMAT "%8.2" /end CHARACTERISTIC
/begin CHARACTERISTIC Tlib_isPassHeiMotSts_VLAN205ControlMid_C "" VALUE 0x00720d1d Val_Wu8 1 OneToOne 0.0 255.00 FORMAT "%8.2" /end CHARACTERISTIC
/begin CHARACTERISTIC Tlib_isPassLenMotSts_VLAN205ControlMid_C "" VALUE 0x00720d1e Val_Wu8 1 OneToOne 0.0 255.00 FORMAT "%8.2" /end CHARACTERISTIC
/begin CHARACTERISTIC Tlib_isWindowLearnStAtPass_VLAN205ControlMid_C "" VALUE 0x00720d1f Val_Wu8 1 OneToOne 0.0 255.00 FORMAT "%8.2" /end CHARACTERISTIC
/begin CHARACTERISTIC Tlib_isPassLegRstVertMotSts_VLAN205ControlMid_C "" VALUE 0x00720d20 Val_Wu8 1 OneToOne 0.0 255.00 FORMAT "%8.2" /end CHARACTERISTIC
/begin CHARACTERISTIC Tlib_isPassSeatCushExtPosSeatPosPerc_VLAN205ControlMid_C "" VALUE 0x007208da Val_Wu16 1 OneToOne 0.0 65535 FORMAT "%8.2" /end CHARACTERISTIC
/begin CHARACTERISTIC Tlib_isPassSeatCushExtPosSeatPosQf_VLAN205ControlMid_C "" VALUE 0x00720d21 Val_Wu8 1 OneToOne 0.0 255.00 FORMAT "%8.2" /end CHARACTERISTIC
/begin CHARACTERISTIC Tlib_isWinDiagcAtPassOverTemperature_VLAN205ControlMid_C "" VALUE 0x00720d22 Val_Wu8 1 OneToOne 0.0 255.00 FORMAT "%8.2" /end CHARACTERISTIC
/begin CHARACTERISTIC Tlib_isWinDiagcAtPassMissCal_VLAN205ControlMid_C "" VALUE 0x00720d23 Val_Wu8 1 OneToOne 0.0 255.00 FORMAT "%8.2" /end CHARACTERISTIC
/begin CHARACTERISTIC Tlib_isWinDiagcAtPassOverCurrent_VLAN205ControlMid_C "" VALUE 0x00720d24 Val_Wu8 1 OneToOne 0.0 255.00 FORMAT "%8.2" /end CHARACTERISTIC
/begin CHARACTERISTIC Tlib_isWinDiagcAtPassvoltageoutofrange_VLAN205ControlMid_C "" VALUE 0x00720d25 Val_Wu8 1 OneToOne 0.0 255.00 FORMAT "%8.2" /end CHARACTERISTIC
/begin CHARACTERISTIC Tlib_isWinDiagcAtPassOpenCirc_VLAN205ControlMid_C "" VALUE 0x00720d26 Val_Wu8 1 OneToOne 0.0 255.00 FORMAT "%8.2" /end CHARACTERISTIC
/begin CHARACTERISTIC Tlib_isWinDiagcAtPassRipplefault_VLAN205ControlMid_C "" VALUE 0x00720d27 Val_Wu8 1 OneToOne 0.0 255.00 FORMAT "%8.2" /end CHARACTERISTIC
/begin CHARACTERISTIC Tlib_isWinDiagcAtPassIntElecFailr_VLAN205ControlMid_C "" VALUE 0x00720d28 Val_Wu8 1 OneToOne 0.0 255.00 FORMAT "%8.2" /end CHARACTERISTIC
/begin CHARACTERISTIC Tlib_isWinDiagcAtPassMeclFailr_VLAN205ControlMid_C "" VALUE 0x00720d29 Val_Wu8 1 OneToOne 0.0 255.00 FORMAT "%8.2" /end CHARACTERISTIC
/begin CHARACTERISTIC Tlib_isPassSeatLumHeiSwt_VLAN205ControlMid_C "" VALUE 0x00720d2a Val_Wu8 1 OneToOne 0.0 255.00 FORMAT "%8.2" /end CHARACTERISTIC
/begin CHARACTERISTIC Tlib_isPassSeatLumLenSwt_VLAN205ControlMid_C "" VALUE 0x00720d2b Val_Wu8 1 OneToOne 0.0 255.00 FORMAT "%8.2" /end CHARACTERISTIC
/begin CHARACTERISTIC Tlib_isPassCushTiltMotSts_VLAN205ControlMid_C "" VALUE 0x00720d2c Val_Wu8 1 OneToOne 0.0 255.00 FORMAT "%8.2" /end CHARACTERISTIC
/begin CHARACTERISTIC Tlib_isYMirrorMotDiagcAtPassXposSnsrShoBattOrOpen_VLAN205ControlMid_C "" VALUE 0x00720d2d Val_Wu8 1 OneToOne 0.0 255.00 FORMAT "%8.2" /end CHARACTERISTIC
/begin CHARACTERISTIC Tlib_isYMirrorMotDiagcAtPassXMotShoBattOrOpen_VLAN205ControlMid_C "" VALUE 0x00720d2e Val_Wu8 1 OneToOne 0.0 255.00 FORMAT "%8.2" /end CHARACTERISTIC
/begin CHARACTERISTIC Tlib_isYMirrorMotDiagcAtPassVccOutOfRng_VLAN205ControlMid_C "" VALUE 0x00720d2f Val_Wu8 1 OneToOne 0.0 255.00 FORMAT "%8.2" /end CHARACTERISTIC
/begin CHARACTERISTIC Tlib_isYMirrorMotDiagcAtPassXMotShoToGnd_VLAN205ControlMid_C "" VALUE 0x00720d30 Val_Wu8 1 OneToOne 0.0 255.00 FORMAT "%8.2" /end CHARACTERISTIC
/begin CHARACTERISTIC Tlib_isYMirrorMotDiagcAtPassOverT_VLAN205ControlMid_C "" VALUE 0x00720d31 Val_Wu8 1 OneToOne 0.0 255.00 FORMAT "%8.2" /end CHARACTERISTIC
/begin CHARACTERISTIC Tlib_isYMirrorMotDiagcAtPassXposSnsrShoToGnd_VLAN205ControlMid_C "" VALUE 0x00720d32 Val_Wu8 1 OneToOne 0.0 255.00 FORMAT "%8.2" /end CHARACTERISTIC
/begin CHARACTERISTIC Tlib_isTripResetSyncReqMsgZCR_VLAN205ControlMid_C "" VALUE 0x00720d33 Val_Wu8 1 OneToOne 0.0 255.00 FORMAT "%8.2" /end CHARACTERISTIC
/begin CHARACTERISTIC Tlib_isPassSeatPvtSwtSts_VLAN205ControlMid_C "" VALUE 0x00720d34 Val_Wu8 1 OneToOne 0.0 255.00 FORMAT "%8.2" /end CHARACTERISTIC
/begin CHARACTERISTIC Tlib_isPassLegRstHozlMotSts_VLAN205ControlMid_C "" VALUE 0x00720d35 Val_Wu8 1 OneToOne 0.0 255.00 FORMAT "%8.2" /end CHARACTERISTIC
/begin CHARACTERISTIC Tlib_isPassSeatZerGravTiltPosSeatPosPerc_VLAN205ControlMid_C "" VALUE 0x007208dc Val_Wu16 1 OneToOne 0.0 65535 FORMAT "%8.2" /end CHARACTERISTIC
/begin CHARACTERISTIC Tlib_isPassSeatZerGravTiltPosSeatPosQf_VLAN205ControlMid_C "" VALUE 0x00720d36 Val_Wu8 1 OneToOne 0.0 255.00 FORMAT "%8.2" /end CHARACTERISTIC
/begin CHARACTERISTIC Tlib_isPassSeatShldPosSeatPosPerc_VLAN205ControlMid_C "" VALUE 0x007208de Val_Wu16 1 OneToOne 0.0 65535 FORMAT "%8.2" /end CHARACTERISTIC
/begin CHARACTERISTIC Tlib_isPassSeatShldPosSeatPosQf_VLAN205ControlMid_C "" VALUE 0x00720d37 Val_Wu8 1 OneToOne 0.0 255.00 FORMAT "%8.2" /end CHARACTERISTIC
/begin CHARACTERISTIC Tlib_isPassSeatSwtCushExtSts_VLAN205ControlMid_C "" VALUE 0x00720d38 Val_Wu8 1 OneToOne 0.0 255.00 FORMAT "%8.2" /end CHARACTERISTIC
/begin CHARACTERISTIC Tlib_isPassSeatLegRstVertSwt_VLAN205ControlMid_C "" VALUE 0x00720d39 Val_Wu8 1 OneToOne 0.0 255.00 FORMAT "%8.2" /end CHARACTERISTIC
/begin CHARACTERISTIC Tlib_isPassHedrVertMotSts_VLAN205ControlMid_C "" VALUE 0x00720d3a Val_Wu8 1 OneToOne 0.0 255.00 FORMAT "%8.2" /end CHARACTERISTIC
/begin CHARACTERISTIC Tlib_isPassSeatLegRstLenPosSeatPosQf_VLAN205ControlMid_C "" VALUE 0x00720d3b Val_Wu8 1 OneToOne 0.0 255.00 FORMAT "%8.2" /end CHARACTERISTIC
/begin CHARACTERISTIC Tlib_isPassSeatLegRstLenPosSeatPosPerc_VLAN205ControlMid_C "" VALUE 0x007208e0 Val_Wu16 1 OneToOne 0.0 65535 FORMAT "%8.2" /end CHARACTERISTIC
/begin CHARACTERISTIC Tlib_isPassSeatHedrVertPosSeatPosQf_VLAN205ControlMid_C "" VALUE 0x00720d3c Val_Wu8 1 OneToOne 0.0 255.00 FORMAT "%8.2" /end CHARACTERISTIC
/begin CHARACTERISTIC Tlib_isPassSeatHedrVertPosSeatPosPerc_VLAN205ControlMid_C "" VALUE 0x007208e2 Val_Wu16 1 OneToOne 0.0 65535 FORMAT "%8.2" /end CHARACTERISTIC
/begin CHARACTERISTIC Tlib_isPassCushExtMotSts_VLAN205ControlMid_C "" VALUE 0x00720d3d Val_Wu8 1 OneToOne 0.0 255.00 FORMAT "%8.2" /end CHARACTERISTIC
/begin CHARACTERISTIC Tlib_isPassSeatMassgFctReq_VLAN205ControlMid_C "" VALUE 0x00720d3e Val_Wu8 1 OneToOne 0.0 255.00 FORMAT "%8.2" /end CHARACTERISTIC
/begin CHARACTERISTIC Tlib_isPassSeatHedrHozlPosSeatPosPerc_VLAN205ControlMid_C "" VALUE 0x007208e4 Val_Wu16 1 OneToOne 0.0 65535 FORMAT "%8.2" /end CHARACTERISTIC
/begin CHARACTERISTIC Tlib_isPassSeatHedrHozlPosSeatPosQf_VLAN205ControlMid_C "" VALUE 0x00720d3f Val_Wu8 1 OneToOne 0.0 255.00 FORMAT "%8.2" /end CHARACTERISTIC
/begin CHARACTERISTIC Tlib_isPassSeatLegRstHozlSwt_VLAN205ControlMid_C "" VALUE 0x00720d40 Val_Wu8 1 OneToOne 0.0 255.00 FORMAT "%8.2" /end CHARACTERISTIC
/begin CHARACTERISTIC Tlib_isPassShldMotSts_VLAN205ControlMid_C "" VALUE 0x00720d41 Val_Wu8 1 OneToOne 0.0 255.00 FORMAT "%8.2" /end CHARACTERISTIC
/begin CHARACTERISTIC Tlib_isPassSeatLegRstHeiPosSeatPosPerc_VLAN205ControlMid_C "" VALUE 0x007208e6 Val_Wu16 1 OneToOne 0.0 65535 FORMAT "%8.2" /end CHARACTERISTIC
/begin CHARACTERISTIC Tlib_isPassSeatLegRstHeiPosSeatPosQf_VLAN205ControlMid_C "" VALUE 0x00720d42 Val_Wu8 1 OneToOne 0.0 255.00 FORMAT "%8.2" /end CHARACTERISTIC
/begin CHARACTERISTIC Tlib_isPassSeatBackrestPosSeatPosQf_VLAN205ControlMid_C "" VALUE 0x00720d43 Val_Wu8 1 OneToOne 0.0 255.00 FORMAT "%8.2" /end CHARACTERISTIC
/begin CHARACTERISTIC Tlib_isPassSeatBackrestPosSeatPosPerc_VLAN205ControlMid_C "" VALUE 0x007208e8 Val_Wu16 1 OneToOne 0.0 65535 FORMAT "%8.2" /end CHARACTERISTIC
/begin CHARACTERISTIC Tlib_isPassSeatSwtBlstrSts_VLAN205ControlMid_C "" VALUE 0x00720d44 Val_Wu8 1 OneToOne 0.0 255.00 FORMAT "%8.2" /end CHARACTERISTIC
/begin CHARACTERISTIC Tlib_isPassSeatSwtStsPassSeatSwtInclSts_VLAN205ControlMid_C "" VALUE 0x00720d45 Val_Wu8 1 OneToOne 0.0 255.00 FORMAT "%8.2" /end CHARACTERISTIC
/begin CHARACTERISTIC Tlib_isPassSeatSwtStsPassSeatSwtSldSts_VLAN205ControlMid_C "" VALUE 0x00720d46 Val_Wu8 1 OneToOne 0.0 255.00 FORMAT "%8.2" /end CHARACTERISTIC
/begin CHARACTERISTIC Tlib_isPassSeatSwtStsPassSeatSwtHeiFrntSts_VLAN205ControlMid_C "" VALUE 0x00720d47 Val_Wu8 1 OneToOne 0.0 255.00 FORMAT "%8.2" /end CHARACTERISTIC
/begin CHARACTERISTIC Tlib_isPassSeatSwtStsPassSeatSwtAdjmtOfSpplFctHozlSts_VLAN205ControlMid_C "" VALUE 0x00720d48 Val_Wu8 1 OneToOne 0.0 255.00 FORMAT "%8.2" /end CHARACTERISTIC
/begin CHARACTERISTIC Tlib_isPassSeatSwtStsPassSeatSwtSelnOfSpplFctStsSts_VLAN205ControlMid_C "" VALUE 0x00720d49 Val_Wu8 1 OneToOne 0.0 255.00 FORMAT "%8.2" /end CHARACTERISTIC
/begin CHARACTERISTIC Tlib_isPassSeatSwtStsPassSeatSwtHdrstVertSts_VLAN205ControlMid_C "" VALUE 0x00720d4a Val_Wu8 1 OneToOne 0.0 255.00 FORMAT "%8.2" /end CHARACTERISTIC
/begin CHARACTERISTIC Tlib_isPassSeatSwtStsPassSeatSwtHeiSts_VLAN205ControlMid_C "" VALUE 0x00720d4b Val_Wu8 1 OneToOne 0.0 255.00 FORMAT "%8.2" /end CHARACTERISTIC
/begin CHARACTERISTIC Tlib_isPassSeatSwtStsPassSeatSwtAdjmtOfSpplFctVerSts_VLAN205ControlMid_C "" VALUE 0x00720d4c Val_Wu8 1 OneToOne 0.0 255.00 FORMAT "%8.2" /end CHARACTERISTIC
/begin CHARACTERISTIC Tlib_isPassSeatSwtStsPassSeatSwtHdrstHozlSts_VLAN205ControlMid_C "" VALUE 0x00720d4d Val_Wu8 1 OneToOne 0.0 255.00 FORMAT "%8.2" /end CHARACTERISTIC
/begin CHARACTERISTIC Tlib_isPassSeatRotSwtSts_VLAN205ControlMid_C "" VALUE 0x00720d4e Val_Wu8 1 OneToOne 0.0 255.00 FORMAT "%8.2" /end CHARACTERISTIC
/begin CHARACTERISTIC Tlib_isPassBackrestMotSts_VLAN205ControlMid_C "" VALUE 0x00720d4f Val_Wu8 1 OneToOne 0.0 255.00 FORMAT "%8.2" /end CHARACTERISTIC
/begin CHARACTERISTIC Tlib_SecBattSnsrRstReq_ZCR_LIN9_C "" VALUE 0x00720d50 Val_Wu8 1 OneToOne 0.0 255.00 FORMAT "%8.2" /end CHARACTERISTIC
/begin CHARACTERISTIC Tlib_BattRlyReqSec_ZCR_LIN9_C "" VALUE 0x00720d51 Val_Wu8 1 OneToOne 0.0 255.00 FORMAT "%8.2" /end CHARACTERISTIC
/begin CHARACTERISTIC Tlib_ActvdStSecDcDc_ZCR_LIN9_C "" VALUE 0x00720d52 Val_Wu8 1 OneToOne 0.0 255.00 FORMAT "%8.2" /end CHARACTERISTIC
/begin CHARACTERISTIC Tlib_UtcTiGlbDataValid_ZCR_LIN9_C "" VALUE 0x00720d53 Val_Wu8 1 OneToOne 0.0 255.00 FORMAT "%8.2" /end CHARACTERISTIC
/begin CHARACTERISTIC Tlib_UtcTiGlbUtcTiVal_ZCR_LIN9_C "" VALUE 0x007204d8 Val_Wu32 1 OneToOne 0.0 4294967295 FORMAT "%8.2" /end CHARACTERISTIC
/begin CHARACTERISTIC Tlib_HvSysRlyStsChks8_ZCR_LIN9_C "" VALUE 0x00720d54 Val_Wu8 1 OneToOne 0.0 255.00 FORMAT "%8.2" /end CHARACTERISTIC
/begin CHARACTERISTIC Tlib_HvSysRlyStsCntr4_ZCR_LIN9_C "" VALUE 0x00720d55 Val_Wu8 1 OneToOne 0.0 255.00 FORMAT "%8.2" /end CHARACTERISTIC
/begin CHARACTERISTIC Tlib_HvSysRlyStsDataID4_ZCR_LIN9_C "" VALUE 0x00720d56 Val_Wu8 1 OneToOne 0.0 255.00 FORMAT "%8.2" /end CHARACTERISTIC
/begin CHARACTERISTIC Tlib_HvSysRlyStsRly_ZCR_LIN9_C "" VALUE 0x00720d57 Val_Wu8 1 OneToOne 0.0 255.00 FORMAT "%8.2" /end CHARACTERISTIC
/begin CHARACTERISTIC Tlib_VehSpdLgtDataID4_ZCR_LIN9_C "" VALUE 0x00720d58 Val_Wu8 1 OneToOne 0.0 255.00 FORMAT "%8.2" /end CHARACTERISTIC
/begin CHARACTERISTIC Tlib_VehSpdLgtQf_ZCR_LIN9_C "" VALUE 0x00720d59 Val_Wu8 1 OneToOne 0.0 255.00 FORMAT "%8.2" /end CHARACTERISTIC
/begin CHARACTERISTIC Tlib_VehSpdLgtA_ZCR_LIN9_C "" VALUE 0x007208ea Val_Wu16 1 OneToOne 0.0 65535 FORMAT "%8.2" /end CHARACTERISTIC
/begin CHARACTERISTIC Tlib_VehSpdLgtChks8_ZCR_LIN9_C "" VALUE 0x00720d5a Val_Wu8 1 OneToOne 0.0 255.00 FORMAT "%8.2" /end CHARACTERISTIC
/begin CHARACTERISTIC Tlib_VehSpdLgtCntr4_ZCR_LIN9_C "" VALUE 0x00720d5b Val_Wu8 1 OneToOne 0.0 255.00 FORMAT "%8.2" /end CHARACTERISTIC
/begin CHARACTERISTIC Tlib_VehModMngtGlbSafeCarModSts_ZCR_LIN9_C "" VALUE 0x00720d5c Val_Wu8 1 OneToOne 0.0 255.00 FORMAT "%8.2" /end CHARACTERISTIC
/begin CHARACTERISTIC Tlib_VehModMngtGlbSafeFltEgyCnsWdSts_ZCR_LIN9_C "" VALUE 0x00720d5d Val_Wu8 1 OneToOne 0.0 255.00 FORMAT "%8.2" /end CHARACTERISTIC
/begin CHARACTERISTIC Tlib_VehModMngtGlbSafeChks8_ZCR_LIN9_C "" VALUE 0x00720d5e Val_Wu8 1 OneToOne 0.0 255.00 FORMAT "%8.2" /end CHARACTERISTIC
/begin CHARACTERISTIC Tlib_VehModMngtGlbSafePwrModSts_ZCR_LIN9_C "" VALUE 0x00720d5f Val_Wu8 1 OneToOne 0.0 255.00 FORMAT "%8.2" /end CHARACTERISTIC
/begin CHARACTERISTIC Tlib_VehModMngtGlbSafePwrLvlElecMai_ZCR_LIN9_C "" VALUE 0x00720d60 Val_Wu8 1 OneToOne 0.0 255.00 FORMAT "%8.2" /end CHARACTERISTIC
/begin CHARACTERISTIC Tlib_VehModMngtGlbSafeEgyLvlElecMai_ZCR_LIN9_C "" VALUE 0x00720d61 Val_Wu8 1 OneToOne 0.0 255.00 FORMAT "%8.2" /end CHARACTERISTIC
/begin CHARACTERISTIC Tlib_VehModMngtGlbSafeEgyLvlElecSubtyp_ZCR_LIN9_C "" VALUE 0x00720d62 Val_Wu8 1 OneToOne 0.0 255.00 FORMAT "%8.2" /end CHARACTERISTIC
/begin CHARACTERISTIC Tlib_VehModMngtGlbSafePwrLvlElecSubtyp_ZCR_LIN9_C "" VALUE 0x00720d63 Val_Wu8 1 OneToOne 0.0 255.00 FORMAT "%8.2" /end CHARACTERISTIC
/begin CHARACTERISTIC Tlib_VehModMngtGlbSafeCarModSubtypWdCarModSubtyp_ZCR_LIN9_C "" VALUE 0x00720d64 Val_Wu8 1 OneToOne 0.0 255.00 FORMAT "%8.2" /end CHARACTERISTIC
/begin CHARACTERISTIC Tlib_VehModMngtGlbSafeDataID4_ZCR_LIN9_C "" VALUE 0x00720d65 Val_Wu8 1 OneToOne 0.0 255.00 FORMAT "%8.2" /end CHARACTERISTIC
/begin CHARACTERISTIC Tlib_VehModMngtGlbSafeCntr4_ZCR_LIN9_C "" VALUE 0x00720d66 Val_Wu8 1 OneToOne 0.0 255.00 FORMAT "%8.2" /end CHARACTERISTIC
/begin CHARACTERISTIC Tlib_VehLVSysUZCLVehLVSysUBkp_ZCR_LIN9_C "" VALUE 0x00720d67 Val_Wu8 1 OneToOne 0.0 255.00 FORMAT "%8.2" /end CHARACTERISTIC
/begin CHARACTERISTIC Tlib_VehLVSysUZCLVehLVSysUMai_ZCR_LIN9_C "" VALUE 0x00720d68 Val_Wu8 1 OneToOne 0.0 255.00 FORMAT "%8.2" /end CHARACTERISTIC
/begin CHARACTERISTIC Tlib_OdoMeter_ZCR_LIN9_C "" VALUE 0x007204dc Val_Wu32 1 OneToOne 0.0 4294967295 FORMAT "%8.2" /end CHARACTERISTIC
/begin CHARACTERISTIC Tlib_GearLvrIndcnChks8_ZCR_LIN9_C "" VALUE 0x00720d69 Val_Wu8 1 OneToOne 0.0 255.00 FORMAT "%8.2" /end CHARACTERISTIC
/begin CHARACTERISTIC Tlib_GearLvrIndcnCntr4_ZCR_LIN9_C "" VALUE 0x00720d6a Val_Wu8 1 OneToOne 0.0 255.00 FORMAT "%8.2" /end CHARACTERISTIC
/begin CHARACTERISTIC Tlib_GearLvrIndcnDataID4_ZCR_LIN9_C "" VALUE 0x00720d6b Val_Wu8 1 OneToOne 0.0 255.00 FORMAT "%8.2" /end CHARACTERISTIC
/begin CHARACTERISTIC Tlib_GearLvrIndcn2_ZCR_LIN9_C "" VALUE 0x00720d6c Val_Wu8 1 OneToOne 0.0 255.00 FORMAT "%8.2" /end CHARACTERISTIC
/begin CHARACTERISTIC Tlib_VehSpdLgtA_ZCR_CANFD7_C "" VALUE 0x007208ec Val_Wu16 1 OneToOne 0.0 65535 FORMAT "%8.2" /end CHARACTERISTIC
/begin CHARACTERISTIC Tlib_VehSpdLgtQf_ZCR_CANFD7_C "" VALUE 0x00720d6d Val_Wu8 1 OneToOne 0.0 255.00 FORMAT "%8.2" /end CHARACTERISTIC
/begin CHARACTERISTIC Tlib_VehSpdLgtCntr4_ZCR_CANFD7_C "" VALUE 0x00720d6e Val_Wu8 1 OneToOne 0.0 255.00 FORMAT "%8.2" /end CHARACTERISTIC
/begin CHARACTERISTIC Tlib_VehSpdLgtChks8_ZCR_CANFD7_C "" VALUE 0x00720d6f Val_Wu8 1 OneToOne 0.0 255.00 FORMAT "%8.2" /end CHARACTERISTIC
/begin CHARACTERISTIC Tlib_VehSpdLgtDataID4_ZCR_CANFD7_C "" VALUE 0x00720d70 Val_Wu8 1 OneToOne 0.0 255.00 FORMAT "%8.2" /end CHARACTERISTIC
/begin CHARACTERISTIC Tlib_UtcTiGlbUtcTiVal_ZCR_CANFD7_C "" VALUE 0x007204e0 Val_Wu32 1 OneToOne 0.0 4294967295 FORMAT "%8.2" /end CHARACTERISTIC
/begin CHARACTERISTIC Tlib_UtcTiGlbDataValid_ZCR_CANFD7_C "" VALUE 0x00720d71 Val_Wu8 1 OneToOne 0.0 255.00 FORMAT "%8.2" /end CHARACTERISTIC
/begin CHARACTERISTIC Tlib_GearLvrIndcn2_ZCR_CANFD7_C "" VALUE 0x00720d72 Val_Wu8 1 OneToOne 0.0 255.00 FORMAT "%8.2" /end CHARACTERISTIC
/begin CHARACTERISTIC Tlib_GearLvrIndcnDataID4_ZCR_CANFD7_C "" VALUE 0x00720d73 Val_Wu8 1 OneToOne 0.0 255.00 FORMAT "%8.2" /end CHARACTERISTIC
/begin CHARACTERISTIC Tlib_GearLvrIndcnCntr4_ZCR_CANFD7_C "" VALUE 0x00720d74 Val_Wu8 1 OneToOne 0.0 255.00 FORMAT "%8.2" /end CHARACTERISTIC
/begin CHARACTERISTIC Tlib_GearLvrIndcnChks8_ZCR_CANFD7_C "" VALUE 0x00720d75 Val_Wu8 1 OneToOne 0.0 255.00 FORMAT "%8.2" /end CHARACTERISTIC
/begin CHARACTERISTIC Tlib_VehModMngtGlbSafeCarModSts_ZCR_CANFD7_C "" VALUE 0x00720d76 Val_Wu8 1 OneToOne 0.0 255.00 FORMAT "%8.2" /end CHARACTERISTIC
/begin CHARACTERISTIC Tlib_VehModMngtGlbSafeEgyLvlElecMai_ZCR_CANFD7_C "" VALUE 0x00720d77 Val_Wu8 1 OneToOne 0.0 255.00 FORMAT "%8.2" /end CHARACTERISTIC
/begin CHARACTERISTIC Tlib_VehModMngtGlbSafeCntr4_ZCR_CANFD7_C "" VALUE 0x00720d78 Val_Wu8 1 OneToOne 0.0 255.00 FORMAT "%8.2" /end CHARACTERISTIC
/begin CHARACTERISTIC Tlib_VehModMngtGlbSafeDataID4_ZCR_CANFD7_C "" VALUE 0x00720d79 Val_Wu8 1 OneToOne 0.0 255.00 FORMAT "%8.2" /end CHARACTERISTIC
/begin CHARACTERISTIC Tlib_VehModMngtGlbSafeCarModSubtypWdCarModSubtyp_ZCR_CANFD7_C "" VALUE 0x00720d7a Val_Wu8 1 OneToOne 0.0 255.00 FORMAT "%8.2" /end CHARACTERISTIC
/begin CHARACTERISTIC Tlib_VehModMngtGlbSafePwrLvlElecSubtyp_ZCR_CANFD7_C "" VALUE 0x00720d7b Val_Wu8 1 OneToOne 0.0 255.00 FORMAT "%8.2" /end CHARACTERISTIC
/begin CHARACTERISTIC Tlib_VehModMngtGlbSafePwrModSts_ZCR_CANFD7_C "" VALUE 0x00720d7c Val_Wu8 1 OneToOne 0.0 255.00 FORMAT "%8.2" /end CHARACTERISTIC
/begin CHARACTERISTIC Tlib_VehModMngtGlbSafeEgyLvlElecSubtyp_ZCR_CANFD7_C "" VALUE 0x00720d7d Val_Wu8 1 OneToOne 0.0 255.00 FORMAT "%8.2" /end CHARACTERISTIC
/begin CHARACTERISTIC Tlib_VehModMngtGlbSafeFltEgyCnsWdSts_ZCR_CANFD7_C "" VALUE 0x00720d7e Val_Wu8 1 OneToOne 0.0 255.00 FORMAT "%8.2" /end CHARACTERISTIC
/begin CHARACTERISTIC Tlib_VehModMngtGlbSafePwrLvlElecMai_ZCR_CANFD7_C "" VALUE 0x00720d7f Val_Wu8 1 OneToOne 0.0 255.00 FORMAT "%8.2" /end CHARACTERISTIC
/begin CHARACTERISTIC Tlib_VehModMngtGlbSafeChks8_ZCR_CANFD7_C "" VALUE 0x00720d80 Val_Wu8 1 OneToOne 0.0 255.00 FORMAT "%8.2" /end CHARACTERISTIC
/begin CHARACTERISTIC Tlib_VehLVSysUZCLVehLVSysUBkp_ZCR_CANFD7_C "" VALUE 0x00720d81 Val_Wu8 1 OneToOne 0.0 255.00 FORMAT "%8.2" /end CHARACTERISTIC
/begin CHARACTERISTIC Tlib_VehLVSysUZCLVehLVSysUMai_ZCR_CANFD7_C "" VALUE 0x00720d82 Val_Wu8 1 OneToOne 0.0 255.00 FORMAT "%8.2" /end CHARACTERISTIC
/begin CHARACTERISTIC Tlib_HvSysRlyStsCntr4_ZCR_CANFD7_C "" VALUE 0x00720d83 Val_Wu8 1 OneToOne 0.0 255.00 FORMAT "%8.2" /end CHARACTERISTIC
/begin CHARACTERISTIC Tlib_HvSysRlyStsDataID4_ZCR_CANFD7_C "" VALUE 0x00720d84 Val_Wu8 1 OneToOne 0.0 255.00 FORMAT "%8.2" /end CHARACTERISTIC
/begin CHARACTERISTIC Tlib_HvSysRlyStsChks8_ZCR_CANFD7_C "" VALUE 0x00720d85 Val_Wu8 1 OneToOne 0.0 255.00 FORMAT "%8.2" /end CHARACTERISTIC
/begin CHARACTERISTIC Tlib_HvSysRlyStsRly_ZCR_CANFD7_C "" VALUE 0x00720d86 Val_Wu8 1 OneToOne 0.0 255.00 FORMAT "%8.2" /end CHARACTERISTIC
/begin CHARACTERISTIC Tlib_OdoMeter_ZCR_CANFD7_C "" VALUE 0x007204e4 Val_Wu32 1 OneToOne 0.0 4294967295 FORMAT "%8.2" /end CHARACTERISTIC
/begin CHARACTERISTIC Tlib_ActvnOfWelcomeLi_ZCR_CANFD7_C "" VALUE 0x00720d87 Val_Wu8 1 OneToOne 0.0 255.00 FORMAT "%8.2" /end CHARACTERISTIC
/begin CHARACTERISTIC Tlib_ActvnOfGoodByeLi_ZCR_CANFD7_C "" VALUE 0x00720d88 Val_Wu8 1 OneToOne 0.0 255.00 FORMAT "%8.2" /end CHARACTERISTIC
/begin CHARACTERISTIC Tlib_ActnOfLedDaytiRunngLamp_ZCR_CANFD7_C "" VALUE 0x00720d89 Val_Wu8 1 OneToOne 0.0 255.00 FORMAT "%8.2" /end CHARACTERISTIC
/begin CHARACTERISTIC Tlib_ActnOfLedPosnLampChks8_ZCR_CANFD7_C "" VALUE 0x00720d8a Val_Wu8 1 OneToOne 0.0 255.00 FORMAT "%8.2" /end CHARACTERISTIC
/begin CHARACTERISTIC Tlib_ActnOfLedPosnLampDataID4_ZCR_CANFD7_C "" VALUE 0x00720d8b Val_Wu8 1 OneToOne 0.0 255.00 FORMAT "%8.2" /end CHARACTERISTIC
/begin CHARACTERISTIC Tlib_ActnOfLedPosnLampOnOffSafe1_ZCR_CANFD7_C "" VALUE 0x00720d8c Val_Wu8 1 OneToOne 0.0 255.00 FORMAT "%8.2" /end CHARACTERISTIC
/begin CHARACTERISTIC Tlib_ActnOfLedPosnLampCntr4_ZCR_CANFD7_C "" VALUE 0x00720d8d Val_Wu8 1 OneToOne 0.0 255.00 FORMAT "%8.2" /end CHARACTERISTIC
/begin CHARACTERISTIC Tlib_ActnBatChargingPCM_ZCR_CANFD7_C "" VALUE 0x00720d8e Val_Wu8 1 OneToOne 0.0 255.00 FORMAT "%8.2" /end CHARACTERISTIC
/begin CHARACTERISTIC Tlib_OutdBriSts_ZCR_CANFD7_C "" VALUE 0x00720d8f Val_Wu8 1 OneToOne 0.0 255.00 FORMAT "%8.2" /end CHARACTERISTIC
/begin CHARACTERISTIC Tlib_OutdBriDataID4_ZCR_CANFD7_C "" VALUE 0x00720d90 Val_Wu8 1 OneToOne 0.0 255.00 FORMAT "%8.2" /end CHARACTERISTIC
/begin CHARACTERISTIC Tlib_OutdBriChks8_ZCR_CANFD7_C "" VALUE 0x00720d91 Val_Wu8 1 OneToOne 0.0 255.00 FORMAT "%8.2" /end CHARACTERISTIC
/begin CHARACTERISTIC Tlib_OutdBriCntr4_ZCR_CANFD7_C "" VALUE 0x00720d92 Val_Wu8 1 OneToOne 0.0 255.00 FORMAT "%8.2" /end CHARACTERISTIC
/begin CHARACTERISTIC Tlib_VehSpdLgtA_ZCR_CANFD6_C "" VALUE 0x007208ee Val_Wu16 1 OneToOne 0.0 65535 FORMAT "%8.2" /end CHARACTERISTIC
/begin CHARACTERISTIC Tlib_VehSpdLgtQf_ZCR_CANFD6_C "" VALUE 0x00720d93 Val_Wu8 1 OneToOne 0.0 255.00 FORMAT "%8.2" /end CHARACTERISTIC
/begin CHARACTERISTIC Tlib_VehSpdLgtDataID4_ZCR_CANFD6_C "" VALUE 0x00720d94 Val_Wu8 1 OneToOne 0.0 255.00 FORMAT "%8.2" /end CHARACTERISTIC
/begin CHARACTERISTIC Tlib_VehSpdLgtChks8_ZCR_CANFD6_C "" VALUE 0x00720d95 Val_Wu8 1 OneToOne 0.0 255.00 FORMAT "%8.2" /end CHARACTERISTIC
/begin CHARACTERISTIC Tlib_VehSpdLgtCntr4_ZCR_CANFD6_C "" VALUE 0x00720d96 Val_Wu8 1 OneToOne 0.0 255.00 FORMAT "%8.2" /end CHARACTERISTIC
/begin CHARACTERISTIC Tlib_GearLvrIndcn2_ZCR_CANFD6_C "" VALUE 0x00720d97 Val_Wu8 1 OneToOne 0.0 255.00 FORMAT "%8.2" /end CHARACTERISTIC
/begin CHARACTERISTIC Tlib_GearLvrIndcnChks8_ZCR_CANFD6_C "" VALUE 0x00720d98 Val_Wu8 1 OneToOne 0.0 255.00 FORMAT "%8.2" /end CHARACTERISTIC
/begin CHARACTERISTIC Tlib_GearLvrIndcnDataID4_ZCR_CANFD6_C "" VALUE 0x00720d99 Val_Wu8 1 OneToOne 0.0 255.00 FORMAT "%8.2" /end CHARACTERISTIC
/begin CHARACTERISTIC Tlib_GearLvrIndcnCntr4_ZCR_CANFD6_C "" VALUE 0x00720d9a Val_Wu8 1 OneToOne 0.0 255.00 FORMAT "%8.2" /end CHARACTERISTIC
/begin CHARACTERISTIC Tlib_UtcTiGlbDataValid_ZCR_CANFD6_C "" VALUE 0x00720d9b Val_Wu8 1 OneToOne 0.0 255.00 FORMAT "%8.2" /end CHARACTERISTIC
/begin CHARACTERISTIC Tlib_UtcTiGlbUtcTiVal_ZCR_CANFD6_C "" VALUE 0x007204e8 Val_Wu32 1 OneToOne 0.0 4294967295 FORMAT "%8.2" /end CHARACTERISTIC
/begin CHARACTERISTIC Tlib_VehModMngtGlbSafeFltEgyCnsWdSts_ZCR_CANFD6_C "" VALUE 0x00720d9c Val_Wu8 1 OneToOne 0.0 255.00 FORMAT "%8.2" /end CHARACTERISTIC
/begin CHARACTERISTIC Tlib_VehModMngtGlbSafeEgyLvlElecMai_ZCR_CANFD6_C "" VALUE 0x00720d9d Val_Wu8 1 OneToOne 0.0 255.00 FORMAT "%8.2" /end CHARACTERISTIC
/begin CHARACTERISTIC Tlib_VehModMngtGlbSafeChks8_ZCR_CANFD6_C "" VALUE 0x00720d9e Val_Wu8 1 OneToOne 0.0 255.00 FORMAT "%8.2" /end CHARACTERISTIC
/begin CHARACTERISTIC Tlib_VehModMngtGlbSafeEgyLvlElecSubtyp_ZCR_CANFD6_C "" VALUE 0x00720d9f Val_Wu8 1 OneToOne 0.0 255.00 FORMAT "%8.2" /end CHARACTERISTIC
/begin CHARACTERISTIC Tlib_VehModMngtGlbSafeCntr4_ZCR_CANFD6_C "" VALUE 0x00720da0 Val_Wu8 1 OneToOne 0.0 255.00 FORMAT "%8.2" /end CHARACTERISTIC
/begin CHARACTERISTIC Tlib_VehModMngtGlbSafeCarModSts_ZCR_CANFD6_C "" VALUE 0x00720da1 Val_Wu8 1 OneToOne 0.0 255.00 FORMAT "%8.2" /end CHARACTERISTIC
/begin CHARACTERISTIC Tlib_VehModMngtGlbSafePwrLvlElecMai_ZCR_CANFD6_C "" VALUE 0x00720da2 Val_Wu8 1 OneToOne 0.0 255.00 FORMAT "%8.2" /end CHARACTERISTIC
/begin CHARACTERISTIC Tlib_VehModMngtGlbSafePwrModSts_ZCR_CANFD6_C "" VALUE 0x00720da3 Val_Wu8 1 OneToOne 0.0 255.00 FORMAT "%8.2" /end CHARACTERISTIC
/begin CHARACTERISTIC Tlib_VehModMngtGlbSafeCarModSubtypWdCarModSubtyp_ZCR_CANFD6_C "" VALUE 0x00720da4 Val_Wu8 1 OneToOne 0.0 255.00 FORMAT "%8.2" /end CHARACTERISTIC
/begin CHARACTERISTIC Tlib_VehModMngtGlbSafePwrLvlElecSubtyp_ZCR_CANFD6_C "" VALUE 0x00720da5 Val_Wu8 1 OneToOne 0.0 255.00 FORMAT "%8.2" /end CHARACTERISTIC
/begin CHARACTERISTIC Tlib_VehModMngtGlbSafeDataID4_ZCR_CANFD6_C "" VALUE 0x00720da6 Val_Wu8 1 OneToOne 0.0 255.00 FORMAT "%8.2" /end CHARACTERISTIC
/begin CHARACTERISTIC Tlib_VehLVSysUZCLVehLVSysUBkp_ZCR_CANFD6_C "" VALUE 0x00720da7 Val_Wu8 1 OneToOne 0.0 255.00 FORMAT "%8.2" /end CHARACTERISTIC
/begin CHARACTERISTIC Tlib_VehLVSysUZCLVehLVSysUMai_ZCR_CANFD6_C "" VALUE 0x00720da8 Val_Wu8 1 OneToOne 0.0 255.00 FORMAT "%8.2" /end CHARACTERISTIC
/begin CHARACTERISTIC Tlib_HvSysRlyStsChks8_ZCR_CANFD6_C "" VALUE 0x00720da9 Val_Wu8 1 OneToOne 0.0 255.00 FORMAT "%8.2" /end CHARACTERISTIC
/begin CHARACTERISTIC Tlib_HvSysRlyStsRly_ZCR_CANFD6_C "" VALUE 0x00720daa Val_Wu8 1 OneToOne 0.0 255.00 FORMAT "%8.2" /end CHARACTERISTIC
/begin CHARACTERISTIC Tlib_HvSysRlyStsCntr4_ZCR_CANFD6_C "" VALUE 0x00720dab Val_Wu8 1 OneToOne 0.0 255.00 FORMAT "%8.2" /end CHARACTERISTIC
/begin CHARACTERISTIC Tlib_HvSysRlyStsDataID4_ZCR_CANFD6_C "" VALUE 0x00720dac Val_Wu8 1 OneToOne 0.0 255.00 FORMAT "%8.2" /end CHARACTERISTIC
/begin CHARACTERISTIC Tlib_OdoMeter_ZCR_CANFD6_C "" VALUE 0x007204ec Val_Wu32 1 OneToOne 0.0 4294967295 FORMAT "%8.2" /end CHARACTERISTIC
/begin CHARACTERISTIC Tlib_SecRiBackrestAntiPinchCtrl_ZCR_CANFD6_C "" VALUE 0x00720dad Val_Wu8 1 OneToOne 0.0 255.00 FORMAT "%8.2" /end CHARACTERISTIC
/begin CHARACTERISTIC Tlib_SecRiLegRstVertMotCmd_ZCR_CANFD6_C "" VALUE 0x00720dae Val_Wu8 1 OneToOne 0.0 255.00 FORMAT "%8.2" /end CHARACTERISTIC
/begin CHARACTERISTIC Tlib_SecRiLumbrHozlCmd_ZCR_CANFD6_C "" VALUE 0x00720daf Val_Wu8 1 OneToOne 0.0 255.00 FORMAT "%8.2" /end CHARACTERISTIC
/begin CHARACTERISTIC Tlib_SecRiLenAntiPinchCtrl_ZCR_CANFD6_C "" VALUE 0x00720db0 Val_Wu8 1 OneToOne 0.0 255.00 FORMAT "%8.2" /end CHARACTERISTIC
/begin CHARACTERISTIC Tlib_SecRiLegRstAntiPinchCtrl_ZCR_CANFD6_C "" VALUE 0x00720db1 Val_Wu8 1 OneToOne 0.0 255.00 FORMAT "%8.2" /end CHARACTERISTIC
/begin CHARACTERISTIC Tlib_SecRiLumbrVertCmd_ZCR_CANFD6_C "" VALUE 0x00720db2 Val_Wu8 1 OneToOne 0.0 255.00 FORMAT "%8.2" /end CHARACTERISTIC
/begin CHARACTERISTIC Tlib_SecRiLegRstHozlMotCmd_ZCR_CANFD6_C "" VALUE 0x00720db3 Val_Wu8 1 OneToOne 0.0 255.00 FORMAT "%8.2" /end CHARACTERISTIC
/begin CHARACTERISTIC Tlib_SecRiHeiMotCmd_ZCR_CANFD6_C "" VALUE 0x00720db4 Val_Wu8 1 OneToOne 0.0 255.00 FORMAT "%8.2" /end CHARACTERISTIC
/begin CHARACTERISTIC Tlib_SecRiCushTiltMotCmd_ZCR_CANFD6_C "" VALUE 0x00720db5 Val_Wu8 1 OneToOne 0.0 255.00 FORMAT "%8.2" /end CHARACTERISTIC
/begin CHARACTERISTIC Tlib_SecRiShldMotCmd_ZCR_CANFD6_C "" VALUE 0x00720db6 Val_Wu8 1 OneToOne 0.0 255.00 FORMAT "%8.2" /end CHARACTERISTIC
/begin CHARACTERISTIC Tlib_PassSeatMassgLoadAndStoreReqErgoPosn_ZCR_CANFD6_C "" VALUE 0x00720db7 Val_Wu8 1 OneToOne 0.0 255.00 FORMAT "%8.2" /end CHARACTERISTIC
/begin CHARACTERISTIC Tlib_PassSeatMassgLoadAndStoreReqIdPen_ZCR_CANFD6_C "" VALUE 0x00720db8 Val_Wu8 1 OneToOne 0.0 255.00 FORMAT "%8.2" /end CHARACTERISTIC
/begin CHARACTERISTIC Tlib_PassSeatMassgLoadAndStoreReqInOutEasy_ZCR_CANFD6_C "" VALUE 0x00720db9 Val_Wu8 1 OneToOne 0.0 255.00 FORMAT "%8.2" /end CHARACTERISTIC
/begin CHARACTERISTIC Tlib_PassSeatMassgLoadAndStoreReqErgoSetgEve_ZCR_CANFD6_C "" VALUE 0x00720dba Val_Wu8 1 OneToOne 0.0 255.00 FORMAT "%8.2" /end CHARACTERISTIC
/begin CHARACTERISTIC Tlib_SeatCtrlTotConfigForSecRow_ZCR_CANFD6_C "" VALUE 0x007204f0 Val_Wu32 1 OneToOne 0.0 4294967295 FORMAT "%8.2" /end CHARACTERISTIC
/begin CHARACTERISTIC Tlib_SecRiSeatPowerCtrl_ZCR_CANFD6_C "" VALUE 0x00720dbb Val_Wu8 1 OneToOne 0.0 255.00 FORMAT "%8.2" /end CHARACTERISTIC
/begin CHARACTERISTIC Tlib_SecRiLenMotCmdSwtHozlSts1_ZCR_CANFD6_C "" VALUE 0x00720dbc Val_Wu8 1 OneToOne 0.0 255.00 FORMAT "%8.2" /end CHARACTERISTIC
/begin CHARACTERISTIC Tlib_SecRiLenMotCmdMotorSpeed_ZCR_CANFD6_C "" VALUE 0x00720dbd Val_Wu8 1 OneToOne 0.0 255.00 FORMAT "%8.2" /end CHARACTERISTIC
/begin CHARACTERISTIC Tlib_SecRiRotateMotCmd_ZCR_CANFD6_C "" VALUE 0x00720dbe Val_Wu8 1 OneToOne 0.0 255.00 FORMAT "%8.2" /end CHARACTERISTIC
/begin CHARACTERISTIC Tlib_SecRiBackrestMotCmdSwtHozlSts1_ZCR_CANFD6_C "" VALUE 0x00720dbf Val_Wu8 1 OneToOne 0.0 255.00 FORMAT "%8.2" /end CHARACTERISTIC
/begin CHARACTERISTIC Tlib_SecRiBackrestMotCmdMotorSpeed_ZCR_CANFD6_C "" VALUE 0x00720dc0 Val_Wu8 1 OneToOne 0.0 255.00 FORMAT "%8.2" /end CHARACTERISTIC
/begin CHARACTERISTIC Tlib_SeatHeatgCmdCushSecRi_ZCR_CANFD6_C "" VALUE 0x007208f0 Val_Wu16 1 OneToOne 0.0 65535 FORMAT "%8.2" /end CHARACTERISTIC
/begin CHARACTERISTIC Tlib_SeatVentnCmdCushSecRi_ZCR_CANFD6_C "" VALUE 0x007208f2 Val_Wu16 1 OneToOne 0.0 65535 FORMAT "%8.2" /end CHARACTERISTIC
/begin CHARACTERISTIC Tlib_SeatHeatgCmdBackSecRi_ZCR_CANFD6_C "" VALUE 0x007208f4 Val_Wu16 1 OneToOne 0.0 65535 FORMAT "%8.2" /end CHARACTERISTIC
/begin CHARACTERISTIC Tlib_SeatVentnCmdBackSecRi_ZCR_CANFD6_C "" VALUE 0x007208f6 Val_Wu16 1 OneToOne 0.0 65535 FORMAT "%8.2" /end CHARACTERISTIC
/begin CHARACTERISTIC Tlib_PassCushBlstrCmd_ZCR_LIN7_C "" VALUE 0x00720dc1 Val_Wu8 1 OneToOne 0.0 255.00 FORMAT "%8.2" /end CHARACTERISTIC
/begin CHARACTERISTIC Tlib_PassBackBlstrCmd_ZCR_LIN7_C "" VALUE 0x00720dc2 Val_Wu8 1 OneToOne 0.0 255.00 FORMAT "%8.2" /end CHARACTERISTIC
/begin CHARACTERISTIC Tlib_PassLumbrHozlCmd_ZCR_LIN7_C "" VALUE 0x00720dc3 Val_Wu8 1 OneToOne 0.0 255.00 FORMAT "%8.2" /end CHARACTERISTIC
/begin CHARACTERISTIC Tlib_PassLumbrVertCmd_ZCR_LIN7_C "" VALUE 0x00720dc4 Val_Wu8 1 OneToOne 0.0 255.00 FORMAT "%8.2" /end CHARACTERISTIC
/begin CHARACTERISTIC Tlib_PassMassgFctSetOnOff_ZCR_LIN7_C "" VALUE 0x00720dc5 Val_Wu8 1 OneToOne 0.0 255.00 FORMAT "%8.2" /end CHARACTERISTIC
/begin CHARACTERISTIC Tlib_PassMassgFctSetMassgInten_ZCR_LIN7_C "" VALUE 0x00720dc6 Val_Wu8 1 OneToOne 0.0 255.00 FORMAT "%8.2" /end CHARACTERISTIC
/begin CHARACTERISTIC Tlib_PassMassgFctSetMassgProg_ZCR_LIN7_C "" VALUE 0x00720dc7 Val_Wu8 1 OneToOne 0.0 255.00 FORMAT "%8.2" /end CHARACTERISTIC
/begin CHARACTERISTIC Tlib_SecRiBackBlstrCmd_ZCR_LIN7_C "" VALUE 0x00720dc8 Val_Wu8 1 OneToOne 0.0 255.00 FORMAT "%8.2" /end CHARACTERISTIC
/begin CHARACTERISTIC Tlib_RiLumbrVertCtrlForDiag_ZCR_LIN7_C "" VALUE 0x00720dc9 Val_Wu8 1 OneToOne 0.0 255.00 FORMAT "%8.2" /end CHARACTERISTIC
/begin CHARACTERISTIC Tlib_SecRiSeatMassgLoadAndStoreReqErgoPosn_ZCR_LIN7_C "" VALUE 0x00720dca Val_Wu8 1 OneToOne 0.0 255.00 FORMAT "%8.2" /end CHARACTERISTIC
/begin CHARACTERISTIC Tlib_SecRiSeatMassgLoadAndStoreReqErgoSetgEve_ZCR_LIN7_C "" VALUE 0x00720dcb Val_Wu8 1 OneToOne 0.0 255.00 FORMAT "%8.2" /end CHARACTERISTIC
/begin CHARACTERISTIC Tlib_SecRiSeatMassgLoadAndStoreReqIdPen_ZCR_LIN7_C "" VALUE 0x00720dcc Val_Wu8 1 OneToOne 0.0 255.00 FORMAT "%8.2" /end CHARACTERISTIC
/begin CHARACTERISTIC Tlib_SecRiSeatMassgLoadAndStoreReqInOutEasy_ZCR_LIN7_C "" VALUE 0x00720dcd Val_Wu8 1 OneToOne 0.0 255.00 FORMAT "%8.2" /end CHARACTERISTIC
/begin CHARACTERISTIC Tlib_RiMassgCtrlForDiagMassgInten_ZCR_LIN7_C "" VALUE 0x00720dce Val_Wu8 1 OneToOne 0.0 255.00 FORMAT "%8.2" /end CHARACTERISTIC
/begin CHARACTERISTIC Tlib_RiMassgCtrlForDiagOnOff_ZCR_LIN7_C "" VALUE 0x00720dcf Val_Wu8 1 OneToOne 0.0 255.00 FORMAT "%8.2" /end CHARACTERISTIC
/begin CHARACTERISTIC Tlib_RiMassgCtrlForDiagMassgProg_ZCR_LIN7_C "" VALUE 0x00720dd0 Val_Wu8 1 OneToOne 0.0 255.00 FORMAT "%8.2" /end CHARACTERISTIC
/begin CHARACTERISTIC Tlib_RiLumbrHozlCtrlForDiag_ZCR_LIN7_C "" VALUE 0x00720dd1 Val_Wu8 1 OneToOne 0.0 255.00 FORMAT "%8.2" /end CHARACTERISTIC
/begin CHARACTERISTIC Tlib_SecRiMassgFctSetMassgProg_ZCR_LIN7_C "" VALUE 0x00720dd2 Val_Wu8 1 OneToOne 0.0 255.00 FORMAT "%8.2" /end CHARACTERISTIC
/begin CHARACTERISTIC Tlib_SecRiMassgFctSetOnOff_ZCR_LIN7_C "" VALUE 0x00720dd3 Val_Wu8 1 OneToOne 0.0 255.00 FORMAT "%8.2" /end CHARACTERISTIC
/begin CHARACTERISTIC Tlib_SecRiMassgFctSetMassgInten_ZCR_LIN7_C "" VALUE 0x00720dd4 Val_Wu8 1 OneToOne 0.0 255.00 FORMAT "%8.2" /end CHARACTERISTIC
/begin CHARACTERISTIC Tlib_SecRiCushBlstrCmd_ZCR_LIN7_C "" VALUE 0x00720dd5 Val_Wu8 1 OneToOne 0.0 255.00 FORMAT "%8.2" /end CHARACTERISTIC
/begin CHARACTERISTIC Tlib_SecRiLumbrVertCmd_ZCR_LIN7_C "" VALUE 0x00720dd6 Val_Wu8 1 OneToOne 0.0 255.00 FORMAT "%8.2" /end CHARACTERISTIC
/begin CHARACTERISTIC Tlib_RiSeatMassgPowerCtrl_ZCR_LIN7_C "" VALUE 0x00720dd7 Val_Wu8 1 OneToOne 0.0 255.00 FORMAT "%8.2" /end CHARACTERISTIC
/begin CHARACTERISTIC Tlib_RiBackBlstrCtrlForDiag_ZCR_LIN7_C "" VALUE 0x00720dd8 Val_Wu8 1 OneToOne 0.0 255.00 FORMAT "%8.2" /end CHARACTERISTIC
/begin CHARACTERISTIC Tlib_RiCushBlstrCtrlForDiag_ZCR_LIN7_C "" VALUE 0x00720dd9 Val_Wu8 1 OneToOne 0.0 255.00 FORMAT "%8.2" /end CHARACTERISTIC
/begin CHARACTERISTIC Tlib_SecRiLumbrHozlCmd_ZCR_LIN7_C "" VALUE 0x00720dda Val_Wu8 1 OneToOne 0.0 255.00 FORMAT "%8.2" /end CHARACTERISTIC
/begin CHARACTERISTIC Tlib_PassSeatMassgLoadAndStoreReqErgoPosn_ZCR_LIN7_C "" VALUE 0x00720ddb Val_Wu8 1 OneToOne 0.0 255.00 FORMAT "%8.2" /end CHARACTERISTIC
/begin CHARACTERISTIC Tlib_PassSeatMassgLoadAndStoreReqErgoSetgEve_ZCR_LIN7_C "" VALUE 0x00720ddc Val_Wu8 1 OneToOne 0.0 255.00 FORMAT "%8.2" /end CHARACTERISTIC
/begin CHARACTERISTIC Tlib_PassSeatMassgLoadAndStoreReqInOutEasy_ZCR_LIN7_C "" VALUE 0x00720ddd Val_Wu8 1 OneToOne 0.0 255.00 FORMAT "%8.2" /end CHARACTERISTIC
/begin CHARACTERISTIC Tlib_PassSeatMassgLoadAndStoreReqIdPen_ZCR_LIN7_C "" VALUE 0x00720dde Val_Wu8 1 OneToOne 0.0 255.00 FORMAT "%8.2" /end CHARACTERISTIC
/begin CHARACTERISTIC Tlib_LeftElectricPedalIniCalReq_ZCR_LIN7_C "" VALUE 0x00720ddf Val_Wu8 1 OneToOne 0.0 255.00 FORMAT "%8.2" /end CHARACTERISTIC
/begin CHARACTERISTIC Tlib_RightElectricPedalIniCalReq_ZCR_LIN7_C "" VALUE 0x00720de0 Val_Wu8 1 OneToOne 0.0 255.00 FORMAT "%8.2" /end CHARACTERISTIC
/begin CHARACTERISTIC Tlib_ElSPRightMtnCmd_ZCR_LIN7_C "" VALUE 0x00720de1 Val_Wu8 1 OneToOne 0.0 255.00 FORMAT "%8.2" /end CHARACTERISTIC
/begin CHARACTERISTIC Tlib_ElSPLeftMtnCmd_ZCR_LIN7_C "" VALUE 0x00720de2 Val_Wu8 1 OneToOne 0.0 255.00 FORMAT "%8.2" /end CHARACTERISTIC
/begin CHARACTERISTIC Tlib_RowFrstPassODSSts_ZCR_CANFD4_C "" VALUE 0x00720de3 Val_Wu8 1 OneToOne 0.0 255.00 FORMAT "%8.2" /end CHARACTERISTIC
/begin CHARACTERISTIC Tlib_PassSeatPosPercGroupSeatPosSldPerc_ZCR_CANFD4_C "" VALUE 0x007208f8 Val_Wu16 1 OneToOne 0.0 65535 FORMAT "%8.2" /end CHARACTERISTIC
/begin CHARACTERISTIC Tlib_PassSeatPosPercGroupSeatPosSldQF_ZCR_CANFD4_C "" VALUE 0x00720de4 Val_Wu8 1 OneToOne 0.0 255.00 FORMAT "%8.2" /end CHARACTERISTIC
/begin CHARACTERISTIC Tlib_PassSeatPosPercGroupSeatPosFrntHeiQF_ZCR_CANFD4_C "" VALUE 0x00720de5 Val_Wu8 1 OneToOne 0.0 255.00 FORMAT "%8.2" /end CHARACTERISTIC
/begin CHARACTERISTIC Tlib_PassSeatPosPercGroupSeatPosFrntHeiPerc_ZCR_CANFD4_C "" VALUE 0x007208fa Val_Wu16 1 OneToOne 0.0 65535 FORMAT "%8.2" /end CHARACTERISTIC
/begin CHARACTERISTIC Tlib_PassSeatPosPercGroupSeatPosHeiQF_ZCR_CANFD4_C "" VALUE 0x00720de6 Val_Wu8 1 OneToOne 0.0 255.00 FORMAT "%8.2" /end CHARACTERISTIC
/begin CHARACTERISTIC Tlib_PassSeatPosPercGroupSeatPosHeiPerc_ZCR_CANFD4_C "" VALUE 0x007208fc Val_Wu16 1 OneToOne 0.0 65535 FORMAT "%8.2" /end CHARACTERISTIC
/begin CHARACTERISTIC Tlib_DoorRiReLockSts_ZCR_CANFD4_C "" VALUE 0x00720de7 Val_Wu8 1 OneToOne 0.0 255.00 FORMAT "%8.2" /end CHARACTERISTIC
/begin CHARACTERISTIC Tlib_DoorLeReLockSts_ZCR_CANFD4_C "" VALUE 0x00720de8 Val_Wu8 1 OneToOne 0.0 255.00 FORMAT "%8.2" /end CHARACTERISTIC
/begin CHARACTERISTIC Tlib_TiAndDateIndcdHr1_ZCR_CANFD4_C "" VALUE 0x00720de9 Val_Wu8 1 OneToOne 0.0 255.00 FORMAT "%8.2" /end CHARACTERISTIC
/begin CHARACTERISTIC Tlib_TiAndDateIndcdSec1_ZCR_CANFD4_C "" VALUE 0x00720dea Val_Wu8 1 OneToOne 0.0 255.00 FORMAT "%8.2" /end CHARACTERISTIC
/begin CHARACTERISTIC Tlib_TiAndDateIndcdYr1_ZCR_CANFD4_C "" VALUE 0x00720deb Val_Wu8 1 OneToOne 0.0 255.00 FORMAT "%8.2" /end CHARACTERISTIC
/begin CHARACTERISTIC Tlib_TiAndDateIndcdDay_ZCR_CANFD4_C "" VALUE 0x00720dec Val_Wu8 1 OneToOne 0.0 255.00 FORMAT "%8.2" /end CHARACTERISTIC
/begin CHARACTERISTIC Tlib_TiAndDateIndcdMth1_ZCR_CANFD4_C "" VALUE 0x00720ded Val_Wu8 1 OneToOne 0.0 255.00 FORMAT "%8.2" /end CHARACTERISTIC
/begin CHARACTERISTIC Tlib_TiAndDateIndcdDataValid_ZCR_CANFD4_C "" VALUE 0x00720dee Val_Wu8 1 OneToOne 0.0 255.00 FORMAT "%8.2" /end CHARACTERISTIC
/begin CHARACTERISTIC Tlib_TiAndDateIndcdMins1_ZCR_CANFD4_C "" VALUE 0x00720def Val_Wu8 1 OneToOne 0.0 255.00 FORMAT "%8.2" /end CHARACTERISTIC
/begin CHARACTERISTIC Tlib_DoorPassLockSts_ZCR_CANFD4_C "" VALUE 0x00720df0 Val_Wu8 1 OneToOne 0.0 255.00 FORMAT "%8.2" /end CHARACTERISTIC
/begin CHARACTERISTIC Tlib_DoorPassStsDoorSts2_ZCR_CANFD4_C "" VALUE 0x00720df1 Val_Wu8 1 OneToOne 0.0 255.00 FORMAT "%8.2" /end CHARACTERISTIC
/begin CHARACTERISTIC Tlib_DoorPassStsCntr4_ZCR_CANFD4_C "" VALUE 0x00720df2 Val_Wu8 1 OneToOne 0.0 255.00 FORMAT "%8.2" /end CHARACTERISTIC
/begin CHARACTERISTIC Tlib_DoorPassStsDataID4_ZCR_CANFD4_C "" VALUE 0x00720df3 Val_Wu8 1 OneToOne 0.0 255.00 FORMAT "%8.2" /end CHARACTERISTIC
/begin CHARACTERISTIC Tlib_DoorPassStsChks8_ZCR_CANFD4_C "" VALUE 0x00720df4 Val_Wu8 1 OneToOne 0.0 255.00 FORMAT "%8.2" /end CHARACTERISTIC
/begin CHARACTERISTIC Tlib_DoorRiReStsChks8_ZCR_CANFD4_C "" VALUE 0x00720df5 Val_Wu8 1 OneToOne 0.0 255.00 FORMAT "%8.2" /end CHARACTERISTIC
/begin CHARACTERISTIC Tlib_DoorRiReStsDataID4_ZCR_CANFD4_C "" VALUE 0x00720df6 Val_Wu8 1 OneToOne 0.0 255.00 FORMAT "%8.2" /end CHARACTERISTIC
/begin CHARACTERISTIC Tlib_DoorRiReStsCntr4_ZCR_CANFD4_C "" VALUE 0x00720df7 Val_Wu8 1 OneToOne 0.0 255.00 FORMAT "%8.2" /end CHARACTERISTIC
/begin CHARACTERISTIC Tlib_DoorRiReStsDoorSts2_ZCR_CANFD4_C "" VALUE 0x00720df8 Val_Wu8 1 OneToOne 0.0 255.00 FORMAT "%8.2" /end CHARACTERISTIC
/begin CHARACTERISTIC Tlib_ThrdMidSeatODSSts_ZCR_CANFD4_C "" VALUE 0x00720df9 Val_Wu8 1 OneToOne 0.0 255.00 FORMAT "%8.2" /end CHARACTERISTIC
/begin CHARACTERISTIC Tlib_ThrdRiSeatODSSts_ZCR_CANFD4_C "" VALUE 0x00720dfa Val_Wu8 1 OneToOne 0.0 255.00 FORMAT "%8.2" /end CHARACTERISTIC
/begin CHARACTERISTIC Tlib_ThrdLeSeatODSSts_ZCR_CANFD4_C "" VALUE 0x00720dfb Val_Wu8 1 OneToOne 0.0 255.00 FORMAT "%8.2" /end CHARACTERISTIC
/begin CHARACTERISTIC Tlib_DoorLeReStsChks8_ZCR_CANFD4_C "" VALUE 0x00720dfc Val_Wu8 1 OneToOne 0.0 255.00 FORMAT "%8.2" /end CHARACTERISTIC
/begin CHARACTERISTIC Tlib_DoorLeReStsDoorSts2_ZCR_CANFD4_C "" VALUE 0x00720dfd Val_Wu8 1 OneToOne 0.0 255.00 FORMAT "%8.2" /end CHARACTERISTIC
/begin CHARACTERISTIC Tlib_DoorLeReStsCntr4_ZCR_CANFD4_C "" VALUE 0x00720dfe Val_Wu8 1 OneToOne 0.0 255.00 FORMAT "%8.2" /end CHARACTERISTIC
/begin CHARACTERISTIC Tlib_DoorLeReStsDataID4_ZCR_CANFD4_C "" VALUE 0x00720dff Val_Wu8 1 OneToOne 0.0 255.00 FORMAT "%8.2" /end CHARACTERISTIC
/begin CHARACTERISTIC Tlib_SecRiSeatODSSts_ZCR_CANFD4_C "" VALUE 0x00720e00 Val_Wu8 1 OneToOne 0.0 255.00 FORMAT "%8.2" /end CHARACTERISTIC
/begin CHARACTERISTIC Tlib_VehSpdIndcdVehSpdIndcd_ZCR_CANFD4_C "" VALUE 0x007208fe Val_Wu16 1 OneToOne 0.0 65535 FORMAT "%8.2" /end CHARACTERISTIC
/begin CHARACTERISTIC Tlib_VehSpdIndcdVeSpdIndcdUnit_ZCR_CANFD4_C "" VALUE 0x00720e01 Val_Wu8 1 OneToOne 0.0 255.00 FORMAT "%8.2" /end CHARACTERISTIC
/begin CHARACTERISTIC Tlib_MoveSftyGroupPwrReqChks8_ZCR_CANFD4_C "" VALUE 0x00720e02 Val_Wu8 1 OneToOne 0.0 255.00 FORMAT "%8.2" /end CHARACTERISTIC
/begin CHARACTERISTIC Tlib_MoveSftyGroupPwrReqFLL_ZCR_CANFD4_C "" VALUE 0x00720e03 Val_Wu8 1 OneToOne 0.0 255.00 FORMAT "%8.2" /end CHARACTERISTIC
/begin CHARACTERISTIC Tlib_MoveSftyGroupPwrReqRMR_ZCR_CANFD4_C "" VALUE 0x00720e04 Val_Wu8 1 OneToOne 0.0 255.00 FORMAT "%8.2" /end CHARACTERISTIC
/begin CHARACTERISTIC Tlib_MoveSftyGroupPwrReqMoveSftyResd1_ZCR_CANFD4_C "" VALUE 0x00720e05 Val_Wu8 1 OneToOne 0.0 255.00 FORMAT "%8.2" /end CHARACTERISTIC
/begin CHARACTERISTIC Tlib_MoveSftyGroupPwrReqARMR_ZCR_CANFD4_C "" VALUE 0x00720e06 Val_Wu8 1 OneToOne 0.0 255.00 FORMAT "%8.2" /end CHARACTERISTIC
/begin CHARACTERISTIC Tlib_MoveSftyGroupPwrReqFLC_ZCR_CANFD4_C "" VALUE 0x00720e07 Val_Wu8 1 OneToOne 0.0 255.00 FORMAT "%8.2" /end CHARACTERISTIC
/begin CHARACTERISTIC Tlib_MoveSftyGroupPwrReqSteerRWakeReq_ZCR_CANFD4_C "" VALUE 0x00720e08 Val_Wu8 1 OneToOne 0.0 255.00 FORMAT "%8.2" /end CHARACTERISTIC
/begin CHARACTERISTIC Tlib_MoveSftyGroupPwrReqSRS1_ZCR_CANFD4_C "" VALUE 0x00720e09 Val_Wu8 1 OneToOne 0.0 255.00 FORMAT "%8.2" /end CHARACTERISTIC
/begin CHARACTERISTIC Tlib_MoveSftyGroupPwrReqFLR_ZCR_CANFD4_C "" VALUE 0x00720e0a Val_Wu8 1 OneToOne 0.0 255.00 FORMAT "%8.2" /end CHARACTERISTIC
/begin CHARACTERISTIC Tlib_MoveSftyGroupPwrReqFSRLFSRR_ZCR_CANFD4_C "" VALUE 0x00720e0b Val_Wu8 1 OneToOne 0.0 255.00 FORMAT "%8.2" /end CHARACTERISTIC
/begin CHARACTERISTIC Tlib_MoveSftyGroupPwrReqSteerFwakeReq_ZCR_CANFD4_C "" VALUE 0x00720e0c Val_Wu8 1 OneToOne 0.0 255.00 FORMAT "%8.2" /end CHARACTERISTIC
/begin CHARACTERISTIC Tlib_MoveSftyGroupPwrReqBCMwakeReq_ZCR_CANFD4_C "" VALUE 0x00720e0d Val_Wu8 1 OneToOne 0.0 255.00 FORMAT "%8.2" /end CHARACTERISTIC
/begin CHARACTERISTIC Tlib_MoveSftyGroupPwrReqMoveSftyResd2_ZCR_CANFD4_C "" VALUE 0x00720e0e Val_Wu8 1 OneToOne 0.0 255.00 FORMAT "%8.2" /end CHARACTERISTIC
/begin CHARACTERISTIC Tlib_MoveSftyGroupPwrReqARMF_ZCR_CANFD4_C "" VALUE 0x00720e0f Val_Wu8 1 OneToOne 0.0 255.00 FORMAT "%8.2" /end CHARACTERISTIC
/begin CHARACTERISTIC Tlib_MoveSftyGroupPwrReqSODLSODR_ZCR_CANFD4_C "" VALUE 0x00720e10 Val_Wu8 1 OneToOne 0.0 255.00 FORMAT "%8.2" /end CHARACTERISTIC
/begin CHARACTERISTIC Tlib_MoveSftyGroupPwrReqMoveSftyResd3_ZCR_CANFD4_C "" VALUE 0x00720e11 Val_Wu8 1 OneToOne 0.0 255.00 FORMAT "%8.2" /end CHARACTERISTIC
/begin CHARACTERISTIC Tlib_MoveSftyGroupPwrReqMoveSftyResd4_ZCR_CANFD4_C "" VALUE 0x00720e12 Val_Wu8 1 OneToOne 0.0 255.00 FORMAT "%8.2" /end CHARACTERISTIC
/begin CHARACTERISTIC Tlib_MoveSftyGroupPwrReqDataID4_ZCR_CANFD4_C "" VALUE 0x00720e13 Val_Wu8 1 OneToOne 0.0 255.00 FORMAT "%8.2" /end CHARACTERISTIC
/begin CHARACTERISTIC Tlib_MoveSftyGroupPwrReqSRS2_ZCR_CANFD4_C "" VALUE 0x00720e14 Val_Wu8 1 OneToOne 0.0 255.00 FORMAT "%8.2" /end CHARACTERISTIC
/begin CHARACTERISTIC Tlib_MoveSftyGroupPwrReqSLLSLR_ZCR_CANFD4_C "" VALUE 0x00720e15 Val_Wu8 1 OneToOne 0.0 255.00 FORMAT "%8.2" /end CHARACTERISTIC
/begin CHARACTERISTIC Tlib_MoveSftyGroupPwrReqADPU_ZCR_CANFD4_C "" VALUE 0x00720e16 Val_Wu8 1 OneToOne 0.0 255.00 FORMAT "%8.2" /end CHARACTERISTIC
/begin CHARACTERISTIC Tlib_MoveSftyGroupPwrReqRBCMwakeReq_ZCR_CANFD4_C "" VALUE 0x00720e17 Val_Wu8 1 OneToOne 0.0 255.00 FORMAT "%8.2" /end CHARACTERISTIC
/begin CHARACTERISTIC Tlib_MoveSftyGroupPwrReqSUM_ZCR_CANFD4_C "" VALUE 0x00720e18 Val_Wu8 1 OneToOne 0.0 255.00 FORMAT "%8.2" /end CHARACTERISTIC
/begin CHARACTERISTIC Tlib_MoveSftyGroupPwrReqRMD_ZCR_CANFD4_C "" VALUE 0x00720e19 Val_Wu8 1 OneToOne 0.0 255.00 FORMAT "%8.2" /end CHARACTERISTIC
/begin CHARACTERISTIC Tlib_MoveSftyGroupPwrReqCntr4_ZCR_CANFD4_C "" VALUE 0x00720e1a Val_Wu8 1 OneToOne 0.0 255.00 FORMAT "%8.2" /end CHARACTERISTIC
/begin CHARACTERISTIC Tlib_CmprReqCmprRunReq_ZCR_LIN4_C "" VALUE 0x00720e1b Val_Wu8 1 OneToOne 0.0 255.00 FORMAT "%8.2" /end CHARACTERISTIC
/begin CHARACTERISTIC Tlib_CmprReqCmprPwrLim_ZCR_LIN4_C "" VALUE 0x00720e1c Val_Wu8 1 OneToOne 0.0 255.00 FORMAT "%8.2" /end CHARACTERISTIC
/begin CHARACTERISTIC Tlib_AirPtcEnad_ZCR_LIN4_C "" VALUE 0x00720e1d Val_Wu8 1 OneToOne 0.0 255.00 FORMAT "%8.2" /end CHARACTERISTIC
/begin CHARACTERISTIC Tlib_AirPtcHvPwrReq_ZCR_LIN4_C "" VALUE 0x00720e1e Val_Wu8 1 OneToOne 0.0 255.00 FORMAT "%8.2" /end CHARACTERISTIC
/begin CHARACTERISTIC Tlib_CmprReqCmprSpdReq_ZCR_LIN4_C "" VALUE 0x00720e1f Val_Wu8 1 OneToOne 0.0 255.00 FORMAT "%8.2" /end CHARACTERISTIC
/begin CHARACTERISTIC Tlib_AirPtcDutyReq_ZCR_LIN4_C "" VALUE 0x00720e20 Val_Wu8 1 OneToOne 0.0 255.00 FORMAT "%8.2" /end CHARACTERISTIC
/begin CHARACTERISTIC Tlib_AirPtcModeReq_ZCR_LIN4_C "" VALUE 0x00720e21 Val_Wu8 1 OneToOne 0.0 255.00 FORMAT "%8.2" /end CHARACTERISTIC
/begin CHARACTERISTIC Tlib_CooltFlowInCmptmtCirc_ZCR_LIN4_C "" VALUE 0x00720900 Val_Wu16 1 OneToOne 0.0 65535 FORMAT "%8.2" /end CHARACTERISTIC
/begin CHARACTERISTIC Tlib_HvWtrHeatrPwrCnsAllwd_ZCR_LIN4_C "" VALUE 0x00720e22 Val_Wu8 1 OneToOne 0.0 255.00 FORMAT "%8.2" /end CHARACTERISTIC
/begin CHARACTERISTIC Tlib_HvWtrHeatrWtrTDes_ZCR_LIN4_C "" VALUE 0x00720e23 Val_Wu8 1 OneToOne 0.0 255.00 FORMAT "%8.2" /end CHARACTERISTIC
/begin CHARACTERISTIC Tlib_HvCooltHeatrEnad_ZCR_LIN4_C "" VALUE 0x00720e24 Val_Wu8 1 OneToOne 0.0 255.00 FORMAT "%8.2" /end CHARACTERISTIC
/begin CHARACTERISTIC Tlib_HvCooltHeatrEnadWhE2EHvchEnad_ZCR_LIN4_C "" VALUE 0x00720e25 Val_Wu8 1 OneToOne 0.0 255.00 FORMAT "%8.2" /end CHARACTERISTIC
/begin CHARACTERISTIC Tlib_HvCooltHeatrEnadWhE2EChks_ZCR_LIN4_C "" VALUE 0x00720e26 Val_Wu8 1 OneToOne 0.0 255.00 FORMAT "%8.2" /end CHARACTERISTIC
/begin CHARACTERISTIC Tlib_HvCooltHeatrEnadWhE2ECntr_ZCR_LIN4_C "" VALUE 0x00720e27 Val_Wu8 1 OneToOne 0.0 255.00 FORMAT "%8.2" /end CHARACTERISTIC
/begin CHARACTERISTIC Tlib_ExvPosnReqExvHeatdReq_ZCR_LIN4_C "" VALUE 0x00720e28 Val_Wu8 1 OneToOne 0.0 255.00 FORMAT "%8.2" /end CHARACTERISTIC
/begin CHARACTERISTIC Tlib_ExvPosnReqExvMovEnable_ZCR_LIN4_C "" VALUE 0x00720e29 Val_Wu8 1 OneToOne 0.0 255.00 FORMAT "%8.2" /end CHARACTERISTIC
/begin CHARACTERISTIC Tlib_ExvPosnReqExvPosnReq_ZCR_LIN4_C "" VALUE 0x00720902 Val_Wu16 1 OneToOne 0.0 65535 FORMAT "%8.2" /end CHARACTERISTIC
/begin CHARACTERISTIC Tlib_ExvPosnReqExvCalibReq_ZCR_LIN4_C "" VALUE 0x00720e2a Val_Wu8 1 OneToOne 0.0 255.00 FORMAT "%8.2" /end CHARACTERISTIC
/begin CHARACTERISTIC Tlib_EexvPosnReqExvMovEnable_ZCR_LIN4_C "" VALUE 0x00720e2b Val_Wu8 1 OneToOne 0.0 255.00 FORMAT "%8.2" /end CHARACTERISTIC
/begin CHARACTERISTIC Tlib_EexvPosnReqExvCalibReq_ZCR_LIN4_C "" VALUE 0x00720e2c Val_Wu8 1 OneToOne 0.0 255.00 FORMAT "%8.2" /end CHARACTERISTIC
/begin CHARACTERISTIC Tlib_EexvPosnReqExvHeatdReq_ZCR_LIN4_C "" VALUE 0x00720e2d Val_Wu8 1 OneToOne 0.0 255.00 FORMAT "%8.2" /end CHARACTERISTIC
/begin CHARACTERISTIC Tlib_EexvPosnReqExvPosn_ZCR_LIN4_C "" VALUE 0x00720904 Val_Wu16 1 OneToOne 0.0 65535 FORMAT "%8.2" /end CHARACTERISTIC
/begin CHARACTERISTIC Tlib_BexvPosnReqExvMovEnable_ZCR_LIN4_C "" VALUE 0x00720e2e Val_Wu8 1 OneToOne 0.0 255.00 FORMAT "%8.2" /end CHARACTERISTIC
/begin CHARACTERISTIC Tlib_BexvPosnReqExvCalibReq_ZCR_LIN4_C "" VALUE 0x00720e2f Val_Wu8 1 OneToOne 0.0 255.00 FORMAT "%8.2" /end CHARACTERISTIC
/begin CHARACTERISTIC Tlib_BexvPosnReqExvHeatdReq_ZCR_LIN4_C "" VALUE 0x00720e30 Val_Wu8 1 OneToOne 0.0 255.00 FORMAT "%8.2" /end CHARACTERISTIC
/begin CHARACTERISTIC Tlib_BexvPosnReqExvPosnReq_ZCR_LIN4_C "" VALUE 0x00720906 Val_Wu16 1 OneToOne 0.0 65535 FORMAT "%8.2" /end CHARACTERISTIC
/begin CHARACTERISTIC Tlib_CexvPosnReqExvMovEnable_ZCR_LIN4_C "" VALUE 0x00720e31 Val_Wu8 1 OneToOne 0.0 255.00 FORMAT "%8.2" /end CHARACTERISTIC
/begin CHARACTERISTIC Tlib_CexvPosnReqExvHeatdReq_ZCR_LIN4_C "" VALUE 0x00720e32 Val_Wu8 1 OneToOne 0.0 255.00 FORMAT "%8.2" /end CHARACTERISTIC
/begin CHARACTERISTIC Tlib_CexvPosnReqExvCalibReq_ZCR_LIN4_C "" VALUE 0x00720e33 Val_Wu8 1 OneToOne 0.0 255.00 FORMAT "%8.2" /end CHARACTERISTIC
/begin CHARACTERISTIC Tlib_CexvPosnReqExvPosn_ZCR_LIN4_C "" VALUE 0x00720908 Val_Wu16 1 OneToOne 0.0 65535 FORMAT "%8.2" /end CHARACTERISTIC
/begin CHARACTERISTIC Tlib_HvWtrHeatrActDischrgReq_ZCR_LIN4_C "" VALUE 0x00720e34 Val_Wu8 1 OneToOne 0.0 255.00 FORMAT "%8.2" /end CHARACTERISTIC
/begin CHARACTERISTIC Tlib_RexvPosnReqExvPosnReq_ZCR_LIN4_C "" VALUE 0x0072090a Val_Wu16 1 OneToOne 0.0 65535 FORMAT "%8.2" /end CHARACTERISTIC
/begin CHARACTERISTIC Tlib_RexvPosnReqExvMovEnable_ZCR_LIN4_C "" VALUE 0x00720e35 Val_Wu8 1 OneToOne 0.0 255.00 FORMAT "%8.2" /end CHARACTERISTIC
/begin CHARACTERISTIC Tlib_RexvPosnReqExvCalibReq_ZCR_LIN4_C "" VALUE 0x00720e36 Val_Wu8 1 OneToOne 0.0 255.00 FORMAT "%8.2" /end CHARACTERISTIC
/begin CHARACTERISTIC Tlib_RexvPosnReqExvHeatdReq_ZCR_LIN4_C "" VALUE 0x00720e37 Val_Wu8 1 OneToOne 0.0 255.00 FORMAT "%8.2" /end CHARACTERISTIC
/begin CHARACTERISTIC Tlib_EldtPmpCmdCooltPmpSpdReq_ZCR_LIN4_C "" VALUE 0x00720e38 Val_Wu8 1 OneToOne 0.0 255.00 FORMAT "%8.2" /end CHARACTERISTIC
/begin CHARACTERISTIC Tlib_EldtPmpCmdCooltPmpPostRunReq_ZCR_LIN4_C "" VALUE 0x00720e39 Val_Wu8 1 OneToOne 0.0 255.00 FORMAT "%8.2" /end CHARACTERISTIC
/begin CHARACTERISTIC Tlib_ActvnOfBlackdisplaySwtIllmn_ZCR_LIN8_C "" VALUE 0x00720e3a Val_Wu8 1 OneToOne 0.0 255.00 FORMAT "%8.2" /end CHARACTERISTIC
/begin CHARACTERISTIC Tlib_ActvnOfCenSwtIllmn_ZCR_LIN8_C "" VALUE 0x00720e3b Val_Wu8 1 OneToOne 0.0 255.00 FORMAT "%8.2" /end CHARACTERISTIC
/begin CHARACTERISTIC Tlib_ActvnOfVTMButtonLi_ZCR_LIN8_C "" VALUE 0x00720e3c Val_Wu8 1 OneToOne 0.0 255.00 FORMAT "%8.2" /end CHARACTERISTIC
/begin CHARACTERISTIC Tlib_ActvnOfVTMOnOffLi_ZCR_LIN8_C "" VALUE 0x00720e3d Val_Wu8 1 OneToOne 0.0 255.00 FORMAT "%8.2" /end CHARACTERISTIC
/begin CHARACTERISTIC Tlib_BodyGroupPwrCutToCCSM_ZCR_LIN8_C "" VALUE 0x00720e3e Val_Wu8 1 OneToOne 0.0 255.00 FORMAT "%8.2" /end CHARACTERISTIC
/begin CHARACTERISTIC Tlib_VehThTempSet_ZCR_LIN8_C "" VALUE 0x00720e3f Val_Wu8 1 OneToOne 0.0 255.00 FORMAT "%8.2" /end CHARACTERISTIC
/begin CHARACTERISTIC Tlib_ActvnOfTRCPSeatHeatLEDReq_ZCR_LIN8_C "" VALUE 0x00720e40 Val_Wu8 1 OneToOne 0.0 255.00 FORMAT "%8.2" /end CHARACTERISTIC
/begin CHARACTERISTIC Tlib_ActvnOfTRCPSeatHeatLEDPosition_ZCR_LIN8_C "" VALUE 0x00720e41 Val_Wu8 1 OneToOne 0.0 255.00 FORMAT "%8.2" /end CHARACTERISTIC
/begin CHARACTERISTIC Tlib_ActvnOfTRCPSeatAutoLEDReq_ZCR_LIN8_C "" VALUE 0x00720e42 Val_Wu8 1 OneToOne 0.0 255.00 FORMAT "%8.2" /end CHARACTERISTIC
/begin CHARACTERISTIC Tlib_ActvnOfTRCPSeatAutoLEDPosition_ZCR_LIN8_C "" VALUE 0x00720e43 Val_Wu8 1 OneToOne 0.0 255.00 FORMAT "%8.2" /end CHARACTERISTIC
/begin CHARACTERISTIC Tlib_ThirdRowClimaT_ZCR_LIN8_C "" VALUE 0x00720e44 Val_Wu8 1 OneToOne 0.0 255.00 FORMAT "%8.2" /end CHARACTERISTIC
/begin CHARACTERISTIC Tlib_ActvnOfTRCPAutoIndicator_ZCR_LIN8_C "" VALUE 0x00720e45 Val_Wu8 1 OneToOne 0.0 255.00 FORMAT "%8.2" /end CHARACTERISTIC
/begin CHARACTERISTIC Tlib_CNSLLockCtrl_ZCR_LIN11_C "" VALUE 0x00720e46 Val_Wu8 1 OneToOne 0.0 255.00 FORMAT "%8.2" /end CHARACTERISTIC
/begin CHARACTERISTIC Tlib_CNSLIniCalReq_ZCR_LIN11_C "" VALUE 0x00720e47 Val_Wu8 1 OneToOne 0.0 255.00 FORMAT "%8.2" /end CHARACTERISTIC
/begin CHARACTERISTIC Tlib_ConsoleLiftCtrl_ZCR_LIN11_C "" VALUE 0x00720e48 Val_Wu8 1 OneToOne 0.0 255.00 FORMAT "%8.2" /end CHARACTERISTIC
/begin CHARACTERISTIC Tlib_ConsoleSldCtrl_ZCR_LIN11_C "" VALUE 0x00720e49 Val_Wu8 1 OneToOne 0.0 255.00 FORMAT "%8.2" /end CHARACTERISTIC
/begin CHARACTERISTIC Tlib_DispPosnRotateCmd_ZCR_LIN11_C "" VALUE 0x00720e4a Val_Wu8 1 OneToOne 0.0 255.00 FORMAT "%8.2" /end CHARACTERISTIC
/begin CHARACTERISTIC Tlib_IniCalReq_ZCR_LIN11_C "" VALUE 0x00720e4b Val_Wu8 1 OneToOne 0.0 255.00 FORMAT "%8.2" /end CHARACTERISTIC
/begin CHARACTERISTIC Tlib_VehThOnOffCtrl_ZCR_LIN12_C "" VALUE 0x00720e4c Val_Wu8 1 OneToOne 0.0 255.00 FORMAT "%8.2" /end CHARACTERISTIC
/begin CHARACTERISTIC Tlib_VehThTempSet_ZCR_LIN12_C "" VALUE 0x00720e4d Val_Wu8 1 OneToOne 0.0 255.00 FORMAT "%8.2" /end CHARACTERISTIC
/begin CHARACTERISTIC Tlib_HfaMotBlockCmd_ZCR_LIN6_C "" VALUE 0x00720e4e Val_Wu8 1 OneToOne 0.0 255.00 FORMAT "%8.2" /end CHARACTERISTIC
/begin CHARACTERISTIC Tlib_HfaMotUrgcPson_ZCR_LIN6_C "" VALUE 0x00720e4f Val_Wu8 1 OneToOne 0.0 255.00 FORMAT "%8.2" /end CHARACTERISTIC
/begin CHARACTERISTIC Tlib_HfaMotPsonAvl_ZCR_LIN6_C "" VALUE 0x00720e50 Val_Wu8 1 OneToOne 0.0 255.00 FORMAT "%8.2" /end CHARACTERISTIC
/begin CHARACTERISTIC Tlib_HfaMotDir_ZCR_LIN6_C "" VALUE 0x00720e51 Val_Wu8 1 OneToOne 0.0 255.00 FORMAT "%8.2" /end CHARACTERISTIC
/begin CHARACTERISTIC Tlib_HfaMotStrtPson_ZCR_LIN6_C "" VALUE 0x0072090c Val_Wu16 1 OneToOne 0.0 65535 FORMAT "%8.2" /end CHARACTERISTIC
/begin CHARACTERISTIC Tlib_HfaMotClearReq_ZCR_LIN6_C "" VALUE 0x00720e52 Val_Wu8 1 OneToOne 0.0 255.00 FORMAT "%8.2" /end CHARACTERISTIC
/begin CHARACTERISTIC Tlib_HfaMotMode_ZCR_LIN6_C "" VALUE 0x00720e53 Val_Wu8 1 OneToOne 0.0 255.00 FORMAT "%8.2" /end CHARACTERISTIC
/begin CHARACTERISTIC Tlib_HfaMotSaveData_ZCR_LIN6_C "" VALUE 0x00720e54 Val_Wu8 1 OneToOne 0.0 255.00 FORMAT "%8.2" /end CHARACTERISTIC
/begin CHARACTERISTIC Tlib_HfaMotUrgcUnlck_ZCR_LIN6_C "" VALUE 0x00720e55 Val_Wu8 1 OneToOne 0.0 255.00 FORMAT "%8.2" /end CHARACTERISTIC
/begin CHARACTERISTIC Tlib_HfaMotCoilPwrOn_ZCR_LIN6_C "" VALUE 0x00720e56 Val_Wu8 1 OneToOne 0.0 255.00 FORMAT "%8.2" /end CHARACTERISTIC
/begin CHARACTERISTIC Tlib_HfaMotTargtPson_ZCR_LIN6_C "" VALUE 0x0072090e Val_Wu16 1 OneToOne 0.0 65535 FORMAT "%8.2" /end CHARACTERISTIC
/begin CHARACTERISTIC Tlib_HfaMotSpdSet_ZCR_LIN6_C "" VALUE 0x00720e57 Val_Wu8 1 OneToOne 0.0 255.00 FORMAT "%8.2" /end CHARACTERISTIC
/begin CHARACTERISTIC Tlib_HfaMotAdr_ZCR_LIN6_C "" VALUE 0x00720e58 Val_Wu8 1 OneToOne 0.0 255.00 FORMAT "%8.2" /end CHARACTERISTIC
/begin CHARACTERISTIC Tlib_RoofDispFoldMtnCmd_ZCR_LIN10_C "" VALUE 0x00720e59 Val_Wu8 1 OneToOne 0.0 255.00 FORMAT "%8.2" /end CHARACTERISTIC
/begin CHARACTERISTIC Tlib_RoofDispSlidMtnCmd_ZCR_LIN10_C "" VALUE 0x00720e5a Val_Wu8 1 OneToOne 0.0 255.00 FORMAT "%8.2" /end CHARACTERISTIC
/begin CHARACTERISTIC Tlib_RoofDispIniCalReq_ZCR_LIN10_C "" VALUE 0x00720e5b Val_Wu8 1 OneToOne 0.0 255.00 FORMAT "%8.2" /end CHARACTERISTIC
/begin CHARACTERISTIC Tlib_CANFD1_Tx_C "" VALUE 0x007204f4 Val_Wu32 1 OneToOne 0.0 4294967295 FORMAT "%8.2" /end CHARACTERISTIC
/begin CHARACTERISTIC Tlib_CANFD2_Tx_C "" VALUE 0x007204f8 Val_Wu32 1 OneToOne 0.0 4294967295 FORMAT "%8.2" /end CHARACTERISTIC
/begin CHARACTERISTIC Tlib_CANFD3_Tx_C "" VALUE 0x007204fc Val_Wu32 1 OneToOne 0.0 4294967295 FORMAT "%8.2" /end CHARACTERISTIC
/begin CHARACTERISTIC Tlib_CANFD4_Tx_C "" VALUE 0x00720500 Val_Wu32 1 OneToOne 0.0 4294967295 FORMAT "%8.2" /end CHARACTERISTIC
/begin CHARACTERISTIC Tlib_CANFD5_Tx_C "" VALUE 0x00720504 Val_Wu32 1 OneToOne 0.0 4294967295 FORMAT "%8.2" /end CHARACTERISTIC
/begin CHARACTERISTIC Tlib_CANFD6_Tx_C "" VALUE 0x00720508 Val_Wu32 1 OneToOne 0.0 4294967295 FORMAT "%8.2" /end CHARACTERISTIC
/begin CHARACTERISTIC Tlib_CANFD7_Tx_C "" VALUE 0x0072050c Val_Wu32 1 OneToOne 0.0 4294967295 FORMAT "%8.2" /end CHARACTERISTIC
/begin CHARACTERISTIC Tlib_CANFD8_Tx_C "" VALUE 0x00720510 Val_Wu32 1 OneToOne 0.0 4294967295 FORMAT "%8.2" /end CHARACTERISTIC
/begin CHARACTERISTIC Tlib_CANFD9_Tx_C "" VALUE 0x00720514 Val_Wu32 1 OneToOne 0.0 4294967295 FORMAT "%8.2" /end CHARACTERISTIC
/begin CHARACTERISTIC TEST_DLT_XCP_C "" VALUE 0x00721f3d Val_Wu8 1 OneToOne 0.0 255.00 FORMAT "%8.2" /end CHARACTERISTIC
/begin CHARACTERISTIC Tlib_Dlt_Test_ctrl_XCP_C "" VALUE 0x00721f3e Val_Wu8 1 OneToOne 0.0 255.00 FORMAT "%8.2" /end CHARACTERISTIC
/begin CHARACTERISTIC Tlib_Dlt_Test_message_Log_Level_XCP_C "" VALUE 0x00721f3f Val_Wu8 1 OneToOne 0.0 255.00 FORMAT "%8.2" /end CHARACTERISTIC
/begin CHARACTERISTIC Tlib_Dlt_Log_Ch_Log_Level_XCP_C "" VALUE 0x00721f40 Val_Wu8 1 OneToOne 0.0 255.00 FORMAT "%8.2" /end CHARACTERISTIC
/begin CHARACTERISTIC Tlib_Dlt_Log_Level_XCP_C "" VALUE 0x00721f41 Val_Wu8 1 OneToOne 0.0 255.00 FORMAT "%8.2" /end CHARACTERISTIC
/begin CHARACTERISTIC Tlib_Dlt_SendNewLog_XCP_C "" VALUE 0x00721f42 Val_Wu8 1 OneToOne 0.0 255.00 FORMAT "%8.2" /end CHARACTERISTIC
/begin CHARACTERISTIC Tlib_Dlt_Test_message_new_Log_Level_XCP_C "" VALUE 0x00721f43 Val_Wu8 1 OneToOne 0.0 255.00 FORMAT "%8.2" /end CHARACTERISTIC
/begin CHARACTERISTIC Tlib_Dlt_AddRemoveOp_State_XCP_C "" VALUE 0x00721f44 Val_Wu8 1 OneToOne 0.0 255.00 FORMAT "%8.2" /end CHARACTERISTIC
/begin CHARACTERISTIC Tlib_Dlt_Message_Filter_State_XCP_C "" VALUE 0x00721f45 Val_Wu8 1 OneToOne 0.0 255.00 FORMAT "%8.2" /end CHARACTERISTIC
/begin CHARACTERISTIC Tlib_Dlt_Mode_State_XCP_C "" VALUE 0x00721f46 Val_Wu8 1 OneToOne 0.0 255.00 FORMAT "%8.2" /end CHARACTERISTIC
/begin CHARACTERISTIC Tlib_Dem_Set_OperationCycleState_C "" VALUE 0x00721f3c Val_Wu8 1 OneToOne 0.0 255.00 FORMAT "%8.2" /end CHARACTERISTIC
/begin CHARACTERISTIC Tlib_TestCase_L3_IOI_BSW_Switch_C "" VALUE 0x00721fee Val_Wu8 1 OneToOne 0.0 255.00 FORMAT "%8.2" /end CHARACTERISTIC
/begin CHARACTERISTIC Tlib_TestCase_L3_IOO_BSW_Switch_C "" VALUE 0x00721f90 Val_Wu16 1 OneToOne 0.0 65535 FORMAT "%8.2" /end CHARACTERISTIC
/begin CHARACTERISTIC Tlib_TestCase_L3_IODIAG_BSW_Switch_C "" VALUE 0x00721fef Val_Wu8 1 OneToOne 0.0 255.00 FORMAT "%8.2" /end CHARACTERISTIC
/begin CHARACTERISTIC Tlib_TestCase_L3_IO_BSW_Duty_Switch_C "" VALUE 0x00721ff0 Val_Wu8 1 OneToOne 0.0 255.00 FORMAT "%8.2" /end CHARACTERISTIC
/begin CHARACTERISTIC Tlib_ADC_L3_Set_FilterVal_I_A_IAN45 "" VALUE 0x00721ff1 Val_Wu8 1 OneToOne 0.0 255.00 FORMAT "%8.2" /end CHARACTERISTIC
/begin CHARACTERISTIC Tlib_ADC_L3_Set_FilterVal_I_A_IAN27 "" VALUE 0x00721ff2 Val_Wu8 1 OneToOne 0.0 255.00 FORMAT "%8.2" /end CHARACTERISTIC
/begin CHARACTERISTIC Tlib_ADC_L3_Set_FilterVal_I_A_IAN29 "" VALUE 0x00721ff3 Val_Wu8 1 OneToOne 0.0 255.00 FORMAT "%8.2" /end CHARACTERISTIC
/begin CHARACTERISTIC Tlib_ADC_L3_Set_FilterVal_I_A_IAN24 "" VALUE 0x00721ff4 Val_Wu8 1 OneToOne 0.0 255.00 FORMAT "%8.2" /end CHARACTERISTIC
/begin CHARACTERISTIC Tlib_ADC_L3_Set_FilterVal_I_A_IAN26 "" VALUE 0x00721ff5 Val_Wu8 1 OneToOne 0.0 255.00 FORMAT "%8.2" /end CHARACTERISTIC
/begin CHARACTERISTIC Tlib_ADC_L3_Set_FilterVal_I_A_IAN32 "" VALUE 0x00721ff6 Val_Wu8 1 OneToOne 0.0 255.00 FORMAT "%8.2" /end CHARACTERISTIC
/begin CHARACTERISTIC Tlib_ADC_L3_Set_FilterVal_I_A_IAN33 "" VALUE 0x00721ff7 Val_Wu8 1 OneToOne 0.0 255.00 FORMAT "%8.2" /end CHARACTERISTIC
/begin CHARACTERISTIC Tlib_ADC_L3_Set_FilterVal_I_A_IAN34 "" VALUE 0x00721ff8 Val_Wu8 1 OneToOne 0.0 255.00 FORMAT "%8.2" /end CHARACTERISTIC
/begin CHARACTERISTIC Tlib_ADC_L3_Set_FilterVal_I_A_IAN35 "" VALUE 0x00721ff9 Val_Wu8 1 OneToOne 0.0 255.00 FORMAT "%8.2" /end CHARACTERISTIC
/begin CHARACTERISTIC Tlib_ADC_L3_Set_FilterVal_I_A_IAN36 "" VALUE 0x00721ffa Val_Wu8 1 OneToOne 0.0 255.00 FORMAT "%8.2" /end CHARACTERISTIC
/begin CHARACTERISTIC Tlib_ADC_L3_Set_FilterVal_I_A_IAN37 "" VALUE 0x00721ffb Val_Wu8 1 OneToOne 0.0 255.00 FORMAT "%8.2" /end CHARACTERISTIC
/begin CHARACTERISTIC Tlib_ADC_L3_Set_FilterVal_I_A_IAN25 "" VALUE 0x00721ffc Val_Wu8 1 OneToOne 0.0 255.00 FORMAT "%8.2" /end CHARACTERISTIC
/begin CHARACTERISTIC Tlib_ADC_L3_Set_FilterVal_I_A_IAN55 "" VALUE 0x00721ffd Val_Wu8 1 OneToOne 0.0 255.00 FORMAT "%8.2" /end CHARACTERISTIC
/begin CHARACTERISTIC Tlib_ADC_L3_Set_FilterVal_I_A_IAN56 "" VALUE 0x00721ffe Val_Wu8 1 OneToOne 0.0 255.00 FORMAT "%8.2" /end CHARACTERISTIC
/begin CHARACTERISTIC Tlib_ADC_L3_Set_FilterVal_I_A_IAN57 "" VALUE 0x00721fff Val_Wu8 1 OneToOne 0.0 255.00 FORMAT "%8.2" /end CHARACTERISTIC
/begin CHARACTERISTIC Tlib_ADC_L3_Set_FilterVal_I_A_IAN58 "" VALUE 0x00722000 Val_Wu8 1 OneToOne 0.0 255.00 FORMAT "%8.2" /end CHARACTERISTIC
/begin CHARACTERISTIC Tlib_ADC_L3_Set_FilterVal_I_A_IAN60 "" VALUE 0x00722001 Val_Wu8 1 OneToOne 0.0 255.00 FORMAT "%8.2" /end CHARACTERISTIC
/begin CHARACTERISTIC Tlib_ADC_L3_Set_FilterVal_I_A_IAN61 "" VALUE 0x00722002 Val_Wu8 1 OneToOne 0.0 255.00 FORMAT "%8.2" /end CHARACTERISTIC
/begin CHARACTERISTIC Tlib_ADC_L3_Set_FilterVal_I_A_IAN62 "" VALUE 0x00722003 Val_Wu8 1 OneToOne 0.0 255.00 FORMAT "%8.2" /end CHARACTERISTIC
/begin CHARACTERISTIC Tlib_ADC_L3_Set_FilterVal_I_A_IAN63 "" VALUE 0x00722004 Val_Wu8 1 OneToOne 0.0 255.00 FORMAT "%8.2" /end CHARACTERISTIC
/begin CHARACTERISTIC Tlib_ADC_L3_Set_FilterVal_I_A_IAN64 "" VALUE 0x00722005 Val_Wu8 1 OneToOne 0.0 255.00 FORMAT "%8.2" /end CHARACTERISTIC
/begin CHARACTERISTIC Tlib_ADC_L3_Set_FilterVal_I_A_IAN65 "" VALUE 0x00722006 Val_Wu8 1 OneToOne 0.0 255.00 FORMAT "%8.2" /end CHARACTERISTIC
/begin CHARACTERISTIC Tlib_ADC_L3_Set_FilterVal_I_A_IAN66 "" VALUE 0x00722007 Val_Wu8 1 OneToOne 0.0 255.00 FORMAT "%8.2" /end CHARACTERISTIC
/begin CHARACTERISTIC Tlib_ADC_L3_Set_FilterVal_I_A_IAN67 "" VALUE 0x00722008 Val_Wu8 1 OneToOne 0.0 255.00 FORMAT "%8.2" /end CHARACTERISTIC
/begin CHARACTERISTIC Tlib_ADC_L3_Set_FilterVal_I_A_IAN68 "" VALUE 0x00722009 Val_Wu8 1 OneToOne 0.0 255.00 FORMAT "%8.2" /end CHARACTERISTIC
/begin CHARACTERISTIC Tlib_ADC_L3_Set_FilterVal_I_A_IAN69 "" VALUE 0x0072200a Val_Wu8 1 OneToOne 0.0 255.00 FORMAT "%8.2" /end CHARACTERISTIC
/begin CHARACTERISTIC Tlib_ADC_L3_Set_FilterVal_I_A_IAN70 "" VALUE 0x0072200b Val_Wu8 1 OneToOne 0.0 255.00 FORMAT "%8.2" /end CHARACTERISTIC
/begin CHARACTERISTIC Tlib_ADC_L3_Set_FilterVal_I_A_IAN71 "" VALUE 0x0072200c Val_Wu8 1 OneToOne 0.0 255.00 FORMAT "%8.2" /end CHARACTERISTIC
/begin CHARACTERISTIC Tlib_ADC_L3_Set_FilterVal_I_A_IAN72 "" VALUE 0x0072200d Val_Wu8 1 OneToOne 0.0 255.00 FORMAT "%8.2" /end CHARACTERISTIC
/begin CHARACTERISTIC Tlib_ADC_L3_Set_FilterVal_I_A_IAN73 "" VALUE 0x0072200e Val_Wu8 1 OneToOne 0.0 255.00 FORMAT "%8.2" /end CHARACTERISTIC
/begin CHARACTERISTIC Tlib_ADC_L3_Set_FilterVal_I_A_IAN76 "" VALUE 0x0072200f Val_Wu8 1 OneToOne 0.0 255.00 FORMAT "%8.2" /end CHARACTERISTIC
/begin CHARACTERISTIC Tlib_ADC_L3_Set_FilterVal_I_A_IAN13 "" VALUE 0x00722010 Val_Wu8 1 OneToOne 0.0 255.00 FORMAT "%8.2" /end CHARACTERISTIC
/begin CHARACTERISTIC Tlib_ADC_L3_Set_FilterVal_I_A_IAN14 "" VALUE 0x00722011 Val_Wu8 1 OneToOne 0.0 255.00 FORMAT "%8.2" /end CHARACTERISTIC
/begin CHARACTERISTIC Tlib_ADC_L3_Set_FilterVal_I_A_IAN16 "" VALUE 0x00722012 Val_Wu8 1 OneToOne 0.0 255.00 FORMAT "%8.2" /end CHARACTERISTIC
/begin CHARACTERISTIC Tlib_ADC_L3_Set_FilterVal_I_A_IAN01 "" VALUE 0x00722013 Val_Wu8 1 OneToOne 0.0 255.00 FORMAT "%8.2" /end CHARACTERISTIC
/begin CHARACTERISTIC Tlib_ADC_L3_Set_FilterVal_I_A_IAN02 "" VALUE 0x00722014 Val_Wu8 1 OneToOne 0.0 255.00 FORMAT "%8.2" /end CHARACTERISTIC
/begin CHARACTERISTIC Tlib_ADC_L3_Set_FilterVal_I_A_IAN03 "" VALUE 0x00722015 Val_Wu8 1 OneToOne 0.0 255.00 FORMAT "%8.2" /end CHARACTERISTIC
/begin CHARACTERISTIC Tlib_ADC_L3_Set_FilterVal_I_A_IAN04 "" VALUE 0x00722016 Val_Wu8 1 OneToOne 0.0 255.00 FORMAT "%8.2" /end CHARACTERISTIC
/begin CHARACTERISTIC Tlib_ADC_L3_Set_FilterVal_I_A_IAN05 "" VALUE 0x00722017 Val_Wu8 1 OneToOne 0.0 255.00 FORMAT "%8.2" /end CHARACTERISTIC
/begin CHARACTERISTIC Tlib_ADC_L3_Set_FilterVal_I_A_IAN08 "" VALUE 0x00722018 Val_Wu8 1 OneToOne 0.0 255.00 FORMAT "%8.2" /end CHARACTERISTIC
/begin CHARACTERISTIC Tlib_ADC_L3_Set_FilterVal_I_A_IAN09 "" VALUE 0x00722019 Val_Wu8 1 OneToOne 0.0 255.00 FORMAT "%8.2" /end CHARACTERISTIC
/begin CHARACTERISTIC Tlib_ADC_L3_Set_FilterVal_I_A_IAN17 "" VALUE 0x0072201a Val_Wu8 1 OneToOne 0.0 255.00 FORMAT "%8.2" /end CHARACTERISTIC
/begin CHARACTERISTIC Tlib_ADC_L3_Set_FilterVal_I_A_IAN18 "" VALUE 0x0072201b Val_Wu8 1 OneToOne 0.0 255.00 FORMAT "%8.2" /end CHARACTERISTIC
/begin CHARACTERISTIC Tlib_ADC_L3_Set_FilterVal_I_A_IAN19 "" VALUE 0x0072201c Val_Wu8 1 OneToOne 0.0 255.00 FORMAT "%8.2" /end CHARACTERISTIC
/begin CHARACTERISTIC Tlib_ADC_L3_Set_FilterVal_I_A_IAN12 "" VALUE 0x0072201d Val_Wu8 1 OneToOne 0.0 255.00 FORMAT "%8.2" /end CHARACTERISTIC
/begin CHARACTERISTIC Tlib_ADC_L3_Set_FilterVal_I_A_IAN20 "" VALUE 0x0072201e Val_Wu8 1 OneToOne 0.0 255.00 FORMAT "%8.2" /end CHARACTERISTIC
/begin CHARACTERISTIC Tlib_ADC_L3_Set_FilterVal_I_A_IAN15 "" VALUE 0x0072201f Val_Wu8 1 OneToOne 0.0 255.00 FORMAT "%8.2" /end CHARACTERISTIC
/begin CHARACTERISTIC Tlib_ADC_L3_Set_FilterVal_I_A_IAN52 "" VALUE 0x00722020 Val_Wu8 1 OneToOne 0.0 255.00 FORMAT "%8.2" /end CHARACTERISTIC
/begin CHARACTERISTIC Tlib_ADC_L3_Set_FilterVal_I_A_IAN53 "" VALUE 0x00722021 Val_Wu8 1 OneToOne 0.0 255.00 FORMAT "%8.2" /end CHARACTERISTIC
/begin CHARACTERISTIC Tlib_ADC_L3_Set_FilterVal_I_A_IAN54 "" VALUE 0x00722022 Val_Wu8 1 OneToOne 0.0 255.00 FORMAT "%8.2" /end CHARACTERISTIC
/begin CHARACTERISTIC Tlib_ADC_L3_Set_FilterVal_I_A_IAN83 "" VALUE 0x00722023 Val_Wu8 1 OneToOne 0.0 255.00 FORMAT "%8.2" /end CHARACTERISTIC
/begin CHARACTERISTIC Tlib_ADC_L3_Set_FilterVal_I_A_KL30C "" VALUE 0x00722024 Val_Wu8 1 OneToOne 0.0 255.00 FORMAT "%8.2" /end CHARACTERISTIC
/begin CHARACTERISTIC Tlib_ADC_L3_Set_FilterVal_I_A_KL30D "" VALUE 0x00722025 Val_Wu8 1 OneToOne 0.0 255.00 FORMAT "%8.2" /end CHARACTERISTIC
/begin CHARACTERISTIC Tlib_DI_L3_Set_FilterVal_I_S_IDL06 "" VALUE 0x00722026 Val_Wu8 1 OneToOne 0.0 255.00 FORMAT "%8.2" /end CHARACTERISTIC
/begin CHARACTERISTIC Tlib_DI_L3_Set_FilterVal_I_S_IDL01 "" VALUE 0x00722027 Val_Wu8 1 OneToOne 0.0 255.00 FORMAT "%8.2" /end CHARACTERISTIC
/begin CHARACTERISTIC Tlib_DI_L3_Set_FilterVal_I_S_IDL12 "" VALUE 0x00722028 Val_Wu8 1 OneToOne 0.0 255.00 FORMAT "%8.2" /end CHARACTERISTIC
/begin CHARACTERISTIC Tlib_DI_L3_Set_FilterVal_I_S_IDL18 "" VALUE 0x00722029 Val_Wu8 1 OneToOne 0.0 255.00 FORMAT "%8.2" /end CHARACTERISTIC
/begin CHARACTERISTIC Tlib_DI_L3_Set_FilterVal_I_S_IDL33 "" VALUE 0x0072202a Val_Wu8 1 OneToOne 0.0 255.00 FORMAT "%8.2" /end CHARACTERISTIC
/begin CHARACTERISTIC Tlib_DI_L3_Set_FilterVal_I_S_IDL24 "" VALUE 0x0072202b Val_Wu8 1 OneToOne 0.0 255.00 FORMAT "%8.2" /end CHARACTERISTIC
/begin CHARACTERISTIC Tlib_DI_L3_Set_FilterVal_I_S_IDL20 "" VALUE 0x0072202c Val_Wu8 1 OneToOne 0.0 255.00 FORMAT "%8.2" /end CHARACTERISTIC
/begin CHARACTERISTIC Tlib_DI_L3_Set_FilterVal_I_S_IDL21 "" VALUE 0x0072202d Val_Wu8 1 OneToOne 0.0 255.00 FORMAT "%8.2" /end CHARACTERISTIC
/begin CHARACTERISTIC Tlib_DI_L3_Set_FilterVal_I_S_IDL25 "" VALUE 0x0072202e Val_Wu8 1 OneToOne 0.0 255.00 FORMAT "%8.2" /end CHARACTERISTIC
/begin CHARACTERISTIC Tlib_DI_L3_Set_FilterVal_I_S_IDL32 "" VALUE 0x0072202f Val_Wu8 1 OneToOne 0.0 255.00 FORMAT "%8.2" /end CHARACTERISTIC
/begin CHARACTERISTIC Tlib_DI_L3_Set_FilterVal_I_S_IDL26 "" VALUE 0x00722030 Val_Wu8 1 OneToOne 0.0 255.00 FORMAT "%8.2" /end CHARACTERISTIC
/begin CHARACTERISTIC Tlib_DI_L3_Set_FilterVal_I_S_IDL27 "" VALUE 0x00722031 Val_Wu8 1 OneToOne 0.0 255.00 FORMAT "%8.2" /end CHARACTERISTIC
/begin CHARACTERISTIC Tlib_DI_L3_Set_FilterVal_I_S_IDL28 "" VALUE 0x00722032 Val_Wu8 1 OneToOne 0.0 255.00 FORMAT "%8.2" /end CHARACTERISTIC
/begin CHARACTERISTIC Tlib_DI_L3_Set_FilterVal_I_S_IDL29 "" VALUE 0x00722033 Val_Wu8 1 OneToOne 0.0 255.00 FORMAT "%8.2" /end CHARACTERISTIC
/begin CHARACTERISTIC Tlib_DI_L3_Set_FilterVal_I_S_IDL30 "" VALUE 0x00722034 Val_Wu8 1 OneToOne 0.0 255.00 FORMAT "%8.2" /end CHARACTERISTIC
/begin CHARACTERISTIC Tlib_DI_L3_Set_FilterVal_I_S_IDL34 "" VALUE 0x00722035 Val_Wu8 1 OneToOne 0.0 255.00 FORMAT "%8.2" /end CHARACTERISTIC
/begin CHARACTERISTIC Tlib_DI_L3_Set_FilterVal_I_S_IDL36 "" VALUE 0x00722036 Val_Wu8 1 OneToOne 0.0 255.00 FORMAT "%8.2" /end CHARACTERISTIC
/begin CHARACTERISTIC Tlib_DI_L3_Set_FilterVal_I_S_IDL03 "" VALUE 0x00722037 Val_Wu8 1 OneToOne 0.0 255.00 FORMAT "%8.2" /end CHARACTERISTIC
/begin CHARACTERISTIC Tlib_DI_L3_Set_FilterVal_I_S_IAN83 "" VALUE 0x00722038 Val_Wu8 1 OneToOne 0.0 255.00 FORMAT "%8.2" /end CHARACTERISTIC
/begin CHARACTERISTIC Tlib_DI_L3_Set_FilterVal_I_S_IPL02 "" VALUE 0x00722039 Val_Wu8 1 OneToOne 0.0 255.00 FORMAT "%8.2" /end CHARACTERISTIC
/begin CHARACTERISTIC Tlib_DI_L3_Set_FilterVal_I_S_IDL35 "" VALUE 0x0072203a Val_Wu8 1 OneToOne 0.0 255.00 FORMAT "%8.2" /end CHARACTERISTIC
/begin CHARACTERISTIC Tlib_DoVoltage_L3_Set_FilterVal_O_S_5V05 "" VALUE 0x0072203b Val_Wu8 1 OneToOne 0.0 255.00 FORMAT "%8.2" /end CHARACTERISTIC
/begin CHARACTERISTIC Tlib_DIO_L3_Set_Val_O_S_5V05 "" VALUE 0x0072203c Val_Wu8 1 OneToOne 0.0 255.00 FORMAT "%8.2" /end CHARACTERISTIC
/begin CHARACTERISTIC Tlib_DoVoltage_L3_Set_FilterVal_O_S_5V02 "" VALUE 0x0072203d Val_Wu8 1 OneToOne 0.0 255.00 FORMAT "%8.2" /end CHARACTERISTIC
/begin CHARACTERISTIC Tlib_DIO_L3_Set_Val_O_S_5V02 "" VALUE 0x0072203e Val_Wu8 1 OneToOne 0.0 255.00 FORMAT "%8.2" /end CHARACTERISTIC
/begin CHARACTERISTIC Tlib_DoVoltage_L3_Set_FilterVal_O_S_5V06 "" VALUE 0x0072203f Val_Wu8 1 OneToOne 0.0 255.00 FORMAT "%8.2" /end CHARACTERISTIC
/begin CHARACTERISTIC Tlib_DIO_L3_Set_Val_O_S_5V06 "" VALUE 0x00722040 Val_Wu8 1 OneToOne 0.0 255.00 FORMAT "%8.2" /end CHARACTERISTIC
/begin CHARACTERISTIC Tlib_DoVoltage_L3_Set_FilterVal_O_S_5V07 "" VALUE 0x00722041 Val_Wu8 1 OneToOne 0.0 255.00 FORMAT "%8.2" /end CHARACTERISTIC
/begin CHARACTERISTIC Tlib_DIO_L3_Set_Val_O_S_5V07 "" VALUE 0x00722042 Val_Wu8 1 OneToOne 0.0 255.00 FORMAT "%8.2" /end CHARACTERISTIC
/begin CHARACTERISTIC Tlib_DoVoltage_L3_Set_FilterVal_O_S_5V10 "" VALUE 0x00722043 Val_Wu8 1 OneToOne 0.0 255.00 FORMAT "%8.2" /end CHARACTERISTIC
/begin CHARACTERISTIC Tlib_DIO_L3_Set_Val_O_S_5V10 "" VALUE 0x00722044 Val_Wu8 1 OneToOne 0.0 255.00 FORMAT "%8.2" /end CHARACTERISTIC
/begin CHARACTERISTIC Tlib_DoVoltage_L3_Set_FilterVal_O_S_ODH110 "" VALUE 0x00722045 Val_Wu8 1 OneToOne 0.0 255.00 FORMAT "%8.2" /end CHARACTERISTIC
/begin CHARACTERISTIC Tlib_DIO_L3_Set_Val_O_S_ODH110 "" VALUE 0x00722046 Val_Wu8 1 OneToOne 0.0 255.00 FORMAT "%8.2" /end CHARACTERISTIC
/begin CHARACTERISTIC Tlib_DoVoltage_L3_Set_FilterVal_O_S_ODH111 "" VALUE 0x00722047 Val_Wu8 1 OneToOne 0.0 255.00 FORMAT "%8.2" /end CHARACTERISTIC
/begin CHARACTERISTIC Tlib_DIO_L3_Set_Val_O_S_ODH111 "" VALUE 0x00722048 Val_Wu8 1 OneToOne 0.0 255.00 FORMAT "%8.2" /end CHARACTERISTIC
/begin CHARACTERISTIC Tlib_DoVoltage_L3_Set_FilterVal_O_S_ODH112 "" VALUE 0x00722049 Val_Wu8 1 OneToOne 0.0 255.00 FORMAT "%8.2" /end CHARACTERISTIC
/begin CHARACTERISTIC Tlib_DIO_L3_Set_Val_O_S_ODH112 "" VALUE 0x0072204a Val_Wu8 1 OneToOne 0.0 255.00 FORMAT "%8.2" /end CHARACTERISTIC
/begin CHARACTERISTIC Tlib_DoVoltage_L3_Set_FilterVal_O_S_ODH113 "" VALUE 0x0072204b Val_Wu8 1 OneToOne 0.0 255.00 FORMAT "%8.2" /end CHARACTERISTIC
/begin CHARACTERISTIC Tlib_DIO_L3_Set_Val_O_S_ODH113 "" VALUE 0x0072204c Val_Wu8 1 OneToOne 0.0 255.00 FORMAT "%8.2" /end CHARACTERISTIC
/begin CHARACTERISTIC Tlib_DoVoltage_L3_Set_FilterVal_O_S_EFUSE08 "" VALUE 0x0072204d Val_Wu8 1 OneToOne 0.0 255.00 FORMAT "%8.2" /end CHARACTERISTIC
/begin CHARACTERISTIC Tlib_DIO_L3_Set_Val_O_S_EFUSE08 "" VALUE 0x0072204e Val_Wu8 1 OneToOne 0.0 255.00 FORMAT "%8.2" /end CHARACTERISTIC
/begin CHARACTERISTIC Tlib_DoVoltage_L3_Set_FilterVal_O_S_ODH02 "" VALUE 0x0072204f Val_Wu8 1 OneToOne 0.0 255.00 FORMAT "%8.2" /end CHARACTERISTIC
/begin CHARACTERISTIC Tlib_DIO_L3_Set_Val_O_S_ODH02 "" VALUE 0x00722050 Val_Wu8 1 OneToOne 0.0 255.00 FORMAT "%8.2" /end CHARACTERISTIC
/begin CHARACTERISTIC Tlib_DoVoltage_L3_Set_FilterVal_O_S_ODH24 "" VALUE 0x00722051 Val_Wu8 1 OneToOne 0.0 255.00 FORMAT "%8.2" /end CHARACTERISTIC
/begin CHARACTERISTIC Tlib_DIO_L3_Set_Val_O_S_ODH24 "" VALUE 0x00722052 Val_Wu8 1 OneToOne 0.0 255.00 FORMAT "%8.2" /end CHARACTERISTIC
/begin CHARACTERISTIC Tlib_DoVoltage_L3_Set_FilterVal_O_S_ODH04 "" VALUE 0x00722053 Val_Wu8 1 OneToOne 0.0 255.00 FORMAT "%8.2" /end CHARACTERISTIC
/begin CHARACTERISTIC Tlib_DIO_L3_Set_Val_O_S_ODH04 "" VALUE 0x00722054 Val_Wu8 1 OneToOne 0.0 255.00 FORMAT "%8.2" /end CHARACTERISTIC
/begin CHARACTERISTIC Tlib_DoVoltage_L3_Set_FilterVal_O_S_ODH29 "" VALUE 0x00722055 Val_Wu8 1 OneToOne 0.0 255.00 FORMAT "%8.2" /end CHARACTERISTIC
/begin CHARACTERISTIC Tlib_DIO_L3_Set_Val_O_S_ODH29 "" VALUE 0x00722056 Val_Wu8 1 OneToOne 0.0 255.00 FORMAT "%8.2" /end CHARACTERISTIC
/begin CHARACTERISTIC Tlib_DoVoltage_L3_Set_FilterVal_O_S_ODH22 "" VALUE 0x00722057 Val_Wu8 1 OneToOne 0.0 255.00 FORMAT "%8.2" /end CHARACTERISTIC
/begin CHARACTERISTIC Tlib_DIO_L3_Set_Val_O_S_ODH22 "" VALUE 0x00722058 Val_Wu8 1 OneToOne 0.0 255.00 FORMAT "%8.2" /end CHARACTERISTIC
/begin CHARACTERISTIC Tlib_DoVoltage_L3_Set_FilterVal_O_S_ODH25 "" VALUE 0x00722059 Val_Wu8 1 OneToOne 0.0 255.00 FORMAT "%8.2" /end CHARACTERISTIC
/begin CHARACTERISTIC Tlib_DIO_L3_Set_Val_O_S_ODH25 "" VALUE 0x0072205a Val_Wu8 1 OneToOne 0.0 255.00 FORMAT "%8.2" /end CHARACTERISTIC
/begin CHARACTERISTIC Tlib_DoVoltage_L3_Set_FilterVal_O_S_ODH21 "" VALUE 0x0072205b Val_Wu8 1 OneToOne 0.0 255.00 FORMAT "%8.2" /end CHARACTERISTIC
/begin CHARACTERISTIC Tlib_DIO_L3_Set_Val_O_S_ODH21 "" VALUE 0x0072205c Val_Wu8 1 OneToOne 0.0 255.00 FORMAT "%8.2" /end CHARACTERISTIC
/begin CHARACTERISTIC Tlib_DoVoltage_L3_Set_FilterVal_O_S_EFUSE22 "" VALUE 0x0072205d Val_Wu8 1 OneToOne 0.0 255.00 FORMAT "%8.2" /end CHARACTERISTIC
/begin CHARACTERISTIC Tlib_DIO_L3_Set_Val_O_S_EFUSE22 "" VALUE 0x0072205e Val_Wu8 1 OneToOne 0.0 255.00 FORMAT "%8.2" /end CHARACTERISTIC
/begin CHARACTERISTIC Tlib_DoVoltage_L3_Set_FilterVal_O_S_ODH39 "" VALUE 0x0072205f Val_Wu8 1 OneToOne 0.0 255.00 FORMAT "%8.2" /end CHARACTERISTIC
/begin CHARACTERISTIC Tlib_DIO_L3_Set_Val_O_S_ODH39 "" VALUE 0x00722060 Val_Wu8 1 OneToOne 0.0 255.00 FORMAT "%8.2" /end CHARACTERISTIC
/begin CHARACTERISTIC Tlib_DoVoltage_L3_Set_FilterVal_O_S_ODH37 "" VALUE 0x00722061 Val_Wu8 1 OneToOne 0.0 255.00 FORMAT "%8.2" /end CHARACTERISTIC
/begin CHARACTERISTIC Tlib_DIO_L3_Set_Val_O_S_ODH37 "" VALUE 0x00722062 Val_Wu8 1 OneToOne 0.0 255.00 FORMAT "%8.2" /end CHARACTERISTIC
/begin CHARACTERISTIC Tlib_DoVoltage_L3_Set_FilterVal_O_S_ODH75 "" VALUE 0x00722063 Val_Wu8 1 OneToOne 0.0 255.00 FORMAT "%8.2" /end CHARACTERISTIC
/begin CHARACTERISTIC Tlib_DIO_L3_Set_Val_O_S_ODH75 "" VALUE 0x00722064 Val_Wu8 1 OneToOne 0.0 255.00 FORMAT "%8.2" /end CHARACTERISTIC
/begin CHARACTERISTIC Tlib_DoVoltage_L3_Set_FilterVal_O_S_EFUSE17 "" VALUE 0x00722065 Val_Wu8 1 OneToOne 0.0 255.00 FORMAT "%8.2" /end CHARACTERISTIC
/begin CHARACTERISTIC Tlib_DIO_L3_Set_Val_O_S_EFUSE17 "" VALUE 0x00722066 Val_Wu8 1 OneToOne 0.0 255.00 FORMAT "%8.2" /end CHARACTERISTIC
/begin CHARACTERISTIC Tlib_DoVoltage_L3_Set_FilterVal_O_S_ODH66 "" VALUE 0x00722067 Val_Wu8 1 OneToOne 0.0 255.00 FORMAT "%8.2" /end CHARACTERISTIC
/begin CHARACTERISTIC Tlib_DIO_L3_Set_Val_O_S_ODH66 "" VALUE 0x00722068 Val_Wu8 1 OneToOne 0.0 255.00 FORMAT "%8.2" /end CHARACTERISTIC
/begin CHARACTERISTIC Tlib_DoVoltage_L3_Set_FilterVal_O_S_ODH34 "" VALUE 0x00722069 Val_Wu8 1 OneToOne 0.0 255.00 FORMAT "%8.2" /end CHARACTERISTIC
/begin CHARACTERISTIC Tlib_DIO_L3_Set_Val_O_S_ODH34 "" VALUE 0x0072206a Val_Wu8 1 OneToOne 0.0 255.00 FORMAT "%8.2" /end CHARACTERISTIC
/begin CHARACTERISTIC Tlib_DoVoltage_L3_Set_FilterVal_O_S_EFUSE31 "" VALUE 0x0072206b Val_Wu8 1 OneToOne 0.0 255.00 FORMAT "%8.2" /end CHARACTERISTIC
/begin CHARACTERISTIC Tlib_DIO_L3_Set_Val_O_S_EFUSE31 "" VALUE 0x0072206c Val_Wu8 1 OneToOne 0.0 255.00 FORMAT "%8.2" /end CHARACTERISTIC
/begin CHARACTERISTIC Tlib_DoVoltage_L3_Set_FilterVal_O_S_ODH30 "" VALUE 0x0072206d Val_Wu8 1 OneToOne 0.0 255.00 FORMAT "%8.2" /end CHARACTERISTIC
/begin CHARACTERISTIC Tlib_DIO_L3_Set_Val_O_S_ODH30 "" VALUE 0x0072206e Val_Wu8 1 OneToOne 0.0 255.00 FORMAT "%8.2" /end CHARACTERISTIC
/begin CHARACTERISTIC Tlib_DoVoltage_L3_Set_FilterVal_O_S_EFUSE29 "" VALUE 0x0072206f Val_Wu8 1 OneToOne 0.0 255.00 FORMAT "%8.2" /end CHARACTERISTIC
/begin CHARACTERISTIC Tlib_DIO_L3_Set_Val_O_S_EFUSE29 "" VALUE 0x00722070 Val_Wu8 1 OneToOne 0.0 255.00 FORMAT "%8.2" /end CHARACTERISTIC
/begin CHARACTERISTIC Tlib_DoVoltage_L3_Set_FilterVal_O_S_ODH100 "" VALUE 0x00722071 Val_Wu8 1 OneToOne 0.0 255.00 FORMAT "%8.2" /end CHARACTERISTIC
/begin CHARACTERISTIC Tlib_DIO_L3_Set_Val_O_S_ODH100 "" VALUE 0x00722072 Val_Wu8 1 OneToOne 0.0 255.00 FORMAT "%8.2" /end CHARACTERISTIC
/begin CHARACTERISTIC Tlib_DoVoltage_L3_Set_FilterVal_O_S_ODH86 "" VALUE 0x00722073 Val_Wu8 1 OneToOne 0.0 255.00 FORMAT "%8.2" /end CHARACTERISTIC
/begin CHARACTERISTIC Tlib_DIO_L3_Set_Val_O_S_ODH86 "" VALUE 0x00722074 Val_Wu8 1 OneToOne 0.0 255.00 FORMAT "%8.2" /end CHARACTERISTIC
/begin CHARACTERISTIC Tlib_DoVoltage_L3_Set_FilterVal_O_S_ODH13 "" VALUE 0x00722075 Val_Wu8 1 OneToOne 0.0 255.00 FORMAT "%8.2" /end CHARACTERISTIC
/begin CHARACTERISTIC Tlib_DIO_L3_Set_Val_O_S_ODH13 "" VALUE 0x00722076 Val_Wu8 1 OneToOne 0.0 255.00 FORMAT "%8.2" /end CHARACTERISTIC
/begin CHARACTERISTIC Tlib_DoVoltage_L3_Set_FilterVal_O_S_5V09 "" VALUE 0x00722077 Val_Wu8 1 OneToOne 0.0 255.00 FORMAT "%8.2" /end CHARACTERISTIC
/begin CHARACTERISTIC Tlib_DIO_L3_Set_Val_O_S_5V09 "" VALUE 0x00722078 Val_Wu8 1 OneToOne 0.0 255.00 FORMAT "%8.2" /end CHARACTERISTIC
/begin CHARACTERISTIC Tlib_DoVoltage_L3_Set_FilterVal_O_S_ODH23 "" VALUE 0x00722079 Val_Wu8 1 OneToOne 0.0 255.00 FORMAT "%8.2" /end CHARACTERISTIC
/begin CHARACTERISTIC Tlib_DIO_L3_Set_Val_O_S_ODH23 "" VALUE 0x0072207a Val_Wu8 1 OneToOne 0.0 255.00 FORMAT "%8.2" /end CHARACTERISTIC
/begin CHARACTERISTIC Tlib_DoVoltage_L3_Set_FilterVal_O_S_EFUSE10 "" VALUE 0x0072207b Val_Wu8 1 OneToOne 0.0 255.00 FORMAT "%8.2" /end CHARACTERISTIC
/begin CHARACTERISTIC Tlib_DIO_L3_Set_Val_O_S_EFUSE10 "" VALUE 0x0072207c Val_Wu8 1 OneToOne 0.0 255.00 FORMAT "%8.2" /end CHARACTERISTIC
/begin CHARACTERISTIC Tlib_DoVoltage_L3_Set_FilterVal_O_S_EFUSE18 "" VALUE 0x0072207d Val_Wu8 1 OneToOne 0.0 255.00 FORMAT "%8.2" /end CHARACTERISTIC
/begin CHARACTERISTIC Tlib_DIO_L3_Set_Val_O_S_EFUSE18 "" VALUE 0x0072207e Val_Wu8 1 OneToOne 0.0 255.00 FORMAT "%8.2" /end CHARACTERISTIC
/begin CHARACTERISTIC Tlib_DoVoltage_L3_Set_FilterVal_O_S_ODH27 "" VALUE 0x0072207f Val_Wu8 1 OneToOne 0.0 255.00 FORMAT "%8.2" /end CHARACTERISTIC
/begin CHARACTERISTIC Tlib_DIO_L3_Set_Val_O_S_ODH27 "" VALUE 0x00722080 Val_Wu8 1 OneToOne 0.0 255.00 FORMAT "%8.2" /end CHARACTERISTIC
/begin CHARACTERISTIC Tlib_DoVoltage_L3_Set_FilterVal_O_S_ODH20 "" VALUE 0x00722081 Val_Wu8 1 OneToOne 0.0 255.00 FORMAT "%8.2" /end CHARACTERISTIC
/begin CHARACTERISTIC Tlib_DIO_L3_Set_Val_O_S_ODH20 "" VALUE 0x00722082 Val_Wu8 1 OneToOne 0.0 255.00 FORMAT "%8.2" /end CHARACTERISTIC
/begin CHARACTERISTIC Tlib_DoVoltage_L3_Set_FilterVal_O_S_ODH56 "" VALUE 0x00722083 Val_Wu8 1 OneToOne 0.0 255.00 FORMAT "%8.2" /end CHARACTERISTIC
/begin CHARACTERISTIC Tlib_DIO_L3_Set_Val_O_S_ODH56 "" VALUE 0x00722084 Val_Wu8 1 OneToOne 0.0 255.00 FORMAT "%8.2" /end CHARACTERISTIC
/begin CHARACTERISTIC Tlib_DoVoltage_L3_Set_FilterVal_O_S_ODH98 "" VALUE 0x00722085 Val_Wu8 1 OneToOne 0.0 255.00 FORMAT "%8.2" /end CHARACTERISTIC
/begin CHARACTERISTIC Tlib_DIO_L3_Set_Val_O_S_ODH98 "" VALUE 0x00722086 Val_Wu8 1 OneToOne 0.0 255.00 FORMAT "%8.2" /end CHARACTERISTIC
/begin CHARACTERISTIC Tlib_DoVoltage_L3_Set_FilterVal_O_S_ODH82 "" VALUE 0x00722087 Val_Wu8 1 OneToOne 0.0 255.00 FORMAT "%8.2" /end CHARACTERISTIC
/begin CHARACTERISTIC Tlib_DIO_L3_Set_Val_O_S_ODH82 "" VALUE 0x00722088 Val_Wu8 1 OneToOne 0.0 255.00 FORMAT "%8.2" /end CHARACTERISTIC
/begin CHARACTERISTIC Tlib_DoVoltage_L3_Set_FilterVal_O_S_EFUSE23 "" VALUE 0x00722089 Val_Wu8 1 OneToOne 0.0 255.00 FORMAT "%8.2" /end CHARACTERISTIC
/begin CHARACTERISTIC Tlib_DIO_L3_Set_Val_O_S_EFUSE23 "" VALUE 0x0072208a Val_Wu8 1 OneToOne 0.0 255.00 FORMAT "%8.2" /end CHARACTERISTIC
/begin CHARACTERISTIC Tlib_DoVoltage_L3_Set_FilterVal_O_S_EFUSE24 "" VALUE 0x0072208b Val_Wu8 1 OneToOne 0.0 255.00 FORMAT "%8.2" /end CHARACTERISTIC
/begin CHARACTERISTIC Tlib_DIO_L3_Set_Val_O_S_EFUSE24 "" VALUE 0x0072208c Val_Wu8 1 OneToOne 0.0 255.00 FORMAT "%8.2" /end CHARACTERISTIC
/begin CHARACTERISTIC Tlib_DoVoltage_L3_Set_FilterVal_O_S_ODH53 "" VALUE 0x0072208d Val_Wu8 1 OneToOne 0.0 255.00 FORMAT "%8.2" /end CHARACTERISTIC
/begin CHARACTERISTIC Tlib_DIO_L3_Set_Val_O_S_ODH53 "" VALUE 0x0072208e Val_Wu8 1 OneToOne 0.0 255.00 FORMAT "%8.2" /end CHARACTERISTIC
/begin CHARACTERISTIC Tlib_DoVoltage_L3_Set_FilterVal_O_S_ODH76 "" VALUE 0x0072208f Val_Wu8 1 OneToOne 0.0 255.00 FORMAT "%8.2" /end CHARACTERISTIC
/begin CHARACTERISTIC Tlib_DIO_L3_Set_Val_O_S_ODH76 "" VALUE 0x00722090 Val_Wu8 1 OneToOne 0.0 255.00 FORMAT "%8.2" /end CHARACTERISTIC
/begin CHARACTERISTIC Tlib_DoVoltage_L3_Set_FilterVal_O_S_ODH65 "" VALUE 0x00722091 Val_Wu8 1 OneToOne 0.0 255.00 FORMAT "%8.2" /end CHARACTERISTIC
/begin CHARACTERISTIC Tlib_DIO_L3_Set_Val_O_S_ODH65 "" VALUE 0x00722092 Val_Wu8 1 OneToOne 0.0 255.00 FORMAT "%8.2" /end CHARACTERISTIC
/begin CHARACTERISTIC Tlib_DoVoltage_L3_Set_FilterVal_O_S_ODH83 "" VALUE 0x00722093 Val_Wu8 1 OneToOne 0.0 255.00 FORMAT "%8.2" /end CHARACTERISTIC
/begin CHARACTERISTIC Tlib_DIO_L3_Set_Val_O_S_ODH83 "" VALUE 0x00722094 Val_Wu8 1 OneToOne 0.0 255.00 FORMAT "%8.2" /end CHARACTERISTIC
/begin CHARACTERISTIC Tlib_DoVoltage_L3_Set_FilterVal_O_S_ODH54 "" VALUE 0x00722095 Val_Wu8 1 OneToOne 0.0 255.00 FORMAT "%8.2" /end CHARACTERISTIC
/begin CHARACTERISTIC Tlib_DIO_L3_Set_Val_O_S_ODH54 "" VALUE 0x00722096 Val_Wu8 1 OneToOne 0.0 255.00 FORMAT "%8.2" /end CHARACTERISTIC
/begin CHARACTERISTIC Tlib_DoVoltage_L3_Set_FilterVal_O_S_ODH42 "" VALUE 0x00722097 Val_Wu8 1 OneToOne 0.0 255.00 FORMAT "%8.2" /end CHARACTERISTIC
/begin CHARACTERISTIC Tlib_DIO_L3_Set_Val_O_S_ODH42 "" VALUE 0x00722098 Val_Wu8 1 OneToOne 0.0 255.00 FORMAT "%8.2" /end CHARACTERISTIC
/begin CHARACTERISTIC Tlib_DoVoltage_L3_Set_FilterVal_O_S_ODH80 "" VALUE 0x00722099 Val_Wu8 1 OneToOne 0.0 255.00 FORMAT "%8.2" /end CHARACTERISTIC
/begin CHARACTERISTIC Tlib_DIO_L3_Set_Val_O_S_ODH80 "" VALUE 0x0072209a Val_Wu8 1 OneToOne 0.0 255.00 FORMAT "%8.2" /end CHARACTERISTIC
/begin CHARACTERISTIC Tlib_DoVoltage_L3_Set_FilterVal_O_S_ODH81 "" VALUE 0x0072209b Val_Wu8 1 OneToOne 0.0 255.00 FORMAT "%8.2" /end CHARACTERISTIC
/begin CHARACTERISTIC Tlib_DIO_L3_Set_Val_O_S_ODH81 "" VALUE 0x0072209c Val_Wu8 1 OneToOne 0.0 255.00 FORMAT "%8.2" /end CHARACTERISTIC
/begin CHARACTERISTIC Tlib_DoVoltage_L3_Set_FilterVal_O_S_EFUSE25 "" VALUE 0x0072209d Val_Wu8 1 OneToOne 0.0 255.00 FORMAT "%8.2" /end CHARACTERISTIC
/begin CHARACTERISTIC Tlib_DIO_L3_Set_Val_O_S_EFUSE25 "" VALUE 0x0072209e Val_Wu8 1 OneToOne 0.0 255.00 FORMAT "%8.2" /end CHARACTERISTIC
/begin CHARACTERISTIC Tlib_DoVoltage_L3_Set_FilterVal_O_S_ODH79 "" VALUE 0x0072209f Val_Wu8 1 OneToOne 0.0 255.00 FORMAT "%8.2" /end CHARACTERISTIC
/begin CHARACTERISTIC Tlib_DIO_L3_Set_Val_O_S_ODH79 "" VALUE 0x007220a0 Val_Wu8 1 OneToOne 0.0 255.00 FORMAT "%8.2" /end CHARACTERISTIC
/begin CHARACTERISTIC Tlib_DoVoltage_L3_Set_FilterVal_O_S_ODH78 "" VALUE 0x007220a1 Val_Wu8 1 OneToOne 0.0 255.00 FORMAT "%8.2" /end CHARACTERISTIC
/begin CHARACTERISTIC Tlib_DIO_L3_Set_Val_O_S_ODH78 "" VALUE 0x007220a2 Val_Wu8 1 OneToOne 0.0 255.00 FORMAT "%8.2" /end CHARACTERISTIC
/begin CHARACTERISTIC Tlib_DoVoltage_L3_Set_FilterVal_O_S_ODH74 "" VALUE 0x007220a3 Val_Wu8 1 OneToOne 0.0 255.00 FORMAT "%8.2" /end CHARACTERISTIC
/begin CHARACTERISTIC Tlib_DIO_L3_Set_Val_O_S_ODH74 "" VALUE 0x007220a4 Val_Wu8 1 OneToOne 0.0 255.00 FORMAT "%8.2" /end CHARACTERISTIC
/begin CHARACTERISTIC Tlib_DoVoltage_L3_Set_FilterVal_O_S_EFUSE26 "" VALUE 0x007220a5 Val_Wu8 1 OneToOne 0.0 255.00 FORMAT "%8.2" /end CHARACTERISTIC
/begin CHARACTERISTIC Tlib_DIO_L3_Set_Val_O_S_EFUSE26 "" VALUE 0x007220a6 Val_Wu8 1 OneToOne 0.0 255.00 FORMAT "%8.2" /end CHARACTERISTIC
/begin CHARACTERISTIC Tlib_DoVoltage_L3_Set_FilterVal_O_S_EFUSE28 "" VALUE 0x007220a7 Val_Wu8 1 OneToOne 0.0 255.00 FORMAT "%8.2" /end CHARACTERISTIC
/begin CHARACTERISTIC Tlib_DIO_L3_Set_Val_O_S_EFUSE28 "" VALUE 0x007220a8 Val_Wu8 1 OneToOne 0.0 255.00 FORMAT "%8.2" /end CHARACTERISTIC
/begin CHARACTERISTIC Tlib_DoVoltage_L3_Set_FilterVal_O_S_ODH33 "" VALUE 0x007220a9 Val_Wu8 1 OneToOne 0.0 255.00 FORMAT "%8.2" /end CHARACTERISTIC
/begin CHARACTERISTIC Tlib_DIO_L3_Set_Val_O_S_ODH33 "" VALUE 0x007220aa Val_Wu8 1 OneToOne 0.0 255.00 FORMAT "%8.2" /end CHARACTERISTIC
/begin CHARACTERISTIC Tlib_DoVoltage_L3_Set_FilterVal_O_S_ODH73 "" VALUE 0x007220ab Val_Wu8 1 OneToOne 0.0 255.00 FORMAT "%8.2" /end CHARACTERISTIC
/begin CHARACTERISTIC Tlib_DIO_L3_Set_Val_O_S_ODH73 "" VALUE 0x007220ac Val_Wu8 1 OneToOne 0.0 255.00 FORMAT "%8.2" /end CHARACTERISTIC
/begin CHARACTERISTIC Tlib_DoVoltage_L3_Set_FilterVal_O_S_ODH18 "" VALUE 0x007220ad Val_Wu8 1 OneToOne 0.0 255.00 FORMAT "%8.2" /end CHARACTERISTIC
/begin CHARACTERISTIC Tlib_DIO_L3_Set_Val_O_S_ODH18 "" VALUE 0x007220ae Val_Wu8 1 OneToOne 0.0 255.00 FORMAT "%8.2" /end CHARACTERISTIC
/begin CHARACTERISTIC Tlib_DoVoltage_L3_Set_FilterVal_O_S_ODH77 "" VALUE 0x007220af Val_Wu8 1 OneToOne 0.0 255.00 FORMAT "%8.2" /end CHARACTERISTIC
/begin CHARACTERISTIC Tlib_DIO_L3_Set_Val_O_S_ODH77 "" VALUE 0x007220b0 Val_Wu8 1 OneToOne 0.0 255.00 FORMAT "%8.2" /end CHARACTERISTIC
/begin CHARACTERISTIC Tlib_DoVoltage_L3_Set_FilterVal_O_S_ODH61 "" VALUE 0x007220b1 Val_Wu8 1 OneToOne 0.0 255.00 FORMAT "%8.2" /end CHARACTERISTIC
/begin CHARACTERISTIC Tlib_DIO_L3_Set_Val_O_S_ODH61 "" VALUE 0x007220b2 Val_Wu8 1 OneToOne 0.0 255.00 FORMAT "%8.2" /end CHARACTERISTIC
/begin CHARACTERISTIC Tlib_DoVoltage_L3_Set_FilterVal_O_S_ODH62 "" VALUE 0x007220b3 Val_Wu8 1 OneToOne 0.0 255.00 FORMAT "%8.2" /end CHARACTERISTIC
/begin CHARACTERISTIC Tlib_DIO_L3_Set_Val_O_S_ODH62 "" VALUE 0x007220b4 Val_Wu8 1 OneToOne 0.0 255.00 FORMAT "%8.2" /end CHARACTERISTIC
/begin CHARACTERISTIC Tlib_DoVoltage_L3_Set_FilterVal_O_S_ODH63 "" VALUE 0x007220b5 Val_Wu8 1 OneToOne 0.0 255.00 FORMAT "%8.2" /end CHARACTERISTIC
/begin CHARACTERISTIC Tlib_DIO_L3_Set_Val_O_S_ODH63 "" VALUE 0x007220b6 Val_Wu8 1 OneToOne 0.0 255.00 FORMAT "%8.2" /end CHARACTERISTIC
/begin CHARACTERISTIC Tlib_DoVoltage_L3_Set_FilterVal_O_S_ODH64 "" VALUE 0x007220b7 Val_Wu8 1 OneToOne 0.0 255.00 FORMAT "%8.2" /end CHARACTERISTIC
/begin CHARACTERISTIC Tlib_DIO_L3_Set_Val_O_S_ODH64 "" VALUE 0x007220b8 Val_Wu8 1 OneToOne 0.0 255.00 FORMAT "%8.2" /end CHARACTERISTIC
/begin CHARACTERISTIC Tlib_DoVoltage_L3_Set_FilterVal_O_S_ODH106 "" VALUE 0x007220b9 Val_Wu8 1 OneToOne 0.0 255.00 FORMAT "%8.2" /end CHARACTERISTIC
/begin CHARACTERISTIC Tlib_DIO_L3_Set_Val_O_S_ODH106 "" VALUE 0x007220ba Val_Wu8 1 OneToOne 0.0 255.00 FORMAT "%8.2" /end CHARACTERISTIC
/begin CHARACTERISTIC Tlib_DoVoltage_L3_Set_FilterVal_O_S_ODH40 "" VALUE 0x007220bb Val_Wu8 1 OneToOne 0.0 255.00 FORMAT "%8.2" /end CHARACTERISTIC
/begin CHARACTERISTIC Tlib_DIO_L3_Set_Val_O_S_ODH40 "" VALUE 0x007220bc Val_Wu8 1 OneToOne 0.0 255.00 FORMAT "%8.2" /end CHARACTERISTIC
/begin CHARACTERISTIC Tlib_DoVoltage_L3_Set_FilterVal_O_S_EFUSE27 "" VALUE 0x007220bd Val_Wu8 1 OneToOne 0.0 255.00 FORMAT "%8.2" /end CHARACTERISTIC
/begin CHARACTERISTIC Tlib_DIO_L3_Set_Val_O_S_EFUSE27 "" VALUE 0x007220be Val_Wu8 1 OneToOne 0.0 255.00 FORMAT "%8.2" /end CHARACTERISTIC
/begin CHARACTERISTIC Tlib_DoVoltage_L3_Set_FilterVal_O_S_ODH88 "" VALUE 0x007220bf Val_Wu8 1 OneToOne 0.0 255.00 FORMAT "%8.2" /end CHARACTERISTIC
/begin CHARACTERISTIC Tlib_DIO_L3_Set_Val_O_S_ODH88 "" VALUE 0x007220c0 Val_Wu8 1 OneToOne 0.0 255.00 FORMAT "%8.2" /end CHARACTERISTIC
/begin CHARACTERISTIC Tlib_DoVoltage_L3_Set_FilterVal_O_S_ODH89 "" VALUE 0x007220c1 Val_Wu8 1 OneToOne 0.0 255.00 FORMAT "%8.2" /end CHARACTERISTIC
/begin CHARACTERISTIC Tlib_DIO_L3_Set_Val_O_S_ODH89 "" VALUE 0x007220c2 Val_Wu8 1 OneToOne 0.0 255.00 FORMAT "%8.2" /end CHARACTERISTIC
/begin CHARACTERISTIC Tlib_DoVoltage_L3_Set_FilterVal_O_S_ODH90 "" VALUE 0x007220c3 Val_Wu8 1 OneToOne 0.0 255.00 FORMAT "%8.2" /end CHARACTERISTIC
/begin CHARACTERISTIC Tlib_DIO_L3_Set_Val_O_S_ODH90 "" VALUE 0x007220c4 Val_Wu8 1 OneToOne 0.0 255.00 FORMAT "%8.2" /end CHARACTERISTIC
/begin CHARACTERISTIC Tlib_DoVoltage_L3_Set_FilterVal_O_S_ODH114 "" VALUE 0x007220c5 Val_Wu8 1 OneToOne 0.0 255.00 FORMAT "%8.2" /end CHARACTERISTIC
/begin CHARACTERISTIC Tlib_DIO_L3_Set_Val_O_S_ODH114 "" VALUE 0x007220c6 Val_Wu8 1 OneToOne 0.0 255.00 FORMAT "%8.2" /end CHARACTERISTIC
/begin CHARACTERISTIC Tlib_DoVoltage_L3_Set_FilterVal_O_S_ODH92 "" VALUE 0x007220c7 Val_Wu8 1 OneToOne 0.0 255.00 FORMAT "%8.2" /end CHARACTERISTIC
/begin CHARACTERISTIC Tlib_DIO_L3_Set_Val_O_S_ODH92 "" VALUE 0x007220c8 Val_Wu8 1 OneToOne 0.0 255.00 FORMAT "%8.2" /end CHARACTERISTIC
/begin CHARACTERISTIC Tlib_DoVoltage_L3_Set_FilterVal_O_S_ODH93 "" VALUE 0x007220c9 Val_Wu8 1 OneToOne 0.0 255.00 FORMAT "%8.2" /end CHARACTERISTIC
/begin CHARACTERISTIC Tlib_DIO_L3_Set_Val_O_S_ODH93 "" VALUE 0x007220ca Val_Wu8 1 OneToOne 0.0 255.00 FORMAT "%8.2" /end CHARACTERISTIC
/begin CHARACTERISTIC Tlib_DoVoltage_L3_Set_FilterVal_O_S_ODH95 "" VALUE 0x007220cb Val_Wu8 1 OneToOne 0.0 255.00 FORMAT "%8.2" /end CHARACTERISTIC
/begin CHARACTERISTIC Tlib_DIO_L3_Set_Val_O_S_ODH95 "" VALUE 0x007220cc Val_Wu8 1 OneToOne 0.0 255.00 FORMAT "%8.2" /end CHARACTERISTIC
/begin CHARACTERISTIC Tlib_DoVoltage_L3_Set_FilterVal_O_S_ODH51 "" VALUE 0x007220cd Val_Wu8 1 OneToOne 0.0 255.00 FORMAT "%8.2" /end CHARACTERISTIC
/begin CHARACTERISTIC Tlib_DIO_L3_Set_Val_O_S_ODH51 "" VALUE 0x007220ce Val_Wu8 1 OneToOne 0.0 255.00 FORMAT "%8.2" /end CHARACTERISTIC
/begin CHARACTERISTIC Tlib_DoVoltage_L3_Set_FilterVal_O_S_ODH99 "" VALUE 0x007220cf Val_Wu8 1 OneToOne 0.0 255.00 FORMAT "%8.2" /end CHARACTERISTIC
/begin CHARACTERISTIC Tlib_DIO_L3_Set_Val_O_S_ODH99 "" VALUE 0x007220d0 Val_Wu8 1 OneToOne 0.0 255.00 FORMAT "%8.2" /end CHARACTERISTIC
/begin CHARACTERISTIC Tlib_DoVoltage_L3_Set_FilterVal_O_S_ODH71 "" VALUE 0x007220d1 Val_Wu8 1 OneToOne 0.0 255.00 FORMAT "%8.2" /end CHARACTERISTIC
/begin CHARACTERISTIC Tlib_DIO_L3_Set_Val_O_S_ODH71 "" VALUE 0x007220d2 Val_Wu8 1 OneToOne 0.0 255.00 FORMAT "%8.2" /end CHARACTERISTIC
/begin CHARACTERISTIC Tlib_DoVoltage_L3_Set_FilterVal_O_S_ODH87 "" VALUE 0x007220d3 Val_Wu8 1 OneToOne 0.0 255.00 FORMAT "%8.2" /end CHARACTERISTIC
/begin CHARACTERISTIC Tlib_DIO_L3_Set_Val_O_S_ODH87 "" VALUE 0x007220d4 Val_Wu8 1 OneToOne 0.0 255.00 FORMAT "%8.2" /end CHARACTERISTIC
/begin CHARACTERISTIC Tlib_DoVoltage_L3_Set_FilterVal_O_S_ODH28 "" VALUE 0x007220d5 Val_Wu8 1 OneToOne 0.0 255.00 FORMAT "%8.2" /end CHARACTERISTIC
/begin CHARACTERISTIC Tlib_DIO_L3_Set_Val_O_S_ODH28 "" VALUE 0x007220d6 Val_Wu8 1 OneToOne 0.0 255.00 FORMAT "%8.2" /end CHARACTERISTIC
/begin CHARACTERISTIC Tlib_PWM_L3_Set_Duty_Val_O_P_OPL04 "" VALUE 0x00721f92 Val_Wu16 1 OneToOne 0.0 65535 FORMAT "%8.2" /end CHARACTERISTIC
/begin CHARACTERISTIC Tlib_PWM_L3_Set_Info_Period_Val_PwmChannel_O_P_OPL04 "" VALUE 0x00721f68 Val_Wu32 1 OneToOne 0.0 4294967295 FORMAT "%8.2" /end CHARACTERISTIC
/begin CHARACTERISTIC Tlib_PWM_L3_Set_Info_Duty_Val_O_P_OPL04 "" VALUE 0x00721f94 Val_Wu16 1 OneToOne 0.0 65535 FORMAT "%8.2" /end CHARACTERISTIC
/begin CHARACTERISTIC Tlib_PWM_L3_Set_Duty_Val_O_P_OPL07 "" VALUE 0x00721f96 Val_Wu16 1 OneToOne 0.0 65535 FORMAT "%8.2" /end CHARACTERISTIC
/begin CHARACTERISTIC Tlib_PWM_L3_Set_Info_Period_Val_PwmChannel_O_P_OPL07 "" VALUE 0x00721f6c Val_Wu32 1 OneToOne 0.0 4294967295 FORMAT "%8.2" /end CHARACTERISTIC
/begin CHARACTERISTIC Tlib_PWM_L3_Set_Info_Duty_Val_O_P_OPL07 "" VALUE 0x00721f98 Val_Wu16 1 OneToOne 0.0 65535 FORMAT "%8.2" /end CHARACTERISTIC
/begin CHARACTERISTIC Tlib_PWM_L3_Set_Duty_Val_O_P_OPL08 "" VALUE 0x00721f9a Val_Wu16 1 OneToOne 0.0 65535 FORMAT "%8.2" /end CHARACTERISTIC
/begin CHARACTERISTIC Tlib_PWM_L3_Set_Info_Period_Val_PwmChannel_O_P_OPL08 "" VALUE 0x00721f70 Val_Wu32 1 OneToOne 0.0 4294967295 FORMAT "%8.2" /end CHARACTERISTIC
/begin CHARACTERISTIC Tlib_PWM_L3_Set_Info_Duty_Val_O_P_OPL08 "" VALUE 0x00721f9c Val_Wu16 1 OneToOne 0.0 65535 FORMAT "%8.2" /end CHARACTERISTIC
/begin CHARACTERISTIC Tlib_PWM_L3_Set_Duty_Val_O_P_OPL09 "" VALUE 0x00721f9e Val_Wu16 1 OneToOne 0.0 65535 FORMAT "%8.2" /end CHARACTERISTIC
/begin CHARACTERISTIC Tlib_PWM_L3_Set_Info_Period_Val_PwmChannel_O_P_OPL09 "" VALUE 0x00721f74 Val_Wu32 1 OneToOne 0.0 4294967295 FORMAT "%8.2" /end CHARACTERISTIC
/begin CHARACTERISTIC Tlib_PWM_L3_Set_Info_Duty_Val_O_P_OPL09 "" VALUE 0x00721fa0 Val_Wu16 1 OneToOne 0.0 65535 FORMAT "%8.2" /end CHARACTERISTIC
/begin CHARACTERISTIC Tlib_PWM_L3_Set_Duty_Val_O_P_OPH12 "" VALUE 0x00721fa2 Val_Wu16 1 OneToOne 0.0 65535 FORMAT "%8.2" /end CHARACTERISTIC
/begin CHARACTERISTIC Tlib_PWM_L3_Set_Info_Period_Val_PwmChannel_O_P_OPH12 "" VALUE 0x00721f78 Val_Wu32 1 OneToOne 0.0 4294967295 FORMAT "%8.2" /end CHARACTERISTIC
/begin CHARACTERISTIC Tlib_PWM_L3_Set_Info_Duty_Val_O_P_OPH12 "" VALUE 0x00721fa4 Val_Wu16 1 OneToOne 0.0 65535 FORMAT "%8.2" /end CHARACTERISTIC
/begin CHARACTERISTIC Tlib_PWM_L3_Set_Duty_Val_O_P_OPH02 "" VALUE 0x00721fa6 Val_Wu16 1 OneToOne 0.0 65535 FORMAT "%8.2" /end CHARACTERISTIC
/begin CHARACTERISTIC Tlib_PWM_L3_Set_Info_Period_Val_PwmChannel_O_P_OPH02 "" VALUE 0x00721f7c Val_Wu32 1 OneToOne 0.0 4294967295 FORMAT "%8.2" /end CHARACTERISTIC
/begin CHARACTERISTIC Tlib_PWM_L3_Set_Info_Duty_Val_O_P_OPH02 "" VALUE 0x00721fa8 Val_Wu16 1 OneToOne 0.0 65535 FORMAT "%8.2" /end CHARACTERISTIC
/begin CHARACTERISTIC Tlib_PWM_L3_Set_Duty_Val_O_P_OPH09 "" VALUE 0x00721faa Val_Wu16 1 OneToOne 0.0 65535 FORMAT "%8.2" /end CHARACTERISTIC
/begin CHARACTERISTIC Tlib_PWM_L3_Set_Info_Period_Val_PwmChannel_O_P_OPH09 "" VALUE 0x00721f80 Val_Wu32 1 OneToOne 0.0 4294967295 FORMAT "%8.2" /end CHARACTERISTIC
/begin CHARACTERISTIC Tlib_PWM_L3_Set_Info_Duty_Val_O_P_OPH09 "" VALUE 0x00721fac Val_Wu16 1 OneToOne 0.0 65535 FORMAT "%8.2" /end CHARACTERISTIC
/begin CHARACTERISTIC Tlib_PWM_L3_Set_Duty_Val_O_P_OPH10 "" VALUE 0x00721fae Val_Wu16 1 OneToOne 0.0 65535 FORMAT "%8.2" /end CHARACTERISTIC
/begin CHARACTERISTIC Tlib_PWM_L3_Set_Info_Period_Val_PwmChannel_O_P_OPH10 "" VALUE 0x00721f84 Val_Wu32 1 OneToOne 0.0 4294967295 FORMAT "%8.2" /end CHARACTERISTIC
/begin CHARACTERISTIC Tlib_PWM_L3_Set_Info_Duty_Val_O_P_OPH10 "" VALUE 0x00721fb0 Val_Wu16 1 OneToOne 0.0 65535 FORMAT "%8.2" /end CHARACTERISTIC
/begin CHARACTERISTIC Tlib_PWM_L3_Set_Duty_Val_O_P_OPH14 "" VALUE 0x00721fb2 Val_Wu16 1 OneToOne 0.0 65535 FORMAT "%8.2" /end CHARACTERISTIC
/begin CHARACTERISTIC Tlib_PWM_L3_Set_Info_Period_Val_PwmChannel_O_P_OPH14 "" VALUE 0x00721f88 Val_Wu32 1 OneToOne 0.0 4294967295 FORMAT "%8.2" /end CHARACTERISTIC
/begin CHARACTERISTIC Tlib_PWM_L3_Set_Info_Duty_Val_O_P_OPH14 "" VALUE 0x00721fb4 Val_Wu16 1 OneToOne 0.0 65535 FORMAT "%8.2" /end CHARACTERISTIC
/begin CHARACTERISTIC Tlib_PWM_L3_Set_Duty_Val_O_P_OPH11 "" VALUE 0x00721fb6 Val_Wu16 1 OneToOne 0.0 65535 FORMAT "%8.2" /end CHARACTERISTIC
/begin CHARACTERISTIC Tlib_PWM_L3_Set_Info_Period_Val_PwmChannel_O_P_OPH11 "" VALUE 0x00721f8c Val_Wu32 1 OneToOne 0.0 4294967295 FORMAT "%8.2" /end CHARACTERISTIC
/begin CHARACTERISTIC Tlib_PWM_L3_Set_Info_Duty_Val_O_P_OPH11 "" VALUE 0x00721fb8 Val_Wu16 1 OneToOne 0.0 65535 FORMAT "%8.2" /end CHARACTERISTIC
/begin CHARACTERISTIC Tlib_Hbr_L3_Set_Val_O_H_OHB01_02 "" VALUE 0x007220d7 Val_Wu8 1 OneToOne 0.0 255.00 FORMAT "%8.2" /end CHARACTERISTIC
/begin CHARACTERISTIC Tlib_HbrPWM_L3_Set_Duty_Val_O_H_OHB01_02 "" VALUE 0x00721fba Val_Wu16 1 OneToOne 0.0 65535 FORMAT "%8.2" /end CHARACTERISTIC
/begin CHARACTERISTIC Tlib_Hbr_L3_Set_Val_O_H_OHB03_04 "" VALUE 0x007220d8 Val_Wu8 1 OneToOne 0.0 255.00 FORMAT "%8.2" /end CHARACTERISTIC
/begin CHARACTERISTIC Tlib_HbrPWM_L3_Set_Duty_Val_O_H_OHB03_04 "" VALUE 0x00721fbc Val_Wu16 1 OneToOne 0.0 65535 FORMAT "%8.2" /end CHARACTERISTIC
/begin CHARACTERISTIC Tlib_Hbr_L3_Set_Val_O_H_OHB05_06 "" VALUE 0x007220d9 Val_Wu8 1 OneToOne 0.0 255.00 FORMAT "%8.2" /end CHARACTERISTIC
/begin CHARACTERISTIC Tlib_HbrPWM_L3_Set_Duty_Val_O_H_OHB05_06 "" VALUE 0x00721fbe Val_Wu16 1 OneToOne 0.0 65535 FORMAT "%8.2" /end CHARACTERISTIC
/begin CHARACTERISTIC Tlib_Hbr_L3_Set_Val_O_H_OHB07_08 "" VALUE 0x007220da Val_Wu8 1 OneToOne 0.0 255.00 FORMAT "%8.2" /end CHARACTERISTIC
/begin CHARACTERISTIC Tlib_HbrPWM_L3_Set_Duty_Val_O_H_OHB07_08 "" VALUE 0x00721fc0 Val_Wu16 1 OneToOne 0.0 65535 FORMAT "%8.2" /end CHARACTERISTIC
/begin CHARACTERISTIC Tlib_Hbr_L3_Set_Val_O_H_OHB09_10 "" VALUE 0x007220db Val_Wu8 1 OneToOne 0.0 255.00 FORMAT "%8.2" /end CHARACTERISTIC
/begin CHARACTERISTIC Tlib_HbrPWM_L3_Set_Duty_Val_O_H_OHB09_10 "" VALUE 0x00721fc2 Val_Wu16 1 OneToOne 0.0 65535 FORMAT "%8.2" /end CHARACTERISTIC
/begin CHARACTERISTIC Tlib_Hbr_L3_Set_Val_O_H_OHB11_12 "" VALUE 0x007220dc Val_Wu8 1 OneToOne 0.0 255.00 FORMAT "%8.2" /end CHARACTERISTIC
/begin CHARACTERISTIC Tlib_HbrPWM_L3_Set_Duty_Val_O_H_OHB11_12 "" VALUE 0x00721fc4 Val_Wu16 1 OneToOne 0.0 65535 FORMAT "%8.2" /end CHARACTERISTIC
/begin CHARACTERISTIC Tlib_Hbr_L3_Set_Val_O_H_OHB13_14 "" VALUE 0x007220dd Val_Wu8 1 OneToOne 0.0 255.00 FORMAT "%8.2" /end CHARACTERISTIC
/begin CHARACTERISTIC Tlib_HbrPWM_L3_Set_Duty_Val_O_H_OHB13_14 "" VALUE 0x00721fc6 Val_Wu16 1 OneToOne 0.0 65535 FORMAT "%8.2" /end CHARACTERISTIC
/begin CHARACTERISTIC Tlib_Hbr_L3_Set_Val_O_H_OHB15_16 "" VALUE 0x007220de Val_Wu8 1 OneToOne 0.0 255.00 FORMAT "%8.2" /end CHARACTERISTIC
/begin CHARACTERISTIC Tlib_HbrPWM_L3_Set_Duty_Val_O_H_OHB15_16 "" VALUE 0x00721fc8 Val_Wu16 1 OneToOne 0.0 65535 FORMAT "%8.2" /end CHARACTERISTIC
/begin CHARACTERISTIC Tlib_Hbr_L3_Set_Val_O_H_OPB31_32 "" VALUE 0x007220df Val_Wu8 1 OneToOne 0.0 255.00 FORMAT "%8.2" /end CHARACTERISTIC
/begin CHARACTERISTIC Tlib_HbrPWM_L3_Set_Duty_Val_O_H_OPB31_32 "" VALUE 0x00721fca Val_Wu16 1 OneToOne 0.0 65535 FORMAT "%8.2" /end CHARACTERISTIC
/begin CHARACTERISTIC Tlib_Hbr_L3_Set_Val_O_H_OPB05_06 "" VALUE 0x007220e0 Val_Wu8 1 OneToOne 0.0 255.00 FORMAT "%8.2" /end CHARACTERISTIC
/begin CHARACTERISTIC Tlib_HbrPWM_L3_Set_Duty_Val_O_H_OPB05_06 "" VALUE 0x00721fcc Val_Wu16 1 OneToOne 0.0 65535 FORMAT "%8.2" /end CHARACTERISTIC
/begin CHARACTERISTIC Tlib_Hbr_L3_Set_Val_O_H_OPB07_08 "" VALUE 0x007220e1 Val_Wu8 1 OneToOne 0.0 255.00 FORMAT "%8.2" /end CHARACTERISTIC
/begin CHARACTERISTIC Tlib_HbrPWM_L3_Set_Duty_Val_O_H_OPB07_08 "" VALUE 0x00721fce Val_Wu16 1 OneToOne 0.0 65535 FORMAT "%8.2" /end CHARACTERISTIC
/begin CHARACTERISTIC Tlib_Hbr_L3_Set_Val_O_H_OPB09_10 "" VALUE 0x007220e2 Val_Wu8 1 OneToOne 0.0 255.00 FORMAT "%8.2" /end CHARACTERISTIC
/begin CHARACTERISTIC Tlib_HbrPWM_L3_Set_Duty_Val_O_H_OPB09_10 "" VALUE 0x00721fd0 Val_Wu16 1 OneToOne 0.0 65535 FORMAT "%8.2" /end CHARACTERISTIC
/begin CHARACTERISTIC Tlib_Hbr_L3_Set_Val_O_H_OPB09_16 "" VALUE 0x007220e3 Val_Wu8 1 OneToOne 0.0 255.00 FORMAT "%8.2" /end CHARACTERISTIC
/begin CHARACTERISTIC Tlib_HbrPWM_L3_Set_Duty_Val_O_H_OPB09_16 "" VALUE 0x00721fd2 Val_Wu16 1 OneToOne 0.0 65535 FORMAT "%8.2" /end CHARACTERISTIC
/begin CHARACTERISTIC Tlib_Hbr_L3_Set_Val_O_H_OPB12_13 "" VALUE 0x007220e4 Val_Wu8 1 OneToOne 0.0 255.00 FORMAT "%8.2" /end CHARACTERISTIC
/begin CHARACTERISTIC Tlib_HbrPWM_L3_Set_Duty_Val_O_H_OPB12_13 "" VALUE 0x00721fd4 Val_Wu16 1 OneToOne 0.0 65535 FORMAT "%8.2" /end CHARACTERISTIC
/begin CHARACTERISTIC Tlib_Hbr_L3_Set_Val_O_H_OPB11_12 "" VALUE 0x007220e5 Val_Wu8 1 OneToOne 0.0 255.00 FORMAT "%8.2" /end CHARACTERISTIC
/begin CHARACTERISTIC Tlib_HbrPWM_L3_Set_Duty_Val_O_H_OPB11_12 "" VALUE 0x00721fd6 Val_Wu16 1 OneToOne 0.0 65535 FORMAT "%8.2" /end CHARACTERISTIC
/begin CHARACTERISTIC Tlib_Hbr_L3_Set_Val_O_H_OPB14_15 "" VALUE 0x007220e6 Val_Wu8 1 OneToOne 0.0 255.00 FORMAT "%8.2" /end CHARACTERISTIC
/begin CHARACTERISTIC Tlib_HbrPWM_L3_Set_Duty_Val_O_H_OPB14_15 "" VALUE 0x00721fd8 Val_Wu16 1 OneToOne 0.0 65535 FORMAT "%8.2" /end CHARACTERISTIC
/begin CHARACTERISTIC Tlib_Hbr_L3_Set_Val_O_H_OPB14_17 "" VALUE 0x007220e7 Val_Wu8 1 OneToOne 0.0 255.00 FORMAT "%8.2" /end CHARACTERISTIC
/begin CHARACTERISTIC Tlib_HbrPWM_L3_Set_Duty_Val_O_H_OPB14_17 "" VALUE 0x00721fda Val_Wu16 1 OneToOne 0.0 65535 FORMAT "%8.2" /end CHARACTERISTIC
/begin CHARACTERISTIC Tlib_Hbr_L3_Set_Val_O_H_OPB18_30 "" VALUE 0x007220e8 Val_Wu8 1 OneToOne 0.0 255.00 FORMAT "%8.2" /end CHARACTERISTIC
/begin CHARACTERISTIC Tlib_HbrPWM_L3_Set_Duty_Val_O_H_OPB18_30 "" VALUE 0x00721fdc Val_Wu16 1 OneToOne 0.0 65535 FORMAT "%8.2" /end CHARACTERISTIC
/begin CHARACTERISTIC Tlib_Hbr_L3_Set_Val_O_H_OPB19_20 "" VALUE 0x007220e9 Val_Wu8 1 OneToOne 0.0 255.00 FORMAT "%8.2" /end CHARACTERISTIC
/begin CHARACTERISTIC Tlib_HbrPWM_L3_Set_Duty_Val_O_H_OPB19_20 "" VALUE 0x00721fde Val_Wu16 1 OneToOne 0.0 65535 FORMAT "%8.2" /end CHARACTERISTIC
/begin CHARACTERISTIC Tlib_Hbr_L3_Set_Val_O_H_OPB21_22 "" VALUE 0x007220ea Val_Wu8 1 OneToOne 0.0 255.00 FORMAT "%8.2" /end CHARACTERISTIC
/begin CHARACTERISTIC Tlib_HbrPWM_L3_Set_Duty_Val_O_H_OPB21_22 "" VALUE 0x00721fe0 Val_Wu16 1 OneToOne 0.0 65535 FORMAT "%8.2" /end CHARACTERISTIC
/begin CHARACTERISTIC Tlib_Hbr_L3_Set_Val_O_H_OPB22_23 "" VALUE 0x007220eb Val_Wu8 1 OneToOne 0.0 255.00 FORMAT "%8.2" /end CHARACTERISTIC
/begin CHARACTERISTIC Tlib_HbrPWM_L3_Set_Duty_Val_O_H_OPB22_23 "" VALUE 0x00721fe2 Val_Wu16 1 OneToOne 0.0 65535 FORMAT "%8.2" /end CHARACTERISTIC
/begin CHARACTERISTIC Tlib_Hbr_L3_Set_Val_O_H_OPB23_24 "" VALUE 0x007220ec Val_Wu8 1 OneToOne 0.0 255.00 FORMAT "%8.2" /end CHARACTERISTIC
/begin CHARACTERISTIC Tlib_HbrPWM_L3_Set_Duty_Val_O_H_OPB23_24 "" VALUE 0x00721fe4 Val_Wu16 1 OneToOne 0.0 65535 FORMAT "%8.2" /end CHARACTERISTIC
/begin CHARACTERISTIC Tlib_Hbr_L3_Set_Val_O_H_OPB27_28 "" VALUE 0x007220ed Val_Wu8 1 OneToOne 0.0 255.00 FORMAT "%8.2" /end CHARACTERISTIC
/begin CHARACTERISTIC Tlib_HbrPWM_L3_Set_Duty_Val_O_H_OPB27_28 "" VALUE 0x00721fe6 Val_Wu16 1 OneToOne 0.0 65535 FORMAT "%8.2" /end CHARACTERISTIC
/begin CHARACTERISTIC Tlib_Hbr_L3_Set_Val_O_H_OPB25 "" VALUE 0x007220ee Val_Wu8 1 OneToOne 0.0 255.00 FORMAT "%8.2" /end CHARACTERISTIC
/begin CHARACTERISTIC Tlib_HbrPWM_L3_Set_Duty_Val_O_H_OPB25 "" VALUE 0x00721fe8 Val_Wu16 1 OneToOne 0.0 65535 FORMAT "%8.2" /end CHARACTERISTIC
/begin CHARACTERISTIC Tlib_Hbr_L3_Set_Val_O_H_OPB26 "" VALUE 0x007220ef Val_Wu8 1 OneToOne 0.0 255.00 FORMAT "%8.2" /end CHARACTERISTIC
/begin CHARACTERISTIC Tlib_HbrPWM_L3_Set_Duty_Val_O_H_OPB26 "" VALUE 0x00721fea Val_Wu16 1 OneToOne 0.0 65535 FORMAT "%8.2" /end CHARACTERISTIC
/begin CHARACTERISTIC Tlib_Hbr_L3_Set_Val_O_H_OPB29 "" VALUE 0x007220f0 Val_Wu8 1 OneToOne 0.0 255.00 FORMAT "%8.2" /end CHARACTERISTIC
/begin CHARACTERISTIC Tlib_HbrPWM_L3_Set_Duty_Val_O_H_OPB29 "" VALUE 0x00721fec Val_Wu16 1 OneToOne 0.0 65535 FORMAT "%8.2" /end CHARACTERISTIC
/begin CHARACTERISTIC IoExtBtg7xxxx_u16DiagOLOffLowThresHold_C "" VAL_BLK 0x00720e5c Val_Wu16 1 OneToOne 0.0 65535 FORMAT "%8.2" NUMBER 12 /end CHARACTERISTIC
/begin CHARACTERISTIC IoExtBtg7xxxx_u16DiagOLOffHighThresHold_C "" VAL_BLK 0x00720e74 Val_Wu16 1 OneToOne 0.0 65535 FORMAT "%8.2" NUMBER 12 /end CHARACTERISTIC
/begin CHARACTERISTIC IoExtBtg7xxxx_u16DiagDevOffLowThresHold_C "" VAL_BLK 0x00720e8c Val_Wu16 1 OneToOne 0.0 65535 FORMAT "%8.2" NUMBER 12 /end CHARACTERISTIC
/begin CHARACTERISTIC IoExtBtg7xxxx_u16DiagDevOffHighThresHold_C "" VAL_BLK 0x00720ea4 Val_Wu16 1 OneToOne 0.0 65535 FORMAT "%8.2" NUMBER 12 /end CHARACTERISTIC
/begin CHARACTERISTIC IoExtBtg7xxxx_u16DiagISFaultLowThresHold_C "" VAL_BLK 0x00720ebc Val_Wu16 1 OneToOne 0.0 65535 FORMAT "%8.2" NUMBER 12 /end CHARACTERISTIC
/begin CHARACTERISTIC IoExtBtg7xxxx_u16DiagISFaultHighThresHold_C "" VAL_BLK 0x00720ed4 Val_Wu16 1 OneToOne 0.0 65535 FORMAT "%8.2" NUMBER 12 /end CHARACTERISTIC
/begin CHARACTERISTIC IoExtBtg7xxxx_u16DiagI2tOffLowThresHold_C "" VAL_BLK 0x00720eec Val_Wu16 1 OneToOne 0.0 65535 FORMAT "%8.2" NUMBER 12 /end CHARACTERISTIC
/begin CHARACTERISTIC IoExtBtg7xxxx_u16DiagI2tOffHighThresHold_C "" VAL_BLK 0x00720f04 Val_Wu16 1 OneToOne 0.0 65535 FORMAT "%8.2" NUMBER 12 /end CHARACTERISTIC
/begin CHARACTERISTIC IoExtBtg7xxxx_u16DiagISENHighThresHold_C "" VAL_BLK 0x00720f1c Val_Wu16 1 OneToOne 0.0 65535 FORMAT "%8.2" NUMBER 12 /end CHARACTERISTIC
/begin CHARACTERISTIC IoExtBtg7xxx_u16I2tSettingRShortLowThres_C "" VAL_BLK 0x00720f34 Val_Wu16 1 OneToOne 0.0 65535 FORMAT "%8.2" NUMBER 12 /end CHARACTERISTIC
/begin CHARACTERISTIC IoExtBtg7xxx_u16I2tSettingRShortHighThres_C "" VAL_BLK 0x00720f4c Val_Wu16 1 OneToOne 0.0 65535 FORMAT "%8.2" NUMBER 12 /end CHARACTERISTIC
/begin CHARACTERISTIC IoExtBtg7xxx_u16I2tSettingCrv1LowThres_C "" VAL_BLK 0x00720f64 Val_Wu16 1 OneToOne 0.0 65535 FORMAT "%8.2" NUMBER 12 /end CHARACTERISTIC
/begin CHARACTERISTIC IoExtBtg7xxx_u16I2tSettingCrv1HighThres_C "" VAL_BLK 0x00720f7c Val_Wu16 1 OneToOne 0.0 65535 FORMAT "%8.2" NUMBER 12 /end CHARACTERISTIC
/begin CHARACTERISTIC IoExtBtg7xxx_u16I2tSettingCrv2LowThres_C "" VAL_BLK 0x00720f94 Val_Wu16 1 OneToOne 0.0 65535 FORMAT "%8.2" NUMBER 12 /end CHARACTERISTIC
/begin CHARACTERISTIC IoExtBtg7xxx_u16I2tSettingCrv2HighThres_C "" VAL_BLK 0x00720fac Val_Wu16 1 OneToOne 0.0 65535 FORMAT "%8.2" NUMBER 12 /end CHARACTERISTIC
/begin CHARACTERISTIC IoExtBtg7xxx_u16I2tSettingCrv3LowThres_C "" VAL_BLK 0x00720fc4 Val_Wu16 1 OneToOne 0.0 65535 FORMAT "%8.2" NUMBER 12 /end CHARACTERISTIC
/begin CHARACTERISTIC IoExtBtg7xxx_u16I2tSettingCrv3HighThres_C "" VAL_BLK 0x00720fdc Val_Wu16 1 OneToOne 0.0 65535 FORMAT "%8.2" NUMBER 12 /end CHARACTERISTIC
/begin CHARACTERISTIC IoExtBtg7xxx_u16I2tSettingCrv4LowThres_C "" VAL_BLK 0x00720ff4 Val_Wu16 1 OneToOne 0.0 65535 FORMAT "%8.2" NUMBER 12 /end CHARACTERISTIC
/begin CHARACTERISTIC IoExtBtg7xxx_u16I2tSettingCrv4HighThres_C "" VAL_BLK 0x0072100c Val_Wu16 1 OneToOne 0.0 65535 FORMAT "%8.2" NUMBER 12 /end CHARACTERISTIC
/begin CHARACTERISTIC IoExtBtg7xxx_u16I2tSettingCrv5LowThres_C "" VAL_BLK 0x00721024 Val_Wu16 1 OneToOne 0.0 65535 FORMAT "%8.2" NUMBER 12 /end CHARACTERISTIC
/begin CHARACTERISTIC IoExtBtg7xxx_u16I2tSettingCrv5HighThres_C "" VAL_BLK 0x0072103c Val_Wu16 1 OneToOne 0.0 65535 FORMAT "%8.2" NUMBER 12 /end CHARACTERISTIC
/begin CHARACTERISTIC IoExtBtg7xxx_u16I2tSettingCrv6LowThres_C "" VAL_BLK 0x00721054 Val_Wu16 1 OneToOne 0.0 65535 FORMAT "%8.2" NUMBER 12 /end CHARACTERISTIC
/begin CHARACTERISTIC IoExtBtg7xxx_u16I2tSettingCrv6HighThres_C "" VAL_BLK 0x0072106c Val_Wu16 1 OneToOne 0.0 65535 FORMAT "%8.2" NUMBER 12 /end CHARACTERISTIC
/begin CHARACTERISTIC IoExtBtg7xxx_u16I2tSettingROpenLowThres_C "" VAL_BLK 0x00721084 Val_Wu16 1 OneToOne 0.0 65535 FORMAT "%8.2" NUMBER 12 /end CHARACTERISTIC
/begin CHARACTERISTIC IoExtBtg7xxx_u16I2tSettingROpenHighThres_C "" VAL_BLK 0x0072109c Val_Wu16 1 OneToOne 0.0 65535 FORMAT "%8.2" NUMBER 12 /end CHARACTERISTIC
/begin CHARACTERISTIC IoExtBtg7xxxx_u8I2tSetting_C "" VAL_BLK 0x00721294 Val_Wu8 1 OneToOne 0.0 255.00 FORMAT "%8.2" NUMBER 12 /end CHARACTERISTIC
/begin CHARACTERISTIC IoExtBtg7xxxx_u16OCTSettingSHORTLowThres_C "" VAL_BLK 0x007210b4 Val_Wu16 1 OneToOne 0.0 65535 FORMAT "%8.2" NUMBER 12 /end CHARACTERISTIC
/begin CHARACTERISTIC IoExtBtg7xxxx_u16OCTSettingSHORTHighThres_C "" VAL_BLK 0x007210cc Val_Wu16 1 OneToOne 0.0 65535 FORMAT "%8.2" NUMBER 12 /end CHARACTERISTIC
/begin CHARACTERISTIC IoExtBtg7xxxx_u16OCTSettingNormLowThres_C "" VAL_BLK 0x007210e4 Val_Wu16 1 OneToOne 0.0 65535 FORMAT "%8.2" NUMBER 12 /end CHARACTERISTIC
/begin CHARACTERISTIC IoExtBtg7xxxx_u16OCTSettingNormHighThres_C "" VAL_BLK 0x007210fc Val_Wu16 1 OneToOne 0.0 65535 FORMAT "%8.2" NUMBER 12 /end CHARACTERISTIC
/begin CHARACTERISTIC IoExtBtg7xxxx_u16OCTSettingOPENLowThres_C "" VAL_BLK 0x00721114 Val_Wu16 1 OneToOne 0.0 65535 FORMAT "%8.2" NUMBER 12 /end CHARACTERISTIC
/begin CHARACTERISTIC IoExtBtg7xxxx_u16OCTSettingOPENHighThres_C "" VAL_BLK 0x0072112c Val_Wu16 1 OneToOne 0.0 65535 FORMAT "%8.2" NUMBER 12 /end CHARACTERISTIC
/begin CHARACTERISTIC IoExtBtg7xxxx_tiCLSCtrlMax_C "" VAL_BLK 0x00721144 Val_Wu16 1 OneToOne 0.0 65535 FORMAT "%8.2" NUMBER 12 /end CHARACTERISTIC
/begin CHARACTERISTIC IoExtBtg7xxxx_tiPFMMax_C "" VAL_BLK 0x0072115c Val_Wu16 1 OneToOne 0.0 65535 FORMAT "%8.2" NUMBER 12 /end CHARACTERISTIC
/begin CHARACTERISTIC IoExtBtg7xxxx_u32OnFaultMsk_C "" VAL_BLK 0x00721174 Val_Wu32 1 OneToOne 0.0 4294967295 FORMAT "%8.2" NUMBER 12 /end CHARACTERISTIC
/begin CHARACTERISTIC IoExtBtg7xxxx_u32OffFaultMsk_C "" VAL_BLK 0x007211a4 Val_Wu32 1 OneToOne 0.0 4294967295 FORMAT "%8.2" NUMBER 12 /end CHARACTERISTIC
/begin CHARACTERISTIC IoExtBtg7xxxx_u32FaultKeepMsk_C "" VAL_BLK 0x007211d4 Val_Wu32 1 OneToOne 0.0 4294967295 FORMAT "%8.2" NUMBER 12 /end CHARACTERISTIC
/begin CHARACTERISTIC IoExtBtg7xxxx_tiLogReNewMax_C "" VAL_BLK 0x00721204 Val_Wu16 1 OneToOne 0.0 65535 FORMAT "%8.2" NUMBER 12 /end CHARACTERISTIC
/begin CHARACTERISTIC IoExtBtg7xxxx_u16VoutLowThres_C "" VAL_BLK 0x0072121c Val_Wu16 1 OneToOne 0.0 65535 FORMAT "%8.2" NUMBER 12 /end CHARACTERISTIC
/begin CHARACTERISTIC IoExtBtg7xxxx_u16VoutHighThres_C "" VAL_BLK 0x00721234 Val_Wu16 1 OneToOne 0.0 65535 FORMAT "%8.2" NUMBER 12 /end CHARACTERISTIC
/begin CHARACTERISTIC IoExtBtg7xxxx_u16OnDiagSeqCheckVlotDifMax_C "" VAL_BLK 0x0072124c Val_Wu16 1 OneToOne 0.0 65535 FORMAT "%8.2" NUMBER 12 /end CHARACTERISTIC
/begin CHARACTERISTIC IoExtBtg7xxxx_u16OffDiagSeqCheckHighThres_C "" VAL_BLK 0x00721264 Val_Wu16 1 OneToOne 0.0 65535 FORMAT "%8.2" NUMBER 12 /end CHARACTERISTIC
/begin CHARACTERISTIC IoExtBtg7xxxx_u16OffDiagSeqCheckLowThres_C "" VAL_BLK 0x0072127c Val_Wu16 1 OneToOne 0.0 65535 FORMAT "%8.2" NUMBER 12 /end CHARACTERISTIC
/begin CHARACTERISTIC IoExtBtg7xxxx_tiDiagSeqCheckMax_C "" VAL_BLK 0x007212a0 Val_Wu8 1 OneToOne 0.0 255.00 FORMAT "%8.2" NUMBER 12 /end CHARACTERISTIC
/begin CHARACTERISTIC IoExtBtg7xxxx_tiVoutDiagOnDebMax_C "" VAL_BLK 0x007212ac Val_Wu8 1 OneToOne 0.0 255.00 FORMAT "%8.2" NUMBER 12 /end CHARACTERISTIC
/begin CHARACTERISTIC IoExtBtg7xxxx_tiVoutDiagOffDebMax_C "" VAL_BLK 0x007212b8 Val_Wu8 1 OneToOne 0.0 255.00 FORMAT "%8.2" NUMBER 12 /end CHARACTERISTIC
/begin CHARACTERISTIC IoExtBtg7xxxx_tiFusaDebMax_C "" VAL_BLK 0x007212c4 Val_Wu8 1 OneToOne 0.0 255.00 FORMAT "%8.2" NUMBER 12 /end CHARACTERISTIC
/begin CHARACTERISTIC IoExtBtg7xxxx_idEfuseWakeup_C "" VAL_BLK 0x007212d0 Val_Wu8 1 OneToOne 0.0 255.00 FORMAT "%8.2" NUMBER 12 /end CHARACTERISTIC
/begin CHARACTERISTIC MoCSOP_ctDebNormalTest_C "" VALUE 0x0072024b Val_Wu8 1 OneToOne 0.0 255.00 FORMAT "%8.2" /end CHARACTERISTIC
/begin CHARACTERISTIC MoCSOP_stSWResetNormal_CW "" VALUE 0x0072024c Val_Wu8 1 OneToOne 0.0 255.00 FORMAT "%8.2" /end CHARACTERISTIC
/begin CHARACTERISTIC MoCSOP_stSWResetExtdogValid_CW "" VALUE 0x0072024d Val_Wu8 1 OneToOne 0.0 255.00 FORMAT "%8.2" /end CHARACTERISTIC
/begin CHARACTERISTIC MoCSOP_stMPSResetEnable_CW "" VALUE 0x0072024e Val_Wu8 1 OneToOne 0.0 255.00 FORMAT "%8.2" /end CHARACTERISTIC
/begin CHARACTERISTIC MoCSOP_swtMPSRstActv_C "" VALUE 0x0072024f Val_Wu8 1 OneToOne 0.0 255.00 FORMAT "%8.2" /end CHARACTERISTIC
/begin CHARACTERISTIC MoCSOP_RWNVM_Enable_C "" VALUE 0x00720250 Val_Wu8 1 OneToOne 0.0 255.00 FORMAT "%8.2" /end CHARACTERISTIC
/begin CHARACTERISTIC MoCSOP_RWNVMRst_C "" VALUE 0x00720251 Val_Wu8 1 OneToOne 0.0 255.00 FORMAT "%8.2" /end CHARACTERISTIC
/begin CHARACTERISTIC MoCSOP_swtRelErrPin_C "" VALUE 0x00720252 Val_Wu8 1 OneToOne 0.0 255.00 FORMAT "%8.2" /end CHARACTERISTIC
/begin CHARACTERISTIC MoCSOP_stRstFailRelErrPin_CW "" VALUE 0x00720255 Val_Wu8 1 OneToOne 0.0 255.00 FORMAT "%8.2" /end CHARACTERISTIC
/begin CHARACTERISTIC MoCSOP_ctDebRstFailRelErrPin_CW "" VALUE 0x00720256 Val_Wu8 1 OneToOne 0.0 255.00 FORMAT "%8.2" /end CHARACTERISTIC
/begin CHARACTERISTIC MoCSOP_ctDebMMErr_CW "" VALUE 0x00720253 Val_Wu8 1 OneToOne 0.0 255.00 FORMAT "%8.2" /end CHARACTERISTIC
/begin CHARACTERISTIC MoCSOP_ctDebFCErr_CW "" VALUE 0x00720254 Val_Wu8 1 OneToOne 0.0 255.00 FORMAT "%8.2" /end CHARACTERISTIC
/begin CHARACTERISTIC MoCSOP_swtRepFaildEPBTest_C "" VALUE 0x00720258 Val_Wu8 1 OneToOne 0.0 255.00 FORMAT "%8.2" /end CHARACTERISTIC
/begin CHARACTERISTIC MoCMem_noMEMChkRst_CW "" VALUE 0x00720245 Val_Wu8 1 OneToOne 0.0 255.00 FORMAT "%8.2" /end CHARACTERISTIC
/begin CHARACTERISTIC MoCMem_noMEMChkRstCpl_CW "" VALUE 0x00720249 Val_Wu8 1 OneToOne 0.0 255.00 FORMAT "%8.2" /end CHARACTERISTIC
/begin CHARACTERISTIC u_Emm_DemEventInfo_RAMDED_C "" VALUE 0x00720485 Val_Wu8 1 OneToOne 0.0 255.00 FORMAT "%8.2" /end CHARACTERISTIC
/begin CHARACTERISTIC u_Emm_DemEventInfo_FLSDED_C "" VALUE 0x00720486 Val_Wu8 1 OneToOne 0.0 255.00 FORMAT "%8.2" /end CHARACTERISTIC
/begin CHARACTERISTIC u_Emm_DemEventInfo_CLMA_C "" VALUE 0x00720487 Val_Wu8 1 OneToOne 0.0 255.00 FORMAT "%8.2" /end CHARACTERISTIC
/begin CHARACTERISTIC u_Emm_DemEventInfo_DCLS_C "" VALUE 0x00720488 Val_Wu8 1 OneToOne 0.0 255.00 FORMAT "%8.2" /end CHARACTERISTIC
/begin CHARACTERISTIC u_Emm_DemEventInfo_BUS_C "" VALUE 0x00720489 Val_Wu8 1 OneToOne 0.0 255.00 FORMAT "%8.2" /end CHARACTERISTIC
/begin CHARACTERISTIC u_Emm_DemEventInfo_MPU_C "" VALUE 0x0072048a Val_Wu8 1 OneToOne 0.0 255.00 FORMAT "%8.2" /end CHARACTERISTIC
/begin CHARACTERISTIC u_Emm_DemEventInfo_BIST_C "" VALUE 0x0072048b Val_Wu8 1 OneToOne 0.0 255.00 FORMAT "%8.2" /end CHARACTERISTIC
/begin CHARACTERISTIC Tlib_ModeM_10MinTimer_C "" VALUE 0x00721f56 Val_Wu16 1 OneToOne 0.0 65535 FORMAT "%8.2" /end CHARACTERISTIC
/begin CHARACTERISTIC Tlib_ModeM_Timer_Debug "" VALUE 0x00721f54 Val_Wu16 1 OneToOne 0.0 65535 FORMAT "%8.2" /end CHARACTERISTIC
/begin CHARACTERISTIC Tlib_ModeM_WakeUpTimer_C "" VALUE 0x00721f58 Val_Wu16 1 OneToOne 0.0 65535 FORMAT "%8.2" /end CHARACTERISTIC
/begin CHARACTERISTIC Tlib_ModeM_WakeUpTimerMax_C "" VALUE 0x00721f5a Val_Wu16 1 OneToOne 0.0 65535 FORMAT "%8.2" /end CHARACTERISTIC
/begin CHARACTERISTIC Tlib_ModeM_RunTimer_C "" VALUE 0x00721f5c Val_Wu16 1 OneToOne 0.0 65535 FORMAT "%8.2" /end CHARACTERISTIC
/begin CHARACTERISTIC Tlib_ModeM_PostRunTimer_C "" VALUE 0x00721f5e Val_Wu16 1 OneToOne 0.0 65535 FORMAT "%8.2" /end CHARACTERISTIC
/begin CHARACTERISTIC Tlib_ModeM_u8CalibDebug_C "" VALUE 0x00721f60 Val_Wu8 1 OneToOne 0.0 255.00 FORMAT "%8.2" /end CHARACTERISTIC
/begin CHARACTERISTIC Tlib_ModeM_PowerModeState_C "" VALUE 0x00721f61 Val_Wu8 1 OneToOne 0.0 255.00 FORMAT "%8.2" /end CHARACTERISTIC
/begin CHARACTERISTIC Tlib_ModeM_bPollingKeepAlive_C "" VALUE 0x00721f62 Val_Wu8 1 OneToOne 0.0 255.00 FORMAT "%8.2" /end CHARACTERISTIC
/begin CHARACTERISTIC Tlib_ModeM_bPollingState_C "" VALUE 0x00721f63 Val_Wu8 1 OneToOne 0.0 255.00 FORMAT "%8.2" /end CHARACTERISTIC
/begin CHARACTERISTIC Tlib_ModeM_u32PollingPeriod_C "" VALUE 0x00721f50 Val_Wu32 1 OneToOne 0.0 4294967295 FORMAT "%8.2" /end CHARACTERISTIC
/begin CHARACTERISTIC Tlib_ModeM_bZCWorkRequest_C "" VALUE 0x00721f64 Val_Wu8 1 OneToOne 0.0 255.00 FORMAT "%8.2" /end CHARACTERISTIC
/begin CHARACTERISTIC Tlib_ModeM_u8ZCWorkRequestList_C "" VAL_BLK 0x00721f48 Val_Wu8 1 OneToOne 0.0 255.00 FORMAT "%8.2" NUMBER 8 /end CHARACTERISTIC
/*********** Start of merged MEASUREMENT blocks ***********/
/begin MEASUREMENT Tlib_FrntHvacFanBattU_ZCR_LIN2 "" UWORD RB_RBA_Common_CentralElements_CompuMethods_Identical 1 100 0.0 65535 FORMAT "%8.2" ECU_ADDRESS 0xfe40278c /end MEASUREMENT
/begin MEASUREMENT Tlib_FrntHvacSpDetd_ZCR_LIN2 "" UBYTE RB_RBA_Common_CentralElements_CompuMethods_Identical 1 100 0.0 255.00 FORMAT "%8.2" ECU_ADDRESS 0xfe402cca /end MEASUREMENT
/begin MEASUREMENT Tlib_FrntHvacFanDiagFlag1_ZCR_LIN2 "" UBYTE RB_RBA_Common_CentralElements_CompuMethods_Identical 1 100 0.0 255.00 FORMAT "%8.2" ECU_ADDRESS 0xfe402ccb /end MEASUREMENT
/begin MEASUREMENT Tlib_FrntHvacUDetdLo_ZCR_LIN2 "" UBYTE RB_RBA_Common_CentralElements_CompuMethods_Identical 1 100 0.0 255.00 FORMAT "%8.2" ECU_ADDRESS 0xfe402ccc /end MEASUREMENT
/begin MEASUREMENT Tlib_FrntHvacFanSpdFd_ZCR_LIN2 "" UBYTE RB_RBA_Common_CentralElements_CompuMethods_Identical 1 100 0.0 255.00 FORMAT "%8.2" ECU_ADDRESS 0xfe402ccd /end MEASUREMENT
/begin MEASUREMENT Tlib_FrntHvacHvDetd_ZCR_LIN2 "" UBYTE RB_RBA_Common_CentralElements_CompuMethods_Identical 1 100 0.0 255.00 FORMAT "%8.2" ECU_ADDRESS 0xfe402cce /end MEASUREMENT
/begin MEASUREMENT Tlib_FrntHvacFanSupplier_ZCR_LIN2 "" UBYTE RB_RBA_Common_CentralElements_CompuMethods_Identical 1 100 0.0 255.00 FORMAT "%8.2" ECU_ADDRESS 0xfe402ccf /end MEASUREMENT
/begin MEASUREMENT Tlib_FrntHvacOverCurrErr_ZCR_LIN2 "" UBYTE RB_RBA_Common_CentralElements_CompuMethods_Identical 1 100 0.0 255.00 FORMAT "%8.2" ECU_ADDRESS 0xfe402cd0 /end MEASUREMENT
/begin MEASUREMENT Tlib_FrntHvacFanBattI_ZCR_LIN2 "" UBYTE RB_RBA_Common_CentralElements_CompuMethods_Identical 1 100 0.0 255.00 FORMAT "%8.2" ECU_ADDRESS 0xfe402cd1 /end MEASUREMENT
/begin MEASUREMENT Tlib_FrntHvacFanTErr_ZCR_LIN2 "" UBYTE RB_RBA_Common_CentralElements_CompuMethods_Identical 1 100 0.0 255.00 FORMAT "%8.2" ECU_ADDRESS 0xfe402cd2 /end MEASUREMENT
/begin MEASUREMENT Tlib_FrntHvacFanIntErr_ZCR_LIN2 "" UBYTE RB_RBA_Common_CentralElements_CompuMethods_Identical 1 100 0.0 255.00 FORMAT "%8.2" ECU_ADDRESS 0xfe402cd3 /end MEASUREMENT
/begin MEASUREMENT Tlib_FrntHvacFanVersion_ZCR_LIN2 "" UBYTE RB_RBA_Common_CentralElements_CompuMethods_Identical 1 100 0.0 255.00 FORMAT "%8.2" ECU_ADDRESS 0xfe402cd4 /end MEASUREMENT
/begin MEASUREMENT Tlib_FrntHvacFanDirFd_ZCR_LIN2 "" UBYTE RB_RBA_Common_CentralElements_CompuMethods_Identical 1 100 0.0 255.00 FORMAT "%8.2" ECU_ADDRESS 0xfe402cd5 /end MEASUREMENT
/begin MEASUREMENT Tlib_FrntHvacFanT_ZCR_LIN2 "" UBYTE RB_RBA_Common_CentralElements_CompuMethods_Identical 1 100 0.0 255.00 FORMAT "%8.2" ECU_ADDRESS 0xfe402cd6 /end MEASUREMENT
/begin MEASUREMENT Tlib_FrntHvacFanILimn_ZCR_LIN2 "" UBYTE RB_RBA_Common_CentralElements_CompuMethods_Identical 1 100 0.0 255.00 FORMAT "%8.2" ECU_ADDRESS 0xfe402cd7 /end MEASUREMENT
/begin MEASUREMENT Tlib_FrntHvacSpdSts_ZCR_LIN2 "" UBYTE RB_RBA_Common_CentralElements_CompuMethods_Identical 1 100 0.0 255.00 FORMAT "%8.2" ECU_ADDRESS 0xfe402cd8 /end MEASUREMENT
/begin MEASUREMENT Tlib_FrntHvacFanCircShoOrMotBlkd_ZCR_LIN2 "" UBYTE RB_RBA_Common_CentralElements_CompuMethods_Identical 1 100 0.0 255.00 FORMAT "%8.2" ECU_ADDRESS 0xfe402cd9 /end MEASUREMENT
/begin MEASUREMENT Tlib_FrntHvacSftyModEnad_ZCR_LIN2 "" UBYTE RB_RBA_Common_CentralElements_CompuMethods_Identical 1 100 0.0 255.00 FORMAT "%8.2" ECU_ADDRESS 0xfe402cda /end MEASUREMENT
/begin MEASUREMENT Tlib_HfafActr2UrgcSts_ZCR_LIN2 "" UBYTE RB_RBA_Common_CentralElements_CompuMethods_Identical 1 100 0.0 255.00 FORMAT "%8.2" ECU_ADDRESS 0xfe402cdb /end MEASUREMENT
/begin MEASUREMENT Tlib_HfafActr2SpclFct_ZCR_LIN2 "" UBYTE RB_RBA_Common_CentralElements_CompuMethods_Identical 1 100 0.0 255.00 FORMAT "%8.2" ECU_ADDRESS 0xfe402cdc /end MEASUREMENT
/begin MEASUREMENT Tlib_HfafActr2UrgcExist_ZCR_LIN2 "" UBYTE RB_RBA_Common_CentralElements_CompuMethods_Identical 1 100 0.0 255.00 FORMAT "%8.2" ECU_ADDRESS 0xfe402cdd /end MEASUREMENT
/begin MEASUREMENT Tlib_HfafActr2PsonSts_ZCR_LIN2 "" UBYTE RB_RBA_Common_CentralElements_CompuMethods_Identical 1 100 0.0 255.00 FORMAT "%8.2" ECU_ADDRESS 0xfe402cde /end MEASUREMENT
/begin MEASUREMENT Tlib_HfafActr2SpdSts_ZCR_LIN2 "" UBYTE RB_RBA_Common_CentralElements_CompuMethods_Identical 1 100 0.0 255.00 FORMAT "%8.2" ECU_ADDRESS 0xfe402cdf /end MEASUREMENT
/begin MEASUREMENT Tlib_HfafActr2OvrTempErr_ZCR_LIN2 "" UBYTE RB_RBA_Common_CentralElements_CompuMethods_Identical 1 100 0.0 255.00 FORMAT "%8.2" ECU_ADDRESS 0xfe402ce0 /end MEASUREMENT
/begin MEASUREMENT Tlib_HfafActr2BusAdr_ZCR_LIN2 "" UBYTE RB_RBA_Common_CentralElements_CompuMethods_Identical 1 100 0.0 255.00 FORMAT "%8.2" ECU_ADDRESS 0xfe402ce1 /end MEASUREMENT
/begin MEASUREMENT Tlib_HfafActr2UrgcPson_ZCR_LIN2 "" UBYTE RB_RBA_Common_CentralElements_CompuMethods_Identical 1 100 0.0 255.00 FORMAT "%8.2" ECU_ADDRESS 0xfe402ce2 /end MEASUREMENT
/begin MEASUREMENT Tlib_HfafActr2CoilSts_ZCR_LIN2 "" UBYTE RB_RBA_Common_CentralElements_CompuMethods_Identical 1 100 0.0 255.00 FORMAT "%8.2" ECU_ADDRESS 0xfe402ce3 /end MEASUREMENT
/begin MEASUREMENT Tlib_HfafActr2TrqSts_ZCR_LIN2 "" UBYTE RB_RBA_Common_CentralElements_CompuMethods_Identical 1 100 0.0 255.00 FORMAT "%8.2" ECU_ADDRESS 0xfe402ce4 /end MEASUREMENT
/begin MEASUREMENT Tlib_HfafActr2ActPson_ZCR_LIN2 "" UWORD RB_RBA_Common_CentralElements_CompuMethods_Identical 1 100 0.0 65535 FORMAT "%8.2" ECU_ADDRESS 0xfe40278e /end MEASUREMENT
/begin MEASUREMENT Tlib_HfafActr2Mode_ZCR_LIN2 "" UBYTE RB_RBA_Common_CentralElements_CompuMethods_Identical 1 100 0.0 255.00 FORMAT "%8.2" ECU_ADDRESS 0xfe402ce5 /end MEASUREMENT
/begin MEASUREMENT Tlib_HfafActr2ElecErr_ZCR_LIN2 "" UBYTE RB_RBA_Common_CentralElements_CompuMethods_Identical 1 100 0.0 255.00 FORMAT "%8.2" ECU_ADDRESS 0xfe402ce6 /end MEASUREMENT
/begin MEASUREMENT Tlib_HfafActr2VoltErr_ZCR_LIN2 "" UBYTE RB_RBA_Common_CentralElements_CompuMethods_Identical 1 100 0.0 255.00 FORMAT "%8.2" ECU_ADDRESS 0xfe402ce7 /end MEASUREMENT
/begin MEASUREMENT Tlib_HfafActr2ResetSts_ZCR_LIN2 "" UBYTE RB_RBA_Common_CentralElements_CompuMethods_Identical 1 100 0.0 255.00 FORMAT "%8.2" ECU_ADDRESS 0xfe402ce8 /end MEASUREMENT
/begin MEASUREMENT Tlib_HfafActr2DrvDir_ZCR_LIN2 "" UBYTE RB_RBA_Common_CentralElements_CompuMethods_Identical 1 100 0.0 255.00 FORMAT "%8.2" ECU_ADDRESS 0xfe402ce9 /end MEASUREMENT
/begin MEASUREMENT Tlib_HfafActr2BlckSts_ZCR_LIN2 "" UBYTE RB_RBA_Common_CentralElements_CompuMethods_Identical 1 100 0.0 255.00 FORMAT "%8.2" ECU_ADDRESS 0xfe402cea /end MEASUREMENT
/begin MEASUREMENT Tlib_HfafActr2MovDir_ZCR_LIN2 "" UBYTE RB_RBA_Common_CentralElements_CompuMethods_Identical 1 100 0.0 255.00 FORMAT "%8.2" ECU_ADDRESS 0xfe402ceb /end MEASUREMENT
/begin MEASUREMENT Tlib_HfafActr2BlckInd_ZCR_LIN2 "" UBYTE RB_RBA_Common_CentralElements_CompuMethods_Identical 1 100 0.0 255.00 FORMAT "%8.2" ECU_ADDRESS 0xfe402cec /end MEASUREMENT
/begin MEASUREMENT Tlib_HfafActr1SpdSts_ZCR_LIN2 "" UBYTE RB_RBA_Common_CentralElements_CompuMethods_Identical 1 100 0.0 255.00 FORMAT "%8.2" ECU_ADDRESS 0xfe402ced /end MEASUREMENT
/begin MEASUREMENT Tlib_HfafActr1UrgcPson_ZCR_LIN2 "" UBYTE RB_RBA_Common_CentralElements_CompuMethods_Identical 1 100 0.0 255.00 FORMAT "%8.2" ECU_ADDRESS 0xfe402cee /end MEASUREMENT
/begin MEASUREMENT Tlib_HfafActr1OvrTempErr_ZCR_LIN2 "" UBYTE RB_RBA_Common_CentralElements_CompuMethods_Identical 1 100 0.0 255.00 FORMAT "%8.2" ECU_ADDRESS 0xfe402cef /end MEASUREMENT
/begin MEASUREMENT Tlib_HfafActr1ActPson_ZCR_LIN2 "" UWORD RB_RBA_Common_CentralElements_CompuMethods_Identical 1 100 0.0 65535 FORMAT "%8.2" ECU_ADDRESS 0xfe402790 /end MEASUREMENT
/begin MEASUREMENT Tlib_HfafActr1PsonSts_ZCR_LIN2 "" UBYTE RB_RBA_Common_CentralElements_CompuMethods_Identical 1 100 0.0 255.00 FORMAT "%8.2" ECU_ADDRESS 0xfe402cf0 /end MEASUREMENT
/begin MEASUREMENT Tlib_HfafActr1MovDir_ZCR_LIN2 "" UBYTE RB_RBA_Common_CentralElements_CompuMethods_Identical 1 100 0.0 255.00 FORMAT "%8.2" ECU_ADDRESS 0xfe402cf1 /end MEASUREMENT
/begin MEASUREMENT Tlib_HfafActr1CoilSts_ZCR_LIN2 "" UBYTE RB_RBA_Common_CentralElements_CompuMethods_Identical 1 100 0.0 255.00 FORMAT "%8.2" ECU_ADDRESS 0xfe402cf2 /end MEASUREMENT
/begin MEASUREMENT Tlib_HfafActr1UrgcExist_ZCR_LIN2 "" UBYTE RB_RBA_Common_CentralElements_CompuMethods_Identical 1 100 0.0 255.00 FORMAT "%8.2" ECU_ADDRESS 0xfe402cf3 /end MEASUREMENT
/begin MEASUREMENT Tlib_HfafActr1DrvDir_ZCR_LIN2 "" UBYTE RB_RBA_Common_CentralElements_CompuMethods_Identical 1 100 0.0 255.00 FORMAT "%8.2" ECU_ADDRESS 0xfe402cf4 /end MEASUREMENT
/begin MEASUREMENT Tlib_HfafActr1TrqSts_ZCR_LIN2 "" UBYTE RB_RBA_Common_CentralElements_CompuMethods_Identical 1 100 0.0 255.00 FORMAT "%8.2" ECU_ADDRESS 0xfe402cf5 /end MEASUREMENT
/begin MEASUREMENT Tlib_HfafActr1BusAdr_ZCR_LIN2 "" UBYTE RB_RBA_Common_CentralElements_CompuMethods_Identical 1 100 0.0 255.00 FORMAT "%8.2" ECU_ADDRESS 0xfe402cf6 /end MEASUREMENT
/begin MEASUREMENT Tlib_HfafActr1ResetSts_ZCR_LIN2 "" UBYTE RB_RBA_Common_CentralElements_CompuMethods_Identical 1 100 0.0 255.00 FORMAT "%8.2" ECU_ADDRESS 0xfe402cf7 /end MEASUREMENT
/begin MEASUREMENT Tlib_HfafActr1BlckSts_ZCR_LIN2 "" UBYTE RB_RBA_Common_CentralElements_CompuMethods_Identical 1 100 0.0 255.00 FORMAT "%8.2" ECU_ADDRESS 0xfe402cf8 /end MEASUREMENT
/begin MEASUREMENT Tlib_HfafActr1BlckInd_ZCR_LIN2 "" UBYTE RB_RBA_Common_CentralElements_CompuMethods_Identical 1 100 0.0 255.00 FORMAT "%8.2" ECU_ADDRESS 0xfe402cf9 /end MEASUREMENT
/begin MEASUREMENT Tlib_HfafActr1VoltErr_ZCR_LIN2 "" UBYTE RB_RBA_Common_CentralElements_CompuMethods_Identical 1 100 0.0 255.00 FORMAT "%8.2" ECU_ADDRESS 0xfe402cfa /end MEASUREMENT
/begin MEASUREMENT Tlib_HfafActr1ElecErr_ZCR_LIN2 "" UBYTE RB_RBA_Common_CentralElements_CompuMethods_Identical 1 100 0.0 255.00 FORMAT "%8.2" ECU_ADDRESS 0xfe402cfb /end MEASUREMENT
/begin MEASUREMENT Tlib_HfafActr1UrgcSts_ZCR_LIN2 "" UBYTE RB_RBA_Common_CentralElements_CompuMethods_Identical 1 100 0.0 255.00 FORMAT "%8.2" ECU_ADDRESS 0xfe402cfc /end MEASUREMENT
/begin MEASUREMENT Tlib_HfafActr1Mode_ZCR_LIN2 "" UBYTE RB_RBA_Common_CentralElements_CompuMethods_Identical 1 100 0.0 255.00 FORMAT "%8.2" ECU_ADDRESS 0xfe402cfd /end MEASUREMENT
/begin MEASUREMENT Tlib_HfafActr1SpclFct_ZCR_LIN2 "" UBYTE RB_RBA_Common_CentralElements_CompuMethods_Identical 1 100 0.0 255.00 FORMAT "%8.2" ECU_ADDRESS 0xfe402cfe /end MEASUREMENT
/begin MEASUREMENT Tlib_HfafActr3SpclFct_ZCR_LIN2 "" UBYTE RB_RBA_Common_CentralElements_CompuMethods_Identical 1 100 0.0 255.00 FORMAT "%8.2" ECU_ADDRESS 0xfe402cff /end MEASUREMENT
/begin MEASUREMENT Tlib_HfafActr3ResetSts_ZCR_LIN2 "" UBYTE RB_RBA_Common_CentralElements_CompuMethods_Identical 1 100 0.0 255.00 FORMAT "%8.2" ECU_ADDRESS 0xfe402d00 /end MEASUREMENT
/begin MEASUREMENT Tlib_HfafActr3UrgcExist_ZCR_LIN2 "" UBYTE RB_RBA_Common_CentralElements_CompuMethods_Identical 1 100 0.0 255.00 FORMAT "%8.2" ECU_ADDRESS 0xfe402d01 /end MEASUREMENT
/begin MEASUREMENT Tlib_HfafActr3BlckSts_ZCR_LIN2 "" UBYTE RB_RBA_Common_CentralElements_CompuMethods_Identical 1 100 0.0 255.00 FORMAT "%8.2" ECU_ADDRESS 0xfe402d02 /end MEASUREMENT
/begin MEASUREMENT Tlib_HfafActr3OvrTempErr_ZCR_LIN2 "" UBYTE RB_RBA_Common_CentralElements_CompuMethods_Identical 1 100 0.0 255.00 FORMAT "%8.2" ECU_ADDRESS 0xfe402d03 /end MEASUREMENT
/begin MEASUREMENT Tlib_HfafActr3ElecErr_ZCR_LIN2 "" UBYTE RB_RBA_Common_CentralElements_CompuMethods_Identical 1 100 0.0 255.00 FORMAT "%8.2" ECU_ADDRESS 0xfe402d04 /end MEASUREMENT
/begin MEASUREMENT Tlib_HfafActr3UrgcSts_ZCR_LIN2 "" UBYTE RB_RBA_Common_CentralElements_CompuMethods_Identical 1 100 0.0 255.00 FORMAT "%8.2" ECU_ADDRESS 0xfe402d05 /end MEASUREMENT
/begin MEASUREMENT Tlib_HfafActr3ActPson_ZCR_LIN2 "" UWORD RB_RBA_Common_CentralElements_CompuMethods_Identical 1 100 0.0 65535 FORMAT "%8.2" ECU_ADDRESS 0xfe402792 /end MEASUREMENT
/begin MEASUREMENT Tlib_HfafActr3SpdSts_ZCR_LIN2 "" UBYTE RB_RBA_Common_CentralElements_CompuMethods_Identical 1 100 0.0 255.00 FORMAT "%8.2" ECU_ADDRESS 0xfe402d06 /end MEASUREMENT
/begin MEASUREMENT Tlib_HfafActr3UrgcPson_ZCR_LIN2 "" UBYTE RB_RBA_Common_CentralElements_CompuMethods_Identical 1 100 0.0 255.00 FORMAT "%8.2" ECU_ADDRESS 0xfe402d07 /end MEASUREMENT
/begin MEASUREMENT Tlib_HfafActr3MovDir_ZCR_LIN2 "" UBYTE RB_RBA_Common_CentralElements_CompuMethods_Identical 1 100 0.0 255.00 FORMAT "%8.2" ECU_ADDRESS 0xfe402d08 /end MEASUREMENT
/begin MEASUREMENT Tlib_HfafActr3VoltErr_ZCR_LIN2 "" UBYTE RB_RBA_Common_CentralElements_CompuMethods_Identical 1 100 0.0 255.00 FORMAT "%8.2" ECU_ADDRESS 0xfe402d09 /end MEASUREMENT
/begin MEASUREMENT Tlib_HfafActr3BlckInd_ZCR_LIN2 "" UBYTE RB_RBA_Common_CentralElements_CompuMethods_Identical 1 100 0.0 255.00 FORMAT "%8.2" ECU_ADDRESS 0xfe402d0a /end MEASUREMENT
/begin MEASUREMENT Tlib_HfafActr3BusAdr_ZCR_LIN2 "" UBYTE RB_RBA_Common_CentralElements_CompuMethods_Identical 1 100 0.0 255.00 FORMAT "%8.2" ECU_ADDRESS 0xfe402d0b /end MEASUREMENT
/begin MEASUREMENT Tlib_HfafActr3PsonSts_ZCR_LIN2 "" UBYTE RB_RBA_Common_CentralElements_CompuMethods_Identical 1 100 0.0 255.00 FORMAT "%8.2" ECU_ADDRESS 0xfe402d0c /end MEASUREMENT
/begin MEASUREMENT Tlib_HfafActr3DrvDir_ZCR_LIN2 "" UBYTE RB_RBA_Common_CentralElements_CompuMethods_Identical 1 100 0.0 255.00 FORMAT "%8.2" ECU_ADDRESS 0xfe402d0d /end MEASUREMENT
/begin MEASUREMENT Tlib_HfafActr3Mode_ZCR_LIN2 "" UBYTE RB_RBA_Common_CentralElements_CompuMethods_Identical 1 100 0.0 255.00 FORMAT "%8.2" ECU_ADDRESS 0xfe402d0e /end MEASUREMENT
/begin MEASUREMENT Tlib_HfafActr3CoilSts_ZCR_LIN2 "" UBYTE RB_RBA_Common_CentralElements_CompuMethods_Identical 1 100 0.0 255.00 FORMAT "%8.2" ECU_ADDRESS 0xfe402d0f /end MEASUREMENT
/begin MEASUREMENT Tlib_HfafActr3TrqSts_ZCR_LIN2 "" UBYTE RB_RBA_Common_CentralElements_CompuMethods_Identical 1 100 0.0 255.00 FORMAT "%8.2" ECU_ADDRESS 0xfe402d10 /end MEASUREMENT
/begin MEASUREMENT Tlib_ActnOfLedLoBeamCntr4_LowPowerCANFD "" UBYTE RB_RBA_Common_CentralElements_CompuMethods_Identical 1 100 0.0 255.00 FORMAT "%8.2" ECU_ADDRESS 0xfe402d11 /end MEASUREMENT
/begin MEASUREMENT Tlib_ActnOfLedLoBeamOnOffSafe1_LowPowerCANFD "" UBYTE RB_RBA_Common_CentralElements_CompuMethods_Identical 1 100 0.0 255.00 FORMAT "%8.2" ECU_ADDRESS 0xfe402d12 /end MEASUREMENT
/begin MEASUREMENT Tlib_ActnOfLedLoBeamDataID4_LowPowerCANFD "" UBYTE RB_RBA_Common_CentralElements_CompuMethods_Identical 1 100 0.0 255.00 FORMAT "%8.2" ECU_ADDRESS 0xfe402d13 /end MEASUREMENT
/begin MEASUREMENT Tlib_ActnOfLedLoBeamChks8_LowPowerCANFD "" UBYTE RB_RBA_Common_CentralElements_CompuMethods_Identical 1 100 0.0 255.00 FORMAT "%8.2" ECU_ADDRESS 0xfe402d14 /end MEASUREMENT
/begin MEASUREMENT Tlib_ActvnOfHndlDoorLi1HndlDoorLiDrvr_LowPowerCANFD "" UBYTE RB_RBA_Common_CentralElements_CompuMethods_Identical 1 100 0.0 255.00 FORMAT "%8.2" ECU_ADDRESS 0xfe402d15 /end MEASUREMENT
/begin MEASUREMENT Tlib_ActvnOfHndlDoorLi1HndlDoorLiPass_LowPowerCANFD "" UBYTE RB_RBA_Common_CentralElements_CompuMethods_Identical 1 100 0.0 255.00 FORMAT "%8.2" ECU_ADDRESS 0xfe402d16 /end MEASUREMENT
/begin MEASUREMENT Tlib_ActvnOfHndlDoorLi1HndlDoorLiDrvrRe_LowPowerCANFD "" UBYTE RB_RBA_Common_CentralElements_CompuMethods_Identical 1 100 0.0 255.00 FORMAT "%8.2" ECU_ADDRESS 0xfe402d17 /end MEASUREMENT
/begin MEASUREMENT Tlib_ActvnOfHndlDoorLi1HndlDoorLiPassRe_LowPowerCANFD "" UBYTE RB_RBA_Common_CentralElements_CompuMethods_Identical 1 100 0.0 255.00 FORMAT "%8.2" ECU_ADDRESS 0xfe402d18 /end MEASUREMENT
/begin MEASUREMENT Tlib_ActvnOfWaitMode_LowPowerCANFD "" UBYTE RB_RBA_Common_CentralElements_CompuMethods_Identical 1 100 0.0 255.00 FORMAT "%8.2" ECU_ADDRESS 0xfe402d19 /end MEASUREMENT
/begin MEASUREMENT Tlib_ActnOfLedFrntCrossLamp_LowPowerCANFD "" UBYTE RB_RBA_Common_CentralElements_CompuMethods_Identical 1 100 0.0 255.00 FORMAT "%8.2" ECU_ADDRESS 0xfe402d1a /end MEASUREMENT
/begin MEASUREMENT Tlib_ActvnOfLiForSpkr_LowPowerCANFD "" UBYTE RB_RBA_Common_CentralElements_CompuMethods_Identical 1 100 0.0 255.00 FORMAT "%8.2" ECU_ADDRESS 0xfe402d1b /end MEASUREMENT
/begin MEASUREMENT Tlib_ActnOfLedGrilleLampDyn_LowPowerCANFD "" UBYTE RB_RBA_Common_CentralElements_CompuMethods_Identical 1 100 0.0 255.00 FORMAT "%8.2" ECU_ADDRESS 0xfe402d1c /end MEASUREMENT
/begin MEASUREMENT Tlib_ShortDropWinPassDoor_LowPowerCANFD "" UBYTE RB_RBA_Common_CentralElements_CompuMethods_Identical 1 100 0.0 255.00 FORMAT "%8.2" ECU_ADDRESS 0xfe402d1d /end MEASUREMENT
/begin MEASUREMENT Tlib_ActnOfLedGrilleLamp_LowPowerCANFD "" UBYTE RB_RBA_Common_CentralElements_CompuMethods_Identical 1 100 0.0 255.00 FORMAT "%8.2" ECU_ADDRESS 0xfe402d1e /end MEASUREMENT
/begin MEASUREMENT Tlib_ActnOfLedDaytiRunngLamp_LowPowerCANFD "" UBYTE RB_RBA_Common_CentralElements_CompuMethods_Identical 1 100 0.0 255.00 FORMAT "%8.2" ECU_ADDRESS 0xfe402d1f /end MEASUREMENT
/begin MEASUREMENT Tlib_ActnOfLedFrntCrossLampDyn_LowPowerCANFD "" UBYTE RB_RBA_Common_CentralElements_CompuMethods_Identical 1 100 0.0 255.00 FORMAT "%8.2" ECU_ADDRESS 0xfe402d20 /end MEASUREMENT
/begin MEASUREMENT Tlib_ActvnOfIndcrIndcrOut_LowPowerCANFD "" UBYTE RB_RBA_Common_CentralElements_CompuMethods_Identical 1 100 0.0 255.00 FORMAT "%8.2" ECU_ADDRESS 0xfe402d21 /end MEASUREMENT
/begin MEASUREMENT Tlib_ActvnOfIndcrChks8_LowPowerCANFD "" UBYTE RB_RBA_Common_CentralElements_CompuMethods_Identical 1 100 0.0 255.00 FORMAT "%8.2" ECU_ADDRESS 0xfe402d22 /end MEASUREMENT
/begin MEASUREMENT Tlib_ActvnOfIndcrCntr4_LowPowerCANFD "" UBYTE RB_RBA_Common_CentralElements_CompuMethods_Identical 1 100 0.0 255.00 FORMAT "%8.2" ECU_ADDRESS 0xfe402d23 /end MEASUREMENT
/begin MEASUREMENT Tlib_ActvnOfIndcrDataID4_LowPowerCANFD "" UBYTE RB_RBA_Common_CentralElements_CompuMethods_Identical 1 100 0.0 255.00 FORMAT "%8.2" ECU_ADDRESS 0xfe402d24 /end MEASUREMENT
/begin MEASUREMENT Tlib_RoadInclnForPOD_LowPowerCANFD "" UBYTE RB_RBA_Common_CentralElements_CompuMethods_Identical 1 100 0.0 255.00 FORMAT "%8.2" ECU_ADDRESS 0xfe402d25 /end MEASUREMENT
/begin MEASUREMENT Tlib_ActvnOfHomeSafe_LowPowerCANFD "" UBYTE RB_RBA_Common_CentralElements_CompuMethods_Identical 1 100 0.0 255.00 FORMAT "%8.2" ECU_ADDRESS 0xfe402d26 /end MEASUREMENT
/begin MEASUREMENT Tlib_ActvnOfCarLoctr_LowPowerCANFD "" UBYTE RB_RBA_Common_CentralElements_CompuMethods_Identical 1 100 0.0 255.00 FORMAT "%8.2" ECU_ADDRESS 0xfe402d27 /end MEASUREMENT
/begin MEASUREMENT Tlib_ActvnOfGoodByeLi_LowPowerCANFD "" UBYTE RB_RBA_Common_CentralElements_CompuMethods_Identical 1 100 0.0 255.00 FORMAT "%8.2" ECU_ADDRESS 0xfe402d28 /end MEASUREMENT
/begin MEASUREMENT Tlib_ActvnOfLiForComity_LowPowerCANFD "" UBYTE RB_RBA_Common_CentralElements_CompuMethods_Identical 1 100 0.0 255.00 FORMAT "%8.2" ECU_ADDRESS 0xfe402d29 /end MEASUREMENT
/begin MEASUREMENT Tlib_ActvnOfWelcomeLi_LowPowerCANFD "" UBYTE RB_RBA_Common_CentralElements_CompuMethods_Identical 1 100 0.0 255.00 FORMAT "%8.2" ECU_ADDRESS 0xfe402d2a /end MEASUREMENT
/begin MEASUREMENT Tlib_ActvnOfApproach_LowPowerCANFD "" UBYTE RB_RBA_Common_CentralElements_CompuMethods_Identical 1 100 0.0 255.00 FORMAT "%8.2" ECU_ADDRESS 0xfe402d2b /end MEASUREMENT
/begin MEASUREMENT Tlib_DoorRiReHndlCmd_LowPowerCANFD "" UBYTE RB_RBA_Common_CentralElements_CompuMethods_Identical 1 100 0.0 255.00 FORMAT "%8.2" ECU_ADDRESS 0xfe402d2c /end MEASUREMENT
/begin MEASUREMENT Tlib_ActnOfLedHiBeam_LowPowerCANFD "" UBYTE RB_RBA_Common_CentralElements_CompuMethods_Identical 1 100 0.0 255.00 FORMAT "%8.2" ECU_ADDRESS 0xfe402d2d /end MEASUREMENT
/begin MEASUREMENT Tlib_DoorPassHndlCmd_LowPowerCANFD "" UBYTE RB_RBA_Common_CentralElements_CompuMethods_Identical 1 100 0.0 255.00 FORMAT "%8.2" ECU_ADDRESS 0xfe402d2e /end MEASUREMENT
/begin MEASUREMENT Tlib_ActnOfLedFrntFogLamp_LowPowerCANFD "" UBYTE RB_RBA_Common_CentralElements_CompuMethods_Identical 1 100 0.0 255.00 FORMAT "%8.2" ECU_ADDRESS 0xfe402d2f /end MEASUREMENT
/begin MEASUREMENT Tlib_ActvnOfLiForWait_LowPowerCANFD "" UBYTE RB_RBA_Common_CentralElements_CompuMethods_Identical 1 100 0.0 255.00 FORMAT "%8.2" ECU_ADDRESS 0xfe402d30 /end MEASUREMENT
/begin MEASUREMENT Tlib_ActnOfLedCornrgLampRi_LowPowerCANFD "" UBYTE RB_RBA_Common_CentralElements_CompuMethods_Identical 1 100 0.0 255.00 FORMAT "%8.2" ECU_ADDRESS 0xfe402d31 /end MEASUREMENT
/begin MEASUREMENT Tlib_ActvnOfPudLi_LowPowerCANFD "" UBYTE RB_RBA_Common_CentralElements_CompuMethods_Identical 1 100 0.0 255.00 FORMAT "%8.2" ECU_ADDRESS 0xfe402d32 /end MEASUREMENT
/begin MEASUREMENT Tlib_RollAgGlbForPOD_LowPowerCANFD "" UBYTE RB_RBA_Common_CentralElements_CompuMethods_Identical 1 100 0.0 255.00 FORMAT "%8.2" ECU_ADDRESS 0xfe402d33 /end MEASUREMENT
/begin MEASUREMENT Tlib_AntiPinchDsblPass_LowPowerCANFD "" UBYTE RB_RBA_Common_CentralElements_CompuMethods_Identical 1 100 0.0 255.00 FORMAT "%8.2" ECU_ADDRESS 0xfe402d34 /end MEASUREMENT
/begin MEASUREMENT Tlib_AntiPinchDsblReRi_LowPowerCANFD "" UBYTE RB_RBA_Common_CentralElements_CompuMethods_Identical 1 100 0.0 255.00 FORMAT "%8.2" ECU_ADDRESS 0xfe402d35 /end MEASUREMENT
/begin MEASUREMENT Tlib_SecRiShldMotCmd_LowPowerCANFD "" UBYTE RB_RBA_Common_CentralElements_CompuMethods_Identical 1 100 0.0 255.00 FORMAT "%8.2" ECU_ADDRESS 0xfe402d36 /end MEASUREMENT
/begin MEASUREMENT Tlib_SecRiLegRstVertMotCmd_LowPowerCANFD "" UBYTE RB_RBA_Common_CentralElements_CompuMethods_Identical 1 100 0.0 255.00 FORMAT "%8.2" ECU_ADDRESS 0xfe402d37 /end MEASUREMENT
/begin MEASUREMENT Tlib_SecRiCushTiltMotCmd_LowPowerCANFD "" UBYTE RB_RBA_Common_CentralElements_CompuMethods_Identical 1 100 0.0 255.00 FORMAT "%8.2" ECU_ADDRESS 0xfe402d38 /end MEASUREMENT
/begin MEASUREMENT Tlib_SecRiLegRstHozlMotCmd_LowPowerCANFD "" UBYTE RB_RBA_Common_CentralElements_CompuMethods_Identical 1 100 0.0 255.00 FORMAT "%8.2" ECU_ADDRESS 0xfe402d39 /end MEASUREMENT
/begin MEASUREMENT Tlib_SecRiHeiMotCmd_LowPowerCANFD "" UBYTE RB_RBA_Common_CentralElements_CompuMethods_Identical 1 100 0.0 255.00 FORMAT "%8.2" ECU_ADDRESS 0xfe402d3a /end MEASUREMENT
/begin MEASUREMENT Tlib_MirrFoldCmdAtPassMirrFoldCmdTyp_LowPowerCANFD "" UBYTE RB_RBA_Common_CentralElements_CompuMethods_Identical 1 100 0.0 255.00 FORMAT "%8.2" ECU_ADDRESS 0xfe402d3b /end MEASUREMENT
/begin MEASUREMENT Tlib_MirrFoldCmdAtPassMirrFoldCmdTrgSrc_LowPowerCANFD "" UBYTE RB_RBA_Common_CentralElements_CompuMethods_Identical 1 100 0.0 255.00 FORMAT "%8.2" ECU_ADDRESS 0xfe402d3c /end MEASUREMENT
/begin MEASUREMENT Tlib_MirrDwnCmdAtPass_LowPowerCANFD "" UBYTE RB_RBA_Common_CentralElements_CompuMethods_Identical 1 100 0.0 255.00 FORMAT "%8.2" ECU_ADDRESS 0xfe402d3d /end MEASUREMENT
/begin MEASUREMENT Tlib_ActnOfLedPosnLampCntr4_LowPowerCANFD "" UBYTE RB_RBA_Common_CentralElements_CompuMethods_Identical 1 100 0.0 255.00 FORMAT "%8.2" ECU_ADDRESS 0xfe402d3e /end MEASUREMENT
/begin MEASUREMENT Tlib_ActnOfLedPosnLampOnOffSafe1_LowPowerCANFD "" UBYTE RB_RBA_Common_CentralElements_CompuMethods_Identical 1 100 0.0 255.00 FORMAT "%8.2" ECU_ADDRESS 0xfe402d3f /end MEASUREMENT
/begin MEASUREMENT Tlib_ActnOfLedPosnLampDataID4_LowPowerCANFD "" UBYTE RB_RBA_Common_CentralElements_CompuMethods_Identical 1 100 0.0 255.00 FORMAT "%8.2" ECU_ADDRESS 0xfe402d40 /end MEASUREMENT
/begin MEASUREMENT Tlib_ActnOfLedPosnLampChks8_LowPowerCANFD "" UBYTE RB_RBA_Common_CentralElements_CompuMethods_Identical 1 100 0.0 255.00 FORMAT "%8.2" ECU_ADDRESS 0xfe402d41 /end MEASUREMENT
/begin MEASUREMENT Tlib_MirrAdjCmdAtPassMirrAdjCmdTyp_LowPowerCANFD "" UBYTE RB_RBA_Common_CentralElements_CompuMethods_Identical 1 100 0.0 255.00 FORMAT "%8.2" ECU_ADDRESS 0xfe402d42 /end MEASUREMENT
/begin MEASUREMENT Tlib_MirrAdjCmdAtPassMirrAdjCmdTrgSrc_LowPowerCANFD "" UBYTE RB_RBA_Common_CentralElements_CompuMethods_Identical 1 100 0.0 255.00 FORMAT "%8.2" ECU_ADDRESS 0xfe402d43 /end MEASUREMENT
/begin MEASUREMENT Tlib_VehSpdIndcdVeSpdIndcdUnit_LowPowerCANFD "" UBYTE RB_RBA_Common_CentralElements_CompuMethods_Identical 1 100 0.0 255.00 FORMAT "%8.2" ECU_ADDRESS 0xfe402d44 /end MEASUREMENT
/begin MEASUREMENT Tlib_VehSpdIndcdVehSpdIndcd_LowPowerCANFD "" UWORD RB_RBA_Common_CentralElements_CompuMethods_Identical 1 100 0.0 65535 FORMAT "%8.2" ECU_ADDRESS 0xfe402794 /end MEASUREMENT
/begin MEASUREMENT Tlib_SecRiLenMotCmdMotorSpeed_LowPowerCANFD "" UBYTE RB_RBA_Common_CentralElements_CompuMethods_Identical 1 100 0.0 255.00 FORMAT "%8.2" ECU_ADDRESS 0xfe402d45 /end MEASUREMENT
/begin MEASUREMENT Tlib_SecRiLenMotCmdSwtHozlSts1_LowPowerCANFD "" UBYTE RB_RBA_Common_CentralElements_CompuMethods_Identical 1 100 0.0 255.00 FORMAT "%8.2" ECU_ADDRESS 0xfe402d46 /end MEASUREMENT
/begin MEASUREMENT Tlib_SecRiBackrestMotCmdSwtHozlSts1_LowPowerCANFD "" UBYTE RB_RBA_Common_CentralElements_CompuMethods_Identical 1 100 0.0 255.00 FORMAT "%8.2" ECU_ADDRESS 0xfe402d47 /end MEASUREMENT
/begin MEASUREMENT Tlib_SecRiBackrestMotCmdMotorSpeed_LowPowerCANFD "" UBYTE RB_RBA_Common_CentralElements_CompuMethods_Identical 1 100 0.0 255.00 FORMAT "%8.2" ECU_ADDRESS 0xfe402d48 /end MEASUREMENT
/begin MEASUREMENT Tlib_DtcInfDoorDrvr2Boolean10_LowPowerCANFD "" UBYTE RB_RBA_Common_CentralElements_CompuMethods_Identical 1 100 0.0 255.00 FORMAT "%8.2" ECU_ADDRESS 0xfe402d49 /end MEASUREMENT
/begin MEASUREMENT Tlib_DtcInfDoorDrvr2Boolean2_LowPowerCANFD "" UBYTE RB_RBA_Common_CentralElements_CompuMethods_Identical 1 100 0.0 255.00 FORMAT "%8.2" ECU_ADDRESS 0xfe402d4a /end MEASUREMENT
/begin MEASUREMENT Tlib_DtcInfDoorDrvr2Boolean9_LowPowerCANFD "" UBYTE RB_RBA_Common_CentralElements_CompuMethods_Identical 1 100 0.0 255.00 FORMAT "%8.2" ECU_ADDRESS 0xfe402d4b /end MEASUREMENT
/begin MEASUREMENT Tlib_DtcInfDoorDrvr2Boolean14_LowPowerCANFD "" UBYTE RB_RBA_Common_CentralElements_CompuMethods_Identical 1 100 0.0 255.00 FORMAT "%8.2" ECU_ADDRESS 0xfe402d4c /end MEASUREMENT
/begin MEASUREMENT Tlib_DtcInfDoorDrvr2Boolean6_LowPowerCANFD "" UBYTE RB_RBA_Common_CentralElements_CompuMethods_Identical 1 100 0.0 255.00 FORMAT "%8.2" ECU_ADDRESS 0xfe402d4d /end MEASUREMENT
/begin MEASUREMENT Tlib_DtcInfDoorDrvr2Boolean4_LowPowerCANFD "" UBYTE RB_RBA_Common_CentralElements_CompuMethods_Identical 1 100 0.0 255.00 FORMAT "%8.2" ECU_ADDRESS 0xfe402d4e /end MEASUREMENT
/begin MEASUREMENT Tlib_DtcInfDoorDrvr2Boolean5_LowPowerCANFD "" UBYTE RB_RBA_Common_CentralElements_CompuMethods_Identical 1 100 0.0 255.00 FORMAT "%8.2" ECU_ADDRESS 0xfe402d4f /end MEASUREMENT
/begin MEASUREMENT Tlib_DtcInfDoorDrvr2Boolean7_LowPowerCANFD "" UBYTE RB_RBA_Common_CentralElements_CompuMethods_Identical 1 100 0.0 255.00 FORMAT "%8.2" ECU_ADDRESS 0xfe402d50 /end MEASUREMENT
/begin MEASUREMENT Tlib_DtcInfDoorDrvr2Boolean3_LowPowerCANFD "" UBYTE RB_RBA_Common_CentralElements_CompuMethods_Identical 1 100 0.0 255.00 FORMAT "%8.2" ECU_ADDRESS 0xfe402d51 /end MEASUREMENT
/begin MEASUREMENT Tlib_DtcInfDoorDrvr2Boolean13_LowPowerCANFD "" UBYTE RB_RBA_Common_CentralElements_CompuMethods_Identical 1 100 0.0 255.00 FORMAT "%8.2" ECU_ADDRESS 0xfe402d52 /end MEASUREMENT
/begin MEASUREMENT Tlib_DtcInfDoorDrvr2Boolean12_LowPowerCANFD "" UBYTE RB_RBA_Common_CentralElements_CompuMethods_Identical 1 100 0.0 255.00 FORMAT "%8.2" ECU_ADDRESS 0xfe402d53 /end MEASUREMENT
/begin MEASUREMENT Tlib_DtcInfDoorDrvr2Boolean1_LowPowerCANFD "" UBYTE RB_RBA_Common_CentralElements_CompuMethods_Identical 1 100 0.0 255.00 FORMAT "%8.2" ECU_ADDRESS 0xfe402d54 /end MEASUREMENT
/begin MEASUREMENT Tlib_DtcInfDoorDrvr2Boolean11_LowPowerCANFD "" UBYTE RB_RBA_Common_CentralElements_CompuMethods_Identical 1 100 0.0 255.00 FORMAT "%8.2" ECU_ADDRESS 0xfe402d55 /end MEASUREMENT
/begin MEASUREMENT Tlib_DtcInfDoorDrvr2Boolean8_LowPowerCANFD "" UBYTE RB_RBA_Common_CentralElements_CompuMethods_Identical 1 100 0.0 255.00 FORMAT "%8.2" ECU_ADDRESS 0xfe402d56 /end MEASUREMENT
/begin MEASUREMENT Tlib_DtcInfDoorLeRe2Boolean7_LowPowerCANFD "" UBYTE RB_RBA_Common_CentralElements_CompuMethods_Identical 1 100 0.0 255.00 FORMAT "%8.2" ECU_ADDRESS 0xfe402d57 /end MEASUREMENT
/begin MEASUREMENT Tlib_DtcInfDoorLeRe2Boolean6_LowPowerCANFD "" UBYTE RB_RBA_Common_CentralElements_CompuMethods_Identical 1 100 0.0 255.00 FORMAT "%8.2" ECU_ADDRESS 0xfe402d58 /end MEASUREMENT
/begin MEASUREMENT Tlib_DtcInfDoorLeRe2Boolean8_LowPowerCANFD "" UBYTE RB_RBA_Common_CentralElements_CompuMethods_Identical 1 100 0.0 255.00 FORMAT "%8.2" ECU_ADDRESS 0xfe402d59 /end MEASUREMENT
/begin MEASUREMENT Tlib_DtcInfDoorLeRe2Boolean5_LowPowerCANFD "" UBYTE RB_RBA_Common_CentralElements_CompuMethods_Identical 1 100 0.0 255.00 FORMAT "%8.2" ECU_ADDRESS 0xfe402d5a /end MEASUREMENT
/begin MEASUREMENT Tlib_DtcInfDoorLeRe2Boolean1_LowPowerCANFD "" UBYTE RB_RBA_Common_CentralElements_CompuMethods_Identical 1 100 0.0 255.00 FORMAT "%8.2" ECU_ADDRESS 0xfe402d5b /end MEASUREMENT
/begin MEASUREMENT Tlib_DtcInfDoorLeRe2Boolean3_LowPowerCANFD "" UBYTE RB_RBA_Common_CentralElements_CompuMethods_Identical 1 100 0.0 255.00 FORMAT "%8.2" ECU_ADDRESS 0xfe402d5c /end MEASUREMENT
/begin MEASUREMENT Tlib_DtcInfDoorLeRe2Boolean11_LowPowerCANFD "" UBYTE RB_RBA_Common_CentralElements_CompuMethods_Identical 1 100 0.0 255.00 FORMAT "%8.2" ECU_ADDRESS 0xfe402d5d /end MEASUREMENT
/begin MEASUREMENT Tlib_DtcInfDoorLeRe2Boolean2_LowPowerCANFD "" UBYTE RB_RBA_Common_CentralElements_CompuMethods_Identical 1 100 0.0 255.00 FORMAT "%8.2" ECU_ADDRESS 0xfe402d5e /end MEASUREMENT
/begin MEASUREMENT Tlib_DtcInfDoorLeRe2Boolean14_LowPowerCANFD "" UBYTE RB_RBA_Common_CentralElements_CompuMethods_Identical 1 100 0.0 255.00 FORMAT "%8.2" ECU_ADDRESS 0xfe402d5f /end MEASUREMENT
/begin MEASUREMENT Tlib_DtcInfDoorLeRe2Boolean10_LowPowerCANFD "" UBYTE RB_RBA_Common_CentralElements_CompuMethods_Identical 1 100 0.0 255.00 FORMAT "%8.2" ECU_ADDRESS 0xfe402d60 /end MEASUREMENT
/begin MEASUREMENT Tlib_DtcInfDoorLeRe2Boolean13_LowPowerCANFD "" UBYTE RB_RBA_Common_CentralElements_CompuMethods_Identical 1 100 0.0 255.00 FORMAT "%8.2" ECU_ADDRESS 0xfe402d61 /end MEASUREMENT
/begin MEASUREMENT Tlib_DtcInfDoorLeRe2Boolean4_LowPowerCANFD "" UBYTE RB_RBA_Common_CentralElements_CompuMethods_Identical 1 100 0.0 255.00 FORMAT "%8.2" ECU_ADDRESS 0xfe402d62 /end MEASUREMENT
/begin MEASUREMENT Tlib_DtcInfDoorLeRe2Boolean9_LowPowerCANFD "" UBYTE RB_RBA_Common_CentralElements_CompuMethods_Identical 1 100 0.0 255.00 FORMAT "%8.2" ECU_ADDRESS 0xfe402d63 /end MEASUREMENT
/begin MEASUREMENT Tlib_DtcInfDoorLeRe2Boolean12_LowPowerCANFD "" UBYTE RB_RBA_Common_CentralElements_CompuMethods_Identical 1 100 0.0 255.00 FORMAT "%8.2" ECU_ADDRESS 0xfe402d64 /end MEASUREMENT
/begin MEASUREMENT Tlib_DoorDrvrAntiPnch2_LowPowerCANFD "" UBYTE RB_RBA_Common_CentralElements_CompuMethods_Identical 1 100 0.0 255.00 FORMAT "%8.2" ECU_ADDRESS 0xfe402d65 /end MEASUREMENT
/begin MEASUREMENT Tlib_DoorLeRePosn2_LowPowerCANFD "" UBYTE RB_RBA_Common_CentralElements_CompuMethods_Identical 1 100 0.0 255.00 FORMAT "%8.2" ECU_ADDRESS 0xfe402d66 /end MEASUREMENT
/begin MEASUREMENT Tlib_ObstStrDetcnLeRe2_LowPowerCANFD "" UBYTE RB_RBA_Common_CentralElements_CompuMethods_Identical 1 100 0.0 255.00 FORMAT "%8.2" ECU_ADDRESS 0xfe402d67 /end MEASUREMENT
/begin MEASUREMENT Tlib_DoorDrvrPosn2_LowPowerCANFD "" UBYTE RB_RBA_Common_CentralElements_CompuMethods_Identical 1 100 0.0 255.00 FORMAT "%8.2" ECU_ADDRESS 0xfe402d68 /end MEASUREMENT
/begin MEASUREMENT Tlib_BrkPedlrRatQf_LowPowerCANFD "" UBYTE RB_RBA_Common_CentralElements_CompuMethods_Identical 1 100 0.0 255.00 FORMAT "%8.2" ECU_ADDRESS 0xfe402d69 /end MEASUREMENT
/begin MEASUREMENT Tlib_BrkPedlrRatPerc_LowPowerCANFD "" UWORD RB_RBA_Common_CentralElements_CompuMethods_Identical 1 100 0.0 65535 FORMAT "%8.2" ECU_ADDRESS 0xfe402796 /end MEASUREMENT
/begin MEASUREMENT Tlib_DoorLeReAntiPnch2_LowPowerCANFD "" UBYTE RB_RBA_Common_CentralElements_CompuMethods_Identical 1 100 0.0 255.00 FORMAT "%8.2" ECU_ADDRESS 0xfe402d6a /end MEASUREMENT
/begin MEASUREMENT Tlib_ObstStrDetcnDrvr2_LowPowerCANFD "" UBYTE RB_RBA_Common_CentralElements_CompuMethods_Identical 1 100 0.0 255.00 FORMAT "%8.2" ECU_ADDRESS 0xfe402d6b /end MEASUREMENT
/begin MEASUREMENT Tlib_DoorDrvrModSts2_LowPowerCANFD "" UBYTE RB_RBA_Common_CentralElements_CompuMethods_Identical 1 100 0.0 255.00 FORMAT "%8.2" ECU_ADDRESS 0xfe402d6c /end MEASUREMENT
/begin MEASUREMENT Tlib_DoorLeReModSts2_LowPowerCANFD "" UBYTE RB_RBA_Common_CentralElements_CompuMethods_Identical 1 100 0.0 255.00 FORMAT "%8.2" ECU_ADDRESS 0xfe402d6d /end MEASUREMENT
/begin MEASUREMENT Tlib_ActnOfFrntPosnLampRi_LowPowerCANFD "" UBYTE RB_RBA_Common_CentralElements_CompuMethods_Identical 1 100 0.0 255.00 FORMAT "%8.2" ECU_ADDRESS 0xfe402d6e /end MEASUREMENT
/begin MEASUREMENT Tlib_ActnOfRePosnLampRi_LowPowerCANFD "" UBYTE RB_RBA_Common_CentralElements_CompuMethods_Identical 1 100 0.0 255.00 FORMAT "%8.2" ECU_ADDRESS 0xfe402d6f /end MEASUREMENT
/begin MEASUREMENT Tlib_ActnOfRePosnLampLe_LowPowerCANFD "" UBYTE RB_RBA_Common_CentralElements_CompuMethods_Identical 1 100 0.0 255.00 FORMAT "%8.2" ECU_ADDRESS 0xfe402d70 /end MEASUREMENT
/begin MEASUREMENT Tlib_ActnOfFrntPosnLampLe_LowPowerCANFD "" UBYTE RB_RBA_Common_CentralElements_CompuMethods_Identical 1 100 0.0 255.00 FORMAT "%8.2" ECU_ADDRESS 0xfe402d71 /end MEASUREMENT
/begin MEASUREMENT Tlib_ELCarCfgSgnlKey_LowPowerCANFD "" SLONG RB_RBA_Common_CentralElements_CompuMethods_Identical 1 100 -2147483648 2147483647 FORMAT "%8.2" ECU_ADDRESS 0xfe402720 /end MEASUREMENT
/begin MEASUREMENT Tlib_ELCarCfgSgnlValue_LowPowerCANFD "" SLONG RB_RBA_Common_CentralElements_CompuMethods_Identical 1 100 -2147483648 2147483647 FORMAT "%8.2" ECU_ADDRESS 0xfe402724 /end MEASUREMENT
/begin MEASUREMENT Tlib_TiAndDateIndcdSec1_LowPowerCANFD "" UBYTE RB_RBA_Common_CentralElements_CompuMethods_Identical 1 100 0.0 255.00 FORMAT "%8.2" ECU_ADDRESS 0xfe402d72 /end MEASUREMENT
/begin MEASUREMENT Tlib_TiAndDateIndcdHr1_LowPowerCANFD "" UBYTE RB_RBA_Common_CentralElements_CompuMethods_Identical 1 100 0.0 255.00 FORMAT "%8.2" ECU_ADDRESS 0xfe402d73 /end MEASUREMENT
/begin MEASUREMENT Tlib_TiAndDateIndcdDataValid_LowPowerCANFD "" UBYTE RB_RBA_Common_CentralElements_CompuMethods_Identical 1 100 0.0 255.00 FORMAT "%8.2" ECU_ADDRESS 0xfe402d74 /end MEASUREMENT
/begin MEASUREMENT Tlib_TiAndDateIndcdMth1_LowPowerCANFD "" UBYTE RB_RBA_Common_CentralElements_CompuMethods_Identical 1 100 0.0 255.00 FORMAT "%8.2" ECU_ADDRESS 0xfe402d75 /end MEASUREMENT
/begin MEASUREMENT Tlib_TiAndDateIndcdMins1_LowPowerCANFD "" UBYTE RB_RBA_Common_CentralElements_CompuMethods_Identical 1 100 0.0 255.00 FORMAT "%8.2" ECU_ADDRESS 0xfe402d76 /end MEASUREMENT
/begin MEASUREMENT Tlib_TiAndDateIndcdYr1_LowPowerCANFD "" UBYTE RB_RBA_Common_CentralElements_CompuMethods_Identical 1 100 0.0 255.00 FORMAT "%8.2" ECU_ADDRESS 0xfe402d77 /end MEASUREMENT
/begin MEASUREMENT Tlib_TiAndDateIndcdDay_LowPowerCANFD "" UBYTE RB_RBA_Common_CentralElements_CompuMethods_Identical 1 100 0.0 255.00 FORMAT "%8.2" ECU_ADDRESS 0xfe402d78 /end MEASUREMENT
/begin MEASUREMENT Tlib_ExtrMirrPassDiSts_LowPowerCANFD "" UBYTE RB_RBA_Common_CentralElements_CompuMethods_Identical 1 100 0.0 255.00 FORMAT "%8.2" ECU_ADDRESS 0xfe402d79 /end MEASUREMENT
/begin MEASUREMENT Tlib_BrkPedlSnsrSt_LowPowerCANFD "" UBYTE RB_RBA_Common_CentralElements_CompuMethods_Identical 1 100 0.0 255.00 FORMAT "%8.2" ECU_ADDRESS 0xfe402d7a /end MEASUREMENT
/begin MEASUREMENT Tlib_BrkPedlSnsrQf_LowPowerCANFD "" UBYTE RB_RBA_Common_CentralElements_CompuMethods_Identical 1 100 0.0 255.00 FORMAT "%8.2" ECU_ADDRESS 0xfe402d7b /end MEASUREMENT
/begin MEASUREMENT Tlib_BrkPedlSnsrCntr4_LowPowerCANFD "" UBYTE RB_RBA_Common_CentralElements_CompuMethods_Identical 1 100 0.0 255.00 FORMAT "%8.2" ECU_ADDRESS 0xfe402d7c /end MEASUREMENT
/begin MEASUREMENT Tlib_BrkPedlSnsrDataID4_LowPowerCANFD "" UBYTE RB_RBA_Common_CentralElements_CompuMethods_Identical 1 100 0.0 255.00 FORMAT "%8.2" ECU_ADDRESS 0xfe402d7d /end MEASUREMENT
/begin MEASUREMENT Tlib_BrkPedlSnsrChks8_LowPowerCANFD "" UBYTE RB_RBA_Common_CentralElements_CompuMethods_Identical 1 100 0.0 255.00 FORMAT "%8.2" ECU_ADDRESS 0xfe402d7e /end MEASUREMENT
/begin MEASUREMENT Tlib_OnBdChrgrSt_LowPowerCANFD "" UBYTE RB_RBA_Common_CentralElements_CompuMethods_Identical 1 100 0.0 255.00 FORMAT "%8.2" ECU_ADDRESS 0xfe402d7f /end MEASUREMENT
/begin MEASUREMENT Tlib_TwliBriRawQf_LowPowerCANFD "" UBYTE RB_RBA_Common_CentralElements_CompuMethods_Identical 1 100 0.0 255.00 FORMAT "%8.2" ECU_ADDRESS 0xfe402d80 /end MEASUREMENT
/begin MEASUREMENT Tlib_TwliBriRaw1_LowPowerCANFD "" UWORD RB_RBA_Common_CentralElements_CompuMethods_Identical 1 100 0.0 65535 FORMAT "%8.2" ECU_ADDRESS 0xfe402798 /end MEASUREMENT
/begin MEASUREMENT Tlib_GlvBoxRelsReq_LowPowerCANFD "" UBYTE RB_RBA_Common_CentralElements_CompuMethods_Identical 1 100 0.0 255.00 FORMAT "%8.2" ECU_ADDRESS 0xfe402d81 /end MEASUREMENT
/begin MEASUREMENT Tlib_ActnOfLedPosnLampDyn_LowPowerCANFD "" UBYTE RB_RBA_Common_CentralElements_CompuMethods_Identical 1 100 0.0 255.00 FORMAT "%8.2" ECU_ADDRESS 0xfe402d82 /end MEASUREMENT
/begin MEASUREMENT Tlib_CabPressPodCalc_LowPowerCANFD "" UBYTE RB_RBA_Common_CentralElements_CompuMethods_Identical 1 100 0.0 255.00 FORMAT "%8.2" ECU_ADDRESS 0xfe402d83 /end MEASUREMENT
/begin MEASUREMENT Tlib_IDLEPwrSplySts_LowPowerCANFD "" UBYTE RB_RBA_Common_CentralElements_CompuMethods_Identical 1 100 0.0 255.00 FORMAT "%8.2" ECU_ADDRESS 0xfe402d84 /end MEASUREMENT
/begin MEASUREMENT Tlib_ObstStrDetcnPass1_LowPowerCANFD "" UBYTE RB_RBA_Common_CentralElements_CompuMethods_Identical 1 100 0.0 255.00 FORMAT "%8.2" ECU_ADDRESS 0xfe402d85 /end MEASUREMENT
/begin MEASUREMENT Tlib_ObstStrDetcnRiRe1_LowPowerCANFD "" UBYTE RB_RBA_Common_CentralElements_CompuMethods_Identical 1 100 0.0 255.00 FORMAT "%8.2" ECU_ADDRESS 0xfe402d86 /end MEASUREMENT
/begin MEASUREMENT Tlib_ExtrMirrPassPosnCmdMirrPosnAdjCldLeRi_LowPowerCANFD "" UBYTE RB_RBA_Common_CentralElements_CompuMethods_Identical 1 100 0.0 255.00 FORMAT "%8.2" ECU_ADDRESS 0xfe402d87 /end MEASUREMENT
/begin MEASUREMENT Tlib_ExtrMirrPassPosnCmdMirrPosnAdjCldUpDwn_LowPowerCANFD "" UBYTE RB_RBA_Common_CentralElements_CompuMethods_Identical 1 100 0.0 255.00 FORMAT "%8.2" ECU_ADDRESS 0xfe402d88 /end MEASUREMENT
/*********** End of merged FUNCTION blocks ***********/ /*********** Start of merged COMPU_METHOD blocks ***********/
/begin COMPU_METHOD RB_RBA_Common_CentralElements_CompuMethods_Identical "The internal value and the physical one are identical. No physical unit available" RAT_FUNC "%10.5" "noUnit" COEFFS 0.0 1.0 0.0 0.0 0.0 1.0 REF_UNIT RB_RBA_Common_CentralElements_Units_NoUnit /end COMPU_METHOD
/begin COMPU_METHOD OneToOne "" RAT_FUNC "%6.2" "-" COEFFS 0 1 0 0 0 1 /end COMPU_METHOD
/begin RECORD_LAYOUT KwWU16 FNC_VALUES 1 UWORD COLUMN_DIR DIRECT /end RECORD_LAYOUT
/begin RECORD_LAYOUT KwWU8 FNC_VALUES 1 UBYTE COLUMN_DIR DIRECT /end RECORD_LAYOUT
/begin RECORD_LAYOUT Kw_Ws16 FNC_VALUES 1 SWORD COLUMN_DIR DIRECT /end RECORD_LAYOUT
/begin RECORD_LAYOUT RB_Val_Ws16 FNC_VALUES 1 SWORD COLUMN_DIR DIRECT /end RECORD_LAYOUT
/begin RECORD_LAYOUT RB_Val_Wu8 FNC_VALUES 1 UBYTE COLUMN_DIR DIRECT /end RECORD_LAYOUT
/begin RECORD_LAYOUT ValA_Wu16 FNC_VALUES 1 UWORD COLUMN_DIR DIRECT /end RECORD_LAYOUT
/begin RECORD_LAYOUT ValA_Wu8 FNC_VALUES 1 UBYTE COLUMN_DIR DIRECT /end RECORD_LAYOUT
/begin RECORD_LAYOUT Val_WS16 FNC_VALUES 1 SWORD COLUMN_DIR DIRECT /end RECORD_LAYOUT
/begin RECORD_LAYOUT Val_Wu16 FNC_VALUES 1 UWORD COLUMN_DIR DIRECT /end RECORD_LAYOUT
/begin RECORD_LAYOUT Val_Wu32 FNC_VALUES 1 ULONG COLUMN_DIR DIRECT /end RECORD_LAYOUT
/begin RECORD_LAYOUT Val_Wu8 FNC_VALUES 1 UBYTE COLUMN_DIR DIRECT /end RECORD_LAYOUT
/begin RECORD_LAYOUT Val_WS8 FNC_VALUES 1 SBYTE COLUMN_DIR DIRECT /end RECORD_LAYOUT
/*********** Start of merged UNIT blocks ***********/
/begin UNIT RB_RBA_Common_CentralElements_Units_NoUnit "No Unit" "noUnit" EXTENDED_SI SI_EXPONENTS 0 0 0 0 0 0 0 /end UNIT
/end MODULE
/end PROJECT
