ASAP2_VERSION 1 61
/begin PROJECT ZCU "ZCU"
/begin HEADER "" VERSION "ZCU" PROJECT_NO ZCU /end HEADER
/begin MODULE DIM ""
/begin MOD_COMMON "" BYTE_ORDER MSB_LAST ALIGNMENT_BYTE 1 ALIGNMENT_WORD 2 ALIGNMENT_LONG 4 ALIGNMENT_INT64 4 ALIGNMENT_FLOAT32_IEEE 4 ALIGNMENT_FLOAT64_IEEE 4 DATA_SIZE 32 /end MOD_COMMON
/begin MEASUREMENT Tlib_IndcrSts_LowPowerCANFD "" UBYTE RB_RBA_Common_CentralElements_CompuMethods_Identical 1 100 0.0 255.00 FORMAT "%8.2" ECU_ADDRESS 0xfe402d89 /end MEASUREMENT
/begin MEASUREMENT Tlib_IndcrNoSeq_LowPowerCANFD "" UBYTE RB_RBA_Common_CentralElements_CompuMethods_Identical 1 100 0.0 255.00 FORMAT "%8.2" ECU_ADDRESS 0xfe402d8a /end MEASUREMENT
/begin MEASUREMENT Tlib_DoorPassIntrSwtLedLockgCmd_LowPowerCANFD "" UBYTE RB_RBA_Common_CentralElements_CompuMethods_Identical 1 100 0.0 255.00 FORMAT "%8.2" ECU_ADDRESS 0xfe402d8b /end MEASUREMENT
/begin MEASUREMENT Tlib_IndcrPatCmd1WdTiOn_LowPowerCANFD "" UWORD RB_RBA_Common_CentralElements_CompuMethods_Identical 1 100 0.0 65535 FORMAT "%8.2" ECU_ADDRESS 0xfe40279a /end MEASUREMENT
/begin MEASUREMENT Tlib_IndcrPatCmd1WdTiOff_LowPowerCANFD "" UWORD RB_RBA_Common_CentralElements_CompuMethods_Identical 1 100 0.0 65535 FORMAT "%8.2" ECU_ADDRESS 0xfe40279c /end MEASUREMENT
/begin MEASUREMENT Tlib_DoorRiReIntrSwtLedLockgCmd_LowPowerCANFD "" UBYTE RB_RBA_Common_CentralElements_CompuMethods_Identical 1 100 0.0 255.00 FORMAT "%8.2" ECU_ADDRESS 0xfe402d8c /end MEASUREMENT
/begin MEASUREMENT Tlib_EmgyBrkLiIndcrTurn_LowPowerCANFD "" UBYTE RB_RBA_Common_CentralElements_CompuMethods_Identical 1 100 0.0 255.00 FORMAT "%8.2" ECU_ADDRESS 0xfe402d8d /end MEASUREMENT
/begin MEASUREMENT Tlib_CinhRiReSts_LowPowerCANFD "" UBYTE RB_RBA_Common_CentralElements_CompuMethods_Identical 1 100 0.0 255.00 FORMAT "%8.2" ECU_ADDRESS 0xfe402d8e /end MEASUREMENT
/begin MEASUREMENT Tlib_CinhRiReSwt_LowPowerCANFD "" UBYTE RB_RBA_Common_CentralElements_CompuMethods_Identical 1 100 0.0 255.00 FORMAT "%8.2" ECU_ADDRESS 0xfe402d8f /end MEASUREMENT
/begin MEASUREMENT Tlib_PawlRiReSwt_LowPowerCANFD "" UBYTE RB_RBA_Common_CentralElements_CompuMethods_Identical 1 100 0.0 255.00 FORMAT "%8.2" ECU_ADDRESS 0xfe402d90 /end MEASUREMENT
/begin MEASUREMENT Tlib_SuspPosnVertRiRe_LowPowerCANFD "" SWORD RB_RBA_Common_CentralElements_CompuMethods_Identical 1 100 -32768 32767 FORMAT "%8.2" ECU_ADDRESS 0xfe40279e /end MEASUREMENT
/begin MEASUREMENT Tlib_SuspPosnVertRiChks8_LowPowerCANFD "" UBYTE RB_RBA_Common_CentralElements_CompuMethods_Identical 1 100 0.0 255.00 FORMAT "%8.2" ECU_ADDRESS 0xfe402d91 /end MEASUREMENT
/begin MEASUREMENT Tlib_SuspPosnVertRiDataID4_LowPowerCANFD "" UBYTE RB_RBA_Common_CentralElements_CompuMethods_Identical 1 100 0.0 255.00 FORMAT "%8.2" ECU_ADDRESS 0xfe402d92 /end MEASUREMENT
/begin MEASUREMENT Tlib_SuspPosnVertRiFrntQf_LowPowerCANFD "" UBYTE RB_RBA_Common_CentralElements_CompuMethods_Identical 1 100 0.0 255.00 FORMAT "%8.2" ECU_ADDRESS 0xfe402d93 /end MEASUREMENT
/begin MEASUREMENT Tlib_SuspPosnVertRiFrnt_LowPowerCANFD "" SWORD RB_RBA_Common_CentralElements_CompuMethods_Identical 1 100 -32768 32767 FORMAT "%8.2" ECU_ADDRESS 0xfe4027a0 /end MEASUREMENT
/begin MEASUREMENT Tlib_SuspPosnVertRiReQf_LowPowerCANFD "" UBYTE RB_RBA_Common_CentralElements_CompuMethods_Identical 1 100 0.0 255.00 FORMAT "%8.2" ECU_ADDRESS 0xfe402d94 /end MEASUREMENT
/begin MEASUREMENT Tlib_SuspPosnVertRiCntr4_LowPowerCANFD "" UBYTE RB_RBA_Common_CentralElements_CompuMethods_Identical 1 100 0.0 255.00 FORMAT "%8.2" ECU_ADDRESS 0xfe402d95 /end MEASUREMENT
/begin MEASUREMENT Tlib_DoorRiReLatPosn_LowPowerCANFD "" UBYTE RB_RBA_Common_CentralElements_CompuMethods_Identical 1 100 0.0 255.00 FORMAT "%8.2" ECU_ADDRESS 0xfe402d96 /end MEASUREMENT
/begin MEASUREMENT Tlib_SuspPosnVertLeReQf_LowPowerCANFD "" UBYTE RB_RBA_Common_CentralElements_CompuMethods_Identical 1 100 0.0 255.00 FORMAT "%8.2" ECU_ADDRESS 0xfe402d97 /end MEASUREMENT
/begin MEASUREMENT Tlib_SuspPosnVertLeDataID4_LowPowerCANFD "" UBYTE RB_RBA_Common_CentralElements_CompuMethods_Identical 1 100 0.0 255.00 FORMAT "%8.2" ECU_ADDRESS 0xfe402d98 /end MEASUREMENT
/begin MEASUREMENT Tlib_SuspPosnVertLeCntr4_LowPowerCANFD "" UBYTE RB_RBA_Common_CentralElements_CompuMethods_Identical 1 100 0.0 255.00 FORMAT "%8.2" ECU_ADDRESS 0xfe402d99 /end MEASUREMENT
/begin MEASUREMENT Tlib_SuspPosnVertLeFrnt_LowPowerCANFD "" SWORD RB_RBA_Common_CentralElements_CompuMethods_Identical 1 100 -32768 32767 FORMAT "%8.2" ECU_ADDRESS 0xfe4027a2 /end MEASUREMENT
/begin MEASUREMENT Tlib_SuspPosnVertLeChks8_LowPowerCANFD "" UBYTE RB_RBA_Common_CentralElements_CompuMethods_Identical 1 100 0.0 255.00 FORMAT "%8.2" ECU_ADDRESS 0xfe402d9a /end MEASUREMENT
/begin MEASUREMENT Tlib_SuspPosnVertLeFrntQf_LowPowerCANFD "" UBYTE RB_RBA_Common_CentralElements_CompuMethods_Identical 1 100 0.0 255.00 FORMAT "%8.2" ECU_ADDRESS 0xfe402d9b /end MEASUREMENT
/begin MEASUREMENT Tlib_SuspPosnVertLeRe_LowPowerCANFD "" SWORD RB_RBA_Common_CentralElements_CompuMethods_Identical 1 100 -32768 32767 FORMAT "%8.2" ECU_ADDRESS 0xfe4027a4 /end MEASUREMENT
/begin MEASUREMENT Tlib_VehSpdLgtQf_LowPowerCANFD "" UBYTE RB_RBA_Common_CentralElements_CompuMethods_Identical 1 100 0.0 255.00 FORMAT "%8.2" ECU_ADDRESS 0xfe402d9c /end MEASUREMENT
/begin MEASUREMENT Tlib_VehSpdLgtA_LowPowerCANFD "" UWORD RB_RBA_Common_CentralElements_CompuMethods_Identical 1 100 0.0 65535 FORMAT "%8.2" ECU_ADDRESS 0xfe4027a6 /end MEASUREMENT
/begin MEASUREMENT Tlib_VehSpdLgtDataID4_LowPowerCANFD "" UBYTE RB_RBA_Common_CentralElements_CompuMethods_Identical 1 100 0.0 255.00 FORMAT "%8.2" ECU_ADDRESS 0xfe402d9d /end MEASUREMENT
/begin MEASUREMENT Tlib_VehSpdLgtCntr4_LowPowerCANFD "" UBYTE RB_RBA_Common_CentralElements_CompuMethods_Identical 1 100 0.0 255.00 FORMAT "%8.2" ECU_ADDRESS 0xfe402d9e /end MEASUREMENT
/begin MEASUREMENT Tlib_VehSpdLgtChks8_LowPowerCANFD "" UBYTE RB_RBA_Common_CentralElements_CompuMethods_Identical 1 100 0.0 255.00 FORMAT "%8.2" ECU_ADDRESS 0xfe402d9f /end MEASUREMENT
/begin MEASUREMENT Tlib_DCChrgSt_LowPowerCANFD "" UBYTE RB_RBA_Common_CentralElements_CompuMethods_Identical 1 100 0.0 255.00 FORMAT "%8.2" ECU_ADDRESS 0xfe402da0 /end MEASUREMENT
/begin MEASUREMENT Tlib_OpenRiReSwt_LowPowerCANFD "" UBYTE RB_RBA_Common_CentralElements_CompuMethods_Identical 1 100 0.0 255.00 FORMAT "%8.2" ECU_ADDRESS 0xfe402da1 /end MEASUREMENT
/begin MEASUREMENT Tlib_DoorRiReLatPawlSt_LowPowerCANFD "" UBYTE RB_RBA_Common_CentralElements_CompuMethods_Identical 1 100 0.0 255.00 FORMAT "%8.2" ECU_ADDRESS 0xfe402da2 /end MEASUREMENT
/begin MEASUREMENT Tlib_ThrdLeSeatODSSts_LowPowerCANFD "" UBYTE RB_RBA_Common_CentralElements_CompuMethods_Identical 1 100 0.0 255.00 FORMAT "%8.2" ECU_ADDRESS 0xfe402da3 /end MEASUREMENT
/begin MEASUREMENT Tlib_ThrdMidSeatODSSts_LowPowerCANFD "" UBYTE RB_RBA_Common_CentralElements_CompuMethods_Identical 1 100 0.0 255.00 FORMAT "%8.2" ECU_ADDRESS 0xfe402da4 /end MEASUREMENT
/begin MEASUREMENT Tlib_SteerWhlSnsrAg_LowPowerCANFD "" SWORD RB_RBA_Common_CentralElements_CompuMethods_Identical 1 100 -32768 32767 FORMAT "%8.2" ECU_ADDRESS 0xfe4027a8 /end MEASUREMENT
/begin MEASUREMENT Tlib_SteerWhlSnsrAgSpd_LowPowerCANFD "" SWORD RB_RBA_Common_CentralElements_CompuMethods_Identical 1 100 -32768 32767 FORMAT "%8.2" ECU_ADDRESS 0xfe4027aa /end MEASUREMENT
/begin MEASUREMENT Tlib_SteerWhlSnsrQf_LowPowerCANFD "" UBYTE RB_RBA_Common_CentralElements_CompuMethods_Identical 1 100 0.0 255.00 FORMAT "%8.2" ECU_ADDRESS 0xfe402da5 /end MEASUREMENT
/begin MEASUREMENT Tlib_SteerWhlSnsrCntr4_LowPowerCANFD "" UBYTE RB_RBA_Common_CentralElements_CompuMethods_Identical 1 100 0.0 255.00 FORMAT "%8.2" ECU_ADDRESS 0xfe402da6 /end MEASUREMENT
/begin MEASUREMENT Tlib_SteerWhlSnsrDataID4_LowPowerCANFD "" UBYTE RB_RBA_Common_CentralElements_CompuMethods_Identical 1 100 0.0 255.00 FORMAT "%8.2" ECU_ADDRESS 0xfe402da7 /end MEASUREMENT
/begin MEASUREMENT Tlib_SteerWhlSnsrChks8_LowPowerCANFD "" UBYTE RB_RBA_Common_CentralElements_CompuMethods_Identical 1 100 0.0 255.00 FORMAT "%8.2" ECU_ADDRESS 0xfe402da8 /end MEASUREMENT
/begin MEASUREMENT Tlib_WinReqAtReRiWinOpenReqAtDrvr_LowPowerCANFD "" UBYTE RB_RBA_Common_CentralElements_CompuMethods_Identical 1 100 0.0 255.00 FORMAT "%8.2" ECU_ADDRESS 0xfe402da9 /end MEASUREMENT
/begin MEASUREMENT Tlib_WinReqAtReRiWMRTrgSrc_LowPowerCANFD "" UBYTE RB_RBA_Common_CentralElements_CompuMethods_Identical 1 100 0.0 255.00 FORMAT "%8.2" ECU_ADDRESS 0xfe402daa /end MEASUREMENT
/begin MEASUREMENT Tlib_WinReqAtPassWinOpenReqAtDrvr_LowPowerCANFD "" UBYTE RB_RBA_Common_CentralElements_CompuMethods_Identical 1 100 0.0 255.00 FORMAT "%8.2" ECU_ADDRESS 0xfe402dab /end MEASUREMENT
/begin MEASUREMENT Tlib_WinReqAtPassWMRTrgSrc_LowPowerCANFD "" UBYTE RB_RBA_Common_CentralElements_CompuMethods_Identical 1 100 0.0 255.00 FORMAT "%8.2" ECU_ADDRESS 0xfe402dac /end MEASUREMENT
/begin MEASUREMENT Tlib_HvBattThmRunawayEvt_LowPowerCANFD "" UBYTE RB_RBA_Common_CentralElements_CompuMethods_Identical 1 100 0.0 255.00 FORMAT "%8.2" ECU_ADDRESS 0xfe402dad /end MEASUREMENT
/begin MEASUREMENT Tlib_OutdBriSts_LowPowerCANFD "" UBYTE RB_RBA_Common_CentralElements_CompuMethods_Identical 1 100 0.0 255.00 FORMAT "%8.2" ECU_ADDRESS 0xfe402dae /end MEASUREMENT
/begin MEASUREMENT Tlib_OutdBriCntr4_LowPowerCANFD "" UBYTE RB_RBA_Common_CentralElements_CompuMethods_Identical 1 100 0.0 255.00 FORMAT "%8.2" ECU_ADDRESS 0xfe402daf /end MEASUREMENT
/begin MEASUREMENT Tlib_OutdBriChks8_LowPowerCANFD "" UBYTE RB_RBA_Common_CentralElements_CompuMethods_Identical 1 100 0.0 255.00 FORMAT "%8.2" ECU_ADDRESS 0xfe402db0 /end MEASUREMENT
/begin MEASUREMENT Tlib_OutdBriDataID4_LowPowerCANFD "" UBYTE RB_RBA_Common_CentralElements_CompuMethods_Identical 1 100 0.0 255.00 FORMAT "%8.2" ECU_ADDRESS 0xfe402db1 /end MEASUREMENT
/begin MEASUREMENT Tlib_GearLvrIndcn2_LowPowerCANFD "" UBYTE RB_RBA_Common_CentralElements_CompuMethods_Identical 1 100 0.0 255.00 FORMAT "%8.2" ECU_ADDRESS 0xfe402db2 /end MEASUREMENT
/begin MEASUREMENT Tlib_GearLvrIndcnCntr4_LowPowerCANFD "" UBYTE RB_RBA_Common_CentralElements_CompuMethods_Identical 1 100 0.0 255.00 FORMAT "%8.2" ECU_ADDRESS 0xfe402db3 /end MEASUREMENT
/begin MEASUREMENT Tlib_GearLvrIndcnChks8_LowPowerCANFD "" UBYTE RB_RBA_Common_CentralElements_CompuMethods_Identical 1 100 0.0 255.00 FORMAT "%8.2" ECU_ADDRESS 0xfe402db4 /end MEASUREMENT
/begin MEASUREMENT Tlib_GearLvrIndcnDataID4_LowPowerCANFD "" UBYTE RB_RBA_Common_CentralElements_CompuMethods_Identical 1 100 0.0 255.00 FORMAT "%8.2" ECU_ADDRESS 0xfe402db5 /end MEASUREMENT
/begin MEASUREMENT Tlib_CinhLeReStsHi_LowPowerCANFD "" UBYTE RB_RBA_Common_CentralElements_CompuMethods_Identical 1 100 0.0 255.00 FORMAT "%8.2" ECU_ADDRESS 0xfe402db6 /end MEASUREMENT
/begin MEASUREMENT Tlib_CinhDrvrStsHi_LowPowerCANFD "" UBYTE RB_RBA_Common_CentralElements_CompuMethods_Identical 1 100 0.0 255.00 FORMAT "%8.2" ECU_ADDRESS 0xfe402db7 /end MEASUREMENT
/begin MEASUREMENT Tlib_PawlDrvrSwt_LowPowerCANFD "" UBYTE RB_RBA_Common_CentralElements_CompuMethods_Identical 1 100 0.0 255.00 FORMAT "%8.2" ECU_ADDRESS 0xfe402db8 /end MEASUREMENT
/begin MEASUREMENT Tlib_OpenDrvrSwtHi_LowPowerCANFD "" UBYTE RB_RBA_Common_CentralElements_CompuMethods_Identical 1 100 0.0 255.00 FORMAT "%8.2" ECU_ADDRESS 0xfe402db9 /end MEASUREMENT
/begin MEASUREMENT Tlib_PawlLeReSwtHi_LowPowerCANFD "" UBYTE RB_RBA_Common_CentralElements_CompuMethods_Identical 1 100 0.0 255.00 FORMAT "%8.2" ECU_ADDRESS 0xfe402dba /end MEASUREMENT
/begin MEASUREMENT Tlib_PawlDrvrSwtHi_LowPowerCANFD "" UBYTE RB_RBA_Common_CentralElements_CompuMethods_Identical 1 100 0.0 255.00 FORMAT "%8.2" ECU_ADDRESS 0xfe402dbb /end MEASUREMENT
/begin MEASUREMENT Tlib_OpenDrvrSwt_LowPowerCANFD "" UBYTE RB_RBA_Common_CentralElements_CompuMethods_Identical 1 100 0.0 255.00 FORMAT "%8.2" ECU_ADDRESS 0xfe402dbc /end MEASUREMENT
/begin MEASUREMENT Tlib_CinhDrvrSwtHi_LowPowerCANFD "" UBYTE RB_RBA_Common_CentralElements_CompuMethods_Identical 1 100 0.0 255.00 FORMAT "%8.2" ECU_ADDRESS 0xfe402dbd /end MEASUREMENT
/begin MEASUREMENT Tlib_CinhLeReSwtHi_LowPowerCANFD "" UBYTE RB_RBA_Common_CentralElements_CompuMethods_Identical 1 100 0.0 255.00 FORMAT "%8.2" ECU_ADDRESS 0xfe402dbe /end MEASUREMENT
/begin MEASUREMENT Tlib_OpenLeReSwtHi_LowPowerCANFD "" UBYTE RB_RBA_Common_CentralElements_CompuMethods_Identical 1 100 0.0 255.00 FORMAT "%8.2" ECU_ADDRESS 0xfe402dbf /end MEASUREMENT
/begin MEASUREMENT Tlib_FltOfIndcrTurnOnDrvrSide_LowPowerCANFD "" UBYTE RB_RBA_Common_CentralElements_CompuMethods_Identical 1 100 0.0 255.00 FORMAT "%8.2" ECU_ADDRESS 0xfe402dc0 /end MEASUREMENT
/begin MEASUREMENT Tlib_ThemACGroupPwrReqPMSI_LowPowerCANFD "" UBYTE RB_RBA_Common_CentralElements_CompuMethods_Identical 1 100 0.0 255.00 FORMAT "%8.2" ECU_ADDRESS 0xfe402dc1 /end MEASUREMENT
/begin MEASUREMENT Tlib_ThemACGroupPwrReqHBFC_LowPowerCANFD "" UBYTE RB_RBA_Common_CentralElements_CompuMethods_Identical 1 100 0.0 255.00 FORMAT "%8.2" ECU_ADDRESS 0xfe402dc2 /end MEASUREMENT
/begin MEASUREMENT Tlib_ThemACGroupPwrReqTherm4_LowPowerCANFD "" UBYTE RB_RBA_Common_CentralElements_CompuMethods_Identical 1 100 0.0 255.00 FORMAT "%8.2" ECU_ADDRESS 0xfe402dc3 /end MEASUREMENT
/begin MEASUREMENT Tlib_ThemACGroupPwrReqThermResd1_LowPowerCANFD "" UBYTE RB_RBA_Common_CentralElements_CompuMethods_Identical 1 100 0.0 255.00 FORMAT "%8.2" ECU_ADDRESS 0xfe402dc4 /end MEASUREMENT
/begin MEASUREMENT Tlib_ThemACGroupPwrReqHFFAHFFB_LowPowerCANFD "" UBYTE RB_RBA_Common_CentralElements_CompuMethods_Identical 1 100 0.0 255.00 FORMAT "%8.2" ECU_ADDRESS 0xfe402dc5 /end MEASUREMENT
/begin MEASUREMENT Tlib_ThemACGroupPwrReqAFU_LowPowerCANFD "" UBYTE RB_RBA_Common_CentralElements_CompuMethods_Identical 1 100 0.0 255.00 FORMAT "%8.2" ECU_ADDRESS 0xfe402dc6 /end MEASUREMENT
/begin MEASUREMENT Tlib_ThemACGroupPwrReqHFAGroup_LowPowerCANFD "" UBYTE RB_RBA_Common_CentralElements_CompuMethods_Identical 1 100 0.0 255.00 FORMAT "%8.2" ECU_ADDRESS 0xfe402dc7 /end MEASUREMENT
/begin MEASUREMENT Tlib_ThemACGroupPwrReqTherm5_LowPowerCANFD "" UBYTE RB_RBA_Common_CentralElements_CompuMethods_Identical 1 100 0.0 255.00 FORMAT "%8.2" ECU_ADDRESS 0xfe402dc8 /end MEASUREMENT
/begin MEASUREMENT Tlib_ThemACGroupPwrReqVGAGroup1_LowPowerCANFD "" UBYTE RB_RBA_Common_CentralElements_CompuMethods_Identical 1 100 0.0 255.00 FORMAT "%8.2" ECU_ADDRESS 0xfe402dc9 /end MEASUREMENT
/begin MEASUREMENT Tlib_ThemACGroupPwrReqTherm2_LowPowerCANFD "" UBYTE RB_RBA_Common_CentralElements_CompuMethods_Identical 1 100 0.0 255.00 FORMAT "%8.2" ECU_ADDRESS 0xfe402dca /end MEASUREMENT
/begin MEASUREMENT Tlib_ThemACGroupPwrReqVBMR_LowPowerCANFD "" UBYTE RB_RBA_Common_CentralElements_CompuMethods_Identical 1 100 0.0 255.00 FORMAT "%8.2" ECU_ADDRESS 0xfe402dcb /end MEASUREMENT
/begin MEASUREMENT Tlib_ThemACGroupPwrReqHFSpare_LowPowerCANFD "" UBYTE RB_RBA_Common_CentralElements_CompuMethods_Identical 1 100 0.0 255.00 FORMAT "%8.2" ECU_ADDRESS 0xfe402dcc /end MEASUREMENT
/begin MEASUREMENT Tlib_ThemACGroupPwrReqCDSMIX_LowPowerCANFD "" UBYTE RB_RBA_Common_CentralElements_CompuMethods_Identical 1 100 0.0 255.00 FORMAT "%8.2" ECU_ADDRESS 0xfe402dcd /end MEASUREMENT
/begin MEASUREMENT Tlib_ThemACGroupPwrReqHBMF_LowPowerCANFD "" UBYTE RB_RBA_Common_CentralElements_CompuMethods_Identical 1 100 0.0 255.00 FORMAT "%8.2" ECU_ADDRESS 0xfe402dce /end MEASUREMENT
/begin MEASUREMENT Tlib_ThemACGroupPwrReqVGAGroup2_LowPowerCANFD "" UBYTE RB_RBA_Common_CentralElements_CompuMethods_Identical 1 100 0.0 255.00 FORMAT "%8.2" ECU_ADDRESS 0xfe402dcf /end MEASUREMENT
/begin MEASUREMENT Tlib_ThemACGroupPwrReqThermResd2_LowPowerCANFD "" UBYTE RB_RBA_Common_CentralElements_CompuMethods_Identical 1 100 0.0 255.00 FORMAT "%8.2" ECU_ADDRESS 0xfe402dd0 /end MEASUREMENT
/begin MEASUREMENT Tlib_ThemACGroupPwrReqTherm3_LowPowerCANFD "" UBYTE RB_RBA_Common_CentralElements_CompuMethods_Identical 1 100 0.0 255.00 FORMAT "%8.2" ECU_ADDRESS 0xfe402dd1 /end MEASUREMENT
/begin MEASUREMENT Tlib_ThemACGroupPwrReqVIM_LowPowerCANFD "" UBYTE RB_RBA_Common_CentralElements_CompuMethods_Identical 1 100 0.0 255.00 FORMAT "%8.2" ECU_ADDRESS 0xfe402dd2 /end MEASUREMENT
/begin MEASUREMENT Tlib_ThemACGroupPwrReqVGASpare_LowPowerCANFD "" UBYTE RB_RBA_Common_CentralElements_CompuMethods_Identical 1 100 0.0 255.00 FORMAT "%8.2" ECU_ADDRESS 0xfe402dd3 /end MEASUREMENT
/begin MEASUREMENT Tlib_ThemACGroupPwrReqVGAGroup3_LowPowerCANFD "" UBYTE RB_RBA_Common_CentralElements_CompuMethods_Identical 1 100 0.0 255.00 FORMAT "%8.2" ECU_ADDRESS 0xfe402dd4 /end MEASUREMENT
/begin MEASUREMENT Tlib_ThemACGroupPwrReqTherm1_LowPowerCANFD "" UBYTE RB_RBA_Common_CentralElements_CompuMethods_Identical 1 100 0.0 255.00 FORMAT "%8.2" ECU_ADDRESS 0xfe402dd5 /end MEASUREMENT
/begin MEASUREMENT Tlib_ThemACGroupPwrReqTherm6_LowPowerCANFD "" UBYTE RB_RBA_Common_CentralElements_CompuMethods_Identical 1 100 0.0 255.00 FORMAT "%8.2" ECU_ADDRESS 0xfe402dd6 /end MEASUREMENT
/begin MEASUREMENT Tlib_ThemACGroupPwrReqDataID4_LowPowerCANFD "" UBYTE RB_RBA_Common_CentralElements_CompuMethods_Identical 1 100 0.0 255.00 FORMAT "%8.2" ECU_ADDRESS 0xfe402dd7 /end MEASUREMENT
/begin MEASUREMENT Tlib_ThemACGroupPwrReqCntr4_LowPowerCANFD "" UBYTE RB_RBA_Common_CentralElements_CompuMethods_Identical 1 100 0.0 255.00 FORMAT "%8.2" ECU_ADDRESS 0xfe402dd8 /end MEASUREMENT
/begin MEASUREMENT Tlib_ThemACGroupPwrReqChks8_LowPowerCANFD "" UBYTE RB_RBA_Common_CentralElements_CompuMethods_Identical 1 100 0.0 255.00 FORMAT "%8.2" ECU_ADDRESS 0xfe402dd9 /end MEASUREMENT
/begin MEASUREMENT Tlib_HVGroupPwrReqBECM5_LowPowerCANFD "" UBYTE RB_RBA_Common_CentralElements_CompuMethods_Identical 1 100 0.0 255.00 FORMAT "%8.2" ECU_ADDRESS 0xfe402dda /end MEASUREMENT
/begin MEASUREMENT Tlib_HVGroupPwrReqHBCM_LowPowerCANFD "" UBYTE RB_RBA_Common_CentralElements_CompuMethods_Identical 1 100 0.0 255.00 FORMAT "%8.2" ECU_ADDRESS 0xfe402ddb /end MEASUREMENT
/begin MEASUREMENT Tlib_HVGroupPwrReqBECM3_LowPowerCANFD "" UBYTE RB_RBA_Common_CentralElements_CompuMethods_Identical 1 100 0.0 255.00 FORMAT "%8.2" ECU_ADDRESS 0xfe402ddc /end MEASUREMENT
/begin MEASUREMENT Tlib_HVGroupPwrReqIFDS2_LowPowerCANFD "" UBYTE RB_RBA_Common_CentralElements_CompuMethods_Identical 1 100 0.0 255.00 FORMAT "%8.2" ECU_ADDRESS 0xfe402ddd /end MEASUREMENT
/begin MEASUREMENT Tlib_HVGroupPwrReqHVResd1_LowPowerCANFD "" UBYTE RB_RBA_Common_CentralElements_CompuMethods_Identical 1 100 0.0 255.00 FORMAT "%8.2" ECU_ADDRESS 0xfe402dde /end MEASUREMENT
/begin MEASUREMENT Tlib_HVGroupPwrReqHVResd2_LowPowerCANFD "" UBYTE RB_RBA_Common_CentralElements_CompuMethods_Identical 1 100 0.0 255.00 FORMAT "%8.2" ECU_ADDRESS 0xfe402ddf /end MEASUREMENT
/begin MEASUREMENT Tlib_HVGroupPwrReqWPTM_LowPowerCANFD "" UBYTE RB_RBA_Common_CentralElements_CompuMethods_Identical 1 100 0.0 255.00 FORMAT "%8.2" ECU_ADDRESS 0xfe402de0 /end MEASUREMENT
/begin MEASUREMENT Tlib_HVGroupPwrReqOBC_LowPowerCANFD "" UBYTE RB_RBA_Common_CentralElements_CompuMethods_Identical 1 100 0.0 255.00 FORMAT "%8.2" ECU_ADDRESS 0xfe402de1 /end MEASUREMENT
/begin MEASUREMENT Tlib_HVGroupPwrReqIFDS1_LowPowerCANFD "" UBYTE RB_RBA_Common_CentralElements_CompuMethods_Identical 1 100 0.0 255.00 FORMAT "%8.2" ECU_ADDRESS 0xfe402de2 /end MEASUREMENT
/begin MEASUREMENT Tlib_HVGroupPwrReqIRDS2_LowPowerCANFD "" UBYTE RB_RBA_Common_CentralElements_CompuMethods_Identical 1 100 0.0 255.00 FORMAT "%8.2" ECU_ADDRESS 0xfe402de3 /end MEASUREMENT
/begin MEASUREMENT Tlib_HVGroupPwrReqEOPM1_LowPowerCANFD "" UBYTE RB_RBA_Common_CentralElements_CompuMethods_Identical 1 100 0.0 255.00 FORMAT "%8.2" ECU_ADDRESS 0xfe402de4 /end MEASUREMENT
/begin MEASUREMENT Tlib_HVGroupPwrReqIRDS1_LowPowerCANFD "" UBYTE RB_RBA_Common_CentralElements_CompuMethods_Identical 1 100 0.0 255.00 FORMAT "%8.2" ECU_ADDRESS 0xfe402de5 /end MEASUREMENT
/begin MEASUREMENT Tlib_HVGroupPwrReqEOPM2_LowPowerCANFD "" UBYTE RB_RBA_Common_CentralElements_CompuMethods_Identical 1 100 0.0 255.00 FORMAT "%8.2" ECU_ADDRESS 0xfe402de6 /end MEASUREMENT
/begin MEASUREMENT Tlib_HVGroupPwrReqBECM1_LowPowerCANFD "" UBYTE RB_RBA_Common_CentralElements_CompuMethods_Identical 1 100 0.0 255.00 FORMAT "%8.2" ECU_ADDRESS 0xfe402de7 /end MEASUREMENT
/begin MEASUREMENT Tlib_HVGroupPwrReqBECM4_LowPowerCANFD "" UBYTE RB_RBA_Common_CentralElements_CompuMethods_Identical 1 100 0.0 255.00 FORMAT "%8.2" ECU_ADDRESS 0xfe402de8 /end MEASUREMENT
/begin MEASUREMENT Tlib_HVGroupPwrReqOutletChg_LowPowerCANFD "" UBYTE RB_RBA_Common_CentralElements_CompuMethods_Identical 1 100 0.0 255.00 FORMAT "%8.2" ECU_ADDRESS 0xfe402de9 /end MEASUREMENT
/begin MEASUREMENT Tlib_HVGroupPwrReqSHVC_LowPowerCANFD "" UBYTE RB_RBA_Common_CentralElements_CompuMethods_Identical 1 100 0.0 255.00 FORMAT "%8.2" ECU_ADDRESS 0xfe402dea /end MEASUREMENT
/begin MEASUREMENT Tlib_HVGroupPwrReqHVCM_LowPowerCANFD "" UBYTE RB_RBA_Common_CentralElements_CompuMethods_Identical 1 100 0.0 255.00 FORMAT "%8.2" ECU_ADDRESS 0xfe402deb /end MEASUREMENT
/begin MEASUREMENT Tlib_HVGroupPwrReqEOPM3_LowPowerCANFD "" UBYTE RB_RBA_Common_CentralElements_CompuMethods_Identical 1 100 0.0 255.00 FORMAT "%8.2" ECU_ADDRESS 0xfe402dec /end MEASUREMENT
/begin MEASUREMENT Tlib_HVGroupPwrReqAccrPedl_LowPowerCANFD "" UBYTE RB_RBA_Common_CentralElements_CompuMethods_Identical 1 100 0.0 255.00 FORMAT "%8.2" ECU_ADDRESS 0xfe402ded /end MEASUREMENT
/begin MEASUREMENT Tlib_HVGroupPwrReqBECM2_LowPowerCANFD "" UBYTE RB_RBA_Common_CentralElements_CompuMethods_Identical 1 100 0.0 255.00 FORMAT "%8.2" ECU_ADDRESS 0xfe402dee /end MEASUREMENT
/begin MEASUREMENT Tlib_HVGroupPwrReqChks8_LowPowerCANFD "" UBYTE RB_RBA_Common_CentralElements_CompuMethods_Identical 1 100 0.0 255.00 FORMAT "%8.2" ECU_ADDRESS 0xfe402def /end MEASUREMENT
/begin MEASUREMENT Tlib_HVGroupPwrReqDataID4_LowPowerCANFD "" UBYTE RB_RBA_Common_CentralElements_CompuMethods_Identical 1 100 0.0 255.00 FORMAT "%8.2" ECU_ADDRESS 0xfe402df0 /end MEASUREMENT
/begin MEASUREMENT Tlib_HVGroupPwrReqCntr4_LowPowerCANFD "" UBYTE RB_RBA_Common_CentralElements_CompuMethods_Identical 1 100 0.0 255.00 FORMAT "%8.2" ECU_ADDRESS 0xfe402df1 /end MEASUREMENT
/begin MEASUREMENT Tlib_HVGroupPwrReqWPTMWakeReq_LowPowerCANFD "" UBYTE RB_RBA_Common_CentralElements_CompuMethods_Identical 1 100 0.0 255.00 FORMAT "%8.2" ECU_ADDRESS 0xfe402df2 /end MEASUREMENT
/begin MEASUREMENT Tlib_LiGroupPwrReqHCMR2_LowPowerCANFD "" UBYTE RB_RBA_Common_CentralElements_CompuMethods_Identical 1 100 0.0 255.00 FORMAT "%8.2" ECU_ADDRESS 0xfe402df3 /end MEASUREMENT
/begin MEASUREMENT Tlib_LiGroupPwrReqFCSI_LowPowerCANFD "" UBYTE RB_RBA_Common_CentralElements_CompuMethods_Identical 1 100 0.0 255.00 FORMAT "%8.2" ECU_ADDRESS 0xfe402df4 /end MEASUREMENT
/begin MEASUREMENT Tlib_LiGroupPwrReqALMGroup2_LowPowerCANFD "" UBYTE RB_RBA_Common_CentralElements_CompuMethods_Identical 1 100 0.0 255.00 FORMAT "%8.2" ECU_ADDRESS 0xfe402df5 /end MEASUREMENT
/begin MEASUREMENT Tlib_LiGroupPwrReqHCMR1_LowPowerCANFD "" UBYTE RB_RBA_Common_CentralElements_CompuMethods_Identical 1 100 0.0 255.00 FORMAT "%8.2" ECU_ADDRESS 0xfe402df6 /end MEASUREMENT
/begin MEASUREMENT Tlib_LiGroupPwrReqSmtLED1_LowPowerCANFD "" UBYTE RB_RBA_Common_CentralElements_CompuMethods_Identical 1 100 0.0 255.00 FORMAT "%8.2" ECU_ADDRESS 0xfe402df7 /end MEASUREMENT
/begin MEASUREMENT Tlib_LiGroupPwrReqCbnIntr_LowPowerCANFD "" UBYTE RB_RBA_Common_CentralElements_CompuMethods_Identical 1 100 0.0 255.00 FORMAT "%8.2" ECU_ADDRESS 0xfe402df8 /end MEASUREMENT
/begin MEASUREMENT Tlib_LiGroupPwrReqCLML_LowPowerCANFD "" UBYTE RB_RBA_Common_CentralElements_CompuMethods_Identical 1 100 0.0 255.00 FORMAT "%8.2" ECU_ADDRESS 0xfe402df9 /end MEASUREMENT
/begin MEASUREMENT Tlib_LiGroupPwrReqALMGroup1_LowPowerCANFD "" UBYTE RB_RBA_Common_CentralElements_CompuMethods_Identical 1 100 0.0 255.00 FORMAT "%8.2" ECU_ADDRESS 0xfe402dfa /end MEASUREMENT
/begin MEASUREMENT Tlib_LiGroupPwrReqCLMR_LowPowerCANFD "" UBYTE RB_RBA_Common_CentralElements_CompuMethods_Identical 1 100 0.0 255.00 FORMAT "%8.2" ECU_ADDRESS 0xfe402dfb /end MEASUREMENT
/begin MEASUREMENT Tlib_LiGroupPwrReqHCML1_LowPowerCANFD "" UBYTE RB_RBA_Common_CentralElements_CompuMethods_Identical 1 100 0.0 255.00 FORMAT "%8.2" ECU_ADDRESS 0xfe402dfc /end MEASUREMENT
/begin MEASUREMENT Tlib_LiGroupPwrReqOHC_LowPowerCANFD "" UBYTE RB_RBA_Common_CentralElements_CompuMethods_Identical 1 100 0.0 255.00 FORMAT "%8.2" ECU_ADDRESS 0xfe402dfd /end MEASUREMENT
/begin MEASUREMENT Tlib_LiGroupPwrReqRCM2_LowPowerCANFD "" UBYTE RB_RBA_Common_CentralElements_CompuMethods_Identical 1 100 0.0 255.00 FORMAT "%8.2" ECU_ADDRESS 0xfe402dfe /end MEASUREMENT
/begin MEASUREMENT Tlib_LiGroupPwrReqLiResd2_LowPowerCANFD "" UBYTE RB_RBA_Common_CentralElements_CompuMethods_Identical 1 100 0.0 255.00 FORMAT "%8.2" ECU_ADDRESS 0xfe402dff /end MEASUREMENT
/begin MEASUREMENT Tlib_LiGroupPwrReqSmtLED2_LowPowerCANFD "" UBYTE RB_RBA_Common_CentralElements_CompuMethods_Identical 1 100 0.0 255.00 FORMAT "%8.2" ECU_ADDRESS 0xfe402e00 /end MEASUREMENT
/begin MEASUREMENT Tlib_LiGroupPwrReqRCM1_LowPowerCANFD "" UBYTE RB_RBA_Common_CentralElements_CompuMethods_Identical 1 100 0.0 255.00 FORMAT "%8.2" ECU_ADDRESS 0xfe402e01 /end MEASUREMENT
/begin MEASUREMENT Tlib_LiGroupPwrReqHCML2_LowPowerCANFD "" UBYTE RB_RBA_Common_CentralElements_CompuMethods_Identical 1 100 0.0 255.00 FORMAT "%8.2" ECU_ADDRESS 0xfe402e02 /end MEASUREMENT
/begin MEASUREMENT Tlib_LiGroupPwrReqLiResd1_LowPowerCANFD "" UBYTE RB_RBA_Common_CentralElements_CompuMethods_Identical 1 100 0.0 255.00 FORMAT "%8.2" ECU_ADDRESS 0xfe402e03 /end MEASUREMENT
/begin MEASUREMENT Tlib_LiGroupPwrReqLiResd4_LowPowerCANFD "" UBYTE RB_RBA_Common_CentralElements_CompuMethods_Identical 1 100 0.0 255.00 FORMAT "%8.2" ECU_ADDRESS 0xfe402e04 /end MEASUREMENT
/begin MEASUREMENT Tlib_LiGroupPwrReqLiResd3_LowPowerCANFD "" UBYTE RB_RBA_Common_CentralElements_CompuMethods_Identical 1 100 0.0 255.00 FORMAT "%8.2" ECU_ADDRESS 0xfe402e05 /end MEASUREMENT
/begin MEASUREMENT Tlib_LiGroupPwrReqDataID4_LowPowerCANFD "" UBYTE RB_RBA_Common_CentralElements_CompuMethods_Identical 1 100 0.0 255.00 FORMAT "%8.2" ECU_ADDRESS 0xfe402e06 /end MEASUREMENT
/begin MEASUREMENT Tlib_LiGroupPwrReqCntr4_LowPowerCANFD "" UBYTE RB_RBA_Common_CentralElements_CompuMethods_Identical 1 100 0.0 255.00 FORMAT "%8.2" ECU_ADDRESS 0xfe402e07 /end MEASUREMENT
/begin MEASUREMENT Tlib_LiGroupPwrReqChks8_LowPowerCANFD "" UBYTE RB_RBA_Common_CentralElements_CompuMethods_Identical 1 100 0.0 255.00 FORMAT "%8.2" ECU_ADDRESS 0xfe402e08 /end MEASUREMENT
/begin MEASUREMENT Tlib_BodyGroupPwrReqNKR_LowPowerCANFD "" UBYTE RB_RBA_Common_CentralElements_CompuMethods_Identical 1 100 0.0 255.00 FORMAT "%8.2" ECU_ADDRESS 0xfe402e09 /end MEASUREMENT
/begin MEASUREMENT Tlib_BodyGroupPwrReqCSCHIPA_LowPowerCANFD "" UBYTE RB_RBA_Common_CentralElements_CompuMethods_Identical 1 100 0.0 255.00 FORMAT "%8.2" ECU_ADDRESS 0xfe402e0a /end MEASUREMENT
/begin MEASUREMENT Tlib_BodyGroupPwrReqCSCBC2_LowPowerCANFD "" UBYTE RB_RBA_Common_CentralElements_CompuMethods_Identical 1 100 0.0 255.00 FORMAT "%8.2" ECU_ADDRESS 0xfe402e0b /end MEASUREMENT
/begin MEASUREMENT Tlib_BodyGroupPwrReqETC_LowPowerCANFD "" UBYTE RB_RBA_Common_CentralElements_CompuMethods_Identical 1 100 0.0 255.00 FORMAT "%8.2" ECU_ADDRESS 0xfe402e0c /end MEASUREMENT
/begin MEASUREMENT Tlib_BodyGroupPwrReqUSB2_LowPowerCANFD "" UBYTE RB_RBA_Common_CentralElements_CompuMethods_Identical 1 100 0.0 255.00 FORMAT "%8.2" ECU_ADDRESS 0xfe402e0d /end MEASUREMENT
/begin MEASUREMENT Tlib_BodyGroupPwrReqETCM_LowPowerCANFD "" UBYTE RB_RBA_Common_CentralElements_CompuMethods_Identical 1 100 0.0 255.00 FORMAT "%8.2" ECU_ADDRESS 0xfe402e0e /end MEASUREMENT
/begin MEASUREMENT Tlib_BodyGroupPwrReqCigar1_LowPowerCANFD "" UBYTE RB_RBA_Common_CentralElements_CompuMethods_Identical 1 100 0.0 255.00 FORMAT "%8.2" ECU_ADDRESS 0xfe402e0f /end MEASUREMENT
/begin MEASUREMENT Tlib_BodyGroupPwrReqBodyResd2_LowPowerCANFD "" UBYTE RB_RBA_Common_CentralElements_CompuMethods_Identical 1 100 0.0 255.00 FORMAT "%8.2" ECU_ADDRESS 0xfe402e10 /end MEASUREMENT
/begin MEASUREMENT Tlib_BodyGroupPwrReqCSCBC1_LowPowerCANFD "" UBYTE RB_RBA_Common_CentralElements_CompuMethods_Identical 1 100 0.0 255.00 FORMAT "%8.2" ECU_ADDRESS 0xfe402e11 /end MEASUREMENT
/begin MEASUREMENT Tlib_BodyGroupPwrReqWPC_LowPowerCANFD "" UBYTE RB_RBA_Common_CentralElements_CompuMethods_Identical 1 100 0.0 255.00 FORMAT "%8.2" ECU_ADDRESS 0xfe402e12 /end MEASUREMENT
/begin MEASUREMENT Tlib_BodyGroupPwrReqSRM_LowPowerCANFD "" UBYTE RB_RBA_Common_CentralElements_CompuMethods_Identical 1 100 0.0 255.00 FORMAT "%8.2" ECU_ADDRESS 0xfe402e13 /end MEASUREMENT
/begin MEASUREMENT Tlib_BodyGroupPwrReqDDRMMIX_LowPowerCANFD "" UBYTE RB_RBA_Common_CentralElements_CompuMethods_Identical 1 100 0.0 255.00 FORMAT "%8.2" ECU_ADDRESS 0xfe402e14 /end MEASUREMENT
/begin MEASUREMENT Tlib_BodyGroupPwrReqSSRCTRCP_LowPowerCANFD "" UBYTE RB_RBA_Common_CentralElements_CompuMethods_Identical 1 100 0.0 255.00 FORMAT "%8.2" ECU_ADDRESS 0xfe402e15 /end MEASUREMENT
/begin MEASUREMENT Tlib_BodyGroupPwrReqWMM_LowPowerCANFD "" UBYTE RB_RBA_Common_CentralElements_CompuMethods_Identical 1 100 0.0 255.00 FORMAT "%8.2" ECU_ADDRESS 0xfe402e16 /end MEASUREMENT
/begin MEASUREMENT Tlib_BodyGroupPwrReqCSCUXHK3_LowPowerCANFD "" UBYTE RB_RBA_Common_CentralElements_CompuMethods_Identical 1 100 0.0 255.00 FORMAT "%8.2" ECU_ADDRESS 0xfe402e17 /end MEASUREMENT
/begin MEASUREMENT Tlib_BodyGroupPwrReqCSCUXHK2_LowPowerCANFD "" UBYTE RB_RBA_Common_CentralElements_CompuMethods_Identical 1 100 0.0 255.00 FORMAT "%8.2" ECU_ADDRESS 0xfe402e18 /end MEASUREMENT
/begin MEASUREMENT Tlib_BodyGroupPwrReqCSLM_LowPowerCANFD "" UBYTE RB_RBA_Common_CentralElements_CompuMethods_Identical 1 100 0.0 255.00 FORMAT "%8.2" ECU_ADDRESS 0xfe402e19 /end MEASUREMENT
/begin MEASUREMENT Tlib_BodyGroupPwrReqOutletRsd_LowPowerCANFD "" UBYTE RB_RBA_Common_CentralElements_CompuMethods_Identical 1 100 0.0 255.00 FORMAT "%8.2" ECU_ADDRESS 0xfe402e1a /end MEASUREMENT
/begin MEASUREMENT Tlib_BodyGroupPwrReqCigar2_LowPowerCANFD "" UBYTE RB_RBA_Common_CentralElements_CompuMethods_Identical 1 100 0.0 255.00 FORMAT "%8.2" ECU_ADDRESS 0xfe402e1b /end MEASUREMENT
/begin MEASUREMENT Tlib_BodyGroupPwrReqPRLD_LowPowerCANFD "" UBYTE RB_RBA_Common_CentralElements_CompuMethods_Identical 1 100 0.0 255.00 FORMAT "%8.2" ECU_ADDRESS 0xfe402e1c /end MEASUREMENT
/begin MEASUREMENT Tlib_BodyGroupPwrReqUSB1_LowPowerCANFD "" UBYTE RB_RBA_Common_CentralElements_CompuMethods_Identical 1 100 0.0 255.00 FORMAT "%8.2" ECU_ADDRESS 0xfe402e1d /end MEASUREMENT
/begin MEASUREMENT Tlib_BodyGroupPwrReqETCMWake_LowPowerCANFD "" UBYTE RB_RBA_Common_CentralElements_CompuMethods_Identical 1 100 0.0 255.00 FORMAT "%8.2" ECU_ADDRESS 0xfe402e1e /end MEASUREMENT
/begin MEASUREMENT Tlib_BodyGroupPwrReqCSCUXHK1_LowPowerCANFD "" UBYTE RB_RBA_Common_CentralElements_CompuMethods_Identical 1 100 0.0 255.00 FORMAT "%8.2" ECU_ADDRESS 0xfe402e1f /end MEASUREMENT
/begin MEASUREMENT Tlib_BodyGroupPwrReqCSCHIPB_LowPowerCANFD "" UBYTE RB_RBA_Common_CentralElements_CompuMethods_Identical 1 100 0.0 255.00 FORMAT "%8.2" ECU_ADDRESS 0xfe402e20 /end MEASUREMENT
/begin MEASUREMENT Tlib_BodyGroupPwrReqTCAM_LowPowerCANFD "" UBYTE RB_RBA_Common_CentralElements_CompuMethods_Identical 1 100 0.0 255.00 FORMAT "%8.2" ECU_ADDRESS 0xfe402e21 /end MEASUREMENT
/begin MEASUREMENT Tlib_BodyGroupPwrReqBodyResd1_LowPowerCANFD "" UBYTE RB_RBA_Common_CentralElements_CompuMethods_Identical 1 100 0.0 255.00 FORMAT "%8.2" ECU_ADDRESS 0xfe402e22 /end MEASUREMENT
/begin MEASUREMENT Tlib_BodyGroupPwrReqPwrReq7_LowPowerCANFD "" UBYTE RB_RBA_Common_CentralElements_CompuMethods_Identical 1 100 0.0 255.00 FORMAT "%8.2" ECU_ADDRESS 0xfe402e23 /end MEASUREMENT
/begin MEASUREMENT Tlib_BodyGroupPwrReqWakeReq_LowPowerCANFD "" UBYTE RB_RBA_Common_CentralElements_CompuMethods_Identical 1 100 0.0 255.00 FORMAT "%8.2" ECU_ADDRESS 0xfe402e24 /end MEASUREMENT
/begin MEASUREMENT Tlib_BodyGroupPwrReqPwrReq3_LowPowerCANFD "" UBYTE RB_RBA_Common_CentralElements_CompuMethods_Identical 1 100 0.0 255.00 FORMAT "%8.2" ECU_ADDRESS 0xfe402e25 /end MEASUREMENT
/begin MEASUREMENT Tlib_BodyGroupPwrReqPwrReq15_LowPowerCANFD "" UBYTE RB_RBA_Common_CentralElements_CompuMethods_Identical 1 100 0.0 255.00 FORMAT "%8.2" ECU_ADDRESS 0xfe402e26 /end MEASUREMENT
/begin MEASUREMENT Tlib_BodyGroupPwrReqPwrReq2_LowPowerCANFD "" UBYTE RB_RBA_Common_CentralElements_CompuMethods_Identical 1 100 0.0 255.00 FORMAT "%8.2" ECU_ADDRESS 0xfe402e27 /end MEASUREMENT
/begin MEASUREMENT Tlib_BodyGroupPwrReqPwrReq16_LowPowerCANFD "" UBYTE RB_RBA_Common_CentralElements_CompuMethods_Identical 1 100 0.0 255.00 FORMAT "%8.2" ECU_ADDRESS 0xfe402e28 /end MEASUREMENT
/begin MEASUREMENT Tlib_BodyGroupPwrReqPwrReq5_LowPowerCANFD "" UBYTE RB_RBA_Common_CentralElements_CompuMethods_Identical 1 100 0.0 255.00 FORMAT "%8.2" ECU_ADDRESS 0xfe402e29 /end MEASUREMENT
/begin MEASUREMENT Tlib_BodyGroupPwrReqPwrReq1_LowPowerCANFD "" UBYTE RB_RBA_Common_CentralElements_CompuMethods_Identical 1 100 0.0 255.00 FORMAT "%8.2" ECU_ADDRESS 0xfe402e2a /end MEASUREMENT
/begin MEASUREMENT Tlib_BodyGroupPwrReqPwrReq9_LowPowerCANFD "" UBYTE RB_RBA_Common_CentralElements_CompuMethods_Identical 1 100 0.0 255.00 FORMAT "%8.2" ECU_ADDRESS 0xfe402e2b /end MEASUREMENT
/begin MEASUREMENT Tlib_BodyGroupPwrReqBMSWakeReq_LowPowerCANFD "" UBYTE RB_RBA_Common_CentralElements_CompuMethods_Identical 1 100 0.0 255.00 FORMAT "%8.2" ECU_ADDRESS 0xfe402e2c /end MEASUREMENT
/begin MEASUREMENT Tlib_BodyGroupPwrReqPwrReq12_LowPowerCANFD "" UBYTE RB_RBA_Common_CentralElements_CompuMethods_Identical 1 100 0.0 255.00 FORMAT "%8.2" ECU_ADDRESS 0xfe402e2d /end MEASUREMENT
/begin MEASUREMENT Tlib_BodyGroupPwrReqPwrReq8_LowPowerCANFD "" UBYTE RB_RBA_Common_CentralElements_CompuMethods_Identical 1 100 0.0 255.00 FORMAT "%8.2" ECU_ADDRESS 0xfe402e2e /end MEASUREMENT
/begin MEASUREMENT Tlib_BodyGroupPwrReqBMSBWakeReq_LowPowerCANFD "" UBYTE RB_RBA_Common_CentralElements_CompuMethods_Identical 1 100 0.0 255.00 FORMAT "%8.2" ECU_ADDRESS 0xfe402e2f /end MEASUREMENT
/begin MEASUREMENT Tlib_BodyGroupPwrReqPwrReq13_LowPowerCANFD "" UBYTE RB_RBA_Common_CentralElements_CompuMethods_Identical 1 100 0.0 255.00 FORMAT "%8.2" ECU_ADDRESS 0xfe402e30 /end MEASUREMENT
/begin MEASUREMENT Tlib_BodyGroupPwrReqPwrReq6_LowPowerCANFD "" UBYTE RB_RBA_Common_CentralElements_CompuMethods_Identical 1 100 0.0 255.00 FORMAT "%8.2" ECU_ADDRESS 0xfe402e31 /end MEASUREMENT
/begin MEASUREMENT Tlib_BodyGroupPwrReqPwrReq4_LowPowerCANFD "" UBYTE RB_RBA_Common_CentralElements_CompuMethods_Identical 1 100 0.0 255.00 FORMAT "%8.2" ECU_ADDRESS 0xfe402e32 /end MEASUREMENT
/begin MEASUREMENT Tlib_BodyGroupPwrReqPwrReq10_LowPowerCANFD "" UBYTE RB_RBA_Common_CentralElements_CompuMethods_Identical 1 100 0.0 255.00 FORMAT "%8.2" ECU_ADDRESS 0xfe402e33 /end MEASUREMENT
/begin MEASUREMENT Tlib_BodyGroupPwrReqPwrReq14_LowPowerCANFD "" UBYTE RB_RBA_Common_CentralElements_CompuMethods_Identical 1 100 0.0 255.00 FORMAT "%8.2" ECU_ADDRESS 0xfe402e34 /end MEASUREMENT
/begin MEASUREMENT Tlib_BodyGroupPwrReqPwrReq11_LowPowerCANFD "" UBYTE RB_RBA_Common_CentralElements_CompuMethods_Identical 1 100 0.0 255.00 FORMAT "%8.2" ECU_ADDRESS 0xfe402e35 /end MEASUREMENT
/begin MEASUREMENT Tlib_BodyGroupPwrReqRLSMWakeReq_LowPowerCANFD "" UBYTE RB_RBA_Common_CentralElements_CompuMethods_Identical 1 100 0.0 255.00 FORMAT "%8.2" ECU_ADDRESS 0xfe402e36 /end MEASUREMENT
/begin MEASUREMENT Tlib_BodyGroupPwrReqSWSM_LowPowerCANFD "" UBYTE RB_RBA_Common_CentralElements_CompuMethods_Identical 1 100 0.0 255.00 FORMAT "%8.2" ECU_ADDRESS 0xfe402e37 /end MEASUREMENT
/begin MEASUREMENT Tlib_BodyGroupPwrReqDataID4_LowPowerCANFD "" UBYTE RB_RBA_Common_CentralElements_CompuMethods_Identical 1 100 0.0 255.00 FORMAT "%8.2" ECU_ADDRESS 0xfe402e38 /end MEASUREMENT
/begin MEASUREMENT Tlib_BodyGroupPwrReqCntr4_LowPowerCANFD "" UBYTE RB_RBA_Common_CentralElements_CompuMethods_Identical 1 100 0.0 255.00 FORMAT "%8.2" ECU_ADDRESS 0xfe402e39 /end MEASUREMENT
/begin MEASUREMENT Tlib_BodyGroupPwrReqChks8_LowPowerCANFD "" UBYTE RB_RBA_Common_CentralElements_CompuMethods_Identical 1 100 0.0 255.00 FORMAT "%8.2" ECU_ADDRESS 0xfe402e3a /end MEASUREMENT
/begin MEASUREMENT Tlib_CbnGroupPwrReqPwrReq1_LowPowerCANFD "" UBYTE RB_RBA_Common_CentralElements_CompuMethods_Identical 1 100 0.0 255.00 FORMAT "%8.2" ECU_ADDRESS 0xfe402e3b /end MEASUREMENT
/begin MEASUREMENT Tlib_CbnGroupPwrReqSMBR_LowPowerCANFD "" UBYTE RB_RBA_Common_CentralElements_CompuMethods_Identical 1 100 0.0 255.00 FORMAT "%8.2" ECU_ADDRESS 0xfe402e3c /end MEASUREMENT
/begin MEASUREMENT Tlib_CbnGroupPwrReqDIS_LowPowerCANFD "" UBYTE RB_RBA_Common_CentralElements_CompuMethods_Identical 1 100 0.0 255.00 FORMAT "%8.2" ECU_ADDRESS 0xfe402e3d /end MEASUREMENT
/begin MEASUREMENT Tlib_CbnGroupPwrReqSMP_LowPowerCANFD "" UBYTE RB_RBA_Common_CentralElements_CompuMethods_Identical 1 100 0.0 255.00 FORMAT "%8.2" ECU_ADDRESS 0xfe402e3e /end MEASUREMENT
/begin MEASUREMENT Tlib_CbnGroupPwrReqIRMM_LowPowerCANFD "" UBYTE RB_RBA_Common_CentralElements_CompuMethods_Identical 1 100 0.0 255.00 FORMAT "%8.2" ECU_ADDRESS 0xfe402e3f /end MEASUREMENT
/begin MEASUREMENT Tlib_CbnGroupPwrReqPwrReq3_LowPowerCANFD "" UBYTE RB_RBA_Common_CentralElements_CompuMethods_Identical 1 100 0.0 255.00 FORMAT "%8.2" ECU_ADDRESS 0xfe402e40 /end MEASUREMENT
/begin MEASUREMENT Tlib_CbnGroupPwrReqPOT2_LowPowerCANFD "" UBYTE RB_RBA_Common_CentralElements_CompuMethods_Identical 1 100 0.0 255.00 FORMAT "%8.2" ECU_ADDRESS 0xfe402e41 /end MEASUREMENT
/begin MEASUREMENT Tlib_CbnGroupPwrReqABU_LowPowerCANFD "" UBYTE RB_RBA_Common_CentralElements_CompuMethods_Identical 1 100 0.0 255.00 FORMAT "%8.2" ECU_ADDRESS 0xfe402e42 /end MEASUREMENT
/begin MEASUREMENT Tlib_CbnGroupPwrReqOMSLi_LowPowerCANFD "" UBYTE RB_RBA_Common_CentralElements_CompuMethods_Identical 1 100 0.0 255.00 FORMAT "%8.2" ECU_ADDRESS 0xfe402e43 /end MEASUREMENT
/begin MEASUREMENT Tlib_CbnGroupPwrReqPwrReq6_LowPowerCANFD "" UBYTE RB_RBA_Common_CentralElements_CompuMethods_Identical 1 100 0.0 255.00 FORMAT "%8.2" ECU_ADDRESS 0xfe402e44 /end MEASUREMENT
/begin MEASUREMENT Tlib_CbnGroupPwrReqSMD_LowPowerCANFD "" UBYTE RB_RBA_Common_CentralElements_CompuMethods_Identical 1 100 0.0 255.00 FORMAT "%8.2" ECU_ADDRESS 0xfe402e45 /end MEASUREMENT
/begin MEASUREMENT Tlib_CbnGroupPwrReqPwrReq4_LowPowerCANFD "" UBYTE RB_RBA_Common_CentralElements_CompuMethods_Identical 1 100 0.0 255.00 FORMAT "%8.2" ECU_ADDRESS 0xfe402e46 /end MEASUREMENT
/begin MEASUREMENT Tlib_CbnGroupPwrReqPwrReq8_LowPowerCANFD "" UBYTE RB_RBA_Common_CentralElements_CompuMethods_Identical 1 100 0.0 255.00 FORMAT "%8.2" ECU_ADDRESS 0xfe402e47 /end MEASUREMENT
/begin MEASUREMENT Tlib_CbnGroupPwrReqMMLeft_LowPowerCANFD "" UBYTE RB_RBA_Common_CentralElements_CompuMethods_Identical 1 100 0.0 255.00 FORMAT "%8.2" ECU_ADDRESS 0xfe402e48 /end MEASUREMENT
/begin MEASUREMENT Tlib_CbnGroupPwrReqMMRight_LowPowerCANFD "" UBYTE RB_RBA_Common_CentralElements_CompuMethods_Identical 1 100 0.0 255.00 FORMAT "%8.2" ECU_ADDRESS 0xfe402e49 /end MEASUREMENT
/begin MEASUREMENT Tlib_CbnGroupPwrReqPwrReq7_LowPowerCANFD "" UBYTE RB_RBA_Common_CentralElements_CompuMethods_Identical 1 100 0.0 255.00 FORMAT "%8.2" ECU_ADDRESS 0xfe402e4a /end MEASUREMENT
/begin MEASUREMENT Tlib_CbnGroupPwrReqCbnResd1_LowPowerCANFD "" UBYTE RB_RBA_Common_CentralElements_CompuMethods_Identical 1 100 0.0 255.00 FORMAT "%8.2" ECU_ADDRESS 0xfe402e4b /end MEASUREMENT
/begin MEASUREMENT Tlib_CbnGroupPwrReqPOT1_LowPowerCANFD "" UBYTE RB_RBA_Common_CentralElements_CompuMethods_Identical 1 100 0.0 255.00 FORMAT "%8.2" ECU_ADDRESS 0xfe402e4c /end MEASUREMENT
/begin MEASUREMENT Tlib_CbnGroupPwrReqSMBL1_LowPowerCANFD "" UBYTE RB_RBA_Common_CentralElements_CompuMethods_Identical 1 100 0.0 255.00 FORMAT "%8.2" ECU_ADDRESS 0xfe402e4d /end MEASUREMENT
/begin MEASUREMENT Tlib_CbnGroupPwrReqPwrReq2_LowPowerCANFD "" UBYTE RB_RBA_Common_CentralElements_CompuMethods_Identical 1 100 0.0 255.00 FORMAT "%8.2" ECU_ADDRESS 0xfe402e4e /end MEASUREMENT
/begin MEASUREMENT Tlib_CbnGroupPwrReqSMBR1_LowPowerCANFD "" UBYTE RB_RBA_Common_CentralElements_CompuMethods_Identical 1 100 0.0 255.00 FORMAT "%8.2" ECU_ADDRESS 0xfe402e4f /end MEASUREMENT
/begin MEASUREMENT Tlib_CbnGroupPwrReqSMBL_LowPowerCANFD "" UBYTE RB_RBA_Common_CentralElements_CompuMethods_Identical 1 100 0.0 255.00 FORMAT "%8.2" ECU_ADDRESS 0xfe402e50 /end MEASUREMENT
/begin MEASUREMENT Tlib_CbnGroupPwrReqHUD_LowPowerCANFD "" UBYTE RB_RBA_Common_CentralElements_CompuMethods_Identical 1 100 0.0 255.00 FORMAT "%8.2" ECU_ADDRESS 0xfe402e51 /end MEASUREMENT
/begin MEASUREMENT Tlib_CbnGroupPwrReqCSD_LowPowerCANFD "" UBYTE RB_RBA_Common_CentralElements_CompuMethods_Identical 1 100 0.0 255.00 FORMAT "%8.2" ECU_ADDRESS 0xfe402e52 /end MEASUREMENT
/begin MEASUREMENT Tlib_CbnGroupPwrReqAUD_LowPowerCANFD "" UBYTE RB_RBA_Common_CentralElements_CompuMethods_Identical 1 100 0.0 255.00 FORMAT "%8.2" ECU_ADDRESS 0xfe402e53 /end MEASUREMENT
/begin MEASUREMENT Tlib_CbnGroupPwrReqPSD_LowPowerCANFD "" UBYTE RB_RBA_Common_CentralElements_CompuMethods_Identical 1 100 0.0 255.00 FORMAT "%8.2" ECU_ADDRESS 0xfe402e54 /end MEASUREMENT
/begin MEASUREMENT Tlib_CbnGroupPwrReqCbnResd2_LowPowerCANFD "" UBYTE RB_RBA_Common_CentralElements_CompuMethods_Identical 1 100 0.0 255.00 FORMAT "%8.2" ECU_ADDRESS 0xfe402e55 /end MEASUREMENT
/begin MEASUREMENT Tlib_CbnGroupPwrReqPwrReq5_LowPowerCANFD "" UBYTE RB_RBA_Common_CentralElements_CompuMethods_Identical 1 100 0.0 255.00 FORMAT "%8.2" ECU_ADDRESS 0xfe402e56 /end MEASUREMENT
/begin MEASUREMENT Tlib_MoveSftyGroupPwrReqRMD_LowPowerCANFD "" UBYTE RB_RBA_Common_CentralElements_CompuMethods_Identical 1 100 0.0 255.00 FORMAT "%8.2" ECU_ADDRESS 0xfe402e57 /end MEASUREMENT
/begin MEASUREMENT Tlib_MoveSftyGroupPwrReqMoveSftyResd1_LowPowerCANFD "" UBYTE RB_RBA_Common_CentralElements_CompuMethods_Identical 1 100 0.0 255.00 FORMAT "%8.2" ECU_ADDRESS 0xfe402e58 /end MEASUREMENT
/begin MEASUREMENT Tlib_MoveSftyGroupPwrReqSRS1_LowPowerCANFD "" UBYTE RB_RBA_Common_CentralElements_CompuMethods_Identical 1 100 0.0 255.00 FORMAT "%8.2" ECU_ADDRESS 0xfe402e59 /end MEASUREMENT
/begin MEASUREMENT Tlib_MoveSftyGroupPwrReqRMR_LowPowerCANFD "" UBYTE RB_RBA_Common_CentralElements_CompuMethods_Identical 1 100 0.0 255.00 FORMAT "%8.2" ECU_ADDRESS 0xfe402e5a /end MEASUREMENT
/begin MEASUREMENT Tlib_MoveSftyGroupPwrReqSODLSODR_LowPowerCANFD "" UBYTE RB_RBA_Common_CentralElements_CompuMethods_Identical 1 100 0.0 255.00 FORMAT "%8.2" ECU_ADDRESS 0xfe402e5b /end MEASUREMENT
/begin MEASUREMENT Tlib_MoveSftyGroupPwrReqSteerFwakeReq_LowPowerCANFD "" UBYTE RB_RBA_Common_CentralElements_CompuMethods_Identical 1 100 0.0 255.00 FORMAT "%8.2" ECU_ADDRESS 0xfe402e5c /end MEASUREMENT
/begin MEASUREMENT Tlib_MoveSftyGroupPwrReqBCMwakeReq_LowPowerCANFD "" UBYTE RB_RBA_Common_CentralElements_CompuMethods_Identical 1 100 0.0 255.00 FORMAT "%8.2" ECU_ADDRESS 0xfe402e5d /end MEASUREMENT
/begin MEASUREMENT Tlib_MoveSftyGroupPwrReqFLC_LowPowerCANFD "" UBYTE RB_RBA_Common_CentralElements_CompuMethods_Identical 1 100 0.0 255.00 FORMAT "%8.2" ECU_ADDRESS 0xfe402e5e /end MEASUREMENT
/begin MEASUREMENT Tlib_MoveSftyGroupPwrReqMoveSftyResd4_LowPowerCANFD "" UBYTE RB_RBA_Common_CentralElements_CompuMethods_Identical 1 100 0.0 255.00 FORMAT "%8.2" ECU_ADDRESS 0xfe402e5f /end MEASUREMENT
/begin MEASUREMENT Tlib_MoveSftyGroupPwrReqFLL_LowPowerCANFD "" UBYTE RB_RBA_Common_CentralElements_CompuMethods_Identical 1 100 0.0 255.00 FORMAT "%8.2" ECU_ADDRESS 0xfe402e60 /end MEASUREMENT
/begin MEASUREMENT Tlib_MoveSftyGroupPwrReqMoveSftyResd3_LowPowerCANFD "" UBYTE RB_RBA_Common_CentralElements_CompuMethods_Identical 1 100 0.0 255.00 FORMAT "%8.2" ECU_ADDRESS 0xfe402e61 /end MEASUREMENT
/begin MEASUREMENT Tlib_MoveSftyGroupPwrReqDataID4_LowPowerCANFD "" UBYTE RB_RBA_Common_CentralElements_CompuMethods_Identical 1 100 0.0 255.00 FORMAT "%8.2" ECU_ADDRESS 0xfe402e62 /end MEASUREMENT
/begin MEASUREMENT Tlib_MoveSftyGroupPwrReqFSRLFSRR_LowPowerCANFD "" UBYTE RB_RBA_Common_CentralElements_CompuMethods_Identical 1 100 0.0 255.00 FORMAT "%8.2" ECU_ADDRESS 0xfe402e63 /end MEASUREMENT
/begin MEASUREMENT Tlib_MoveSftyGroupPwrReqFLR_LowPowerCANFD "" UBYTE RB_RBA_Common_CentralElements_CompuMethods_Identical 1 100 0.0 255.00 FORMAT "%8.2" ECU_ADDRESS 0xfe402e64 /end MEASUREMENT
/begin MEASUREMENT Tlib_MoveSftyGroupPwrReqRBCMwakeReq_LowPowerCANFD "" UBYTE RB_RBA_Common_CentralElements_CompuMethods_Identical 1 100 0.0 255.00 FORMAT "%8.2" ECU_ADDRESS 0xfe402e65 /end MEASUREMENT
/begin MEASUREMENT Tlib_MoveSftyGroupPwrReqMoveSftyResd2_LowPowerCANFD "" UBYTE RB_RBA_Common_CentralElements_CompuMethods_Identical 1 100 0.0 255.00 FORMAT "%8.2" ECU_ADDRESS 0xfe402e66 /end MEASUREMENT
/begin MEASUREMENT Tlib_MoveSftyGroupPwrReqCntr4_LowPowerCANFD "" UBYTE RB_RBA_Common_CentralElements_CompuMethods_Identical 1 100 0.0 255.00 FORMAT "%8.2" ECU_ADDRESS 0xfe402e67 /end MEASUREMENT
/begin MEASUREMENT Tlib_MoveSftyGroupPwrReqSUM_LowPowerCANFD "" UBYTE RB_RBA_Common_CentralElements_CompuMethods_Identical 1 100 0.0 255.00 FORMAT "%8.2" ECU_ADDRESS 0xfe402e68 /end MEASUREMENT
/begin MEASUREMENT Tlib_MoveSftyGroupPwrReqADPU_LowPowerCANFD "" UBYTE RB_RBA_Common_CentralElements_CompuMethods_Identical 1 100 0.0 255.00 FORMAT "%8.2" ECU_ADDRESS 0xfe402e69 /end MEASUREMENT
/begin MEASUREMENT Tlib_MoveSftyGroupPwrReqARMF_LowPowerCANFD "" UBYTE RB_RBA_Common_CentralElements_CompuMethods_Identical 1 100 0.0 255.00 FORMAT "%8.2" ECU_ADDRESS 0xfe402e6a /end MEASUREMENT
/begin MEASUREMENT Tlib_MoveSftyGroupPwrReqSRS2_LowPowerCANFD "" UBYTE RB_RBA_Common_CentralElements_CompuMethods_Identical 1 100 0.0 255.00 FORMAT "%8.2" ECU_ADDRESS 0xfe402e6b /end MEASUREMENT
/begin MEASUREMENT Tlib_MoveSftyGroupPwrReqSteerRWakeReq_LowPowerCANFD "" UBYTE RB_RBA_Common_CentralElements_CompuMethods_Identical 1 100 0.0 255.00 FORMAT "%8.2" ECU_ADDRESS 0xfe402e6c /end MEASUREMENT
/begin MEASUREMENT Tlib_MoveSftyGroupPwrReqSLLSLR_LowPowerCANFD "" UBYTE RB_RBA_Common_CentralElements_CompuMethods_Identical 1 100 0.0 255.00 FORMAT "%8.2" ECU_ADDRESS 0xfe402e6d /end MEASUREMENT
/begin MEASUREMENT Tlib_MoveSftyGroupPwrReqARMR_LowPowerCANFD "" UBYTE RB_RBA_Common_CentralElements_CompuMethods_Identical 1 100 0.0 255.00 FORMAT "%8.2" ECU_ADDRESS 0xfe402e6e /end MEASUREMENT
/begin MEASUREMENT Tlib_MoveSftyGroupPwrReqChks8_LowPowerCANFD "" UBYTE RB_RBA_Common_CentralElements_CompuMethods_Identical 1 100 0.0 255.00 FORMAT "%8.2" ECU_ADDRESS 0xfe402e6f /end MEASUREMENT
/begin MEASUREMENT Tlib_ShortDropWinRiReDoor_LowPowerCANFD "" UBYTE RB_RBA_Common_CentralElements_CompuMethods_Identical 1 100 0.0 255.00 FORMAT "%8.2" ECU_ADDRESS 0xfe402e70 /end MEASUREMENT
/begin MEASUREMENT Tlib_LockgFailAcoustReq_LowPowerCANFD "" UBYTE RB_RBA_Common_CentralElements_CompuMethods_Identical 1 100 0.0 255.00 FORMAT "%8.2" ECU_ADDRESS 0xfe402e71 /end MEASUREMENT
/begin MEASUREMENT Tlib_WinCurtReqAtReRiWinOpenReqAtDrvr_LowPowerCANFD "" UBYTE RB_RBA_Common_CentralElements_CompuMethods_Identical 1 100 0.0 255.00 FORMAT "%8.2" ECU_ADDRESS 0xfe402e72 /end MEASUREMENT
/begin MEASUREMENT Tlib_WinCurtReqAtReRiWMRTrgSrc_LowPowerCANFD "" UBYTE RB_RBA_Common_CentralElements_CompuMethods_Identical 1 100 0.0 255.00 FORMAT "%8.2" ECU_ADDRESS 0xfe402e73 /end MEASUREMENT
/begin MEASUREMENT Tlib_LockgFbAcoustReq_LowPowerCANFD "" UBYTE RB_RBA_Common_CentralElements_CompuMethods_Identical 1 100 0.0 255.00 FORMAT "%8.2" ECU_ADDRESS 0xfe402e74 /end MEASUREMENT
/begin MEASUREMENT Tlib_LVPwrSplyErrStsSts_LowPowerCANFD "" UWORD RB_RBA_Common_CentralElements_CompuMethods_Identical 1 100 0.0 65535 FORMAT "%8.2" ECU_ADDRESS 0xfe4027ac /end MEASUREMENT
/begin MEASUREMENT Tlib_LVPwrSplyErrStsCntr4_LowPowerCANFD "" UBYTE RB_RBA_Common_CentralElements_CompuMethods_Identical 1 100 0.0 255.00 FORMAT "%8.2" ECU_ADDRESS 0xfe402e75 /end MEASUREMENT
/begin MEASUREMENT Tlib_LVPwrSplyErrStsDataID4_LowPowerCANFD "" UBYTE RB_RBA_Common_CentralElements_CompuMethods_Identical 1 100 0.0 255.00 FORMAT "%8.2" ECU_ADDRESS 0xfe402e76 /end MEASUREMENT
/begin MEASUREMENT Tlib_LVPwrSplyErrStsChks8_LowPowerCANFD "" UBYTE RB_RBA_Common_CentralElements_CompuMethods_Identical 1 100 0.0 255.00 FORMAT "%8.2" ECU_ADDRESS 0xfe402e77 /end MEASUREMENT
/begin MEASUREMENT Tlib_IDPSCarConfigToZCRValue_LowPowerCANFD "" SLONG RB_RBA_Common_CentralElements_CompuMethods_Identical 1 100 -2147483648 2147483647 FORMAT "%8.2" ECU_ADDRESS 0xfe402728 /end MEASUREMENT
/begin MEASUREMENT Tlib_IDPSCarConfigToZCRKey_LowPowerCANFD "" SLONG RB_RBA_Common_CentralElements_CompuMethods_Identical 1 100 -2147483648 2147483647 FORMAT "%8.2" ECU_ADDRESS 0xfe40272c /end MEASUREMENT
/begin MEASUREMENT Tlib_AllWMRCCToEcuKey_LowPowerCANFD "" SLONG RB_RBA_Common_CentralElements_CompuMethods_Identical 1 100 -2147483648 2147483647 FORMAT "%8.2" ECU_ADDRESS 0xfe402730 /end MEASUREMENT
/begin MEASUREMENT Tlib_AllWMRCCToEcuValue_LowPowerCANFD "" SLONG RB_RBA_Common_CentralElements_CompuMethods_Identical 1 100 -2147483648 2147483647 FORMAT "%8.2" ECU_ADDRESS 0xfe402734 /end MEASUREMENT
/begin MEASUREMENT Tlib_MobDevBtnCarLctrStsCarLctrLightReq_LowPowerCANFD "" UBYTE RB_RBA_Common_CentralElements_CompuMethods_Identical 1 100 0.0 255.00 FORMAT "%8.2" ECU_ADDRESS 0xfe402e78 /end MEASUREMENT
/begin MEASUREMENT Tlib_MobDevBtnCarLctrStsCarLctrHornReq_LowPowerCANFD "" UBYTE RB_RBA_Common_CentralElements_CompuMethods_Identical 1 100 0.0 255.00 FORMAT "%8.2" ECU_ADDRESS 0xfe402e79 /end MEASUREMENT
/begin MEASUREMENT Tlib_MobDevBtnCarLctrStsKeyID_LowPowerCANFD "" UBYTE RB_RBA_Common_CentralElements_CompuMethods_Identical 1 100 0.0 255.00 FORMAT "%8.2" ECU_ADDRESS 0xfe402e7a /end MEASUREMENT
/begin MEASUREMENT Tlib_DoorLeReSwtLockgSts_LowPowerCANFD "" UBYTE RB_RBA_Common_CentralElements_CompuMethods_Identical 1 100 0.0 255.00 FORMAT "%8.2" ECU_ADDRESS 0xfe402e7b /end MEASUREMENT
/begin MEASUREMENT Tlib_ThrdRiSeatODSSts_LowPowerCANFD "" UBYTE RB_RBA_Common_CentralElements_CompuMethods_Identical 1 100 0.0 255.00 FORMAT "%8.2" ECU_ADDRESS 0xfe402e7c /end MEASUREMENT
/begin MEASUREMENT Tlib_TrStsChks8_LowPowerCANFD "" UBYTE RB_RBA_Common_CentralElements_CompuMethods_Identical 1 100 0.0 255.00 FORMAT "%8.2" ECU_ADDRESS 0xfe402e7d /end MEASUREMENT
/begin MEASUREMENT Tlib_TrStsCntr4_LowPowerCANFD "" UBYTE RB_RBA_Common_CentralElements_CompuMethods_Identical 1 100 0.0 255.00 FORMAT "%8.2" ECU_ADDRESS 0xfe402e7e /end MEASUREMENT
/begin MEASUREMENT Tlib_TrStsDoorSts2_LowPowerCANFD "" UBYTE RB_RBA_Common_CentralElements_CompuMethods_Identical 1 100 0.0 255.00 FORMAT "%8.2" ECU_ADDRESS 0xfe402e7f /end MEASUREMENT
/begin MEASUREMENT Tlib_TrStsDataID4_LowPowerCANFD "" UBYTE RB_RBA_Common_CentralElements_CompuMethods_Identical 1 100 0.0 255.00 FORMAT "%8.2" ECU_ADDRESS 0xfe402e80 /end MEASUREMENT
/begin MEASUREMENT Tlib_DoorLeReStsCntr4_LowPowerCANFD "" UBYTE RB_RBA_Common_CentralElements_CompuMethods_Identical 1 100 0.0 255.00 FORMAT "%8.2" ECU_ADDRESS 0xfe402e81 /end MEASUREMENT
/begin MEASUREMENT Tlib_DoorLeReStsDataID4_LowPowerCANFD "" UBYTE RB_RBA_Common_CentralElements_CompuMethods_Identical 1 100 0.0 255.00 FORMAT "%8.2" ECU_ADDRESS 0xfe402e82 /end MEASUREMENT
/begin MEASUREMENT Tlib_DoorLeReStsChks8_LowPowerCANFD "" UBYTE RB_RBA_Common_CentralElements_CompuMethods_Identical 1 100 0.0 255.00 FORMAT "%8.2" ECU_ADDRESS 0xfe402e83 /end MEASUREMENT
/begin MEASUREMENT Tlib_DoorLeReStsDoorSts2_LowPowerCANFD "" UBYTE RB_RBA_Common_CentralElements_CompuMethods_Identical 1 100 0.0 255.00 FORMAT "%8.2" ECU_ADDRESS 0xfe402e84 /end MEASUREMENT
/begin MEASUREMENT Tlib_DoorLeReLockSts_LowPowerCANFD "" UBYTE RB_RBA_Common_CentralElements_CompuMethods_Identical 1 100 0.0 255.00 FORMAT "%8.2" ECU_ADDRESS 0xfe402e85 /end MEASUREMENT
/begin MEASUREMENT Tlib_DoorRiReStsChks8_LowPowerCANFD "" UBYTE RB_RBA_Common_CentralElements_CompuMethods_Identical 1 100 0.0 255.00 FORMAT "%8.2" ECU_ADDRESS 0xfe402e86 /end MEASUREMENT
/begin MEASUREMENT Tlib_DoorRiReStsDoorSts2_LowPowerCANFD "" UBYTE RB_RBA_Common_CentralElements_CompuMethods_Identical 1 100 0.0 255.00 FORMAT "%8.2" ECU_ADDRESS 0xfe402e87 /end MEASUREMENT
/begin MEASUREMENT Tlib_DoorRiReStsDataID4_LowPowerCANFD "" UBYTE RB_RBA_Common_CentralElements_CompuMethods_Identical 1 100 0.0 255.00 FORMAT "%8.2" ECU_ADDRESS 0xfe402e88 /end MEASUREMENT
/begin MEASUREMENT Tlib_DoorRiReStsCntr4_LowPowerCANFD "" UBYTE RB_RBA_Common_CentralElements_CompuMethods_Identical 1 100 0.0 255.00 FORMAT "%8.2" ECU_ADDRESS 0xfe402e89 /end MEASUREMENT
/begin MEASUREMENT Tlib_DoorRiReLockSts_LowPowerCANFD "" UBYTE RB_RBA_Common_CentralElements_CompuMethods_Identical 1 100 0.0 255.00 FORMAT "%8.2" ECU_ADDRESS 0xfe402e8a /end MEASUREMENT
/begin MEASUREMENT Tlib_VehMtnStCntr4_LowPowerCANFD "" UBYTE RB_RBA_Common_CentralElements_CompuMethods_Identical 1 100 0.0 255.00 FORMAT "%8.2" ECU_ADDRESS 0xfe402e8b /end MEASUREMENT
/begin MEASUREMENT Tlib_VehMtnStVehMtnSt_LowPowerCANFD "" UBYTE RB_RBA_Common_CentralElements_CompuMethods_Identical 1 100 0.0 255.00 FORMAT "%8.2" ECU_ADDRESS 0xfe402e8c /end MEASUREMENT
/begin MEASUREMENT Tlib_VehMtnStChks8_LowPowerCANFD "" UBYTE RB_RBA_Common_CentralElements_CompuMethods_Identical 1 100 0.0 255.00 FORMAT "%8.2" ECU_ADDRESS 0xfe402e8d /end MEASUREMENT
/begin MEASUREMENT Tlib_VehMtnStDataID4_LowPowerCANFD "" UBYTE RB_RBA_Common_CentralElements_CompuMethods_Identical 1 100 0.0 255.00 FORMAT "%8.2" ECU_ADDRESS 0xfe402e8e /end MEASUREMENT
/begin MEASUREMENT Tlib_DoorRiReSwtLockgSts_LowPowerCANFD "" UBYTE RB_RBA_Common_CentralElements_CompuMethods_Identical 1 100 0.0 255.00 FORMAT "%8.2" ECU_ADDRESS 0xfe402e8f /end MEASUREMENT
/begin MEASUREMENT Tlib_CinhDrvrSts_LowPowerCANFD "" UBYTE RB_RBA_Common_CentralElements_CompuMethods_Identical 1 100 0.0 255.00 FORMAT "%8.2" ECU_ADDRESS 0xfe402e90 /end MEASUREMENT
/begin MEASUREMENT Tlib_CinhDrvrSwt_LowPowerCANFD "" UBYTE RB_RBA_Common_CentralElements_CompuMethods_Identical 1 100 0.0 255.00 FORMAT "%8.2" ECU_ADDRESS 0xfe402e91 /end MEASUREMENT
/begin MEASUREMENT Tlib_DoorLeReSwtLockgStsHi_LowPowerCANFD "" UBYTE RB_RBA_Common_CentralElements_CompuMethods_Identical 1 100 0.0 255.00 FORMAT "%8.2" ECU_ADDRESS 0xfe402e92 /end MEASUREMENT
/begin MEASUREMENT Tlib_DoorDrvrStsChks8_LowPowerCANFD "" UBYTE RB_RBA_Common_CentralElements_CompuMethods_Identical 1 100 0.0 255.00 FORMAT "%8.2" ECU_ADDRESS 0xfe402e93 /end MEASUREMENT
/begin MEASUREMENT Tlib_DoorDrvrStsCntr4_LowPowerCANFD "" UBYTE RB_RBA_Common_CentralElements_CompuMethods_Identical 1 100 0.0 255.00 FORMAT "%8.2" ECU_ADDRESS 0xfe402e94 /end MEASUREMENT
/begin MEASUREMENT Tlib_DoorDrvrStsDoorSts2_LowPowerCANFD "" UBYTE RB_RBA_Common_CentralElements_CompuMethods_Identical 1 100 0.0 255.00 FORMAT "%8.2" ECU_ADDRESS 0xfe402e95 /end MEASUREMENT
/begin MEASUREMENT Tlib_DoorDrvrStsDataID4_LowPowerCANFD "" UBYTE RB_RBA_Common_CentralElements_CompuMethods_Identical 1 100 0.0 255.00 FORMAT "%8.2" ECU_ADDRESS 0xfe402e96 /end MEASUREMENT
/begin MEASUREMENT Tlib_HoodRelsReqDataID4_LowPowerCANFD "" UBYTE RB_RBA_Common_CentralElements_CompuMethods_Identical 1 100 0.0 255.00 FORMAT "%8.2" ECU_ADDRESS 0xfe402e97 /end MEASUREMENT
/begin MEASUREMENT Tlib_HoodRelsReqCntr4_LowPowerCANFD "" UBYTE RB_RBA_Common_CentralElements_CompuMethods_Identical 1 100 0.0 255.00 FORMAT "%8.2" ECU_ADDRESS 0xfe402e98 /end MEASUREMENT
/begin MEASUREMENT Tlib_HoodRelsReqOnOffSafe1_LowPowerCANFD "" UBYTE RB_RBA_Common_CentralElements_CompuMethods_Identical 1 100 0.0 255.00 FORMAT "%8.2" ECU_ADDRESS 0xfe402e99 /end MEASUREMENT
/begin MEASUREMENT Tlib_HoodRelsReqChks8_LowPowerCANFD "" UBYTE RB_RBA_Common_CentralElements_CompuMethods_Identical 1 100 0.0 255.00 FORMAT "%8.2" ECU_ADDRESS 0xfe402e9a /end MEASUREMENT
/begin MEASUREMENT Tlib_LockgCenStsUpdEve_LowPowerCANFD "" UBYTE RB_RBA_Common_CentralElements_CompuMethods_Identical 1 100 0.0 255.00 FORMAT "%8.2" ECU_ADDRESS 0xfe402e9b /end MEASUREMENT
/begin MEASUREMENT Tlib_LockgCenStsLockSt_LowPowerCANFD "" UBYTE RB_RBA_Common_CentralElements_CompuMethods_Identical 1 100 0.0 255.00 FORMAT "%8.2" ECU_ADDRESS 0xfe402e9c /end MEASUREMENT
/begin MEASUREMENT Tlib_LockgCenStsTrigSrc_LowPowerCANFD "" UBYTE RB_RBA_Common_CentralElements_CompuMethods_Identical 1 100 0.0 255.00 FORMAT "%8.2" ECU_ADDRESS 0xfe402e9d /end MEASUREMENT
/begin MEASUREMENT Tlib_VehModMngtGlbSafeCarModSubtypWdCarModSubtyp_LowPowerCANFD "" UBYTE RB_RBA_Common_CentralElements_CompuMethods_Identical 1 100 0.0 255.00 FORMAT "%8.2" ECU_ADDRESS 0xfe402e9e /end MEASUREMENT
/begin MEASUREMENT Tlib_VehModMngtGlbSafeDataID4_LowPowerCANFD "" UBYTE RB_RBA_Common_CentralElements_CompuMethods_Identical 1 100 0.0 255.00 FORMAT "%8.2" ECU_ADDRESS 0xfe402e9f /end MEASUREMENT
/begin MEASUREMENT Tlib_VehModMngtGlbSafeChks8_LowPowerCANFD "" UBYTE RB_RBA_Common_CentralElements_CompuMethods_Identical 1 100 0.0 255.00 FORMAT "%8.2" ECU_ADDRESS 0xfe402ea0 /end MEASUREMENT
/begin MEASUREMENT Tlib_VehModMngtGlbSafeEgyLvlElecMai_LowPowerCANFD "" UBYTE RB_RBA_Common_CentralElements_CompuMethods_Identical 1 100 0.0 255.00 FORMAT "%8.2" ECU_ADDRESS 0xfe402ea1 /end MEASUREMENT
/begin MEASUREMENT Tlib_VehModMngtGlbSafeFltEgyCnsWdSts_LowPowerCANFD "" UBYTE RB_RBA_Common_CentralElements_CompuMethods_Identical 1 100 0.0 255.00 FORMAT "%8.2" ECU_ADDRESS 0xfe402ea2 /end MEASUREMENT
/begin MEASUREMENT Tlib_VehModMngtGlbSafeCntr4_LowPowerCANFD "" UBYTE RB_RBA_Common_CentralElements_CompuMethods_Identical 1 100 0.0 255.00 FORMAT "%8.2" ECU_ADDRESS 0xfe402ea3 /end MEASUREMENT
/begin MEASUREMENT Tlib_VehModMngtGlbSafePwrLvlElecMai_LowPowerCANFD "" UBYTE RB_RBA_Common_CentralElements_CompuMethods_Identical 1 100 0.0 255.00 FORMAT "%8.2" ECU_ADDRESS 0xfe402ea4 /end MEASUREMENT
/begin MEASUREMENT Tlib_VehModMngtGlbSafePwrModSts_LowPowerCANFD "" UBYTE RB_RBA_Common_CentralElements_CompuMethods_Identical 1 100 0.0 255.00 FORMAT "%8.2" ECU_ADDRESS 0xfe402ea5 /end MEASUREMENT
/begin MEASUREMENT Tlib_VehModMngtGlbSafePwrLvlElecSubtyp_LowPowerCANFD "" UBYTE RB_RBA_Common_CentralElements_CompuMethods_Identical 1 100 0.0 255.00 FORMAT "%8.2" ECU_ADDRESS 0xfe402ea6 /end MEASUREMENT
/begin MEASUREMENT Tlib_VehModMngtGlbSafeEgyLvlElecSubtyp_LowPowerCANFD "" UBYTE RB_RBA_Common_CentralElements_CompuMethods_Identical 1 100 0.0 255.00 FORMAT "%8.2" ECU_ADDRESS 0xfe402ea7 /end MEASUREMENT
/begin MEASUREMENT Tlib_VehModMngtGlbSafeCarModSts_LowPowerCANFD "" UBYTE RB_RBA_Common_CentralElements_CompuMethods_Identical 1 100 0.0 255.00 FORMAT "%8.2" ECU_ADDRESS 0xfe402ea8 /end MEASUREMENT
/begin MEASUREMENT Tlib_DoorOpenerPassReqDataID4_LowPowerCANFD "" UBYTE RB_RBA_Common_CentralElements_CompuMethods_Identical 1 100 0.0 255.00 FORMAT "%8.2" ECU_ADDRESS 0xfe402ea9 /end MEASUREMENT
/begin MEASUREMENT Tlib_DoorOpenerPassReqChks8_LowPowerCANFD "" UBYTE RB_RBA_Common_CentralElements_CompuMethods_Identical 1 100 0.0 255.00 FORMAT "%8.2" ECU_ADDRESS 0xfe402eaa /end MEASUREMENT
/begin MEASUREMENT Tlib_DoorOpenerPassReqCntr4_LowPowerCANFD "" UBYTE RB_RBA_Common_CentralElements_CompuMethods_Identical 1 100 0.0 255.00 FORMAT "%8.2" ECU_ADDRESS 0xfe402eab /end MEASUREMENT
/begin MEASUREMENT Tlib_DoorOpenerPassReqDoorOpenerReq1_LowPowerCANFD "" UBYTE RB_RBA_Common_CentralElements_CompuMethods_Identical 1 100 0.0 255.00 FORMAT "%8.2" ECU_ADDRESS 0xfe402eac /end MEASUREMENT
/begin MEASUREMENT Tlib_DoorOpenerPassReqTrigSrc_LowPowerCANFD "" UBYTE RB_RBA_Common_CentralElements_CompuMethods_Identical 1 100 0.0 255.00 FORMAT "%8.2" ECU_ADDRESS 0xfe402ead /end MEASUREMENT
/begin MEASUREMENT Tlib_AllLockingCCToEcuKey_LowPowerCANFD "" SLONG RB_RBA_Common_CentralElements_CompuMethods_Identical 1 100 -2147483648 2147483647 FORMAT "%8.2" ECU_ADDRESS 0xfe402738 /end MEASUREMENT
/begin MEASUREMENT Tlib_AllLockingCCToEcuValue_LowPowerCANFD "" SLONG RB_RBA_Common_CentralElements_CompuMethods_Identical 1 100 -2147483648 2147483647 FORMAT "%8.2" ECU_ADDRESS 0xfe40273c /end MEASUREMENT
/begin MEASUREMENT Tlib_TripResetSyncMsgRestCnt_LowPowerCANFD "" UWORD RB_RBA_Common_CentralElements_CompuMethods_Identical 1 100 0.0 65535 FORMAT "%8.2" ECU_ADDRESS 0xfe4027ae /end MEASUREMENT
/begin MEASUREMENT Tlib_TripResetSyncMsgTripCnt_LowPowerCANFD "" ULONG RB_RBA_Common_CentralElements_CompuMethods_Identical 1 100 0.0 4294967295 FORMAT "%8.2" ECU_ADDRESS 0xfe402740 /end MEASUREMENT
/begin MEASUREMENT Tlib_DoorPassLockCmd_LowPowerCANFD "" UBYTE RB_RBA_Common_CentralElements_CompuMethods_Identical 1 100 0.0 255.00 FORMAT "%8.2" ECU_ADDRESS 0xfe402eae /end MEASUREMENT
/begin MEASUREMENT Tlib_DoorPassRelsReqCntr4_LowPowerCANFD "" UBYTE RB_RBA_Common_CentralElements_CompuMethods_Identical 1 100 0.0 255.00 FORMAT "%8.2" ECU_ADDRESS 0xfe402eaf /end MEASUREMENT
/begin MEASUREMENT Tlib_DoorPassRelsReqOnOffSafe1_LowPowerCANFD "" UBYTE RB_RBA_Common_CentralElements_CompuMethods_Identical 1 100 0.0 255.00 FORMAT "%8.2" ECU_ADDRESS 0xfe402eb0 /end MEASUREMENT
/begin MEASUREMENT Tlib_DoorPassRelsReqDataID4_LowPowerCANFD "" UBYTE RB_RBA_Common_CentralElements_CompuMethods_Identical 1 100 0.0 255.00 FORMAT "%8.2" ECU_ADDRESS 0xfe402eb1 /end MEASUREMENT
/begin MEASUREMENT Tlib_DoorPassRelsReqChks8_LowPowerCANFD "" UBYTE RB_RBA_Common_CentralElements_CompuMethods_Identical 1 100 0.0 255.00 FORMAT "%8.2" ECU_ADDRESS 0xfe402eb2 /end MEASUREMENT
/begin MEASUREMENT Tlib_WelcomeGoodbyeSetReq_LowPowerCANFD "" UBYTE RB_RBA_Common_CentralElements_CompuMethods_Identical 1 100 0.0 255.00 FORMAT "%8.2" ECU_ADDRESS 0xfe402eb3 /end MEASUREMENT
/begin MEASUREMENT Tlib_isWhlMotSysRiInvrT_VLAN205ControlMid "" UBYTE RB_RBA_Common_CentralElements_CompuMethods_Identical 1 100 0.0 255.00 FORMAT "%8.2" ECU_ADDRESS 0xfe402eb4 /end MEASUREMENT
/begin MEASUREMENT Tlib_isWhlMotSysRiCooltT_VLAN205ControlMid "" UBYTE RB_RBA_Common_CentralElements_CompuMethods_Identical 1 100 0.0 255.00 FORMAT "%8.2" ECU_ADDRESS 0xfe402eb5 /end MEASUREMENT
/begin MEASUREMENT Tlib_isWhlMotSysCooltFlowMinReq_VLAN205ControlMid "" UWORD RB_RBA_Common_CentralElements_CompuMethods_Identical 1 100 0.0 65535 FORMAT "%8.2" ECU_ADDRESS 0xfe4027b0 /end MEASUREMENT
/begin MEASUREMENT Tlib_isWhlMotSysCooltT_VLAN205ControlMid "" UBYTE RB_RBA_Common_CentralElements_CompuMethods_Identical 1 100 0.0 255.00 FORMAT "%8.2" ECU_ADDRESS 0xfe402eb6 /end MEASUREMENT
/begin MEASUREMENT Tlib_isWhlMotSysRiCooltFlowMinReq_VLAN205ControlMid "" UWORD RB_RBA_Common_CentralElements_CompuMethods_Identical 1 100 0.0 65535 FORMAT "%8.2" ECU_ADDRESS 0xfe4027b2 /end MEASUREMENT
/begin MEASUREMENT Tlib_isWhlMotSysRiHeatFdBck_VLAN205ControlMid "" UBYTE RB_RBA_Common_CentralElements_CompuMethods_Identical 1 100 0.0 255.00 FORMAT "%8.2" ECU_ADDRESS 0xfe402eb7 /end MEASUREMENT
/begin MEASUREMENT Tlib_isWhlMotSysRiHeatPwrAct_VLAN205ControlMid "" UBYTE RB_RBA_Common_CentralElements_CompuMethods_Identical 1 100 0.0 255.00 FORMAT "%8.2" ECU_ADDRESS 0xfe402eb8 /end MEASUREMENT
/begin MEASUREMENT Tlib_isWhlMotSysHeatPwrMax_VLAN205ControlMid "" UBYTE RB_RBA_Common_CentralElements_CompuMethods_Identical 1 100 0.0 255.00 FORMAT "%8.2" ECU_ADDRESS 0xfe402eb9 /end MEASUREMENT
/begin MEASUREMENT Tlib_isWhlMotSysHeatPwrAct_VLAN205ControlMid "" UBYTE RB_RBA_Common_CentralElements_CompuMethods_Identical 1 100 0.0 255.00 FORMAT "%8.2" ECU_ADDRESS 0xfe402eba /end MEASUREMENT
/begin MEASUREMENT Tlib_isWhlMotSysRiHeatPwrSumAct_VLAN205ControlMid "" UWORD RB_RBA_Common_CentralElements_CompuMethods_Identical 1 100 0.0 65535 FORMAT "%8.2" ECU_ADDRESS 0xfe4027b4 /end MEASUREMENT
/begin MEASUREMENT Tlib_isWhlMotSysHeatFdBck_VLAN205ControlMid "" UBYTE RB_RBA_Common_CentralElements_CompuMethods_Identical 1 100 0.0 255.00 FORMAT "%8.2" ECU_ADDRESS 0xfe402ebb /end MEASUREMENT
/begin MEASUREMENT Tlib_isWhlMotSysHeatPwrSumAct_VLAN205ControlMid "" UWORD RB_RBA_Common_CentralElements_CompuMethods_Identical 1 100 0.0 65535 FORMAT "%8.2" ECU_ADDRESS 0xfe4027b6 /end MEASUREMENT
/begin MEASUREMENT Tlib_isWhlMotSysRiHeatPwrMax_VLAN205ControlMid "" UBYTE RB_RBA_Common_CentralElements_CompuMethods_Identical 1 100 0.0 255.00 FORMAT "%8.2" ECU_ADDRESS 0xfe402ebc /end MEASUREMENT
/begin MEASUREMENT Tlib_isIsgHeatPwrSumAct_VLAN205ControlMid "" UWORD RB_RBA_Common_CentralElements_CompuMethods_Identical 1 100 0.0 65535 FORMAT "%8.2" ECU_ADDRESS 0xfe4027b8 /end MEASUREMENT
/begin MEASUREMENT Tlib_isIsgHeatFdBck_VLAN205ControlMid "" UBYTE RB_RBA_Common_CentralElements_CompuMethods_Identical 1 100 0.0 255.00 FORMAT "%8.2" ECU_ADDRESS 0xfe402ebd /end MEASUREMENT
/begin MEASUREMENT Tlib_isIsgRiHeatPwrSumAct_VLAN205ControlMid "" UWORD RB_RBA_Common_CentralElements_CompuMethods_Identical 1 100 0.0 65535 FORMAT "%8.2" ECU_ADDRESS 0xfe4027ba /end MEASUREMENT
/begin MEASUREMENT Tlib_isIsgCooltT_VLAN205ControlMid "" UBYTE RB_RBA_Common_CentralElements_CompuMethods_Identical 1 100 0.0 255.00 FORMAT "%8.2" ECU_ADDRESS 0xfe402ebe /end MEASUREMENT
/begin MEASUREMENT Tlib_isIsgRiHeatPwrMax_VLAN205ControlMid "" UBYTE RB_RBA_Common_CentralElements_CompuMethods_Identical 1 100 0.0 255.00 FORMAT "%8.2" ECU_ADDRESS 0xfe402ebf /end MEASUREMENT
/begin MEASUREMENT Tlib_isIsgCooltFlowMinReq_VLAN205ControlMid "" UWORD RB_RBA_Common_CentralElements_CompuMethods_Identical 1 100 0.0 65535 FORMAT "%8.2" ECU_ADDRESS 0xfe4027bc /end MEASUREMENT
/begin MEASUREMENT Tlib_isIsgHeatPwrMax_VLAN205ControlMid "" UBYTE RB_RBA_Common_CentralElements_CompuMethods_Identical 1 100 0.0 255.00 FORMAT "%8.2" ECU_ADDRESS 0xfe402ec0 /end MEASUREMENT
/begin MEASUREMENT Tlib_isIsgRiCooltT_VLAN205ControlMid "" UBYTE RB_RBA_Common_CentralElements_CompuMethods_Identical 1 100 0.0 255.00 FORMAT "%8.2" ECU_ADDRESS 0xfe402ec1 /end MEASUREMENT
/begin MEASUREMENT Tlib_isIsgRiCooltFlowMinReq_VLAN205ControlMid "" UWORD RB_RBA_Common_CentralElements_CompuMethods_Identical 1 100 0.0 65535 FORMAT "%8.2" ECU_ADDRESS 0xfe4027be /end MEASUREMENT
/begin MEASUREMENT Tlib_isIsgRiHeatFdBck_VLAN205ControlMid "" UBYTE RB_RBA_Common_CentralElements_CompuMethods_Identical 1 100 0.0 255.00 FORMAT "%8.2" ECU_ADDRESS 0xfe402ec2 /end MEASUREMENT
/begin MEASUREMENT Tlib_isIsgRiHeatPwrAct_VLAN205ControlMid "" UBYTE RB_RBA_Common_CentralElements_CompuMethods_Identical 1 100 0.0 255.00 FORMAT "%8.2" ECU_ADDRESS 0xfe402ec3 /end MEASUREMENT
/begin MEASUREMENT Tlib_isIsgHeatPwrAct_VLAN205ControlMid "" UBYTE RB_RBA_Common_CentralElements_CompuMethods_Identical 1 100 0.0 255.00 FORMAT "%8.2" ECU_ADDRESS 0xfe402ec4 /end MEASUREMENT
/begin MEASUREMENT Tlib_isCmptmtFlowReqForRowFirstAtDefrstLe_VLAN205ControlMid "" UWORD RB_RBA_Common_CentralElements_CompuMethods_Identical 1 100 0.0 65535 FORMAT "%8.2" ECU_ADDRESS 0xfe4027c0 /end MEASUREMENT
/begin MEASUREMENT Tlib_isCmptmtFlowReqForRowFirstAtVentRi_VLAN205ControlMid "" UWORD RB_RBA_Common_CentralElements_CompuMethods_Identical 1 100 0.0 65535 FORMAT "%8.2" ECU_ADDRESS 0xfe4027c2 /end MEASUREMENT
/begin MEASUREMENT Tlib_isIntrBriSts_VLAN205ControlMid "" UBYTE RB_RBA_Common_CentralElements_CompuMethods_Identical 1 100 0.0 255.00 FORMAT "%8.2" ECU_ADDRESS 0xfe402ec5 /end MEASUREMENT
/begin MEASUREMENT Tlib_isCmptmtFlowReqForRowFirstAtVentLe_VLAN205ControlMid "" UWORD RB_RBA_Common_CentralElements_CompuMethods_Identical 1 100 0.0 65535 FORMAT "%8.2" ECU_ADDRESS 0xfe4027c4 /end MEASUREMENT
/begin MEASUREMENT Tlib_isIntrLiAmb2TargetTransitionTime_VLAN205ControlMid "" UBYTE RB_RBA_Common_CentralElements_CompuMethods_Identical 1 100 0.0 255.00 FORMAT "%8.2" ECU_ADDRESS 0xfe402ec6 /end MEASUREMENT
/begin MEASUREMENT Tlib_isIntrLiAmb2Intensty_VLAN205ControlMid "" UBYTE RB_RBA_Common_CentralElements_CompuMethods_Identical 1 100 0.0 255.00 FORMAT "%8.2" ECU_ADDRESS 0xfe402ec7 /end MEASUREMENT
/begin MEASUREMENT Tlib_isIntrLiAmb2Update_VLAN205ControlMid "" UBYTE RB_RBA_Common_CentralElements_CompuMethods_Identical 1 100 0.0 255.00 FORMAT "%8.2" ECU_ADDRESS 0xfe402ec8 /end MEASUREMENT
/begin MEASUREMENT Tlib_isIntrLiAmb2BnIngrd_VLAN205ControlMid "" UBYTE RB_RBA_Common_CentralElements_CompuMethods_Identical 1 100 0.0 255.00 FORMAT "%8.2" ECU_ADDRESS 0xfe402ec9 /end MEASUREMENT
/begin MEASUREMENT Tlib_isIntrLiAmb2SynchDelay_VLAN205ControlMid "" UBYTE RB_RBA_Common_CentralElements_CompuMethods_Identical 1 100 0.0 255.00 FORMAT "%8.2" ECU_ADDRESS 0xfe402eca /end MEASUREMENT
/begin MEASUREMENT Tlib_isIntrLiAmb2SelCmd2_VLAN205ControlMid "" UBYTE RB_RBA_Common_CentralElements_CompuMethods_Identical 1 100 0.0 255.00 FORMAT "%8.2" ECU_ADDRESS 0xfe402ecb /end MEASUREMENT
/begin MEASUREMENT Tlib_isIntrLiAmb2Trigger_VLAN205ControlMid "" UBYTE RB_RBA_Common_CentralElements_CompuMethods_Identical 1 100 0.0 255.00 FORMAT "%8.2" ECU_ADDRESS 0xfe402ecc /end MEASUREMENT
/begin MEASUREMENT Tlib_isIntrLiAmb2GrnIngrd_VLAN205ControlMid "" UBYTE RB_RBA_Common_CentralElements_CompuMethods_Identical 1 100 0.0 255.00 FORMAT "%8.2" ECU_ADDRESS 0xfe402ecd /end MEASUREMENT
/begin MEASUREMENT Tlib_isIntrLiAmb2RedIngrd_VLAN205ControlMid "" UBYTE RB_RBA_Common_CentralElements_CompuMethods_Identical 1 100 0.0 255.00 FORMAT "%8.2" ECU_ADDRESS 0xfe402ece /end MEASUREMENT
/begin MEASUREMENT Tlib_isIntrLiAmb2SelCmd1_VLAN205ControlMid "" UBYTE RB_RBA_Common_CentralElements_CompuMethods_Identical 1 100 0.0 255.00 FORMAT "%8.2" ECU_ADDRESS 0xfe402ecf /end MEASUREMENT
/begin MEASUREMENT Tlib_isCmptmtFlowReqForRowThrdAtVentRi_VLAN205ControlMid "" UWORD RB_RBA_Common_CentralElements_CompuMethods_Identical 1 100 0.0 65535 FORMAT "%8.2" ECU_ADDRESS 0xfe4027c6 /end MEASUREMENT
/begin MEASUREMENT Tlib_isCmptmtFlowReqForRowFirstAtFlrLe_VLAN205ControlMid "" UWORD RB_RBA_Common_CentralElements_CompuMethods_Identical 1 100 0.0 65535 FORMAT "%8.2" ECU_ADDRESS 0xfe4027c8 /end MEASUREMENT
/begin MEASUREMENT Tlib_isCmptmtFlowReqForRowThrdAtFlrLe_VLAN205ControlMid "" UWORD RB_RBA_Common_CentralElements_CompuMethods_Identical 1 100 0.0 65535 FORMAT "%8.2" ECU_ADDRESS 0xfe4027ca /end MEASUREMENT
/begin MEASUREMENT Tlib_isCmptmtFlowReqForRowSecAtVentRi_VLAN205ControlMid "" UWORD RB_RBA_Common_CentralElements_CompuMethods_Identical 1 100 0.0 65535 FORMAT "%8.2" ECU_ADDRESS 0xfe4027cc /end MEASUREMENT
/begin MEASUREMENT Tlib_isCmptmtFlowReqForRowSecAtFlrLe_VLAN205ControlMid "" UWORD RB_RBA_Common_CentralElements_CompuMethods_Identical 1 100 0.0 65535 FORMAT "%8.2" ECU_ADDRESS 0xfe4027ce /end MEASUREMENT
/begin MEASUREMENT Tlib_isCmptmtFlowReqForRowFirstAtDefrstRi_VLAN205ControlMid "" UWORD RB_RBA_Common_CentralElements_CompuMethods_Identical 1 100 0.0 65535 FORMAT "%8.2" ECU_ADDRESS 0xfe4027d0 /end MEASUREMENT
/begin MEASUREMENT Tlib_isCmptmtFlowReqForRowThrdAtFlrRi_VLAN205ControlMid "" UWORD RB_RBA_Common_CentralElements_CompuMethods_Identical 1 100 0.0 65535 FORMAT "%8.2" ECU_ADDRESS 0xfe4027d2 /end MEASUREMENT
/begin MEASUREMENT Tlib_isCmptmtFlowReqForRowFirstAtFlrRi_VLAN205ControlMid "" UWORD RB_RBA_Common_CentralElements_CompuMethods_Identical 1 100 0.0 65535 FORMAT "%8.2" ECU_ADDRESS 0xfe4027d4 /end MEASUREMENT
/begin MEASUREMENT Tlib_isCmptmtFlowReqForRowSecAtVentLe_VLAN205ControlMid "" UWORD RB_RBA_Common_CentralElements_CompuMethods_Identical 1 100 0.0 65535 FORMAT "%8.2" ECU_ADDRESS 0xfe4027d6 /end MEASUREMENT
/begin MEASUREMENT Tlib_isCmptmtFlowReqForRowSecAtFlrRi_VLAN205ControlMid "" UWORD RB_RBA_Common_CentralElements_CompuMethods_Identical 1 100 0.0 65535 FORMAT "%8.2" ECU_ADDRESS 0xfe4027d8 /end MEASUREMENT
/begin MEASUREMENT Tlib_isIntrLiAmb1Intensty_VLAN205ControlMid "" UBYTE RB_RBA_Common_CentralElements_CompuMethods_Identical 1 100 0.0 255.00 FORMAT "%8.2" ECU_ADDRESS 0xfe402ed0 /end MEASUREMENT
/begin MEASUREMENT Tlib_isIntrLiAmb1RedIngrd_VLAN205ControlMid "" UBYTE RB_RBA_Common_CentralElements_CompuMethods_Identical 1 100 0.0 255.00 FORMAT "%8.2" ECU_ADDRESS 0xfe402ed1 /end MEASUREMENT
/begin MEASUREMENT Tlib_isIntrLiAmb1SynchDelay_VLAN205ControlMid "" UBYTE RB_RBA_Common_CentralElements_CompuMethods_Identical 1 100 0.0 255.00 FORMAT "%8.2" ECU_ADDRESS 0xfe402ed2 /end MEASUREMENT
/begin MEASUREMENT Tlib_isIntrLiAmb1SelCmd2_VLAN205ControlMid "" UBYTE RB_RBA_Common_CentralElements_CompuMethods_Identical 1 100 0.0 255.00 FORMAT "%8.2" ECU_ADDRESS 0xfe402ed3 /end MEASUREMENT
/begin MEASUREMENT Tlib_isIntrLiAmb1Trigger_VLAN205ControlMid "" UBYTE RB_RBA_Common_CentralElements_CompuMethods_Identical 1 100 0.0 255.00 FORMAT "%8.2" ECU_ADDRESS 0xfe402ed4 /end MEASUREMENT
/begin MEASUREMENT Tlib_isIntrLiAmb1BnIngrd_VLAN205ControlMid "" UBYTE RB_RBA_Common_CentralElements_CompuMethods_Identical 1 100 0.0 255.00 FORMAT "%8.2" ECU_ADDRESS 0xfe402ed5 /end MEASUREMENT
/begin MEASUREMENT Tlib_isIntrLiAmb1GrnIngrd_VLAN205ControlMid "" UBYTE RB_RBA_Common_CentralElements_CompuMethods_Identical 1 100 0.0 255.00 FORMAT "%8.2" ECU_ADDRESS 0xfe402ed6 /end MEASUREMENT
/begin MEASUREMENT Tlib_isIntrLiAmb1SelCmd1_VLAN205ControlMid "" UBYTE RB_RBA_Common_CentralElements_CompuMethods_Identical 1 100 0.0 255.00 FORMAT "%8.2" ECU_ADDRESS 0xfe402ed7 /end MEASUREMENT
/begin MEASUREMENT Tlib_isIntrLiAmb1TargetTransitionTime_VLAN205ControlMid "" UBYTE RB_RBA_Common_CentralElements_CompuMethods_Identical 1 100 0.0 255.00 FORMAT "%8.2" ECU_ADDRESS 0xfe402ed8 /end MEASUREMENT
/begin MEASUREMENT Tlib_isIntrLiAmb1Update_VLAN205ControlMid "" UBYTE RB_RBA_Common_CentralElements_CompuMethods_Identical 1 100 0.0 255.00 FORMAT "%8.2" ECU_ADDRESS 0xfe402ed9 /end MEASUREMENT
/begin MEASUREMENT Tlib_isCmptmtFlowReqForRowThrdAtVentLe_VLAN205ControlMid "" UWORD RB_RBA_Common_CentralElements_CompuMethods_Identical 1 100 0.0 65535 FORMAT "%8.2" ECU_ADDRESS 0xfe4027da /end MEASUREMENT
/begin MEASUREMENT Tlib_isTgtHvacAirTForRowThrdRi_VLAN205ControlMid "" SWORD RB_RBA_Common_CentralElements_CompuMethods_Identical 1 100 -32768 32767 FORMAT "%8.2" ECU_ADDRESS 0xfe4027dc /end MEASUREMENT
/begin MEASUREMENT Tlib_isTgtHvacAirTForRowFirstLe_VLAN205ControlMid "" SWORD RB_RBA_Common_CentralElements_CompuMethods_Identical 1 100 -32768 32767 FORMAT "%8.2" ECU_ADDRESS 0xfe4027de /end MEASUREMENT
/begin MEASUREMENT Tlib_isActvnOfHzrd_VLAN205ControlMid "" UBYTE RB_RBA_Common_CentralElements_CompuMethods_Identical 1 100 0.0 255.00 FORMAT "%8.2" ECU_ADDRESS 0xfe402eda /end MEASUREMENT
/begin MEASUREMENT Tlib_isTgtHvacAirTForRowSecLe_VLAN205ControlMid "" SWORD RB_RBA_Common_CentralElements_CompuMethods_Identical 1 100 -32768 32767 FORMAT "%8.2" ECU_ADDRESS 0xfe4027e0 /end MEASUREMENT
/begin MEASUREMENT Tlib_isTgtHvacAirTForRowFirstRi_VLAN205ControlMid "" SWORD RB_RBA_Common_CentralElements_CompuMethods_Identical 1 100 -32768 32767 FORMAT "%8.2" ECU_ADDRESS 0xfe4027e2 /end MEASUREMENT
/begin MEASUREMENT Tlib_isHvacRecircRatReq_VLAN205ControlMid "" UBYTE RB_RBA_Common_CentralElements_CompuMethods_Identical 1 100 0.0 255.00 FORMAT "%8.2" ECU_ADDRESS 0xfe402edb /end MEASUREMENT
/begin MEASUREMENT Tlib_isActvnOfTrCmptmtLi_VLAN205ControlMid "" UBYTE RB_RBA_Common_CentralElements_CompuMethods_Identical 1 100 0.0 255.00 FORMAT "%8.2" ECU_ADDRESS 0xfe402edc /end MEASUREMENT
/begin MEASUREMENT Tlib_isTgtHvacAirTForRowSecRi_VLAN205ControlMid "" SWORD RB_RBA_Common_CentralElements_CompuMethods_Identical 1 100 -32768 32767 FORMAT "%8.2" ECU_ADDRESS 0xfe4027e4 /end MEASUREMENT
/begin MEASUREMENT Tlib_isTgtHvacAirTForRowThrdLe_VLAN205ControlMid "" SWORD RB_RBA_Common_CentralElements_CompuMethods_Identical 1 100 -32768 32767 FORMAT "%8.2" ECU_ADDRESS 0xfe4027e6 /end MEASUREMENT
/begin MEASUREMENT Tlib_isElecAirVentn16PosnReq_VLAN205ControlMid "" UWORD RB_RBA_Common_CentralElements_CompuMethods_Identical 1 100 0.0 65535 FORMAT "%8.2" ECU_ADDRESS 0xfe4027e8 /end MEASUREMENT
/begin MEASUREMENT Tlib_isElecAirVentn18PosnReq_VLAN205ControlMid "" UWORD RB_RBA_Common_CentralElements_CompuMethods_Identical 1 100 0.0 65535 FORMAT "%8.2" ECU_ADDRESS 0xfe4027ea /end MEASUREMENT
/begin MEASUREMENT Tlib_isActvnOfBlackdisplaySwtIllmn_0_VLAN205ControlMid "" UBYTE RB_RBA_Common_CentralElements_CompuMethods_Identical 1 100 0.0 255.00 FORMAT "%8.2" ECU_ADDRESS 0xfe402edd /end MEASUREMENT
/begin MEASUREMENT Tlib_isActvnOfCenSwtIllmn_0_VLAN205ControlMid "" UBYTE RB_RBA_Common_CentralElements_CompuMethods_Identical 1 100 0.0 255.00 FORMAT "%8.2" ECU_ADDRESS 0xfe402ede /end MEASUREMENT
/begin MEASUREMENT Tlib_isElecAirVentn20PosnReq_VLAN205ControlMid "" UWORD RB_RBA_Common_CentralElements_CompuMethods_Identical 1 100 0.0 65535 FORMAT "%8.2" ECU_ADDRESS 0xfe4027ec /end MEASUREMENT
/begin MEASUREMENT Tlib_isActvnOfSwtIllmnSply_0_VLAN205ControlMid "" UBYTE RB_RBA_Common_CentralElements_CompuMethods_Identical 1 100 0.0 255.00 FORMAT "%8.2" ECU_ADDRESS 0xfe402edf /end MEASUREMENT
/begin MEASUREMENT Tlib_isElecAirVentn10PosnReq_VLAN205ControlMid "" UWORD RB_RBA_Common_CentralElements_CompuMethods_Identical 1 100 0.0 65535 FORMAT "%8.2" ECU_ADDRESS 0xfe4027ee /end MEASUREMENT
/begin MEASUREMENT Tlib_isMirrDefrstAtCmd_0_VLAN205ControlMid "" UBYTE RB_RBA_Common_CentralElements_CompuMethods_Identical 1 100 0.0 255.00 FORMAT "%8.2" ECU_ADDRESS 0xfe402ee0 /end MEASUREMENT
/begin MEASUREMENT Tlib_isElecAirVentn11PosnReq_VLAN205ControlMid "" UWORD RB_RBA_Common_CentralElements_CompuMethods_Identical 1 100 0.0 65535 FORMAT "%8.2" ECU_ADDRESS 0xfe4027f0 /end MEASUREMENT
/begin MEASUREMENT Tlib_isElecAirVentn13PosnReq_VLAN205ControlMid "" UWORD RB_RBA_Common_CentralElements_CompuMethods_Identical 1 100 0.0 65535 FORMAT "%8.2" ECU_ADDRESS 0xfe4027f2 /end MEASUREMENT
/begin MEASUREMENT Tlib_isElecAirVentn9PosnReq_VLAN205ControlMid "" UWORD RB_RBA_Common_CentralElements_CompuMethods_Identical 1 100 0.0 65535 FORMAT "%8.2" ECU_ADDRESS 0xfe4027f4 /end MEASUREMENT
/begin MEASUREMENT Tlib_isElecAirVentn14PosnReq_VLAN205ControlMid "" UWORD RB_RBA_Common_CentralElements_CompuMethods_Identical 1 100 0.0 65535 FORMAT "%8.2" ECU_ADDRESS 0xfe4027f6 /end MEASUREMENT
/begin MEASUREMENT Tlib_isElecAirVentn17PosnReq_VLAN205ControlMid "" UWORD RB_RBA_Common_CentralElements_CompuMethods_Identical 1 100 0.0 65535 FORMAT "%8.2" ECU_ADDRESS 0xfe4027f8 /end MEASUREMENT
/begin MEASUREMENT Tlib_isElecAirVentn12PosnReq_VLAN205ControlMid "" UWORD RB_RBA_Common_CentralElements_CompuMethods_Identical 1 100 0.0 65535 FORMAT "%8.2" ECU_ADDRESS 0xfe4027fa /end MEASUREMENT
/begin MEASUREMENT Tlib_isElecAirVentn19PosnReq_VLAN205ControlMid "" UWORD RB_RBA_Common_CentralElements_CompuMethods_Identical 1 100 0.0 65535 FORMAT "%8.2" ECU_ADDRESS 0xfe4027fc /end MEASUREMENT
/begin MEASUREMENT Tlib_isElecAirVentn15PosnReq_VLAN205ControlMid "" UWORD RB_RBA_Common_CentralElements_CompuMethods_Identical 1 100 0.0 65535 FORMAT "%8.2" ECU_ADDRESS 0xfe4027fe /end MEASUREMENT
/begin MEASUREMENT Tlib_isCarconfigForTmVal_VLAN205ControlMid "" UBYTE RB_RBA_Common_CentralElements_CompuMethods_Identical 1 100 0.0 255.00 FORMAT "%8.2" ECU_ADDRESS 0xfe402ee1 /end MEASUREMENT
/begin MEASUREMENT Tlib_isCarconfigForTmPrmId_VLAN205ControlMid "" UWORD RB_RBA_Common_CentralElements_CompuMethods_Identical 1 100 0.0 65535 FORMAT "%8.2" ECU_ADDRESS 0xfe402800 /end MEASUREMENT
/begin MEASUREMENT Tlib_isAirFragConcReq_VLAN205ControlMid "" UBYTE RB_RBA_Common_CentralElements_CompuMethods_Identical 1 100 0.0 255.00 FORMAT "%8.2" ECU_ADDRESS 0xfe402ee2 /end MEASUREMENT
/begin MEASUREMENT Tlib_isPSMCarConfigPrmId_VLAN205ControlMid "" UWORD RB_RBA_Common_CentralElements_CompuMethods_Identical 1 100 0.0 65535 FORMAT "%8.2" ECU_ADDRESS 0xfe402802 /end MEASUREMENT
/begin MEASUREMENT Tlib_isPSMCarConfigVal_VLAN205ControlMid "" UBYTE RB_RBA_Common_CentralElements_CompuMethods_Identical 1 100 0.0 255.00 FORMAT "%8.2" ECU_ADDRESS 0xfe402ee3 /end MEASUREMENT
/begin MEASUREMENT Tlib_isActvnOfVTMOnOffLi_0_VLAN205ControlMid "" UBYTE RB_RBA_Common_CentralElements_CompuMethods_Identical 1 100 0.0 255.00 FORMAT "%8.2" ECU_ADDRESS 0xfe402ee4 /end MEASUREMENT
/begin MEASUREMENT Tlib_isActvnOfBuckleLightBuckleLightId_VLAN205ControlMid "" UBYTE RB_RBA_Common_CentralElements_CompuMethods_Identical 1 100 0.0 255.00 FORMAT "%8.2" ECU_ADDRESS 0xfe402ee5 /end MEASUREMENT
/begin MEASUREMENT Tlib_isActvnOfBuckleLightBuckleLightReq_VLAN205ControlMid "" UBYTE RB_RBA_Common_CentralElements_CompuMethods_Identical 1 100 0.0 255.00 FORMAT "%8.2" ECU_ADDRESS 0xfe402ee6 /end MEASUREMENT
/begin MEASUREMENT Tlib_isCNSLLockCmd_VLAN205ControlMid "" UBYTE RB_RBA_Common_CentralElements_CompuMethods_Identical 1 100 0.0 255.00 FORMAT "%8.2" ECU_ADDRESS 0xfe402ee7 /end MEASUREMENT
/begin MEASUREMENT Tlib_isCNSLSldCmdTrig_VLAN205ControlMid "" UBYTE RB_RBA_Common_CentralElements_CompuMethods_Identical 1 100 0.0 255.00 FORMAT "%8.2" ECU_ADDRESS 0xfe402ee8 /end MEASUREMENT
/begin MEASUREMENT Tlib_isActvnOfVTMButtonLi_0_VLAN205ControlMid "" UBYTE RB_RBA_Common_CentralElements_CompuMethods_Identical 1 100 0.0 255.00 FORMAT "%8.2" ECU_ADDRESS 0xfe402ee9 /end MEASUREMENT
/begin MEASUREMENT Tlib_isVTMOnOffCtrl_VLAN205ControlMid "" UBYTE RB_RBA_Common_CentralElements_CompuMethods_Identical 1 100 0.0 255.00 FORMAT "%8.2" ECU_ADDRESS 0xfe402eea /end MEASUREMENT
/begin MEASUREMENT Tlib_isLiftAudSpkrPosnCmd_VLAN205ControlMid "" UBYTE RB_RBA_Common_CentralElements_CompuMethods_Identical 1 100 0.0 255.00 FORMAT "%8.2" ECU_ADDRESS 0xfe402eeb /end MEASUREMENT
/begin MEASUREMENT Tlib_isCNSLLiftCmd_VLAN205ControlMid "" UBYTE RB_RBA_Common_CentralElements_CompuMethods_Identical 1 100 0.0 255.00 FORMAT "%8.2" ECU_ADDRESS 0xfe402eec /end MEASUREMENT
/begin MEASUREMENT Tlib_isLiftAudSpkrPosnTrig_VLAN205ControlMid "" UBYTE RB_RBA_Common_CentralElements_CompuMethods_Identical 1 100 0.0 255.00 FORMAT "%8.2" ECU_ADDRESS 0xfe402eed /end MEASUREMENT
/begin MEASUREMENT Tlib_isAirClngActn_VLAN205ControlMid "" UBYTE RB_RBA_Common_CentralElements_CompuMethods_Identical 1 100 0.0 255.00 FORMAT "%8.2" ECU_ADDRESS 0xfe402eee /end MEASUREMENT
/begin MEASUREMENT Tlib_isAirFragChReqFragRunngStsCh5_VLAN205ControlMid "" UBYTE RB_RBA_Common_CentralElements_CompuMethods_Identical 1 100 0.0 255.00 FORMAT "%8.2" ECU_ADDRESS 0xfe402eef /end MEASUREMENT
/begin MEASUREMENT Tlib_isAirFragChReqFragRunngStsCh2_VLAN205ControlMid "" UBYTE RB_RBA_Common_CentralElements_CompuMethods_Identical 1 100 0.0 255.00 FORMAT "%8.2" ECU_ADDRESS 0xfe402ef0 /end MEASUREMENT
/begin MEASUREMENT Tlib_isAirFragChReqFragRunngStsCh4_VLAN205ControlMid "" UBYTE RB_RBA_Common_CentralElements_CompuMethods_Identical 1 100 0.0 255.00 FORMAT "%8.2" ECU_ADDRESS 0xfe402ef1 /end MEASUREMENT
/begin MEASUREMENT Tlib_isAirFragChReqFragRunngStsCh1_VLAN205ControlMid "" UBYTE RB_RBA_Common_CentralElements_CompuMethods_Identical 1 100 0.0 255.00 FORMAT "%8.2" ECU_ADDRESS 0xfe402ef2 /end MEASUREMENT
/begin MEASUREMENT Tlib_isAirFragChReqFragRunngStsCh3_VLAN205ControlMid "" UBYTE RB_RBA_Common_CentralElements_CompuMethods_Identical 1 100 0.0 255.00 FORMAT "%8.2" ECU_ADDRESS 0xfe402ef3 /end MEASUREMENT
/begin MEASUREMENT Tlib_isCNSLSldCmd_VLAN205ControlMid "" UBYTE RB_RBA_Common_CentralElements_CompuMethods_Identical 1 100 0.0 255.00 FORMAT "%8.2" ECU_ADDRESS 0xfe402ef4 /end MEASUREMENT
/begin MEASUREMENT Tlib_isActvnOfSideStepIllmnSideStepIllmnReq_VLAN205ControlMid "" UBYTE RB_RBA_Common_CentralElements_CompuMethods_Identical 1 100 0.0 255.00 FORMAT "%8.2" ECU_ADDRESS 0xfe402ef5 /end MEASUREMENT
/begin MEASUREMENT Tlib_isActvnOfSideStepIllmnSideStepIllmnId_VLAN205ControlMid "" UBYTE RB_RBA_Common_CentralElements_CompuMethods_Identical 1 100 0.0 255.00 FORMAT "%8.2" ECU_ADDRESS 0xfe402ef6 /end MEASUREMENT
/begin MEASUREMENT Tlib_isCNSLLockTrig_VLAN205ControlMid "" UBYTE RB_RBA_Common_CentralElements_CompuMethods_Identical 1 100 0.0 255.00 FORMAT "%8.2" ECU_ADDRESS 0xfe402ef7 /end MEASUREMENT
/begin MEASUREMENT Tlib_isHornReqHornTrgSrc_VLAN205ControlMid "" UBYTE RB_RBA_Common_CentralElements_CompuMethods_Identical 1 100 0.0 255.00 FORMAT "%8.2" ECU_ADDRESS 0xfe402ef8 /end MEASUREMENT
/begin MEASUREMENT Tlib_isHornReqOnOff1_VLAN205ControlMid "" UBYTE RB_RBA_Common_CentralElements_CompuMethods_Identical 1 100 0.0 255.00 FORMAT "%8.2" ECU_ADDRESS 0xfe402ef9 /end MEASUREMENT
/begin MEASUREMENT Tlib_isCNSLLiftCmdTrig_VLAN205ControlMid "" UBYTE RB_RBA_Common_CentralElements_CompuMethods_Identical 1 100 0.0 255.00 FORMAT "%8.2" ECU_ADDRESS 0xfe402efa /end MEASUREMENT
/begin MEASUREMENT Tlib_isVTMTempSet_VLAN205ControlMid "" UBYTE RB_RBA_Common_CentralElements_CompuMethods_Identical 1 100 0.0 255.00 FORMAT "%8.2" ECU_ADDRESS 0xfe402efb /end MEASUREMENT
/begin MEASUREMENT Tlib_isCarconfigChangePrmId_VLAN205ControlMid "" UWORD RB_RBA_Common_CentralElements_CompuMethods_Identical 1 100 0.0 65535 FORMAT "%8.2" ECU_ADDRESS 0xfe402804 /end MEASUREMENT
/begin MEASUREMENT Tlib_isCarconfigChangeVal_VLAN205ControlMid "" UBYTE RB_RBA_Common_CentralElements_CompuMethods_Identical 1 100 0.0 255.00 FORMAT "%8.2" ECU_ADDRESS 0xfe402efc /end MEASUREMENT
/begin MEASUREMENT Tlib_isSeatHeatgTypCushFirstRi_VLAN205ControlMid "" UBYTE RB_RBA_Common_CentralElements_CompuMethods_Identical 1 100 0.0 255.00 FORMAT "%8.2" ECU_ADDRESS 0xfe402efd /end MEASUREMENT
/begin MEASUREMENT Tlib_isSteerAdjSwtSts_VLAN205ControlMid "" UBYTE RB_RBA_Common_CentralElements_CompuMethods_Identical 1 100 0.0 255.00 FORMAT "%8.2" ECU_ADDRESS 0xfe402efe /end MEASUREMENT
/begin MEASUREMENT Tlib_isSeatHeatgReqBackSecRi_VLAN205ControlMid "" UBYTE RB_RBA_Common_CentralElements_CompuMethods_Identical 1 100 0.0 255.00 FORMAT "%8.2" ECU_ADDRESS 0xfe402eff /end MEASUREMENT
/begin MEASUREMENT Tlib_isSeatHeatgReqBackFirstRi_VLAN205ControlMid "" UBYTE RB_RBA_Common_CentralElements_CompuMethods_Identical 1 100 0.0 255.00 FORMAT "%8.2" ECU_ADDRESS 0xfe402f00 /end MEASUREMENT
/begin MEASUREMENT Tlib_isSeatHeatgReqCushFirstRi_VLAN205ControlMid "" UBYTE RB_RBA_Common_CentralElements_CompuMethods_Identical 1 100 0.0 255.00 FORMAT "%8.2" ECU_ADDRESS 0xfe402f01 /end MEASUREMENT
/begin MEASUREMENT Tlib_isActvnOfTRCPSeatHeatLEDPosition_0_VLAN205ControlMid "" UBYTE RB_RBA_Common_CentralElements_CompuMethods_Identical 1 100 0.0 255.00 FORMAT "%8.2" ECU_ADDRESS 0xfe402f02 /end MEASUREMENT
/begin MEASUREMENT Tlib_isActvnOfTRCPSeatHeatLEDReq_0_VLAN205ControlMid "" UBYTE RB_RBA_Common_CentralElements_CompuMethods_Identical 1 100 0.0 255.00 FORMAT "%8.2" ECU_ADDRESS 0xfe402f03 /end MEASUREMENT
/begin MEASUREMENT Tlib_isSeatHeatgReqCushSecRi_VLAN205ControlMid "" UBYTE RB_RBA_Common_CentralElements_CompuMethods_Identical 1 100 0.0 255.00 FORMAT "%8.2" ECU_ADDRESS 0xfe402f04 /end MEASUREMENT
/begin MEASUREMENT Tlib_isSeatVentnReqCushFirstRi_VLAN205ControlMid "" UBYTE RB_RBA_Common_CentralElements_CompuMethods_Identical 1 100 0.0 255.00 FORMAT "%8.2" ECU_ADDRESS 0xfe402f05 /end MEASUREMENT
/begin MEASUREMENT Tlib_isSeatVentnReqCushSecRi_VLAN205ControlMid "" UBYTE RB_RBA_Common_CentralElements_CompuMethods_Identical 1 100 0.0 255.00 FORMAT "%8.2" ECU_ADDRESS 0xfe402f06 /end MEASUREMENT
/begin MEASUREMENT Tlib_isSeatHeatgTypCushSecRi_VLAN205ControlMid "" UBYTE RB_RBA_Common_CentralElements_CompuMethods_Identical 1 100 0.0 255.00 FORMAT "%8.2" ECU_ADDRESS 0xfe402f07 /end MEASUREMENT
/begin MEASUREMENT Tlib_isSeatVentnTypCushSecRi_VLAN205ControlMid "" UBYTE RB_RBA_Common_CentralElements_CompuMethods_Identical 1 100 0.0 255.00 FORMAT "%8.2" ECU_ADDRESS 0xfe402f08 /end MEASUREMENT
/begin MEASUREMENT Tlib_isCSDRotateIniCalReq_VLAN205ControlMid "" UBYTE RB_RBA_Common_CentralElements_CompuMethods_Identical 1 100 0.0 255.00 FORMAT "%8.2" ECU_ADDRESS 0xfe402f09 /end MEASUREMENT
/begin MEASUREMENT Tlib_isSeatVentnTypBackFirstRi_VLAN205ControlMid "" UBYTE RB_RBA_Common_CentralElements_CompuMethods_Identical 1 100 0.0 255.00 FORMAT "%8.2" ECU_ADDRESS 0xfe402f0a /end MEASUREMENT
/begin MEASUREMENT Tlib_isSeatHeatgTypBackFirstRi_VLAN205ControlMid "" UBYTE RB_RBA_Common_CentralElements_CompuMethods_Identical 1 100 0.0 255.00 FORMAT "%8.2" ECU_ADDRESS 0xfe402f0b /end MEASUREMENT
/begin MEASUREMENT Tlib_isElSPRightMtnCtrlReq_VLAN205ControlMid "" UBYTE RB_RBA_Common_CentralElements_CompuMethods_Identical 1 100 0.0 255.00 FORMAT "%8.2" ECU_ADDRESS 0xfe402f0c /end MEASUREMENT
/begin MEASUREMENT Tlib_isSeatVentnReqBackFirstRi_VLAN205ControlMid "" UBYTE RB_RBA_Common_CentralElements_CompuMethods_Identical 1 100 0.0 255.00 FORMAT "%8.2" ECU_ADDRESS 0xfe402f0d /end MEASUREMENT
/begin MEASUREMENT Tlib_isRoofDispFoldMtnCmd_0_VLAN205ControlMid "" UBYTE RB_RBA_Common_CentralElements_CompuMethods_Identical 1 100 0.0 255.00 FORMAT "%8.2" ECU_ADDRESS 0xfe402f0e /end MEASUREMENT
/begin MEASUREMENT Tlib_isSeatVentnTypCushFirstRi_VLAN205ControlMid "" UBYTE RB_RBA_Common_CentralElements_CompuMethods_Identical 1 100 0.0 255.00 FORMAT "%8.2" ECU_ADDRESS 0xfe402f0f /end MEASUREMENT
/begin MEASUREMENT Tlib_isActvnOfTRCPSeatAutoLEDReq_0_VLAN205ControlMid "" UBYTE RB_RBA_Common_CentralElements_CompuMethods_Identical 1 100 0.0 255.00 FORMAT "%8.2" ECU_ADDRESS 0xfe402f10 /end MEASUREMENT
/begin MEASUREMENT Tlib_isActvnOfTRCPSeatAutoLEDPosition_0_VLAN205ControlMid "" UBYTE RB_RBA_Common_CentralElements_CompuMethods_Identical 1 100 0.0 255.00 FORMAT "%8.2" ECU_ADDRESS 0xfe402f11 /end MEASUREMENT
/begin MEASUREMENT Tlib_isADCStop_VLAN205ControlMid "" UBYTE RB_RBA_Common_CentralElements_CompuMethods_Identical 1 100 0.0 255.00 FORMAT "%8.2" ECU_ADDRESS 0xfe402f12 /end MEASUREMENT
/begin MEASUREMENT Tlib_isSeatVentnTypBackSecRi_VLAN205ControlMid "" UBYTE RB_RBA_Common_CentralElements_CompuMethods_Identical 1 100 0.0 255.00 FORMAT "%8.2" ECU_ADDRESS 0xfe402f13 /end MEASUREMENT
/begin MEASUREMENT Tlib_isListOfNodAv4_0_VLAN205ControlMid "" ULONG RB_RBA_Common_CentralElements_CompuMethods_Identical 1 100 0.0 4294967295 FORMAT "%8.2" ECU_ADDRESS 0xfe402744 /end MEASUREMENT
/begin MEASUREMENT Tlib_isListOfNodAv2_0_VLAN205ControlMid "" ULONG RB_RBA_Common_CentralElements_CompuMethods_Identical 1 100 0.0 4294967295 FORMAT "%8.2" ECU_ADDRESS 0xfe402748 /end MEASUREMENT
/begin MEASUREMENT Tlib_isListOfNodAv1_0_VLAN205ControlMid "" ULONG RB_RBA_Common_CentralElements_CompuMethods_Identical 1 100 0.0 4294967295 FORMAT "%8.2" ECU_ADDRESS 0xfe40274c /end MEASUREMENT
/begin MEASUREMENT Tlib_isListOfNodAv5_0_VLAN205ControlMid "" ULONG RB_RBA_Common_CentralElements_CompuMethods_Identical 1 100 0.0 4294967295 FORMAT "%8.2" ECU_ADDRESS 0xfe402750 /end MEASUREMENT
/begin MEASUREMENT Tlib_isListOfNodAv3_0_VLAN205ControlMid "" ULONG RB_RBA_Common_CentralElements_CompuMethods_Identical 1 100 0.0 4294967295 FORMAT "%8.2" ECU_ADDRESS 0xfe402754 /end MEASUREMENT
/begin MEASUREMENT Tlib_isListOfNodAv7_0_VLAN205ControlMid "" ULONG RB_RBA_Common_CentralElements_CompuMethods_Identical 1 100 0.0 4294967295 FORMAT "%8.2" ECU_ADDRESS 0xfe402758 /end MEASUREMENT
/begin MEASUREMENT Tlib_isListOfNodAv8_0_VLAN205ControlMid "" ULONG RB_RBA_Common_CentralElements_CompuMethods_Identical 1 100 0.0 4294967295 FORMAT "%8.2" ECU_ADDRESS 0xfe40275c /end MEASUREMENT
/begin MEASUREMENT Tlib_isListOfNodAv6_0_VLAN205ControlMid "" ULONG RB_RBA_Common_CentralElements_CompuMethods_Identical 1 100 0.0 4294967295 FORMAT "%8.2" ECU_ADDRESS 0xfe402760 /end MEASUREMENT
/begin MEASUREMENT Tlib_isSeatVentnReqBackSecRi_VLAN205ControlMid "" UBYTE RB_RBA_Common_CentralElements_CompuMethods_Identical 1 100 0.0 255.00 FORMAT "%8.2" ECU_ADDRESS 0xfe402f14 /end MEASUREMENT
/begin MEASUREMENT Tlib_isADCMtnCmdSteerWhlPosnAng_VLAN205ControlMid "" UWORD RB_RBA_Common_CentralElements_CompuMethods_Identical 1 100 0.0 65535 FORMAT "%8.2" ECU_ADDRESS 0xfe402806 /end MEASUREMENT
/begin MEASUREMENT Tlib_isADCMtnCmdSteerWhlPosnX_VLAN205ControlMid "" UWORD RB_RBA_Common_CentralElements_CompuMethods_Identical 1 100 0.0 65535 FORMAT "%8.2" ECU_ADDRESS 0xfe402808 /end MEASUREMENT
/begin MEASUREMENT Tlib_isActvnOfTRCPAutoIndicator_0_VLAN205ControlMid "" UBYTE RB_RBA_Common_CentralElements_CompuMethods_Identical 1 100 0.0 255.00 FORMAT "%8.2" ECU_ADDRESS 0xfe402f15 /end MEASUREMENT
/begin MEASUREMENT Tlib_isRoofDispSlidMtnCmd_0_VLAN205ControlMid "" UBYTE RB_RBA_Common_CentralElements_CompuMethods_Identical 1 100 0.0 255.00 FORMAT "%8.2" ECU_ADDRESS 0xfe402f16 /end MEASUREMENT
/begin MEASUREMENT Tlib_isSeatHeatgTypBackSecRi_VLAN205ControlMid "" UBYTE RB_RBA_Common_CentralElements_CompuMethods_Identical 1 100 0.0 255.00 FORMAT "%8.2" ECU_ADDRESS 0xfe402f17 /end MEASUREMENT
/begin MEASUREMENT Tlib_isElSPLeftMtnCtrlReq_VLAN205ControlMid "" UBYTE RB_RBA_Common_CentralElements_CompuMethods_Identical 1 100 0.0 255.00 FORMAT "%8.2" ECU_ADDRESS 0xfe402f18 /end MEASUREMENT
/begin MEASUREMENT Tlib_isDispPosnRotateCmd_0_VLAN205ControlMid "" UBYTE RB_RBA_Common_CentralElements_CompuMethods_Identical 1 100 0.0 255.00 FORMAT "%8.2" ECU_ADDRESS 0xfe402f19 /end MEASUREMENT
/begin MEASUREMENT Tlib_isElSPDrivSetting_VLAN205ControlMid "" UBYTE RB_RBA_Common_CentralElements_CompuMethods_Identical 1 100 0.0 255.00 FORMAT "%8.2" ECU_ADDRESS 0xfe402f1a /end MEASUREMENT
/begin MEASUREMENT Tlib_isRoadInclnRoadIncln_0_VLAN205ControlMid "" SWORD RB_RBA_Common_CentralElements_CompuMethods_Identical 1 100 -32768 32767 FORMAT "%8.2" ECU_ADDRESS 0xfe40280a /end MEASUREMENT
/begin MEASUREMENT Tlib_isRoadInclnQly_0_VLAN205ControlMid "" UBYTE RB_RBA_Common_CentralElements_CompuMethods_Identical 1 100 0.0 255.00 FORMAT "%8.2" ECU_ADDRESS 0xfe402f1b /end MEASUREMENT
/begin MEASUREMENT Tlib_isExtrMirrDimCmd_0_VLAN205ControlMid "" UBYTE RB_RBA_Common_CentralElements_CompuMethods_Identical 1 100 0.0 255.00 FORMAT "%8.2" ECU_ADDRESS 0xfe402f1c /end MEASUREMENT
/begin MEASUREMENT Tlib_isRollAgGlbQf_0_VLAN205ControlMid "" UBYTE RB_RBA_Common_CentralElements_CompuMethods_Identical 1 100 0.0 255.00 FORMAT "%8.2" ECU_ADDRESS 0xfe402f1d /end MEASUREMENT
/begin MEASUREMENT Tlib_isRollAgGlbVal_0_VLAN205ControlMid "" SWORD RB_RBA_Common_CentralElements_CompuMethods_Identical 1 100 -32768 32767 FORMAT "%8.2" ECU_ADDRESS 0xfe40280c /end MEASUREMENT
/begin MEASUREMENT Tlib_isSecRiLumbrVertCmd_0_VLAN205ControlMid "" UBYTE RB_RBA_Common_CentralElements_CompuMethods_Identical 1 100 0.0 255.00 FORMAT "%8.2" ECU_ADDRESS 0xfe402f1e /end MEASUREMENT
/begin MEASUREMENT Tlib_isSecRiLenAntiPinchCtrl_0_VLAN205ControlMid "" UBYTE RB_RBA_Common_CentralElements_CompuMethods_Identical 1 100 0.0 255.00 FORMAT "%8.2" ECU_ADDRESS 0xfe402f1f /end MEASUREMENT
/begin MEASUREMENT Tlib_isSecRiBackrestAntiPinchCtrl_0_VLAN205ControlMid "" UBYTE RB_RBA_Common_CentralElements_CompuMethods_Identical 1 100 0.0 255.00 FORMAT "%8.2" ECU_ADDRESS 0xfe402f20 /end MEASUREMENT
/begin MEASUREMENT Tlib_isSecRiLegRstAntiPinchCtrl_0_VLAN205ControlMid "" UBYTE RB_RBA_Common_CentralElements_CompuMethods_Identical 1 100 0.0 255.00 FORMAT "%8.2" ECU_ADDRESS 0xfe402f21 /end MEASUREMENT
/begin MEASUREMENT Tlib_isSecRiLumbrHozlCmd_0_VLAN205ControlMid "" UBYTE RB_RBA_Common_CentralElements_CompuMethods_Identical 1 100 0.0 255.00 FORMAT "%8.2" ECU_ADDRESS 0xfe402f22 /end MEASUREMENT
/begin MEASUREMENT Tlib_isSecRiCushBlstrCmd_0_VLAN205ControlMid "" UBYTE RB_RBA_Common_CentralElements_CompuMethods_Identical 1 100 0.0 255.00 FORMAT "%8.2" ECU_ADDRESS 0xfe402f23 /end MEASUREMENT
/begin MEASUREMENT Tlib_isSecRiSeatMassgLoadAndStoreReqIdPen_0_VLAN205ControlMid "" UBYTE RB_RBA_Common_CentralElements_CompuMethods_Identical 1 100 0.0 255.00 FORMAT "%8.2" ECU_ADDRESS 0xfe402f24 /end MEASUREMENT
/begin MEASUREMENT Tlib_isSecRiSeatMassgLoadAndStoreReqErgoPosn_0_VLAN205ControlMid "" UBYTE RB_RBA_Common_CentralElements_CompuMethods_Identical 1 100 0.0 255.00 FORMAT "%8.2" ECU_ADDRESS 0xfe402f25 /end MEASUREMENT
/begin MEASUREMENT Tlib_isSecRiSeatMassgLoadAndStoreReqErgoSetgEve_0_VLAN205ControlMid "" UBYTE RB_RBA_Common_CentralElements_CompuMethods_Identical 1 100 0.0 255.00 FORMAT "%8.2" ECU_ADDRESS 0xfe402f26 /end MEASUREMENT
/begin MEASUREMENT Tlib_isSecRiSeatMassgLoadAndStoreReqInOutEasy_0_VLAN205ControlMid "" UBYTE RB_RBA_Common_CentralElements_CompuMethods_Identical 1 100 0.0 255.00 FORMAT "%8.2" ECU_ADDRESS 0xfe402f27 /end MEASUREMENT
/begin MEASUREMENT Tlib_isSecRiMassgFctSetOnOff_0_VLAN205ControlMid "" UBYTE RB_RBA_Common_CentralElements_CompuMethods_Identical 1 100 0.0 255.00 FORMAT "%8.2" ECU_ADDRESS 0xfe402f28 /end MEASUREMENT
/begin MEASUREMENT Tlib_isSecRiMassgFctSetMassgInten_0_VLAN205ControlMid "" UBYTE RB_RBA_Common_CentralElements_CompuMethods_Identical 1 100 0.0 255.00 FORMAT "%8.2" ECU_ADDRESS 0xfe402f29 /end MEASUREMENT
/begin MEASUREMENT Tlib_isSecRiMassgFctSetMassgProg_0_VLAN205ControlMid "" UBYTE RB_RBA_Common_CentralElements_CompuMethods_Identical 1 100 0.0 255.00 FORMAT "%8.2" ECU_ADDRESS 0xfe402f2a /end MEASUREMENT
/begin MEASUREMENT Tlib_isSecRiBackBlstrCmd_0_VLAN205ControlMid "" UBYTE RB_RBA_Common_CentralElements_CompuMethods_Identical 1 100 0.0 255.00 FORMAT "%8.2" ECU_ADDRESS 0xfe402f2b /end MEASUREMENT
/begin MEASUREMENT Tlib_isPassHedrHozlMotCmd_VLAN205ControlMid "" UBYTE RB_RBA_Common_CentralElements_CompuMethods_Identical 1 100 0.0 255.00 FORMAT "%8.2" ECU_ADDRESS 0xfe402f2c /end MEASUREMENT
/begin MEASUREMENT Tlib_isPassCushTiltMotCmd_VLAN205ControlMid "" UBYTE RB_RBA_Common_CentralElements_CompuMethods_Identical 1 100 0.0 255.00 FORMAT "%8.2" ECU_ADDRESS 0xfe402f2d /end MEASUREMENT
/begin MEASUREMENT Tlib_isPassLenMotCmdSwtHozlSts1_VLAN205ControlMid "" UBYTE RB_RBA_Common_CentralElements_CompuMethods_Identical 1 100 0.0 255.00 FORMAT "%8.2" ECU_ADDRESS 0xfe402f2e /end MEASUREMENT
/begin MEASUREMENT Tlib_isPassLenMotCmdMotorSpeed_VLAN205ControlMid "" UBYTE RB_RBA_Common_CentralElements_CompuMethods_Identical 1 100 0.0 255.00 FORMAT "%8.2" ECU_ADDRESS 0xfe402f2f /end MEASUREMENT
/begin MEASUREMENT Tlib_isActvnOfHDZebra_0_VLAN205ControlMid "" UBYTE RB_RBA_Common_CentralElements_CompuMethods_Identical 1 100 0.0 255.00 FORMAT "%8.2" ECU_ADDRESS 0xfe402f30 /end MEASUREMENT
/begin MEASUREMENT Tlib_isPwrDoorManStrengthLvlSetRiRe_0_VLAN205ControlMid "" UBYTE RB_RBA_Common_CentralElements_CompuMethods_Identical 1 100 0.0 255.00 FORMAT "%8.2" ECU_ADDRESS 0xfe402f31 /end MEASUREMENT
/begin MEASUREMENT Tlib_isPwrDoorManStrengthLvlSetPass_0_VLAN205ControlMid "" UBYTE RB_RBA_Common_CentralElements_CompuMethods_Identical 1 100 0.0 255.00 FORMAT "%8.2" ECU_ADDRESS 0xfe402f32 /end MEASUREMENT
/begin MEASUREMENT Tlib_isPassRotateMotCmd_VLAN205ControlMid "" UBYTE RB_RBA_Common_CentralElements_CompuMethods_Identical 1 100 0.0 255.00 FORMAT "%8.2" ECU_ADDRESS 0xfe402f33 /end MEASUREMENT
/begin MEASUREMENT Tlib_isPassCushExtMotCmd_VLAN205ControlMid "" UBYTE RB_RBA_Common_CentralElements_CompuMethods_Identical 1 100 0.0 255.00 FORMAT "%8.2" ECU_ADDRESS 0xfe402f34 /end MEASUREMENT
/begin MEASUREMENT Tlib_isPassHedrVertMotCmd_VLAN205ControlMid "" UBYTE RB_RBA_Common_CentralElements_CompuMethods_Identical 1 100 0.0 255.00 FORMAT "%8.2" ECU_ADDRESS 0xfe402f35 /end MEASUREMENT
/begin MEASUREMENT Tlib_isPassLegRstLenMotCmd_VLAN205ControlMid "" UBYTE RB_RBA_Common_CentralElements_CompuMethods_Identical 1 100 0.0 255.00 FORMAT "%8.2" ECU_ADDRESS 0xfe402f36 /end MEASUREMENT
/begin MEASUREMENT Tlib_isPassHeiMotCmd_VLAN205ControlMid "" UBYTE RB_RBA_Common_CentralElements_CompuMethods_Identical 1 100 0.0 255.00 FORMAT "%8.2" ECU_ADDRESS 0xfe402f37 /end MEASUREMENT
/begin MEASUREMENT Tlib_isPassShldMotCmd_VLAN205ControlMid "" UBYTE RB_RBA_Common_CentralElements_CompuMethods_Identical 1 100 0.0 255.00 FORMAT "%8.2" ECU_ADDRESS 0xfe402f38 /end MEASUREMENT
/begin MEASUREMENT Tlib_isPassPivtMotCmd_VLAN205ControlMid "" UBYTE RB_RBA_Common_CentralElements_CompuMethods_Identical 1 100 0.0 255.00 FORMAT "%8.2" ECU_ADDRESS 0xfe402f39 /end MEASUREMENT
/begin MEASUREMENT Tlib_isPassInclMotCmdMotorSpeed_VLAN205ControlMid "" UBYTE RB_RBA_Common_CentralElements_CompuMethods_Identical 1 100 0.0 255.00 FORMAT "%8.2" ECU_ADDRESS 0xfe402f3a /end MEASUREMENT
/begin MEASUREMENT Tlib_isPassInclMotCmdSwtHozlSts1_VLAN205ControlMid "" UBYTE RB_RBA_Common_CentralElements_CompuMethods_Identical 1 100 0.0 255.00 FORMAT "%8.2" ECU_ADDRESS 0xfe402f3b /end MEASUREMENT
/begin MEASUREMENT Tlib_isPassLegRstHeiMotCmd_VLAN205ControlMid "" UBYTE RB_RBA_Common_CentralElements_CompuMethods_Identical 1 100 0.0 255.00 FORMAT "%8.2" ECU_ADDRESS 0xfe402f3c /end MEASUREMENT
/begin MEASUREMENT Tlib_isActvnOfHDLaneLine_0_VLAN205ControlMid "" UBYTE RB_RBA_Common_CentralElements_CompuMethods_Identical 1 100 0.0 255.00 FORMAT "%8.2" ECU_ADDRESS 0xfe402f3d /end MEASUREMENT
/begin MEASUREMENT Tlib_isPassCushBlstrCmd_0_VLAN205ControlMid "" UBYTE RB_RBA_Common_CentralElements_CompuMethods_Identical 1 100 0.0 255.00 FORMAT "%8.2" ECU_ADDRESS 0xfe402f3e /end MEASUREMENT
/begin MEASUREMENT Tlib_isPassBackBlstrCmd_0_VLAN205ControlMid "" UBYTE RB_RBA_Common_CentralElements_CompuMethods_Identical 1 100 0.0 255.00 FORMAT "%8.2" ECU_ADDRESS 0xfe402f3f /end MEASUREMENT
/begin MEASUREMENT Tlib_isPassLumbrVertCmd_0_VLAN205ControlMid "" UBYTE RB_RBA_Common_CentralElements_CompuMethods_Identical 1 100 0.0 255.00 FORMAT "%8.2" ECU_ADDRESS 0xfe402f40 /end MEASUREMENT
/begin MEASUREMENT Tlib_isPassMassgFctSetMassgProg_0_VLAN205ControlMid "" UBYTE RB_RBA_Common_CentralElements_CompuMethods_Identical 1 100 0.0 255.00 FORMAT "%8.2" ECU_ADDRESS 0xfe402f41 /end MEASUREMENT
/begin MEASUREMENT Tlib_isPassMassgFctSetOnOff_0_VLAN205ControlMid "" UBYTE RB_RBA_Common_CentralElements_CompuMethods_Identical 1 100 0.0 255.00 FORMAT "%8.2" ECU_ADDRESS 0xfe402f42 /end MEASUREMENT
/begin MEASUREMENT Tlib_isPassMassgFctSetMassgInten_0_VLAN205ControlMid "" UBYTE RB_RBA_Common_CentralElements_CompuMethods_Identical 1 100 0.0 255.00 FORMAT "%8.2" ECU_ADDRESS 0xfe402f43 /end MEASUREMENT
/begin MEASUREMENT Tlib_isPassLumbrHozlCmd_0_VLAN205ControlMid "" UBYTE RB_RBA_Common_CentralElements_CompuMethods_Identical 1 100 0.0 255.00 FORMAT "%8.2" ECU_ADDRESS 0xfe402f44 /end MEASUREMENT
/begin MEASUREMENT Tlib_isPassSeatMassgLoadAndStoreReqErgoPosn_0_VLAN205ControlMid "" UBYTE RB_RBA_Common_CentralElements_CompuMethods_Identical 1 100 0.0 255.00 FORMAT "%8.2" ECU_ADDRESS 0xfe402f45 /end MEASUREMENT
/begin MEASUREMENT Tlib_isPassSeatMassgLoadAndStoreReqInOutEasy_0_VLAN205ControlMid "" UBYTE RB_RBA_Common_CentralElements_CompuMethods_Identical 1 100 0.0 255.00 FORMAT "%8.2" ECU_ADDRESS 0xfe402f46 /end MEASUREMENT
/begin MEASUREMENT Tlib_isPassSeatMassgLoadAndStoreReqErgoSetgEve_0_VLAN205ControlMid "" UBYTE RB_RBA_Common_CentralElements_CompuMethods_Identical 1 100 0.0 255.00 FORMAT "%8.2" ECU_ADDRESS 0xfe402f47 /end MEASUREMENT
/begin MEASUREMENT Tlib_isPassSeatMassgLoadAndStoreReqIdPen_0_VLAN205ControlMid "" UBYTE RB_RBA_Common_CentralElements_CompuMethods_Identical 1 100 0.0 255.00 FORMAT "%8.2" ECU_ADDRESS 0xfe402f48 /end MEASUREMENT
/begin MEASUREMENT Tlib_isPassLenAntiPinchCtrl_VLAN205ControlMid "" UBYTE RB_RBA_Common_CentralElements_CompuMethods_Identical 1 100 0.0 255.00 FORMAT "%8.2" ECU_ADDRESS 0xfe402f49 /end MEASUREMENT
/begin MEASUREMENT Tlib_isDoorMaxOpnSetPass_0_VLAN205ControlMid "" UBYTE RB_RBA_Common_CentralElements_CompuMethods_Identical 1 100 0.0 255.00 FORMAT "%8.2" ECU_ADDRESS 0xfe402f4a /end MEASUREMENT
/begin MEASUREMENT Tlib_isDoorMaxOpnSetRiRe_0_VLAN205ControlMid "" UBYTE RB_RBA_Common_CentralElements_CompuMethods_Identical 1 100 0.0 255.00 FORMAT "%8.2" ECU_ADDRESS 0xfe402f4b /end MEASUREMENT
/begin MEASUREMENT Tlib_isPassBackrestAntiPinchCtrl_VLAN205ControlMid "" UBYTE RB_RBA_Common_CentralElements_CompuMethods_Identical 1 100 0.0 255.00 FORMAT "%8.2" ECU_ADDRESS 0xfe402f4c /end MEASUREMENT
/begin MEASUREMENT Tlib_isSecRiRotateMotCmd_0_VLAN205ControlMid "" UBYTE RB_RBA_Common_CentralElements_CompuMethods_Identical 1 100 0.0 255.00 FORMAT "%8.2" ECU_ADDRESS 0xfe402f4d /end MEASUREMENT
/begin MEASUREMENT Tlib_isPassLegRstAntiPinchCtrl_VLAN205ControlMid "" UBYTE RB_RBA_Common_CentralElements_CompuMethods_Identical 1 100 0.0 255.00 FORMAT "%8.2" ECU_ADDRESS 0xfe402f4e /end MEASUREMENT
/begin MEASUREMENT Tlib_isCcvVlvSts2PosSts_VLAN205ControlMid "" UWORD RB_RBA_Common_CentralElements_CompuMethods_Identical 1 100 0.0 65535 FORMAT "%8.2" ECU_ADDRESS 0xfe40280e /end MEASUREMENT
/begin MEASUREMENT Tlib_isCcvVlvStsOprFlt_VLAN205ControlMid "" UBYTE RB_RBA_Common_CentralElements_CompuMethods_Identical 1 100 0.0 255.00 FORMAT "%8.2" ECU_ADDRESS 0xfe402f4f /end MEASUREMENT
/begin MEASUREMENT Tlib_isCcvVlvStsIntFlt_VLAN205ControlMid "" UBYTE RB_RBA_Common_CentralElements_CompuMethods_Identical 1 100 0.0 255.00 FORMAT "%8.2" ECU_ADDRESS 0xfe402f50 /end MEASUREMENT
/begin MEASUREMENT Tlib_isCcvVlvStsARC_VLAN205ControlMid "" UBYTE RB_RBA_Common_CentralElements_CompuMethods_Identical 1 100 0.0 255.00 FORMAT "%8.2" ECU_ADDRESS 0xfe402f51 /end MEASUREMENT
/begin MEASUREMENT Tlib_isCcvVlvStsTrqSts_VLAN205ControlMid "" UBYTE RB_RBA_Common_CentralElements_CompuMethods_Identical 1 100 0.0 255.00 FORMAT "%8.2" ECU_ADDRESS 0xfe402f52 /end MEASUREMENT
/begin MEASUREMENT Tlib_isWipgInfoWiprInWipgAr_0_VLAN205ControlMid "" UBYTE RB_RBA_Common_CentralElements_CompuMethods_Identical 1 100 0.0 255.00 FORMAT "%8.2" ECU_ADDRESS 0xfe402f53 /end MEASUREMENT
/begin MEASUREMENT Tlib_isWipgInfoWipgSpdInfo_0_VLAN205ControlMid "" UBYTE RB_RBA_Common_CentralElements_CompuMethods_Identical 1 100 0.0 255.00 FORMAT "%8.2" ECU_ADDRESS 0xfe402f54 /end MEASUREMENT
/begin MEASUREMENT Tlib_isWipgInfoWiprActv_0_VLAN205ControlMid "" UBYTE RB_RBA_Common_CentralElements_CompuMethods_Identical 1 100 0.0 255.00 FORMAT "%8.2" ECU_ADDRESS 0xfe402f55 /end MEASUREMENT
/begin MEASUREMENT Tlib_isIActLoSideSecDcDc_VLAN205ControlMid "" UWORD RB_RBA_Common_CentralElements_CompuMethods_Identical 1 100 0.0 65535 FORMAT "%8.2" ECU_ADDRESS 0xfe402810 /end MEASUREMENT
/begin MEASUREMENT Tlib_isIMaxAvlLoSideSecDcDc_VLAN205ControlMid "" UWORD RB_RBA_Common_CentralElements_CompuMethods_Identical 1 100 0.0 65535 FORMAT "%8.2" ECU_ADDRESS 0xfe402812 /end MEASUREMENT
/begin MEASUREMENT Tlib_isUActLoSideSecDcDc_VLAN205ControlMid "" UBYTE RB_RBA_Common_CentralElements_CompuMethods_Identical 1 100 0.0 255.00 FORMAT "%8.2" ECU_ADDRESS 0xfe402f56 /end MEASUREMENT
/begin MEASUREMENT Tlib_isTankTurnMaxCoolReq_VLAN205ControlMid "" UBYTE RB_RBA_Common_CentralElements_CompuMethods_Identical 1 100 0.0 255.00 FORMAT "%8.2" ECU_ADDRESS 0xfe402f57 /end MEASUREMENT
/begin MEASUREMENT Tlib_isLVEEMCfgSignalVal_VLAN205ControlMid "" UBYTE RB_RBA_Common_CentralElements_CompuMethods_Identical 1 100 0.0 255.00 FORMAT "%8.2" ECU_ADDRESS 0xfe402f58 /end MEASUREMENT
/begin MEASUREMENT Tlib_isLVEEMCfgSignalPrmId_VLAN205ControlMid "" UWORD RB_RBA_Common_CentralElements_CompuMethods_Identical 1 100 0.0 65535 FORMAT "%8.2" ECU_ADDRESS 0xfe402814 /end MEASUREMENT
/begin MEASUREMENT Tlib_isCircVldRiGroup3Boolean1_VLAN205ControlMid "" UBYTE RB_RBA_Common_CentralElements_CompuMethods_Identical 1 100 0.0 255.00 FORMAT "%8.2" ECU_ADDRESS 0xfe402f59 /end MEASUREMENT
/begin MEASUREMENT Tlib_isCircVldRiGroup3Boolean2_VLAN205ControlMid "" UBYTE RB_RBA_Common_CentralElements_CompuMethods_Identical 1 100 0.0 255.00 FORMAT "%8.2" ECU_ADDRESS 0xfe402f5a /end MEASUREMENT
/begin MEASUREMENT Tlib_isCircVldRiGroup3Boolean5_VLAN205ControlMid "" UBYTE RB_RBA_Common_CentralElements_CompuMethods_Identical 1 100 0.0 255.00 FORMAT "%8.2" ECU_ADDRESS 0xfe402f5b /end MEASUREMENT
/begin MEASUREMENT Tlib_isCircVldRiGroup3Boolean9_VLAN205ControlMid "" UBYTE RB_RBA_Common_CentralElements_CompuMethods_Identical 1 100 0.0 255.00 FORMAT "%8.2" ECU_ADDRESS 0xfe402f5c /end MEASUREMENT
/begin MEASUREMENT Tlib_isCircVldRiGroup3Boolean3_VLAN205ControlMid "" UBYTE RB_RBA_Common_CentralElements_CompuMethods_Identical 1 100 0.0 255.00 FORMAT "%8.2" ECU_ADDRESS 0xfe402f5d /end MEASUREMENT
/begin MEASUREMENT Tlib_isCircVldRiGroup3Boolean6_VLAN205ControlMid "" UBYTE RB_RBA_Common_CentralElements_CompuMethods_Identical 1 100 0.0 255.00 FORMAT "%8.2" ECU_ADDRESS 0xfe402f5e /end MEASUREMENT
/begin MEASUREMENT Tlib_isCircVldRiGroup3Boolean7_VLAN205ControlMid "" UBYTE RB_RBA_Common_CentralElements_CompuMethods_Identical 1 100 0.0 255.00 FORMAT "%8.2" ECU_ADDRESS 0xfe402f5f /end MEASUREMENT
/begin MEASUREMENT Tlib_isCircVldRiGroup3Boolean8_VLAN205ControlMid "" UBYTE RB_RBA_Common_CentralElements_CompuMethods_Identical 1 100 0.0 255.00 FORMAT "%8.2" ECU_ADDRESS 0xfe402f60 /end MEASUREMENT
/begin MEASUREMENT Tlib_isCircVldRiGroup3Boolean10_VLAN205ControlMid "" UBYTE RB_RBA_Common_CentralElements_CompuMethods_Identical 1 100 0.0 255.00 FORMAT "%8.2" ECU_ADDRESS 0xfe402f61 /end MEASUREMENT
/begin MEASUREMENT Tlib_isCircVldRiGroup3Boolean4_VLAN205ControlMid "" UBYTE RB_RBA_Common_CentralElements_CompuMethods_Identical 1 100 0.0 255.00 FORMAT "%8.2" ECU_ADDRESS 0xfe402f62 /end MEASUREMENT
/begin MEASUREMENT Tlib_isCircVldRiGroup4Boolean7_VLAN205ControlMid "" UBYTE RB_RBA_Common_CentralElements_CompuMethods_Identical 1 100 0.0 255.00 FORMAT "%8.2" ECU_ADDRESS 0xfe402f63 /end MEASUREMENT
/begin MEASUREMENT Tlib_isCircVldRiGroup4Boolean2_VLAN205ControlMid "" UBYTE RB_RBA_Common_CentralElements_CompuMethods_Identical 1 100 0.0 255.00 FORMAT "%8.2" ECU_ADDRESS 0xfe402f64 /end MEASUREMENT
/begin MEASUREMENT Tlib_isCircVldRiGroup4Boolean6_VLAN205ControlMid "" UBYTE RB_RBA_Common_CentralElements_CompuMethods_Identical 1 100 0.0 255.00 FORMAT "%8.2" ECU_ADDRESS 0xfe402f65 /end MEASUREMENT
/begin MEASUREMENT Tlib_isCircVldRiGroup4Boolean9_VLAN205ControlMid "" UBYTE RB_RBA_Common_CentralElements_CompuMethods_Identical 1 100 0.0 255.00 FORMAT "%8.2" ECU_ADDRESS 0xfe402f66 /end MEASUREMENT
/begin MEASUREMENT Tlib_isCircVldRiGroup4Boolean10_VLAN205ControlMid "" UBYTE RB_RBA_Common_CentralElements_CompuMethods_Identical 1 100 0.0 255.00 FORMAT "%8.2" ECU_ADDRESS 0xfe402f67 /end MEASUREMENT
/begin MEASUREMENT Tlib_isCircVldRiGroup4Boolean4_VLAN205ControlMid "" UBYTE RB_RBA_Common_CentralElements_CompuMethods_Identical 1 100 0.0 255.00 FORMAT "%8.2" ECU_ADDRESS 0xfe402f68 /end MEASUREMENT
/begin MEASUREMENT Tlib_isCircVldRiGroup4Boolean1_VLAN205ControlMid "" UBYTE RB_RBA_Common_CentralElements_CompuMethods_Identical 1 100 0.0 255.00 FORMAT "%8.2" ECU_ADDRESS 0xfe402f69 /end MEASUREMENT
/begin MEASUREMENT Tlib_isCircVldRiGroup4Boolean5_VLAN205ControlMid "" UBYTE RB_RBA_Common_CentralElements_CompuMethods_Identical 1 100 0.0 255.00 FORMAT "%8.2" ECU_ADDRESS 0xfe402f6a /end MEASUREMENT
/begin MEASUREMENT Tlib_isCircVldRiGroup4Boolean8_VLAN205ControlMid "" UBYTE RB_RBA_Common_CentralElements_CompuMethods_Identical 1 100 0.0 255.00 FORMAT "%8.2" ECU_ADDRESS 0xfe402f6b /end MEASUREMENT
/begin MEASUREMENT Tlib_isCircVldRiGroup4Boolean3_VLAN205ControlMid "" UBYTE RB_RBA_Common_CentralElements_CompuMethods_Identical 1 100 0.0 255.00 FORMAT "%8.2" ECU_ADDRESS 0xfe402f6c /end MEASUREMENT
/begin MEASUREMENT Tlib_isCircVldRiGroup6Boolean5_VLAN205ControlMid "" UBYTE RB_RBA_Common_CentralElements_CompuMethods_Identical 1 100 0.0 255.00 FORMAT "%8.2" ECU_ADDRESS 0xfe402f6d /end MEASUREMENT
/begin MEASUREMENT Tlib_isCircVldRiGroup6Boolean6_VLAN205ControlMid "" UBYTE RB_RBA_Common_CentralElements_CompuMethods_Identical 1 100 0.0 255.00 FORMAT "%8.2" ECU_ADDRESS 0xfe402f6e /end MEASUREMENT
/begin MEASUREMENT Tlib_isCircVldRiGroup6Boolean1_VLAN205ControlMid "" UBYTE RB_RBA_Common_CentralElements_CompuMethods_Identical 1 100 0.0 255.00 FORMAT "%8.2" ECU_ADDRESS 0xfe402f6f /end MEASUREMENT
/begin MEASUREMENT Tlib_isCircVldRiGroup6Boolean8_VLAN205ControlMid "" UBYTE RB_RBA_Common_CentralElements_CompuMethods_Identical 1 100 0.0 255.00 FORMAT "%8.2" ECU_ADDRESS 0xfe402f70 /end MEASUREMENT
/begin MEASUREMENT Tlib_isCircVldRiGroup6Boolean9_VLAN205ControlMid "" UBYTE RB_RBA_Common_CentralElements_CompuMethods_Identical 1 100 0.0 255.00 FORMAT "%8.2" ECU_ADDRESS 0xfe402f71 /end MEASUREMENT
/begin MEASUREMENT Tlib_isCircVldRiGroup6Boolean10_VLAN205ControlMid "" UBYTE RB_RBA_Common_CentralElements_CompuMethods_Identical 1 100 0.0 255.00 FORMAT "%8.2" ECU_ADDRESS 0xfe402f72 /end MEASUREMENT
/begin MEASUREMENT Tlib_isCircVldRiGroup6Boolean2_VLAN205ControlMid "" UBYTE RB_RBA_Common_CentralElements_CompuMethods_Identical 1 100 0.0 255.00 FORMAT "%8.2" ECU_ADDRESS 0xfe402f73 /end MEASUREMENT
/begin MEASUREMENT Tlib_isCircVldRiGroup6Boolean3_VLAN205ControlMid "" UBYTE RB_RBA_Common_CentralElements_CompuMethods_Identical 1 100 0.0 255.00 FORMAT "%8.2" ECU_ADDRESS 0xfe402f74 /end MEASUREMENT
/begin MEASUREMENT Tlib_isCircVldRiGroup6Boolean7_VLAN205ControlMid "" UBYTE RB_RBA_Common_CentralElements_CompuMethods_Identical 1 100 0.0 255.00 FORMAT "%8.2" ECU_ADDRESS 0xfe402f75 /end MEASUREMENT
/begin MEASUREMENT Tlib_isCircVldRiGroup6Boolean4_VLAN205ControlMid "" UBYTE RB_RBA_Common_CentralElements_CompuMethods_Identical 1 100 0.0 255.00 FORMAT "%8.2" ECU_ADDRESS 0xfe402f76 /end MEASUREMENT
/begin MEASUREMENT Tlib_isCircVldRiGroup2Boolean10_VLAN205ControlMid "" UBYTE RB_RBA_Common_CentralElements_CompuMethods_Identical 1 100 0.0 255.00 FORMAT "%8.2" ECU_ADDRESS 0xfe402f77 /end MEASUREMENT
/begin MEASUREMENT Tlib_isCircVldRiGroup2Boolean9_VLAN205ControlMid "" UBYTE RB_RBA_Common_CentralElements_CompuMethods_Identical 1 100 0.0 255.00 FORMAT "%8.2" ECU_ADDRESS 0xfe402f78 /end MEASUREMENT
/begin MEASUREMENT Tlib_isCircVldRiGroup2Boolean1_VLAN205ControlMid "" UBYTE RB_RBA_Common_CentralElements_CompuMethods_Identical 1 100 0.0 255.00 FORMAT "%8.2" ECU_ADDRESS 0xfe402f79 /end MEASUREMENT
/begin MEASUREMENT Tlib_isCircVldRiGroup2Boolean3_VLAN205ControlMid "" UBYTE RB_RBA_Common_CentralElements_CompuMethods_Identical 1 100 0.0 255.00 FORMAT "%8.2" ECU_ADDRESS 0xfe402f7a /end MEASUREMENT
/begin MEASUREMENT Tlib_isCircVldRiGroup2Boolean7_VLAN205ControlMid "" UBYTE RB_RBA_Common_CentralElements_CompuMethods_Identical 1 100 0.0 255.00 FORMAT "%8.2" ECU_ADDRESS 0xfe402f7b /end MEASUREMENT
/begin MEASUREMENT Tlib_isCircVldRiGroup2Boolean2_VLAN205ControlMid "" UBYTE RB_RBA_Common_CentralElements_CompuMethods_Identical 1 100 0.0 255.00 FORMAT "%8.2" ECU_ADDRESS 0xfe402f7c /end MEASUREMENT
/begin MEASUREMENT Tlib_isCircVldRiGroup2Boolean4_VLAN205ControlMid "" UBYTE RB_RBA_Common_CentralElements_CompuMethods_Identical 1 100 0.0 255.00 FORMAT "%8.2" ECU_ADDRESS 0xfe402f7d /end MEASUREMENT
/begin MEASUREMENT Tlib_isCircVldRiGroup2Boolean8_VLAN205ControlMid "" UBYTE RB_RBA_Common_CentralElements_CompuMethods_Identical 1 100 0.0 255.00 FORMAT "%8.2" ECU_ADDRESS 0xfe402f7e /end MEASUREMENT
/begin MEASUREMENT Tlib_isCircVldRiGroup2Boolean6_VLAN205ControlMid "" UBYTE RB_RBA_Common_CentralElements_CompuMethods_Identical 1 100 0.0 255.00 FORMAT "%8.2" ECU_ADDRESS 0xfe402f7f /end MEASUREMENT
/begin MEASUREMENT Tlib_isCircVldRiGroup2Boolean5_VLAN205ControlMid "" UBYTE RB_RBA_Common_CentralElements_CompuMethods_Identical 1 100 0.0 255.00 FORMAT "%8.2" ECU_ADDRESS 0xfe402f80 /end MEASUREMENT
/begin MEASUREMENT Tlib_isSeatCtrlTotConfigForSecRow_0_VLAN205ControlMid "" ULONG RB_RBA_Common_CentralElements_CompuMethods_Identical 1 100 0.0 4294967295 FORMAT "%8.2" ECU_ADDRESS 0xfe402764 /end MEASUREMENT
/begin MEASUREMENT Tlib_isCircVldRiGroup1Boolean5_VLAN205ControlMid "" UBYTE RB_RBA_Common_CentralElements_CompuMethods_Identical 1 100 0.0 255.00 FORMAT "%8.2" ECU_ADDRESS 0xfe402f81 /end MEASUREMENT
/begin MEASUREMENT Tlib_isCircVldRiGroup1Boolean1_VLAN205ControlMid "" UBYTE RB_RBA_Common_CentralElements_CompuMethods_Identical 1 100 0.0 255.00 FORMAT "%8.2" ECU_ADDRESS 0xfe402f82 /end MEASUREMENT
/begin MEASUREMENT Tlib_isCircVldRiGroup1Boolean6_VLAN205ControlMid "" UBYTE RB_RBA_Common_CentralElements_CompuMethods_Identical 1 100 0.0 255.00 FORMAT "%8.2" ECU_ADDRESS 0xfe402f83 /end MEASUREMENT
/begin MEASUREMENT Tlib_isCircVldRiGroup1Boolean2_VLAN205ControlMid "" UBYTE RB_RBA_Common_CentralElements_CompuMethods_Identical 1 100 0.0 255.00 FORMAT "%8.2" ECU_ADDRESS 0xfe402f84 /end MEASUREMENT
/begin MEASUREMENT Tlib_isCircVldRiGroup1Boolean3_VLAN205ControlMid "" UBYTE RB_RBA_Common_CentralElements_CompuMethods_Identical 1 100 0.0 255.00 FORMAT "%8.2" ECU_ADDRESS 0xfe402f85 /end MEASUREMENT
/begin MEASUREMENT Tlib_isCircVldRiGroup1Boolean4_VLAN205ControlMid "" UBYTE RB_RBA_Common_CentralElements_CompuMethods_Identical 1 100 0.0 255.00 FORMAT "%8.2" ECU_ADDRESS 0xfe402f86 /end MEASUREMENT
/begin MEASUREMENT Tlib_isCircVldRiGroup1Boolean10_VLAN205ControlMid "" UBYTE RB_RBA_Common_CentralElements_CompuMethods_Identical 1 100 0.0 255.00 FORMAT "%8.2" ECU_ADDRESS 0xfe402f87 /end MEASUREMENT
/begin MEASUREMENT Tlib_isCircVldRiGroup1Boolean8_VLAN205ControlMid "" UBYTE RB_RBA_Common_CentralElements_CompuMethods_Identical 1 100 0.0 255.00 FORMAT "%8.2" ECU_ADDRESS 0xfe402f88 /end MEASUREMENT
/begin MEASUREMENT Tlib_isCircVldRiGroup1Boolean7_VLAN205ControlMid "" UBYTE RB_RBA_Common_CentralElements_CompuMethods_Identical 1 100 0.0 255.00 FORMAT "%8.2" ECU_ADDRESS 0xfe402f89 /end MEASUREMENT
/begin MEASUREMENT Tlib_isCircVldRiGroup1Boolean9_VLAN205ControlMid "" UBYTE RB_RBA_Common_CentralElements_CompuMethods_Identical 1 100 0.0 255.00 FORMAT "%8.2" ECU_ADDRESS 0xfe402f8a /end MEASUREMENT
/begin MEASUREMENT Tlib_isCircVldRiGroup5Boolean4_VLAN205ControlMid "" UBYTE RB_RBA_Common_CentralElements_CompuMethods_Identical 1 100 0.0 255.00 FORMAT "%8.2" ECU_ADDRESS 0xfe402f8b /end MEASUREMENT
/begin MEASUREMENT Tlib_isCircVldRiGroup5Boolean1_VLAN205ControlMid "" UBYTE RB_RBA_Common_CentralElements_CompuMethods_Identical 1 100 0.0 255.00 FORMAT "%8.2" ECU_ADDRESS 0xfe402f8c /end MEASUREMENT
/begin MEASUREMENT Tlib_isCircVldRiGroup5Boolean2_VLAN205ControlMid "" UBYTE RB_RBA_Common_CentralElements_CompuMethods_Identical 1 100 0.0 255.00 FORMAT "%8.2" ECU_ADDRESS 0xfe402f8d /end MEASUREMENT
/begin MEASUREMENT Tlib_isCircVldRiGroup5Boolean10_VLAN205ControlMid "" UBYTE RB_RBA_Common_CentralElements_CompuMethods_Identical 1 100 0.0 255.00 FORMAT "%8.2" ECU_ADDRESS 0xfe402f8e /end MEASUREMENT
/begin MEASUREMENT Tlib_isCircVldRiGroup5Boolean7_VLAN205ControlMid "" UBYTE RB_RBA_Common_CentralElements_CompuMethods_Identical 1 100 0.0 255.00 FORMAT "%8.2" ECU_ADDRESS 0xfe402f8f /end MEASUREMENT
/begin MEASUREMENT Tlib_isCircVldRiGroup5Boolean8_VLAN205ControlMid "" UBYTE RB_RBA_Common_CentralElements_CompuMethods_Identical 1 100 0.0 255.00 FORMAT "%8.2" ECU_ADDRESS 0xfe402f90 /end MEASUREMENT
/begin MEASUREMENT Tlib_isCircVldRiGroup5Boolean9_VLAN205ControlMid "" UBYTE RB_RBA_Common_CentralElements_CompuMethods_Identical 1 100 0.0 255.00 FORMAT "%8.2" ECU_ADDRESS 0xfe402f91 /end MEASUREMENT
/begin MEASUREMENT Tlib_isCircVldRiGroup5Boolean6_VLAN205ControlMid "" UBYTE RB_RBA_Common_CentralElements_CompuMethods_Identical 1 100 0.0 255.00 FORMAT "%8.2" ECU_ADDRESS 0xfe402f92 /end MEASUREMENT
/begin MEASUREMENT Tlib_isCircVldRiGroup5Boolean3_VLAN205ControlMid "" UBYTE RB_RBA_Common_CentralElements_CompuMethods_Identical 1 100 0.0 255.00 FORMAT "%8.2" ECU_ADDRESS 0xfe402f93 /end MEASUREMENT
/begin MEASUREMENT Tlib_isCircVldRiGroup5Boolean5_VLAN205ControlMid "" UBYTE RB_RBA_Common_CentralElements_CompuMethods_Identical 1 100 0.0 255.00 FORMAT "%8.2" ECU_ADDRESS 0xfe402f94 /end MEASUREMENT
/begin MEASUREMENT Tlib_isVehObjforADB3AdbObjHozlAgSpdLe_0_VLAN205ControlMid "" UWORD RB_RBA_Common_CentralElements_CompuMethods_Identical 1 100 0.0 65535 FORMAT "%8.2" ECU_ADDRESS 0xfe402816 /end MEASUREMENT
/begin MEASUREMENT Tlib_isVehObjforADB3AdbHozlAgLe_0_VLAN205ControlMid "" UWORD RB_RBA_Common_CentralElements_CompuMethods_Identical 1 100 0.0 65535 FORMAT "%8.2" ECU_ADDRESS 0xfe402818 /end MEASUREMENT
/begin MEASUREMENT Tlib_isVehObjforADB3AdbObjDir_0_VLAN205ControlMid "" UBYTE RB_RBA_Common_CentralElements_CompuMethods_Identical 1 100 0.0 255.00 FORMAT "%8.2" ECU_ADDRESS 0xfe402f95 /end MEASUREMENT
/begin MEASUREMENT Tlib_isVehObjforADB3AdbObjHozlAgSpdRi_0_VLAN205ControlMid "" UWORD RB_RBA_Common_CentralElements_CompuMethods_Identical 1 100 0.0 65535 FORMAT "%8.2" ECU_ADDRESS 0xfe40281a /end MEASUREMENT
/begin MEASUREMENT Tlib_isVehObjforADB3AdbAbsDist_0_VLAN205ControlMid "" UWORD RB_RBA_Common_CentralElements_CompuMethods_Identical 1 100 0.0 65535 FORMAT "%8.2" ECU_ADDRESS 0xfe40281c /end MEASUREMENT
/begin MEASUREMENT Tlib_isVehObjforADB3AdbVertAg_0_VLAN205ControlMid "" UBYTE RB_RBA_Common_CentralElements_CompuMethods_Identical 1 100 0.0 255.00 FORMAT "%8.2" ECU_ADDRESS 0xfe402f96 /end MEASUREMENT
/begin MEASUREMENT Tlib_isVehObjforADB3AdbTrkInfo_0_VLAN205ControlMid "" UBYTE RB_RBA_Common_CentralElements_CompuMethods_Identical 1 100 0.0 255.00 FORMAT "%8.2" ECU_ADDRESS 0xfe402f97 /end MEASUREMENT
/begin MEASUREMENT Tlib_isVehObjforADB3AdbClassn_0_VLAN205ControlMid "" UBYTE RB_RBA_Common_CentralElements_CompuMethods_Identical 1 100 0.0 255.00 FORMAT "%8.2" ECU_ADDRESS 0xfe402f98 /end MEASUREMENT
/begin MEASUREMENT Tlib_isVehObjforADB3AdbHozlAgRi_0_VLAN205ControlMid "" UWORD RB_RBA_Common_CentralElements_CompuMethods_Identical 1 100 0.0 65535 FORMAT "%8.2" ECU_ADDRESS 0xfe40281e /end MEASUREMENT
/begin MEASUREMENT Tlib_isTrafficSignForADB2AdbAbsDist_0_VLAN205ControlMid "" UWORD RB_RBA_Common_CentralElements_CompuMethods_Identical 1 100 0.0 65535 FORMAT "%8.2" ECU_ADDRESS 0xfe402820 /end MEASUREMENT
/begin MEASUREMENT Tlib_isTrafficSignForADB2AdbVertAgTop_0_VLAN205ControlMid "" UWORD RB_RBA_Common_CentralElements_CompuMethods_Identical 1 100 0.0 65535 FORMAT "%8.2" ECU_ADDRESS 0xfe402822 /end MEASUREMENT
/begin MEASUREMENT Tlib_isTrafficSignForADB2AdbHozlAgLe_0_VLAN205ControlMid "" UWORD RB_RBA_Common_CentralElements_CompuMethods_Identical 1 100 0.0 65535 FORMAT "%8.2" ECU_ADDRESS 0xfe402824 /end MEASUREMENT
/begin MEASUREMENT Tlib_isTrafficSignForADB2AdbTrkInfo_0_VLAN205ControlMid "" UBYTE RB_RBA_Common_CentralElements_CompuMethods_Identical 1 100 0.0 255.00 FORMAT "%8.2" ECU_ADDRESS 0xfe402f99 /end MEASUREMENT
/begin MEASUREMENT Tlib_isTrafficSignForADB2AdbDetdQly_0_VLAN205ControlMid "" UBYTE RB_RBA_Common_CentralElements_CompuMethods_Identical 1 100 0.0 255.00 FORMAT "%8.2" ECU_ADDRESS 0xfe402f9a /end MEASUREMENT
/begin MEASUREMENT Tlib_isTrafficSignForADB2AdbHozlAgRi_0_VLAN205ControlMid "" UWORD RB_RBA_Common_CentralElements_CompuMethods_Identical 1 100 0.0 65535 FORMAT "%8.2" ECU_ADDRESS 0xfe402826 /end MEASUREMENT
/begin MEASUREMENT Tlib_isTrafficSignForADB2AdbVertAgBot_0_VLAN205ControlMid "" UWORD RB_RBA_Common_CentralElements_CompuMethods_Identical 1 100 0.0 65535 FORMAT "%8.2" ECU_ADDRESS 0xfe402828 /end MEASUREMENT
/begin MEASUREMENT Tlib_isVehObjforADB1AdbAbsDist_0_VLAN205ControlMid "" UWORD RB_RBA_Common_CentralElements_CompuMethods_Identical 1 100 0.0 65535 FORMAT "%8.2" ECU_ADDRESS 0xfe40282a /end MEASUREMENT
/begin MEASUREMENT Tlib_isVehObjforADB1AdbHozlAgLe_0_VLAN205ControlMid "" UWORD RB_RBA_Common_CentralElements_CompuMethods_Identical 1 100 0.0 65535 FORMAT "%8.2" ECU_ADDRESS 0xfe40282c /end MEASUREMENT
/begin MEASUREMENT Tlib_isVehObjforADB1AdbTrkInfo_0_VLAN205ControlMid "" UBYTE RB_RBA_Common_CentralElements_CompuMethods_Identical 1 100 0.0 255.00 FORMAT "%8.2" ECU_ADDRESS 0xfe402f9b /end MEASUREMENT
/begin MEASUREMENT Tlib_isVehObjforADB1AdbObjDir_0_VLAN205ControlMid "" UBYTE RB_RBA_Common_CentralElements_CompuMethods_Identical 1 100 0.0 255.00 FORMAT "%8.2" ECU_ADDRESS 0xfe402f9c /end MEASUREMENT
/begin MEASUREMENT Tlib_isVehObjforADB1AdbObjHozlAgSpdRi_0_VLAN205ControlMid "" UWORD RB_RBA_Common_CentralElements_CompuMethods_Identical 1 100 0.0 65535 FORMAT "%8.2" ECU_ADDRESS 0xfe40282e /end MEASUREMENT
/begin MEASUREMENT Tlib_isVehObjforADB1AdbVertAg_0_VLAN205ControlMid "" UBYTE RB_RBA_Common_CentralElements_CompuMethods_Identical 1 100 0.0 255.00 FORMAT "%8.2" ECU_ADDRESS 0xfe402f9d /end MEASUREMENT
/begin MEASUREMENT Tlib_isVehObjforADB1AdbHozlAgRi_0_VLAN205ControlMid "" UWORD RB_RBA_Common_CentralElements_CompuMethods_Identical 1 100 0.0 65535 FORMAT "%8.2" ECU_ADDRESS 0xfe402830 /end MEASUREMENT
/begin MEASUREMENT Tlib_isVehObjforADB1AdbObjHozlAgSpdLe_0_VLAN205ControlMid "" UWORD RB_RBA_Common_CentralElements_CompuMethods_Identical 1 100 0.0 65535 FORMAT "%8.2" ECU_ADDRESS 0xfe402832 /end MEASUREMENT
/begin MEASUREMENT Tlib_isVehObjforADB1AdbClassn_0_VLAN205ControlMid "" UBYTE RB_RBA_Common_CentralElements_CompuMethods_Identical 1 100 0.0 255.00 FORMAT "%8.2" ECU_ADDRESS 0xfe402f9e /end MEASUREMENT
/begin MEASUREMENT Tlib_isVehObjforADB6AdbHozlAgLe_0_VLAN205ControlMid "" UWORD RB_RBA_Common_CentralElements_CompuMethods_Identical 1 100 0.0 65535 FORMAT "%8.2" ECU_ADDRESS 0xfe402834 /end MEASUREMENT
/begin MEASUREMENT Tlib_isVehObjforADB6AdbObjHozlAgSpdLe_0_VLAN205ControlMid "" UWORD RB_RBA_Common_CentralElements_CompuMethods_Identical 1 100 0.0 65535 FORMAT "%8.2" ECU_ADDRESS 0xfe402836 /end MEASUREMENT
/begin MEASUREMENT Tlib_isVehObjforADB6AdbObjDir_0_VLAN205ControlMid "" UBYTE RB_RBA_Common_CentralElements_CompuMethods_Identical 1 100 0.0 255.00 FORMAT "%8.2" ECU_ADDRESS 0xfe402f9f /end MEASUREMENT
/begin MEASUREMENT Tlib_isVehObjforADB6AdbClassn_0_VLAN205ControlMid "" UBYTE RB_RBA_Common_CentralElements_CompuMethods_Identical 1 100 0.0 255.00 FORMAT "%8.2" ECU_ADDRESS 0xfe402fa0 /end MEASUREMENT
/begin MEASUREMENT Tlib_isVehObjforADB6AdbTrkInfo_0_VLAN205ControlMid "" UBYTE RB_RBA_Common_CentralElements_CompuMethods_Identical 1 100 0.0 255.00 FORMAT "%8.2" ECU_ADDRESS 0xfe402fa1 /end MEASUREMENT
/begin MEASUREMENT Tlib_isVehObjforADB6AdbAbsDist_0_VLAN205ControlMid "" UWORD RB_RBA_Common_CentralElements_CompuMethods_Identical 1 100 0.0 65535 FORMAT "%8.2" ECU_ADDRESS 0xfe402838 /end MEASUREMENT
/begin MEASUREMENT Tlib_isVehObjforADB6AdbObjHozlAgSpdRi_0_VLAN205ControlMid "" UWORD RB_RBA_Common_CentralElements_CompuMethods_Identical 1 100 0.0 65535 FORMAT "%8.2" ECU_ADDRESS 0xfe40283a /end MEASUREMENT
/begin MEASUREMENT Tlib_isVehObjforADB6AdbVertAg_0_VLAN205ControlMid "" UBYTE RB_RBA_Common_CentralElements_CompuMethods_Identical 1 100 0.0 255.00 FORMAT "%8.2" ECU_ADDRESS 0xfe402fa2 /end MEASUREMENT
/begin MEASUREMENT Tlib_isVehObjforADB6AdbHozlAgRi_0_VLAN205ControlMid "" UWORD RB_RBA_Common_CentralElements_CompuMethods_Identical 1 100 0.0 65535 FORMAT "%8.2" ECU_ADDRESS 0xfe40283c /end MEASUREMENT
/begin MEASUREMENT Tlib_isVehObjforADB5AdbHozlAgRi_0_VLAN205ControlMid "" UWORD RB_RBA_Common_CentralElements_CompuMethods_Identical 1 100 0.0 65535 FORMAT "%8.2" ECU_ADDRESS 0xfe40283e /end MEASUREMENT
/begin MEASUREMENT Tlib_isVehObjforADB5AdbVertAg_0_VLAN205ControlMid "" UBYTE RB_RBA_Common_CentralElements_CompuMethods_Identical 1 100 0.0 255.00 FORMAT "%8.2" ECU_ADDRESS 0xfe402fa3 /end MEASUREMENT
/begin MEASUREMENT Tlib_isVehObjforADB5AdbObjHozlAgSpdRi_0_VLAN205ControlMid "" UWORD RB_RBA_Common_CentralElements_CompuMethods_Identical 1 100 0.0 65535 FORMAT "%8.2" ECU_ADDRESS 0xfe402840 /end MEASUREMENT
/begin MEASUREMENT Tlib_isVehObjforADB5AdbAbsDist_0_VLAN205ControlMid "" UWORD RB_RBA_Common_CentralElements_CompuMethods_Identical 1 100 0.0 65535 FORMAT "%8.2" ECU_ADDRESS 0xfe402842 /end MEASUREMENT
/begin MEASUREMENT Tlib_isVehObjforADB5AdbClassn_0_VLAN205ControlMid "" UBYTE RB_RBA_Common_CentralElements_CompuMethods_Identical 1 100 0.0 255.00 FORMAT "%8.2" ECU_ADDRESS 0xfe402fa4 /end MEASUREMENT
/begin MEASUREMENT Tlib_isVehObjforADB5AdbObjHozlAgSpdLe_0_VLAN205ControlMid "" UWORD RB_RBA_Common_CentralElements_CompuMethods_Identical 1 100 0.0 65535 FORMAT "%8.2" ECU_ADDRESS 0xfe402844 /end MEASUREMENT
/begin MEASUREMENT Tlib_isVehObjforADB5AdbHozlAgLe_0_VLAN205ControlMid "" UWORD RB_RBA_Common_CentralElements_CompuMethods_Identical 1 100 0.0 65535 FORMAT "%8.2" ECU_ADDRESS 0xfe402846 /end MEASUREMENT
/begin MEASUREMENT Tlib_isVehObjforADB5AdbObjDir_0_VLAN205ControlMid "" UBYTE RB_RBA_Common_CentralElements_CompuMethods_Identical 1 100 0.0 255.00 FORMAT "%8.2" ECU_ADDRESS 0xfe402fa5 /end MEASUREMENT
/begin MEASUREMENT Tlib_isVehObjforADB5AdbTrkInfo_0_VLAN205ControlMid "" UBYTE RB_RBA_Common_CentralElements_CompuMethods_Identical 1 100 0.0 255.00 FORMAT "%8.2" ECU_ADDRESS 0xfe402fa6 /end MEASUREMENT
/begin MEASUREMENT Tlib_isVehObjforADB7AdbClassn_0_VLAN205ControlMid "" UBYTE RB_RBA_Common_CentralElements_CompuMethods_Identical 1 100 0.0 255.00 FORMAT "%8.2" ECU_ADDRESS 0xfe402fa7 /end MEASUREMENT
/begin MEASUREMENT Tlib_isVehObjforADB7AdbObjHozlAgSpdLe_0_VLAN205ControlMid "" UWORD RB_RBA_Common_CentralElements_CompuMethods_Identical 1 100 0.0 65535 FORMAT "%8.2" ECU_ADDRESS 0xfe402848 /end MEASUREMENT
/begin MEASUREMENT Tlib_isVehObjforADB7AdbTrkInfo_0_VLAN205ControlMid "" UBYTE RB_RBA_Common_CentralElements_CompuMethods_Identical 1 100 0.0 255.00 FORMAT "%8.2" ECU_ADDRESS 0xfe402fa8 /end MEASUREMENT
/begin MEASUREMENT Tlib_isVehObjforADB7AdbHozlAgLe_0_VLAN205ControlMid "" UWORD RB_RBA_Common_CentralElements_CompuMethods_Identical 1 100 0.0 65535 FORMAT "%8.2" ECU_ADDRESS 0xfe40284a /end MEASUREMENT
/begin MEASUREMENT Tlib_isVehObjforADB7AdbVertAg_0_VLAN205ControlMid "" UBYTE RB_RBA_Common_CentralElements_CompuMethods_Identical 1 100 0.0 255.00 FORMAT "%8.2" ECU_ADDRESS 0xfe402fa9 /end MEASUREMENT
/begin MEASUREMENT Tlib_isVehObjforADB7AdbObjDir_0_VLAN205ControlMid "" UBYTE RB_RBA_Common_CentralElements_CompuMethods_Identical 1 100 0.0 255.00 FORMAT "%8.2" ECU_ADDRESS 0xfe402faa /end MEASUREMENT
/begin MEASUREMENT Tlib_isVehObjforADB7AdbAbsDist_0_VLAN205ControlMid "" UWORD RB_RBA_Common_CentralElements_CompuMethods_Identical 1 100 0.0 65535 FORMAT "%8.2" ECU_ADDRESS 0xfe40284c /end MEASUREMENT
/begin MEASUREMENT Tlib_isVehObjforADB7AdbObjHozlAgSpdRi_0_VLAN205ControlMid "" UWORD RB_RBA_Common_CentralElements_CompuMethods_Identical 1 100 0.0 65535 FORMAT "%8.2" ECU_ADDRESS 0xfe40284e /end MEASUREMENT
/begin MEASUREMENT Tlib_isVehObjforADB7AdbHozlAgRi_0_VLAN205ControlMid "" UWORD RB_RBA_Common_CentralElements_CompuMethods_Identical 1 100 0.0 65535 FORMAT "%8.2" ECU_ADDRESS 0xfe402850 /end MEASUREMENT
/begin MEASUREMENT Tlib_isVehObjforADB2AdbObjHozlAgSpdLe_0_VLAN205ControlMid "" UWORD RB_RBA_Common_CentralElements_CompuMethods_Identical 1 100 0.0 65535 FORMAT "%8.2" ECU_ADDRESS 0xfe402852 /end MEASUREMENT
/begin MEASUREMENT Tlib_isVehObjforADB2AdbHozlAgLe_0_VLAN205ControlMid "" UWORD RB_RBA_Common_CentralElements_CompuMethods_Identical 1 100 0.0 65535 FORMAT "%8.2" ECU_ADDRESS 0xfe402854 /end MEASUREMENT
/begin MEASUREMENT Tlib_isVehObjforADB2AdbObjHozlAgSpdRi_0_VLAN205ControlMid "" UWORD RB_RBA_Common_CentralElements_CompuMethods_Identical 1 100 0.0 65535 FORMAT "%8.2" ECU_ADDRESS 0xfe402856 /end MEASUREMENT
/begin MEASUREMENT Tlib_isVehObjforADB2AdbAbsDist_0_VLAN205ControlMid "" UWORD RB_RBA_Common_CentralElements_CompuMethods_Identical 1 100 0.0 65535 FORMAT "%8.2" ECU_ADDRESS 0xfe402858 /end MEASUREMENT
/begin MEASUREMENT Tlib_isVehObjforADB2AdbClassn_0_VLAN205ControlMid "" UBYTE RB_RBA_Common_CentralElements_CompuMethods_Identical 1 100 0.0 255.00 FORMAT "%8.2" ECU_ADDRESS 0xfe402fab /end MEASUREMENT
/begin MEASUREMENT Tlib_isVehObjforADB2AdbObjDir_0_VLAN205ControlMid "" UBYTE RB_RBA_Common_CentralElements_CompuMethods_Identical 1 100 0.0 255.00 FORMAT "%8.2" ECU_ADDRESS 0xfe402fac /end MEASUREMENT
/begin MEASUREMENT Tlib_isVehObjforADB2AdbHozlAgRi_0_VLAN205ControlMid "" UWORD RB_RBA_Common_CentralElements_CompuMethods_Identical 1 100 0.0 65535 FORMAT "%8.2" ECU_ADDRESS 0xfe40285a /end MEASUREMENT
/begin MEASUREMENT Tlib_isVehObjforADB2AdbTrkInfo_0_VLAN205ControlMid "" UBYTE RB_RBA_Common_CentralElements_CompuMethods_Identical 1 100 0.0 255.00 FORMAT "%8.2" ECU_ADDRESS 0xfe402fad /end MEASUREMENT
/begin MEASUREMENT Tlib_isVehObjforADB2AdbVertAg_0_VLAN205ControlMid "" UBYTE RB_RBA_Common_CentralElements_CompuMethods_Identical 1 100 0.0 255.00 FORMAT "%8.2" ECU_ADDRESS 0xfe402fae /end MEASUREMENT
/begin MEASUREMENT Tlib_isVehObjforADB8AdbTrkInfo_0_VLAN205ControlMid "" UBYTE RB_RBA_Common_CentralElements_CompuMethods_Identical 1 100 0.0 255.00 FORMAT "%8.2" ECU_ADDRESS 0xfe402faf /end MEASUREMENT
/begin MEASUREMENT Tlib_isVehObjforADB8AdbVertAg_0_VLAN205ControlMid "" UBYTE RB_RBA_Common_CentralElements_CompuMethods_Identical 1 100 0.0 255.00 FORMAT "%8.2" ECU_ADDRESS 0xfe402fb0 /end MEASUREMENT
/begin MEASUREMENT Tlib_isVehObjforADB8AdbObjHozlAgSpdLe_0_VLAN205ControlMid "" UWORD RB_RBA_Common_CentralElements_CompuMethods_Identical 1 100 0.0 65535 FORMAT "%8.2" ECU_ADDRESS 0xfe40285c /end MEASUREMENT
/begin MEASUREMENT Tlib_isVehObjforADB8AdbAbsDist_0_VLAN205ControlMid "" UWORD RB_RBA_Common_CentralElements_CompuMethods_Identical 1 100 0.0 65535 FORMAT "%8.2" ECU_ADDRESS 0xfe40285e /end MEASUREMENT
/begin MEASUREMENT Tlib_isVehObjforADB8AdbClassn_0_VLAN205ControlMid "" UBYTE RB_RBA_Common_CentralElements_CompuMethods_Identical 1 100 0.0 255.00 FORMAT "%8.2" ECU_ADDRESS 0xfe402fb1 /end MEASUREMENT
/begin MEASUREMENT Tlib_isVehObjforADB8AdbObjDir_0_VLAN205ControlMid "" UBYTE RB_RBA_Common_CentralElements_CompuMethods_Identical 1 100 0.0 255.00 FORMAT "%8.2" ECU_ADDRESS 0xfe402fb2 /end MEASUREMENT
/begin MEASUREMENT Tlib_isVehObjforADB8AdbHozlAgLe_0_VLAN205ControlMid "" UWORD RB_RBA_Common_CentralElements_CompuMethods_Identical 1 100 0.0 65535 FORMAT "%8.2" ECU_ADDRESS 0xfe402860 /end MEASUREMENT
/begin MEASUREMENT Tlib_isVehObjforADB8AdbHozlAgRi_0_VLAN205ControlMid "" UWORD RB_RBA_Common_CentralElements_CompuMethods_Identical 1 100 0.0 65535 FORMAT "%8.2" ECU_ADDRESS 0xfe402862 /end MEASUREMENT
/begin MEASUREMENT Tlib_isVehObjforADB8AdbObjHozlAgSpdRi_0_VLAN205ControlMid "" UWORD RB_RBA_Common_CentralElements_CompuMethods_Identical 1 100 0.0 65535 FORMAT "%8.2" ECU_ADDRESS 0xfe402864 /end MEASUREMENT
/begin MEASUREMENT Tlib_isVehObjforADB4AdbObjDir_0_VLAN205ControlMid "" UBYTE RB_RBA_Common_CentralElements_CompuMethods_Identical 1 100 0.0 255.00 FORMAT "%8.2" ECU_ADDRESS 0xfe402fb3 /end MEASUREMENT
/begin MEASUREMENT Tlib_isVehObjforADB4AdbAbsDist_0_VLAN205ControlMid "" UWORD RB_RBA_Common_CentralElements_CompuMethods_Identical 1 100 0.0 65535 FORMAT "%8.2" ECU_ADDRESS 0xfe402866 /end MEASUREMENT
/begin MEASUREMENT Tlib_isVehObjforADB4AdbVertAg_0_VLAN205ControlMid "" UBYTE RB_RBA_Common_CentralElements_CompuMethods_Identical 1 100 0.0 255.00 FORMAT "%8.2" ECU_ADDRESS 0xfe402fb4 /end MEASUREMENT
/begin MEASUREMENT Tlib_isVehObjforADB4AdbObjHozlAgSpdRi_0_VLAN205ControlMid "" UWORD RB_RBA_Common_CentralElements_CompuMethods_Identical 1 100 0.0 65535 FORMAT "%8.2" ECU_ADDRESS 0xfe402868 /end MEASUREMENT
/begin MEASUREMENT Tlib_isVehObjforADB4AdbHozlAgLe_0_VLAN205ControlMid "" UWORD RB_RBA_Common_CentralElements_CompuMethods_Identical 1 100 0.0 65535 FORMAT "%8.2" ECU_ADDRESS 0xfe40286a /end MEASUREMENT
/begin MEASUREMENT Tlib_isVehObjforADB4AdbHozlAgRi_0_VLAN205ControlMid "" UWORD RB_RBA_Common_CentralElements_CompuMethods_Identical 1 100 0.0 65535 FORMAT "%8.2" ECU_ADDRESS 0xfe40286c /end MEASUREMENT
/begin MEASUREMENT Tlib_isVehObjforADB4AdbClassn_0_VLAN205ControlMid "" UBYTE RB_RBA_Common_CentralElements_CompuMethods_Identical 1 100 0.0 255.00 FORMAT "%8.2" ECU_ADDRESS 0xfe402fb5 /end MEASUREMENT
/begin MEASUREMENT Tlib_isVehObjforADB4AdbObjHozlAgSpdLe_0_VLAN205ControlMid "" UWORD RB_RBA_Common_CentralElements_CompuMethods_Identical 1 100 0.0 65535 FORMAT "%8.2" ECU_ADDRESS 0xfe40286e /end MEASUREMENT
/begin MEASUREMENT Tlib_isVehObjforADB4AdbTrkInfo_0_VLAN205ControlMid "" UBYTE RB_RBA_Common_CentralElements_CompuMethods_Identical 1 100 0.0 255.00 FORMAT "%8.2" ECU_ADDRESS 0xfe402fb6 /end MEASUREMENT
/begin MEASUREMENT Tlib_isTrafficSignForADB1AdbHozlAgRi_0_VLAN205ControlMid "" UWORD RB_RBA_Common_CentralElements_CompuMethods_Identical 1 100 0.0 65535 FORMAT "%8.2" ECU_ADDRESS 0xfe402870 /end MEASUREMENT
/begin MEASUREMENT Tlib_isTrafficSignForADB1AdbHozlAgLe_0_VLAN205ControlMid "" UWORD RB_RBA_Common_CentralElements_CompuMethods_Identical 1 100 0.0 65535 FORMAT "%8.2" ECU_ADDRESS 0xfe402872 /end MEASUREMENT
/begin MEASUREMENT Tlib_isTrafficSignForADB1AdbVertAgBot_0_VLAN205ControlMid "" UWORD RB_RBA_Common_CentralElements_CompuMethods_Identical 1 100 0.0 65535 FORMAT "%8.2" ECU_ADDRESS 0xfe402874 /end MEASUREMENT
/begin MEASUREMENT Tlib_isTrafficSignForADB1AdbAbsDist_0_VLAN205ControlMid "" UWORD RB_RBA_Common_CentralElements_CompuMethods_Identical 1 100 0.0 65535 FORMAT "%8.2" ECU_ADDRESS 0xfe402876 /end MEASUREMENT
/begin MEASUREMENT Tlib_isTrafficSignForADB1AdbDetdQly_0_VLAN205ControlMid "" UBYTE RB_RBA_Common_CentralElements_CompuMethods_Identical 1 100 0.0 255.00 FORMAT "%8.2" ECU_ADDRESS 0xfe402fb7 /end MEASUREMENT
/begin MEASUREMENT Tlib_isTrafficSignForADB1AdbVertAgTop_0_VLAN205ControlMid "" UWORD RB_RBA_Common_CentralElements_CompuMethods_Identical 1 100 0.0 65535 FORMAT "%8.2" ECU_ADDRESS 0xfe402878 /end MEASUREMENT
/begin MEASUREMENT Tlib_isTrafficSignForADB1AdbTrkInfo_0_VLAN205ControlMid "" UBYTE RB_RBA_Common_CentralElements_CompuMethods_Identical 1 100 0.0 255.00 FORMAT "%8.2" ECU_ADDRESS 0xfe402fb8 /end MEASUREMENT
/begin MEASUREMENT Tlib_isSeatCtrlTotConfigForFrstRow_VLAN205ControlMid "" ULONG RB_RBA_Common_CentralElements_CompuMethods_Identical 1 100 0.0 4294967295 FORMAT "%8.2" ECU_ADDRESS 0xfe402768 /end MEASUREMENT
/begin MEASUREMENT Tlib_isCcvmStsVlvOverUErr_VLAN205ControlMid "" UBYTE RB_RBA_Common_CentralElements_CompuMethods_Identical 1 100 0.0 255.00 FORMAT "%8.2" ECU_ADDRESS 0xfe402fb9 /end MEASUREMENT
/begin MEASUREMENT Tlib_isCcvmStsVlvCalibSts_VLAN205ControlMid "" UBYTE RB_RBA_Common_CentralElements_CompuMethods_Identical 1 100 0.0 255.00 FORMAT "%8.2" ECU_ADDRESS 0xfe402fba /end MEASUREMENT
/begin MEASUREMENT Tlib_isCcvmStsVlvPosnUkwnFlt_VLAN205ControlMid "" UBYTE RB_RBA_Common_CentralElements_CompuMethods_Identical 1 100 0.0 255.00 FORMAT "%8.2" ECU_ADDRESS 0xfe402fbb /end MEASUREMENT
/begin MEASUREMENT Tlib_isCcvmStsVlvNVMFlt_VLAN205ControlMid "" UBYTE RB_RBA_Common_CentralElements_CompuMethods_Identical 1 100 0.0 255.00 FORMAT "%8.2" ECU_ADDRESS 0xfe402fbc /end MEASUREMENT
/begin MEASUREMENT Tlib_isCcvmStsVlvOverTWarn_VLAN205ControlMid "" UBYTE RB_RBA_Common_CentralElements_CompuMethods_Identical 1 100 0.0 255.00 FORMAT "%8.2" ECU_ADDRESS 0xfe402fbd /end MEASUREMENT
/begin MEASUREMENT Tlib_isCcvmStsVlvOverTrvlFlt_VLAN205ControlMid "" UBYTE RB_RBA_Common_CentralElements_CompuMethods_Identical 1 100 0.0 255.00 FORMAT "%8.2" ECU_ADDRESS 0xfe402fbe /end MEASUREMENT
/begin MEASUREMENT Tlib_isCcvmStsVlvBlkFlt_VLAN205ControlMid "" UBYTE RB_RBA_Common_CentralElements_CompuMethods_Identical 1 100 0.0 255.00 FORMAT "%8.2" ECU_ADDRESS 0xfe402fbf /end MEASUREMENT
/begin MEASUREMENT Tlib_isCcvmStsVlvCmdPosnErr_VLAN205ControlMid "" UBYTE RB_RBA_Common_CentralElements_CompuMethods_Identical 1 100 0.0 255.00 FORMAT "%8.2" ECU_ADDRESS 0xfe402fc0 /end MEASUREMENT
/begin MEASUREMENT Tlib_isCcvmStsVlvOverTErr_VLAN205ControlMid "" UBYTE RB_RBA_Common_CentralElements_CompuMethods_Identical 1 100 0.0 255.00 FORMAT "%8.2" ECU_ADDRESS 0xfe402fc1 /end MEASUREMENT
/begin MEASUREMENT Tlib_isCcvmStsVlvOpenCircFlt_VLAN205ControlMid "" UBYTE RB_RBA_Common_CentralElements_CompuMethods_Identical 1 100 0.0 255.00 FORMAT "%8.2" ECU_ADDRESS 0xfe402fc2 /end MEASUREMENT
/begin MEASUREMENT Tlib_isCcvmStsVlvPosn_VLAN205ControlMid "" UWORD RB_RBA_Common_CentralElements_CompuMethods_Identical 1 100 0.0 65535 FORMAT "%8.2" ECU_ADDRESS 0xfe40287a /end MEASUREMENT
/begin MEASUREMENT Tlib_isCcvmStsVlvPosnCtrlTimeOutFlt_VLAN205ControlMid "" UBYTE RB_RBA_Common_CentralElements_CompuMethods_Identical 1 100 0.0 255.00 FORMAT "%8.2" ECU_ADDRESS 0xfe402fc3 /end MEASUREMENT
/begin MEASUREMENT Tlib_isCcvmStsVlvPreHeatgSts_VLAN205ControlMid "" UBYTE RB_RBA_Common_CentralElements_CompuMethods_Identical 1 100 0.0 255.00 FORMAT "%8.2" ECU_ADDRESS 0xfe402fc4 /end MEASUREMENT
/begin MEASUREMENT Tlib_isCcvmStsVlvShoCircFlt_VLAN205ControlMid "" UBYTE RB_RBA_Common_CentralElements_CompuMethods_Identical 1 100 0.0 255.00 FORMAT "%8.2" ECU_ADDRESS 0xfe402fc5 /end MEASUREMENT
/begin MEASUREMENT Tlib_isCcvmStsVlvUnderUErr_VLAN205ControlMid "" UBYTE RB_RBA_Common_CentralElements_CompuMethods_Identical 1 100 0.0 255.00 FORMAT "%8.2" ECU_ADDRESS 0xfe402fc6 /end MEASUREMENT
/begin MEASUREMENT Tlib_isCcvmStsVlvLoTErr_VLAN205ControlMid "" UBYTE RB_RBA_Common_CentralElements_CompuMethods_Identical 1 100 0.0 255.00 FORMAT "%8.2" ECU_ADDRESS 0xfe402fc7 /end MEASUREMENT
/begin MEASUREMENT Tlib_isCcvmStsVlvSpdLvlSts_VLAN205ControlMid "" UBYTE RB_RBA_Common_CentralElements_CompuMethods_Identical 1 100 0.0 255.00 FORMAT "%8.2" ECU_ADDRESS 0xfe402fc8 /end MEASUREMENT
/begin MEASUREMENT Tlib_isCcvmStsVlvMoveSts_VLAN205ControlMid "" UBYTE RB_RBA_Common_CentralElements_CompuMethods_Identical 1 100 0.0 255.00 FORMAT "%8.2" ECU_ADDRESS 0xfe402fc9 /end MEASUREMENT
/begin MEASUREMENT Tlib_isCcvmStsVlvSelfLearnFlt_VLAN205ControlMid "" UBYTE RB_RBA_Common_CentralElements_CompuMethods_Identical 1 100 0.0 255.00 FORMAT "%8.2" ECU_ADDRESS 0xfe402fca /end MEASUREMENT
/begin MEASUREMENT Tlib_isHexTReAmbTEstimd_VLAN205ControlMid "" UWORD RB_RBA_Common_CentralElements_CompuMethods_Identical 1 100 0.0 65535 FORMAT "%8.2" ECU_ADDRESS 0xfe40287c /end MEASUREMENT
/begin MEASUREMENT Tlib_isHexTReAmbTEstimdQf_VLAN205ControlMid "" UBYTE RB_RBA_Common_CentralElements_CompuMethods_Identical 1 100 0.0 255.00 FORMAT "%8.2" ECU_ADDRESS 0xfe402fcb /end MEASUREMENT
/begin MEASUREMENT Tlib_isThrdRowLeRoofTAmbTEstimdQf_VLAN205ControlMid "" UBYTE RB_RBA_Common_CentralElements_CompuMethods_Identical 1 100 0.0 255.00 FORMAT "%8.2" ECU_ADDRESS 0xfe402fcc /end MEASUREMENT
/begin MEASUREMENT Tlib_isThrdRowLeRoofTAmbTEstimd_VLAN205ControlMid "" UWORD RB_RBA_Common_CentralElements_CompuMethods_Identical 1 100 0.0 65535 FORMAT "%8.2" ECU_ADDRESS 0xfe40287e /end MEASUREMENT
/begin MEASUREMENT Tlib_isEvapTReAmbTEstimd_VLAN205ControlMid "" UWORD RB_RBA_Common_CentralElements_CompuMethods_Identical 1 100 0.0 65535 FORMAT "%8.2" ECU_ADDRESS 0xfe402880 /end MEASUREMENT
/begin MEASUREMENT Tlib_isEvapTReAmbTEstimdQf_VLAN205ControlMid "" UBYTE RB_RBA_Common_CentralElements_CompuMethods_Identical 1 100 0.0 255.00 FORMAT "%8.2" ECU_ADDRESS 0xfe402fcd /end MEASUREMENT
/begin MEASUREMENT Tlib_isThrdRowRiRoofTAmbTEstimdQf_VLAN205ControlMid "" UBYTE RB_RBA_Common_CentralElements_CompuMethods_Identical 1 100 0.0 255.00 FORMAT "%8.2" ECU_ADDRESS 0xfe402fce /end MEASUREMENT
/begin MEASUREMENT Tlib_isThrdRowRiRoofTAmbTEstimd_VLAN205ControlMid "" UWORD RB_RBA_Common_CentralElements_CompuMethods_Identical 1 100 0.0 65535 FORMAT "%8.2" ECU_ADDRESS 0xfe402882 /end MEASUREMENT
/begin MEASUREMENT Tlib_isThrdRowRiFootTAmbTEstimdQf_VLAN205ControlMid "" UBYTE RB_RBA_Common_CentralElements_CompuMethods_Identical 1 100 0.0 255.00 FORMAT "%8.2" ECU_ADDRESS 0xfe402fcf /end MEASUREMENT
/begin MEASUREMENT Tlib_isThrdRowRiFootTAmbTEstimd_VLAN205ControlMid "" UWORD RB_RBA_Common_CentralElements_CompuMethods_Identical 1 100 0.0 65535 FORMAT "%8.2" ECU_ADDRESS 0xfe402884 /end MEASUREMENT
/begin MEASUREMENT Tlib_isCmptmtTReAmbTEstimd_VLAN205ControlMid "" UWORD RB_RBA_Common_CentralElements_CompuMethods_Identical 1 100 0.0 65535 FORMAT "%8.2" ECU_ADDRESS 0xfe402886 /end MEASUREMENT
/begin MEASUREMENT Tlib_isCmptmtTReAmbTEstimdQf_VLAN205ControlMid "" UBYTE RB_RBA_Common_CentralElements_CompuMethods_Identical 1 100 0.0 255.00 FORMAT "%8.2" ECU_ADDRESS 0xfe402fd0 /end MEASUREMENT
/begin MEASUREMENT Tlib_isThrdRowLeFootTAmbTEstimdQf_VLAN205ControlMid "" UBYTE RB_RBA_Common_CentralElements_CompuMethods_Identical 1 100 0.0 255.00 FORMAT "%8.2" ECU_ADDRESS 0xfe402fd1 /end MEASUREMENT
/begin MEASUREMENT Tlib_isThrdRowLeFootTAmbTEstimd_VLAN205ControlMid "" UWORD RB_RBA_Common_CentralElements_CompuMethods_Identical 1 100 0.0 65535 FORMAT "%8.2" ECU_ADDRESS 0xfe402888 /end MEASUREMENT
/begin MEASUREMENT Tlib_isSuspPosnVertLvlFrntQf_0_VLAN205ControlMid "" UBYTE RB_RBA_Common_CentralElements_CompuMethods_Identical 1 100 0.0 255.00 FORMAT "%8.2" ECU_ADDRESS 0xfe402fd2 /end MEASUREMENT
/begin MEASUREMENT Tlib_isSuspPosnVertLvlReQf_0_VLAN205ControlMid "" UBYTE RB_RBA_Common_CentralElements_CompuMethods_Identical 1 100 0.0 255.00 FORMAT "%8.2" ECU_ADDRESS 0xfe402fd3 /end MEASUREMENT
/begin MEASUREMENT Tlib_isSuspPosnVertLvlRe_0_VLAN205ControlMid "" SWORD RB_RBA_Common_CentralElements_CompuMethods_Identical 1 100 -32768 32767 FORMAT "%8.2" ECU_ADDRESS 0xfe40288a /end MEASUREMENT
/begin MEASUREMENT Tlib_isSuspPosnVertLvlFrnt_0_VLAN205ControlMid "" SWORD RB_RBA_Common_CentralElements_CompuMethods_Identical 1 100 -32768 32767 FORMAT "%8.2" ECU_ADDRESS 0xfe40288c /end MEASUREMENT
/begin MEASUREMENT Tlib_isSuspPosnVertAgGenQf_0_VLAN205ControlMid "" UBYTE RB_RBA_Common_CentralElements_CompuMethods_Identical 1 100 0.0 255.00 FORMAT "%8.2" ECU_ADDRESS 0xfe402fd4 /end MEASUREMENT
/begin MEASUREMENT Tlib_isSuspPosnVertAgSuspPosnVertAg_0_VLAN205ControlMid "" SWORD RB_RBA_Common_CentralElements_CompuMethods_Identical 1 100 -32768 32767 FORMAT "%8.2" ECU_ADDRESS 0xfe40288e /end MEASUREMENT
/begin MEASUREMENT Tlib_isSecRowLeVentTAmbTEstimd_VLAN205ControlMid "" UWORD RB_RBA_Common_CentralElements_CompuMethods_Identical 1 100 0.0 65535 FORMAT "%8.2" ECU_ADDRESS 0xfe402890 /end MEASUREMENT
/begin MEASUREMENT Tlib_isSecRowLeVentTAmbTEstimdQf_VLAN205ControlMid "" UBYTE RB_RBA_Common_CentralElements_CompuMethods_Identical 1 100 0.0 255.00 FORMAT "%8.2" ECU_ADDRESS 0xfe402fd5 /end MEASUREMENT
/begin MEASUREMENT Tlib_isSecRowLeFootTAmbTEstimdQf_VLAN205ControlMid "" UBYTE RB_RBA_Common_CentralElements_CompuMethods_Identical 1 100 0.0 255.00 FORMAT "%8.2" ECU_ADDRESS 0xfe402fd6 /end MEASUREMENT
/begin MEASUREMENT Tlib_isSecRowLeFootTAmbTEstimd_VLAN205ControlMid "" UWORD RB_RBA_Common_CentralElements_CompuMethods_Identical 1 100 0.0 65535 FORMAT "%8.2" ECU_ADDRESS 0xfe402892 /end MEASUREMENT
/begin MEASUREMENT Tlib_isSecRowBLeVentTAmbTEstimd_VLAN205ControlMid "" UWORD RB_RBA_Common_CentralElements_CompuMethods_Identical 1 100 0.0 65535 FORMAT "%8.2" ECU_ADDRESS 0xfe402894 /end MEASUREMENT
/begin MEASUREMENT Tlib_isSecRowBLeVentTAmbTEstimdQf_VLAN205ControlMid "" UBYTE RB_RBA_Common_CentralElements_CompuMethods_Identical 1 100 0.0 255.00 FORMAT "%8.2" ECU_ADDRESS 0xfe402fd7 /end MEASUREMENT
/begin MEASUREMENT Tlib_isActvdStSecDcDc_0_VLAN205ControlMid "" UBYTE RB_RBA_Common_CentralElements_CompuMethods_Identical 1 100 0.0 255.00 FORMAT "%8.2" ECU_ADDRESS 0xfe402fd8 /end MEASUREMENT
/begin MEASUREMENT Tlib_isRelHumSnsrQf_VLAN205ControlMid "" UBYTE RB_RBA_Common_CentralElements_CompuMethods_Identical 1 100 0.0 255.00 FORMAT "%8.2" ECU_ADDRESS 0xfe402fd9 /end MEASUREMENT
/begin MEASUREMENT Tlib_isSolarSnsrVluQf_VLAN205ControlMid "" UBYTE RB_RBA_Common_CentralElements_CompuMethods_Identical 1 100 0.0 255.00 FORMAT "%8.2" ECU_ADDRESS 0xfe402fda /end MEASUREMENT
/begin MEASUREMENT Tlib_isRiSolarData_VLAN205ControlMid "" UBYTE RB_RBA_Common_CentralElements_CompuMethods_Identical 1 100 0.0 255.00 FORMAT "%8.2" ECU_ADDRESS 0xfe402fdb /end MEASUREMENT
/begin MEASUREMENT Tlib_isLeSolarData_VLAN205ControlMid "" UBYTE RB_RBA_Common_CentralElements_CompuMethods_Identical 1 100 0.0 255.00 FORMAT "%8.2" ECU_ADDRESS 0xfe402fdc /end MEASUREMENT
/begin MEASUREMENT Tlib_isHornSwtForbid_VLAN205ControlMid "" UBYTE RB_RBA_Common_CentralElements_CompuMethods_Identical 1 100 0.0 255.00 FORMAT "%8.2" ECU_ADDRESS 0xfe402fdd /end MEASUREMENT
/begin MEASUREMENT Tlib_isThirdRowClimaT_0_VLAN205ControlMid "" UBYTE RB_RBA_Common_CentralElements_CompuMethods_Identical 1 100 0.0 255.00 FORMAT "%8.2" ECU_ADDRESS 0xfe402fde /end MEASUREMENT
/begin MEASUREMENT Tlib_isHvBattIDc_VLAN205ControlMid "" UWORD RB_RBA_Common_CentralElements_CompuMethods_Identical 1 100 0.0 65535 FORMAT "%8.2" ECU_ADDRESS 0xfe402896 /end MEASUREMENT
/begin MEASUREMENT Tlib_isLiAmbCommand_VLAN205ControlMid "" UBYTE RB_RBA_Common_CentralElements_CompuMethods_Identical 1 100 0.0 255.00 FORMAT "%8.2" ECU_ADDRESS 0xfe402fdf /end MEASUREMENT
/begin MEASUREMENT Tlib_HfaActr09CoilSts_ZCR_LIN6 "" UBYTE RB_RBA_Common_CentralElements_CompuMethods_Identical 1 100 0.0 255.00 FORMAT "%8.2" ECU_ADDRESS 0xfe402fe0 /end MEASUREMENT
/begin MEASUREMENT Tlib_HfaActr09ActPson_ZCR_LIN6 "" UWORD RB_RBA_Common_CentralElements_CompuMethods_Identical 1 100 0.0 65535 FORMAT "%8.2" ECU_ADDRESS 0xfe402898 /end MEASUREMENT
/begin MEASUREMENT Tlib_HfaActr09Mode_ZCR_LIN6 "" UBYTE RB_RBA_Common_CentralElements_CompuMethods_Identical 1 100 0.0 255.00 FORMAT "%8.2" ECU_ADDRESS 0xfe402fe1 /end MEASUREMENT
/begin MEASUREMENT Tlib_HfaActr09BlckSts_ZCR_LIN6 "" UBYTE RB_RBA_Common_CentralElements_CompuMethods_Identical 1 100 0.0 255.00 FORMAT "%8.2" ECU_ADDRESS 0xfe402fe2 /end MEASUREMENT
/begin MEASUREMENT Tlib_HfaActr09UrgcSts_ZCR_LIN6 "" UBYTE RB_RBA_Common_CentralElements_CompuMethods_Identical 1 100 0.0 255.00 FORMAT "%8.2" ECU_ADDRESS 0xfe402fe3 /end MEASUREMENT
/begin MEASUREMENT Tlib_HfaActr09ElecErr_ZCR_LIN6 "" UBYTE RB_RBA_Common_CentralElements_CompuMethods_Identical 1 100 0.0 255.00 FORMAT "%8.2" ECU_ADDRESS 0xfe402fe4 /end MEASUREMENT
/begin MEASUREMENT Tlib_HfaActr09VoltErr_ZCR_LIN6 "" UBYTE RB_RBA_Common_CentralElements_CompuMethods_Identical 1 100 0.0 255.00 FORMAT "%8.2" ECU_ADDRESS 0xfe402fe5 /end MEASUREMENT
/begin MEASUREMENT Tlib_HfaActr09MovDir_ZCR_LIN6 "" UBYTE RB_RBA_Common_CentralElements_CompuMethods_Identical 1 100 0.0 255.00 FORMAT "%8.2" ECU_ADDRESS 0xfe402fe6 /end MEASUREMENT
/begin MEASUREMENT Tlib_HfaActr09UrgcPson_ZCR_LIN6 "" UBYTE RB_RBA_Common_CentralElements_CompuMethods_Identical 1 100 0.0 255.00 FORMAT "%8.2" ECU_ADDRESS 0xfe402fe7 /end MEASUREMENT
/begin MEASUREMENT Tlib_HfaActr09OvrTempErr_ZCR_LIN6 "" UBYTE RB_RBA_Common_CentralElements_CompuMethods_Identical 1 100 0.0 255.00 FORMAT "%8.2" ECU_ADDRESS 0xfe402fe8 /end MEASUREMENT
/begin MEASUREMENT Tlib_HfaActr09DrvDir_ZCR_LIN6 "" UBYTE RB_RBA_Common_CentralElements_CompuMethods_Identical 1 100 0.0 255.00 FORMAT "%8.2" ECU_ADDRESS 0xfe402fe9 /end MEASUREMENT
/begin MEASUREMENT Tlib_HfaActr09BlckInd_ZCR_LIN6 "" UBYTE RB_RBA_Common_CentralElements_CompuMethods_Identical 1 100 0.0 255.00 FORMAT "%8.2" ECU_ADDRESS 0xfe402fea /end MEASUREMENT
/begin MEASUREMENT Tlib_HfaActr09BusAdr_ZCR_LIN6 "" UBYTE RB_RBA_Common_CentralElements_CompuMethods_Identical 1 100 0.0 255.00 FORMAT "%8.2" ECU_ADDRESS 0xfe402feb /end MEASUREMENT
/begin MEASUREMENT Tlib_HfaActr09TrqSts_ZCR_LIN6 "" UBYTE RB_RBA_Common_CentralElements_CompuMethods_Identical 1 100 0.0 255.00 FORMAT "%8.2" ECU_ADDRESS 0xfe402fec /end MEASUREMENT
/begin MEASUREMENT Tlib_HfaActr09SpdSts_ZCR_LIN6 "" UBYTE RB_RBA_Common_CentralElements_CompuMethods_Identical 1 100 0.0 255.00 FORMAT "%8.2" ECU_ADDRESS 0xfe402fed /end MEASUREMENT
/begin MEASUREMENT Tlib_HfaActr09ResetSts_ZCR_LIN6 "" UBYTE RB_RBA_Common_CentralElements_CompuMethods_Identical 1 100 0.0 255.00 FORMAT "%8.2" ECU_ADDRESS 0xfe402fee /end MEASUREMENT
/begin MEASUREMENT Tlib_HfaActr09UrgcExist_ZCR_LIN6 "" UBYTE RB_RBA_Common_CentralElements_CompuMethods_Identical 1 100 0.0 255.00 FORMAT "%8.2" ECU_ADDRESS 0xfe402fef /end MEASUREMENT
/begin MEASUREMENT Tlib_HfaActr09SpclFct_ZCR_LIN6 "" UBYTE RB_RBA_Common_CentralElements_CompuMethods_Identical 1 100 0.0 255.00 FORMAT "%8.2" ECU_ADDRESS 0xfe402ff0 /end MEASUREMENT
/begin MEASUREMENT Tlib_HfaActr09PsonSts_ZCR_LIN6 "" UBYTE RB_RBA_Common_CentralElements_CompuMethods_Identical 1 100 0.0 255.00 FORMAT "%8.2" ECU_ADDRESS 0xfe402ff1 /end MEASUREMENT
/begin MEASUREMENT Tlib_HfaActr07BlckInd_ZCR_LIN6 "" UBYTE RB_RBA_Common_CentralElements_CompuMethods_Identical 1 100 0.0 255.00 FORMAT "%8.2" ECU_ADDRESS 0xfe402ff2 /end MEASUREMENT
/begin MEASUREMENT Tlib_HfaActr07ResetSts_ZCR_LIN6 "" UBYTE RB_RBA_Common_CentralElements_CompuMethods_Identical 1 100 0.0 255.00 FORMAT "%8.2" ECU_ADDRESS 0xfe402ff3 /end MEASUREMENT
/begin MEASUREMENT Tlib_HfaActr07UrgcSts_ZCR_LIN6 "" UBYTE RB_RBA_Common_CentralElements_CompuMethods_Identical 1 100 0.0 255.00 FORMAT "%8.2" ECU_ADDRESS 0xfe402ff4 /end MEASUREMENT
/begin MEASUREMENT Tlib_HfaActr07VoltErr_ZCR_LIN6 "" UBYTE RB_RBA_Common_CentralElements_CompuMethods_Identical 1 100 0.0 255.00 FORMAT "%8.2" ECU_ADDRESS 0xfe402ff5 /end MEASUREMENT
/begin MEASUREMENT Tlib_HfaActr07MovDir_ZCR_LIN6 "" UBYTE RB_RBA_Common_CentralElements_CompuMethods_Identical 1 100 0.0 255.00 FORMAT "%8.2" ECU_ADDRESS 0xfe402ff6 /end MEASUREMENT
/begin MEASUREMENT Tlib_HfaActr07ElecErr_ZCR_LIN6 "" UBYTE RB_RBA_Common_CentralElements_CompuMethods_Identical 1 100 0.0 255.00 FORMAT "%8.2" ECU_ADDRESS 0xfe402ff7 /end MEASUREMENT
/begin MEASUREMENT Tlib_HfaActr07SpdSts_ZCR_LIN6 "" UBYTE RB_RBA_Common_CentralElements_CompuMethods_Identical 1 100 0.0 255.00 FORMAT "%8.2" ECU_ADDRESS 0xfe402ff8 /end MEASUREMENT
/begin MEASUREMENT Tlib_HfaActr07TrqSts_ZCR_LIN6 "" UBYTE RB_RBA_Common_CentralElements_CompuMethods_Identical 1 100 0.0 255.00 FORMAT "%8.2" ECU_ADDRESS 0xfe402ff9 /end MEASUREMENT
/begin MEASUREMENT Tlib_HfaActr07UrgcPson_ZCR_LIN6 "" UBYTE RB_RBA_Common_CentralElements_CompuMethods_Identical 1 100 0.0 255.00 FORMAT "%8.2" ECU_ADDRESS 0xfe402ffa /end MEASUREMENT
/begin MEASUREMENT Tlib_HfaActr07BusAdr_ZCR_LIN6 "" UBYTE RB_RBA_Common_CentralElements_CompuMethods_Identical 1 100 0.0 255.00 FORMAT "%8.2" ECU_ADDRESS 0xfe402ffb /end MEASUREMENT
/begin MEASUREMENT Tlib_HfaActr07CoilSts_ZCR_LIN6 "" UBYTE RB_RBA_Common_CentralElements_CompuMethods_Identical 1 100 0.0 255.00 FORMAT "%8.2" ECU_ADDRESS 0xfe402ffc /end MEASUREMENT
/begin MEASUREMENT Tlib_HfaActr07SpclFct_ZCR_LIN6 "" UBYTE RB_RBA_Common_CentralElements_CompuMethods_Identical 1 100 0.0 255.00 FORMAT "%8.2" ECU_ADDRESS 0xfe402ffd /end MEASUREMENT
/begin MEASUREMENT Tlib_HfaActr07OvrTempErr_ZCR_LIN6 "" UBYTE RB_RBA_Common_CentralElements_CompuMethods_Identical 1 100 0.0 255.00 FORMAT "%8.2" ECU_ADDRESS 0xfe402ffe /end MEASUREMENT
/begin MEASUREMENT Tlib_HfaActr07ActPson_ZCR_LIN6 "" UWORD RB_RBA_Common_CentralElements_CompuMethods_Identical 1 100 0.0 65535 FORMAT "%8.2" ECU_ADDRESS 0xfe40289a /end MEASUREMENT
/begin MEASUREMENT Tlib_HfaActr07Mode_ZCR_LIN6 "" UBYTE RB_RBA_Common_CentralElements_CompuMethods_Identical 1 100 0.0 255.00 FORMAT "%8.2" ECU_ADDRESS 0xfe402fff /end MEASUREMENT
/begin MEASUREMENT Tlib_HfaActr07DrvDir_ZCR_LIN6 "" UBYTE RB_RBA_Common_CentralElements_CompuMethods_Identical 1 100 0.0 255.00 FORMAT "%8.2" ECU_ADDRESS 0xfe403000 /end MEASUREMENT
/begin MEASUREMENT Tlib_HfaActr07PsonSts_ZCR_LIN6 "" UBYTE RB_RBA_Common_CentralElements_CompuMethods_Identical 1 100 0.0 255.00 FORMAT "%8.2" ECU_ADDRESS 0xfe403001 /end MEASUREMENT
/begin MEASUREMENT Tlib_HfaActr07UrgcExist_ZCR_LIN6 "" UBYTE RB_RBA_Common_CentralElements_CompuMethods_Identical 1 100 0.0 255.00 FORMAT "%8.2" ECU_ADDRESS 0xfe403002 /end MEASUREMENT
/begin MEASUREMENT Tlib_HfaActr07BlckSts_ZCR_LIN6 "" UBYTE RB_RBA_Common_CentralElements_CompuMethods_Identical 1 100 0.0 255.00 FORMAT "%8.2" ECU_ADDRESS 0xfe403003 /end MEASUREMENT
/begin MEASUREMENT Tlib_HfaActr06DrvDir_ZCR_LIN6 "" UBYTE RB_RBA_Common_CentralElements_CompuMethods_Identical 1 100 0.0 255.00 FORMAT "%8.2" ECU_ADDRESS 0xfe403004 /end MEASUREMENT
/begin MEASUREMENT Tlib_HfaActr06VoltErr_ZCR_LIN6 "" UBYTE RB_RBA_Common_CentralElements_CompuMethods_Identical 1 100 0.0 255.00 FORMAT "%8.2" ECU_ADDRESS 0xfe403005 /end MEASUREMENT
/begin MEASUREMENT Tlib_HfaActr06ResetSts_ZCR_LIN6 "" UBYTE RB_RBA_Common_CentralElements_CompuMethods_Identical 1 100 0.0 255.00 FORMAT "%8.2" ECU_ADDRESS 0xfe403006 /end MEASUREMENT
/begin MEASUREMENT Tlib_HfaActr06BlckSts_ZCR_LIN6 "" UBYTE RB_RBA_Common_CentralElements_CompuMethods_Identical 1 100 0.0 255.00 FORMAT "%8.2" ECU_ADDRESS 0xfe403007 /end MEASUREMENT
/begin MEASUREMENT Tlib_HfaActr06TrqSts_ZCR_LIN6 "" UBYTE RB_RBA_Common_CentralElements_CompuMethods_Identical 1 100 0.0 255.00 FORMAT "%8.2" ECU_ADDRESS 0xfe403008 /end MEASUREMENT
/begin MEASUREMENT Tlib_HfaActr06MovDir_ZCR_LIN6 "" UBYTE RB_RBA_Common_CentralElements_CompuMethods_Identical 1 100 0.0 255.00 FORMAT "%8.2" ECU_ADDRESS 0xfe403009 /end MEASUREMENT
/begin MEASUREMENT Tlib_HfaActr06ElecErr_ZCR_LIN6 "" UBYTE RB_RBA_Common_CentralElements_CompuMethods_Identical 1 100 0.0 255.00 FORMAT "%8.2" ECU_ADDRESS 0xfe40300a /end MEASUREMENT
/begin MEASUREMENT Tlib_HfaActr06CoilSts_ZCR_LIN6 "" UBYTE RB_RBA_Common_CentralElements_CompuMethods_Identical 1 100 0.0 255.00 FORMAT "%8.2" ECU_ADDRESS 0xfe40300b /end MEASUREMENT
/begin MEASUREMENT Tlib_HfaActr06UrgcPson_ZCR_LIN6 "" UBYTE RB_RBA_Common_CentralElements_CompuMethods_Identical 1 100 0.0 255.00 FORMAT "%8.2" ECU_ADDRESS 0xfe40300c /end MEASUREMENT
/begin MEASUREMENT Tlib_HfaActr06OvrTempErr_ZCR_LIN6 "" UBYTE RB_RBA_Common_CentralElements_CompuMethods_Identical 1 100 0.0 255.00 FORMAT "%8.2" ECU_ADDRESS 0xfe40300d /end MEASUREMENT
/begin MEASUREMENT Tlib_HfaActr06SpdSts_ZCR_LIN6 "" UBYTE RB_RBA_Common_CentralElements_CompuMethods_Identical 1 100 0.0 255.00 FORMAT "%8.2" ECU_ADDRESS 0xfe40300e /end MEASUREMENT
/begin MEASUREMENT Tlib_HfaActr06SpclFct_ZCR_LIN6 "" UBYTE RB_RBA_Common_CentralElements_CompuMethods_Identical 1 100 0.0 255.00 FORMAT "%8.2" ECU_ADDRESS 0xfe40300f /end MEASUREMENT
/begin MEASUREMENT Tlib_HfaActr06BlckInd_ZCR_LIN6 "" UBYTE RB_RBA_Common_CentralElements_CompuMethods_Identical 1 100 0.0 255.00 FORMAT "%8.2" ECU_ADDRESS 0xfe403010 /end MEASUREMENT
/begin MEASUREMENT Tlib_HfaActr06Mode_ZCR_LIN6 "" UBYTE RB_RBA_Common_CentralElements_CompuMethods_Identical 1 100 0.0 255.00 FORMAT "%8.2" ECU_ADDRESS 0xfe403011 /end MEASUREMENT
/begin MEASUREMENT Tlib_HfaActr06BusAdr_ZCR_LIN6 "" UBYTE RB_RBA_Common_CentralElements_CompuMethods_Identical 1 100 0.0 255.00 FORMAT "%8.2" ECU_ADDRESS 0xfe403012 /end MEASUREMENT
/begin MEASUREMENT Tlib_HfaActr06UrgcExist_ZCR_LIN6 "" UBYTE RB_RBA_Common_CentralElements_CompuMethods_Identical 1 100 0.0 255.00 FORMAT "%8.2" ECU_ADDRESS 0xfe403013 /end MEASUREMENT
/begin MEASUREMENT Tlib_HfaActr06PsonSts_ZCR_LIN6 "" UBYTE RB_RBA_Common_CentralElements_CompuMethods_Identical 1 100 0.0 255.00 FORMAT "%8.2" ECU_ADDRESS 0xfe403014 /end MEASUREMENT
/begin MEASUREMENT Tlib_HfaActr06ActPson_ZCR_LIN6 "" UWORD RB_RBA_Common_CentralElements_CompuMethods_Identical 1 100 0.0 65535 FORMAT "%8.2" ECU_ADDRESS 0xfe40289c /end MEASUREMENT
/begin MEASUREMENT Tlib_HfaActr06UrgcSts_ZCR_LIN6 "" UBYTE RB_RBA_Common_CentralElements_CompuMethods_Identical 1 100 0.0 255.00 FORMAT "%8.2" ECU_ADDRESS 0xfe403015 /end MEASUREMENT
/begin MEASUREMENT Tlib_HfaActr11PsonSts_ZCR_LIN6 "" UBYTE RB_RBA_Common_CentralElements_CompuMethods_Identical 1 100 0.0 255.00 FORMAT "%8.2" ECU_ADDRESS 0xfe403016 /end MEASUREMENT
/begin MEASUREMENT Tlib_HfaActr11SpdSts_ZCR_LIN6 "" UBYTE RB_RBA_Common_CentralElements_CompuMethods_Identical 1 100 0.0 255.00 FORMAT "%8.2" ECU_ADDRESS 0xfe403017 /end MEASUREMENT
/begin MEASUREMENT Tlib_HfaActr11CoilSts_ZCR_LIN6 "" UBYTE RB_RBA_Common_CentralElements_CompuMethods_Identical 1 100 0.0 255.00 FORMAT "%8.2" ECU_ADDRESS 0xfe403018 /end MEASUREMENT
/begin MEASUREMENT Tlib_HfaActr11ElecErr_ZCR_LIN6 "" UBYTE RB_RBA_Common_CentralElements_CompuMethods_Identical 1 100 0.0 255.00 FORMAT "%8.2" ECU_ADDRESS 0xfe403019 /end MEASUREMENT
/begin MEASUREMENT Tlib_HfaActr11BlckInd_ZCR_LIN6 "" UBYTE RB_RBA_Common_CentralElements_CompuMethods_Identical 1 100 0.0 255.00 FORMAT "%8.2" ECU_ADDRESS 0xfe40301a /end MEASUREMENT
/begin MEASUREMENT Tlib_HfaActr11TrqSts_ZCR_LIN6 "" UBYTE RB_RBA_Common_CentralElements_CompuMethods_Identical 1 100 0.0 255.00 FORMAT "%8.2" ECU_ADDRESS 0xfe40301b /end MEASUREMENT
/begin MEASUREMENT Tlib_HfaActr11OvrTempErr_ZCR_LIN6 "" UBYTE RB_RBA_Common_CentralElements_CompuMethods_Identical 1 100 0.0 255.00 FORMAT "%8.2" ECU_ADDRESS 0xfe40301c /end MEASUREMENT
/begin MEASUREMENT Tlib_HfaActr11DrvDir_ZCR_LIN6 "" UBYTE RB_RBA_Common_CentralElements_CompuMethods_Identical 1 100 0.0 255.00 FORMAT "%8.2" ECU_ADDRESS 0xfe40301d /end MEASUREMENT
/begin MEASUREMENT Tlib_HfaActr11VoltErr_ZCR_LIN6 "" UBYTE RB_RBA_Common_CentralElements_CompuMethods_Identical 1 100 0.0 255.00 FORMAT "%8.2" ECU_ADDRESS 0xfe40301e /end MEASUREMENT
/begin MEASUREMENT Tlib_HfaActr11BlckSts_ZCR_LIN6 "" UBYTE RB_RBA_Common_CentralElements_CompuMethods_Identical 1 100 0.0 255.00 FORMAT "%8.2" ECU_ADDRESS 0xfe40301f /end MEASUREMENT
/begin MEASUREMENT Tlib_HfaActr11ActPson_ZCR_LIN6 "" UWORD RB_RBA_Common_CentralElements_CompuMethods_Identical 1 100 0.0 65535 FORMAT "%8.2" ECU_ADDRESS 0xfe40289e /end MEASUREMENT
/begin MEASUREMENT Tlib_HfaActr11SpclFct_ZCR_LIN6 "" UBYTE RB_RBA_Common_CentralElements_CompuMethods_Identical 1 100 0.0 255.00 FORMAT "%8.2" ECU_ADDRESS 0xfe403020 /end MEASUREMENT
/begin MEASUREMENT Tlib_HfaActr11UrgcPson_ZCR_LIN6 "" UBYTE RB_RBA_Common_CentralElements_CompuMethods_Identical 1 100 0.0 255.00 FORMAT "%8.2" ECU_ADDRESS 0xfe403021 /end MEASUREMENT
/begin MEASUREMENT Tlib_HfaActr11ResetSts_ZCR_LIN6 "" UBYTE RB_RBA_Common_CentralElements_CompuMethods_Identical 1 100 0.0 255.00 FORMAT "%8.2" ECU_ADDRESS 0xfe403022 /end MEASUREMENT
/begin MEASUREMENT Tlib_HfaActr11MovDir_ZCR_LIN6 "" UBYTE RB_RBA_Common_CentralElements_CompuMethods_Identical 1 100 0.0 255.00 FORMAT "%8.2" ECU_ADDRESS 0xfe403023 /end MEASUREMENT
/begin MEASUREMENT Tlib_HfaActr11BusAdr_ZCR_LIN6 "" UBYTE RB_RBA_Common_CentralElements_CompuMethods_Identical 1 100 0.0 255.00 FORMAT "%8.2" ECU_ADDRESS 0xfe403024 /end MEASUREMENT
/begin MEASUREMENT Tlib_HfaActr11Mode_ZCR_LIN6 "" UBYTE RB_RBA_Common_CentralElements_CompuMethods_Identical 1 100 0.0 255.00 FORMAT "%8.2" ECU_ADDRESS 0xfe403025 /end MEASUREMENT
/begin MEASUREMENT Tlib_HfaActr11UrgcSts_ZCR_LIN6 "" UBYTE RB_RBA_Common_CentralElements_CompuMethods_Identical 1 100 0.0 255.00 FORMAT "%8.2" ECU_ADDRESS 0xfe403026 /end MEASUREMENT
/begin MEASUREMENT Tlib_HfaActr11UrgcExist_ZCR_LIN6 "" UBYTE RB_RBA_Common_CentralElements_CompuMethods_Identical 1 100 0.0 255.00 FORMAT "%8.2" ECU_ADDRESS 0xfe403027 /end MEASUREMENT
/begin MEASUREMENT Tlib_HfaActr03BlckInd_ZCR_LIN6 "" UBYTE RB_RBA_Common_CentralElements_CompuMethods_Identical 1 100 0.0 255.00 FORMAT "%8.2" ECU_ADDRESS 0xfe403028 /end MEASUREMENT
/begin MEASUREMENT Tlib_HfaActr03UrgcSts_ZCR_LIN6 "" UBYTE RB_RBA_Common_CentralElements_CompuMethods_Identical 1 100 0.0 255.00 FORMAT "%8.2" ECU_ADDRESS 0xfe403029 /end MEASUREMENT
/begin MEASUREMENT Tlib_HfaActr03TrqSts_ZCR_LIN6 "" UBYTE RB_RBA_Common_CentralElements_CompuMethods_Identical 1 100 0.0 255.00 FORMAT "%8.2" ECU_ADDRESS 0xfe40302a /end MEASUREMENT
/begin MEASUREMENT Tlib_HfaActr03ActPson_ZCR_LIN6 "" UWORD RB_RBA_Common_CentralElements_CompuMethods_Identical 1 100 0.0 65535 FORMAT "%8.2" ECU_ADDRESS 0xfe4028a0 /end MEASUREMENT
/begin MEASUREMENT Tlib_HfaActr03CoilSts_ZCR_LIN6 "" UBYTE RB_RBA_Common_CentralElements_CompuMethods_Identical 1 100 0.0 255.00 FORMAT "%8.2" ECU_ADDRESS 0xfe40302b /end MEASUREMENT
/begin MEASUREMENT Tlib_HfaActr03ElecErr_ZCR_LIN6 "" UBYTE RB_RBA_Common_CentralElements_CompuMethods_Identical 1 100 0.0 255.00 FORMAT "%8.2" ECU_ADDRESS 0xfe40302c /end MEASUREMENT
/begin MEASUREMENT Tlib_HfaActr03MovDir_ZCR_LIN6 "" UBYTE RB_RBA_Common_CentralElements_CompuMethods_Identical 1 100 0.0 255.00 FORMAT "%8.2" ECU_ADDRESS 0xfe40302d /end MEASUREMENT
/begin MEASUREMENT Tlib_HfaActr03PsonSts_ZCR_LIN6 "" UBYTE RB_RBA_Common_CentralElements_CompuMethods_Identical 1 100 0.0 255.00 FORMAT "%8.2" ECU_ADDRESS 0xfe40302e /end MEASUREMENT
/begin MEASUREMENT Tlib_HfaActr03UrgcExist_ZCR_LIN6 "" UBYTE RB_RBA_Common_CentralElements_CompuMethods_Identical 1 100 0.0 255.00 FORMAT "%8.2" ECU_ADDRESS 0xfe40302f /end MEASUREMENT
/begin MEASUREMENT Tlib_HfaActr03SpclFct_ZCR_LIN6 "" UBYTE RB_RBA_Common_CentralElements_CompuMethods_Identical 1 100 0.0 255.00 FORMAT "%8.2" ECU_ADDRESS 0xfe403030 /end MEASUREMENT
/begin MEASUREMENT Tlib_HfaActr03OvrTempErr_ZCR_LIN6 "" UBYTE RB_RBA_Common_CentralElements_CompuMethods_Identical 1 100 0.0 255.00 FORMAT "%8.2" ECU_ADDRESS 0xfe403031 /end MEASUREMENT
/begin MEASUREMENT Tlib_HfaActr03ResetSts_ZCR_LIN6 "" UBYTE RB_RBA_Common_CentralElements_CompuMethods_Identical 1 100 0.0 255.00 FORMAT "%8.2" ECU_ADDRESS 0xfe403032 /end MEASUREMENT
/begin MEASUREMENT Tlib_HfaActr03SpdSts_ZCR_LIN6 "" UBYTE RB_RBA_Common_CentralElements_CompuMethods_Identical 1 100 0.0 255.00 FORMAT "%8.2" ECU_ADDRESS 0xfe403033 /end MEASUREMENT
/begin MEASUREMENT Tlib_HfaActr03BlckSts_ZCR_LIN6 "" UBYTE RB_RBA_Common_CentralElements_CompuMethods_Identical 1 100 0.0 255.00 FORMAT "%8.2" ECU_ADDRESS 0xfe403034 /end MEASUREMENT
/begin MEASUREMENT Tlib_HfaActr03UrgcPson_ZCR_LIN6 "" UBYTE RB_RBA_Common_CentralElements_CompuMethods_Identical 1 100 0.0 255.00 FORMAT "%8.2" ECU_ADDRESS 0xfe403035 /end MEASUREMENT
/begin MEASUREMENT Tlib_HfaActr03BusAdr_ZCR_LIN6 "" UBYTE RB_RBA_Common_CentralElements_CompuMethods_Identical 1 100 0.0 255.00 FORMAT "%8.2" ECU_ADDRESS 0xfe403036 /end MEASUREMENT
/begin MEASUREMENT Tlib_HfaActr03VoltErr_ZCR_LIN6 "" UBYTE RB_RBA_Common_CentralElements_CompuMethods_Identical 1 100 0.0 255.00 FORMAT "%8.2" ECU_ADDRESS 0xfe403037 /end MEASUREMENT
/begin MEASUREMENT Tlib_HfaActr03Mode_ZCR_LIN6 "" UBYTE RB_RBA_Common_CentralElements_CompuMethods_Identical 1 100 0.0 255.00 FORMAT "%8.2" ECU_ADDRESS 0xfe403038 /end MEASUREMENT
/begin MEASUREMENT Tlib_HfaActr03DrvDir_ZCR_LIN6 "" UBYTE RB_RBA_Common_CentralElements_CompuMethods_Identical 1 100 0.0 255.00 FORMAT "%8.2" ECU_ADDRESS 0xfe403039 /end MEASUREMENT
/begin MEASUREMENT Tlib_HfaActr04TrqSts_ZCR_LIN6 "" UBYTE RB_RBA_Common_CentralElements_CompuMethods_Identical 1 100 0.0 255.00 FORMAT "%8.2" ECU_ADDRESS 0xfe40303a /end MEASUREMENT
/begin MEASUREMENT Tlib_HfaActr04UrgcExist_ZCR_LIN6 "" UBYTE RB_RBA_Common_CentralElements_CompuMethods_Identical 1 100 0.0 255.00 FORMAT "%8.2" ECU_ADDRESS 0xfe40303b /end MEASUREMENT
/begin MEASUREMENT Tlib_HfaActr04ActPson_ZCR_LIN6 "" UWORD RB_RBA_Common_CentralElements_CompuMethods_Identical 1 100 0.0 65535 FORMAT "%8.2" ECU_ADDRESS 0xfe4028a2 /end MEASUREMENT
/begin MEASUREMENT Tlib_HfaActr04BusAdr_ZCR_LIN6 "" UBYTE RB_RBA_Common_CentralElements_CompuMethods_Identical 1 100 0.0 255.00 FORMAT "%8.2" ECU_ADDRESS 0xfe40303c /end MEASUREMENT
/begin MEASUREMENT Tlib_HfaActr04OvrTempErr_ZCR_LIN6 "" UBYTE RB_RBA_Common_CentralElements_CompuMethods_Identical 1 100 0.0 255.00 FORMAT "%8.2" ECU_ADDRESS 0xfe40303d /end MEASUREMENT
/begin MEASUREMENT Tlib_HfaActr04BlckSts_ZCR_LIN6 "" UBYTE RB_RBA_Common_CentralElements_CompuMethods_Identical 1 100 0.0 255.00 FORMAT "%8.2" ECU_ADDRESS 0xfe40303e /end MEASUREMENT
/begin MEASUREMENT Tlib_HfaActr04DrvDir_ZCR_LIN6 "" UBYTE RB_RBA_Common_CentralElements_CompuMethods_Identical 1 100 0.0 255.00 FORMAT "%8.2" ECU_ADDRESS 0xfe40303f /end MEASUREMENT
/begin MEASUREMENT Tlib_HfaActr04ResetSts_ZCR_LIN6 "" UBYTE RB_RBA_Common_CentralElements_CompuMethods_Identical 1 100 0.0 255.00 FORMAT "%8.2" ECU_ADDRESS 0xfe403040 /end MEASUREMENT
/begin MEASUREMENT Tlib_HfaActr04UrgcPson_ZCR_LIN6 "" UBYTE RB_RBA_Common_CentralElements_CompuMethods_Identical 1 100 0.0 255.00 FORMAT "%8.2" ECU_ADDRESS 0xfe403041 /end MEASUREMENT
/begin MEASUREMENT Tlib_HfaActr04ElecErr_ZCR_LIN6 "" UBYTE RB_RBA_Common_CentralElements_CompuMethods_Identical 1 100 0.0 255.00 FORMAT "%8.2" ECU_ADDRESS 0xfe403042 /end MEASUREMENT
/begin MEASUREMENT Tlib_HfaActr04Mode_ZCR_LIN6 "" UBYTE RB_RBA_Common_CentralElements_CompuMethods_Identical 1 100 0.0 255.00 FORMAT "%8.2" ECU_ADDRESS 0xfe403043 /end MEASUREMENT
/begin MEASUREMENT Tlib_HfaActr04MovDir_ZCR_LIN6 "" UBYTE RB_RBA_Common_CentralElements_CompuMethods_Identical 1 100 0.0 255.00 FORMAT "%8.2" ECU_ADDRESS 0xfe403044 /end MEASUREMENT
/begin MEASUREMENT Tlib_HfaActr04PsonSts_ZCR_LIN6 "" UBYTE RB_RBA_Common_CentralElements_CompuMethods_Identical 1 100 0.0 255.00 FORMAT "%8.2" ECU_ADDRESS 0xfe403045 /end MEASUREMENT
/begin MEASUREMENT Tlib_HfaActr04SpclFct_ZCR_LIN6 "" UBYTE RB_RBA_Common_CentralElements_CompuMethods_Identical 1 100 0.0 255.00 FORMAT "%8.2" ECU_ADDRESS 0xfe403046 /end MEASUREMENT
/begin MEASUREMENT Tlib_HfaActr04CoilSts_ZCR_LIN6 "" UBYTE RB_RBA_Common_CentralElements_CompuMethods_Identical 1 100 0.0 255.00 FORMAT "%8.2" ECU_ADDRESS 0xfe403047 /end MEASUREMENT
/begin MEASUREMENT Tlib_HfaActr04SpdSts_ZCR_LIN6 "" UBYTE RB_RBA_Common_CentralElements_CompuMethods_Identical 1 100 0.0 255.00 FORMAT "%8.2" ECU_ADDRESS 0xfe403048 /end MEASUREMENT
/begin MEASUREMENT Tlib_HfaActr04VoltErr_ZCR_LIN6 "" UBYTE RB_RBA_Common_CentralElements_CompuMethods_Identical 1 100 0.0 255.00 FORMAT "%8.2" ECU_ADDRESS 0xfe403049 /end MEASUREMENT
/begin MEASUREMENT Tlib_HfaActr04BlckInd_ZCR_LIN6 "" UBYTE RB_RBA_Common_CentralElements_CompuMethods_Identical 1 100 0.0 255.00 FORMAT "%8.2" ECU_ADDRESS 0xfe40304a /end MEASUREMENT
/begin MEASUREMENT Tlib_HfaActr04UrgcSts_ZCR_LIN6 "" UBYTE RB_RBA_Common_CentralElements_CompuMethods_Identical 1 100 0.0 255.00 FORMAT "%8.2" ECU_ADDRESS 0xfe40304b /end MEASUREMENT
/begin MEASUREMENT Tlib_HfaActr02ElecErr_ZCR_LIN6 "" UBYTE RB_RBA_Common_CentralElements_CompuMethods_Identical 1 100 0.0 255.00 FORMAT "%8.2" ECU_ADDRESS 0xfe40304c /end MEASUREMENT
/begin MEASUREMENT Tlib_HfaActr02UrgcSts_ZCR_LIN6 "" UBYTE RB_RBA_Common_CentralElements_CompuMethods_Identical 1 100 0.0 255.00 FORMAT "%8.2" ECU_ADDRESS 0xfe40304d /end MEASUREMENT
/begin MEASUREMENT Tlib_HfaActr02BusAdr_ZCR_LIN6 "" UBYTE RB_RBA_Common_CentralElements_CompuMethods_Identical 1 100 0.0 255.00 FORMAT "%8.2" ECU_ADDRESS 0xfe40304e /end MEASUREMENT
/begin MEASUREMENT Tlib_HfaActr02ActPson_ZCR_LIN6 "" UWORD RB_RBA_Common_CentralElements_CompuMethods_Identical 1 100 0.0 65535 FORMAT "%8.2" ECU_ADDRESS 0xfe4028a4 /end MEASUREMENT
/begin MEASUREMENT Tlib_HfaActr02UrgcPson_ZCR_LIN6 "" UBYTE RB_RBA_Common_CentralElements_CompuMethods_Identical 1 100 0.0 255.00 FORMAT "%8.2" ECU_ADDRESS 0xfe40304f /end MEASUREMENT
/begin MEASUREMENT Tlib_HfaActr02ResetSts_ZCR_LIN6 "" UBYTE RB_RBA_Common_CentralElements_CompuMethods_Identical 1 100 0.0 255.00 FORMAT "%8.2" ECU_ADDRESS 0xfe403050 /end MEASUREMENT
/begin MEASUREMENT Tlib_HfaActr02OvrTempErr_ZCR_LIN6 "" UBYTE RB_RBA_Common_CentralElements_CompuMethods_Identical 1 100 0.0 255.00 FORMAT "%8.2" ECU_ADDRESS 0xfe403051 /end MEASUREMENT
/begin MEASUREMENT Tlib_HfaActr02BlckSts_ZCR_LIN6 "" UBYTE RB_RBA_Common_CentralElements_CompuMethods_Identical 1 100 0.0 255.00 FORMAT "%8.2" ECU_ADDRESS 0xfe403052 /end MEASUREMENT
/begin MEASUREMENT Tlib_HfaActr02Mode_ZCR_LIN6 "" UBYTE RB_RBA_Common_CentralElements_CompuMethods_Identical 1 100 0.0 255.00 FORMAT "%8.2" ECU_ADDRESS 0xfe403053 /end MEASUREMENT
/begin MEASUREMENT Tlib_HfaActr02DrvDir_ZCR_LIN6 "" UBYTE RB_RBA_Common_CentralElements_CompuMethods_Identical 1 100 0.0 255.00 FORMAT "%8.2" ECU_ADDRESS 0xfe403054 /end MEASUREMENT
/begin MEASUREMENT Tlib_HfaActr02CoilSts_ZCR_LIN6 "" UBYTE RB_RBA_Common_CentralElements_CompuMethods_Identical 1 100 0.0 255.00 FORMAT "%8.2" ECU_ADDRESS 0xfe403055 /end MEASUREMENT
/begin MEASUREMENT Tlib_HfaActr02BlckInd_ZCR_LIN6 "" UBYTE RB_RBA_Common_CentralElements_CompuMethods_Identical 1 100 0.0 255.00 FORMAT "%8.2" ECU_ADDRESS 0xfe403056 /end MEASUREMENT
/begin MEASUREMENT Tlib_HfaActr02MovDir_ZCR_LIN6 "" UBYTE RB_RBA_Common_CentralElements_CompuMethods_Identical 1 100 0.0 255.00 FORMAT "%8.2" ECU_ADDRESS 0xfe403057 /end MEASUREMENT
/begin MEASUREMENT Tlib_HfaActr02SpdSts_ZCR_LIN6 "" UBYTE RB_RBA_Common_CentralElements_CompuMethods_Identical 1 100 0.0 255.00 FORMAT "%8.2" ECU_ADDRESS 0xfe403058 /end MEASUREMENT
/begin MEASUREMENT Tlib_HfaActr02SpclFct_ZCR_LIN6 "" UBYTE RB_RBA_Common_CentralElements_CompuMethods_Identical 1 100 0.0 255.00 FORMAT "%8.2" ECU_ADDRESS 0xfe403059 /end MEASUREMENT
/begin MEASUREMENT Tlib_HfaActr02UrgcExist_ZCR_LIN6 "" UBYTE RB_RBA_Common_CentralElements_CompuMethods_Identical 1 100 0.0 255.00 FORMAT "%8.2" ECU_ADDRESS 0xfe40305a /end MEASUREMENT
/begin MEASUREMENT Tlib_HfaActr02TrqSts_ZCR_LIN6 "" UBYTE RB_RBA_Common_CentralElements_CompuMethods_Identical 1 100 0.0 255.00 FORMAT "%8.2" ECU_ADDRESS 0xfe40305b /end MEASUREMENT
/begin MEASUREMENT Tlib_HfaActr02PsonSts_ZCR_LIN6 "" UBYTE RB_RBA_Common_CentralElements_CompuMethods_Identical 1 100 0.0 255.00 FORMAT "%8.2" ECU_ADDRESS 0xfe40305c /end MEASUREMENT
/begin MEASUREMENT Tlib_HfaActr02VoltErr_ZCR_LIN6 "" UBYTE RB_RBA_Common_CentralElements_CompuMethods_Identical 1 100 0.0 255.00 FORMAT "%8.2" ECU_ADDRESS 0xfe40305d /end MEASUREMENT
/begin MEASUREMENT Tlib_HfaActr14UrgcExist_ZCR_LIN6 "" UBYTE RB_RBA_Common_CentralElements_CompuMethods_Identical 1 100 0.0 255.00 FORMAT "%8.2" ECU_ADDRESS 0xfe40305e /end MEASUREMENT
/begin MEASUREMENT Tlib_HfaActr14UrgcPson_ZCR_LIN6 "" UBYTE RB_RBA_Common_CentralElements_CompuMethods_Identical 1 100 0.0 255.00 FORMAT "%8.2" ECU_ADDRESS 0xfe40305f /end MEASUREMENT
/begin MEASUREMENT Tlib_HfaActr14BusAdr_ZCR_LIN6 "" UBYTE RB_RBA_Common_CentralElements_CompuMethods_Identical 1 100 0.0 255.00 FORMAT "%8.2" ECU_ADDRESS 0xfe403060 /end MEASUREMENT
/begin MEASUREMENT Tlib_HfaActr14ElecErr_ZCR_LIN6 "" UBYTE RB_RBA_Common_CentralElements_CompuMethods_Identical 1 100 0.0 255.00 FORMAT "%8.2" ECU_ADDRESS 0xfe403061 /end MEASUREMENT
/begin MEASUREMENT Tlib_HfaActr14BlckSts_ZCR_LIN6 "" UBYTE RB_RBA_Common_CentralElements_CompuMethods_Identical 1 100 0.0 255.00 FORMAT "%8.2" ECU_ADDRESS 0xfe403062 /end MEASUREMENT
/begin MEASUREMENT Tlib_HfaActr14Mode_ZCR_LIN6 "" UBYTE RB_RBA_Common_CentralElements_CompuMethods_Identical 1 100 0.0 255.00 FORMAT "%8.2" ECU_ADDRESS 0xfe403063 /end MEASUREMENT
/begin MEASUREMENT Tlib_HfaActr14ResetSts_ZCR_LIN6 "" UBYTE RB_RBA_Common_CentralElements_CompuMethods_Identical 1 100 0.0 255.00 FORMAT "%8.2" ECU_ADDRESS 0xfe403064 /end MEASUREMENT
/begin MEASUREMENT Tlib_HfaActr14TrqSts_ZCR_LIN6 "" UBYTE RB_RBA_Common_CentralElements_CompuMethods_Identical 1 100 0.0 255.00 FORMAT "%8.2" ECU_ADDRESS 0xfe403065 /end MEASUREMENT
/begin MEASUREMENT Tlib_HfaActr14ActPson_ZCR_LIN6 "" UWORD RB_RBA_Common_CentralElements_CompuMethods_Identical 1 100 0.0 65535 FORMAT "%8.2" ECU_ADDRESS 0xfe4028a6 /end MEASUREMENT
/begin MEASUREMENT Tlib_HfaActr14CoilSts_ZCR_LIN6 "" UBYTE RB_RBA_Common_CentralElements_CompuMethods_Identical 1 100 0.0 255.00 FORMAT "%8.2" ECU_ADDRESS 0xfe403066 /end MEASUREMENT
/begin MEASUREMENT Tlib_HfaActr14PsonSts_ZCR_LIN6 "" UBYTE RB_RBA_Common_CentralElements_CompuMethods_Identical 1 100 0.0 255.00 FORMAT "%8.2" ECU_ADDRESS 0xfe403067 /end MEASUREMENT
/begin MEASUREMENT Tlib_HfaActr14SpclFct_ZCR_LIN6 "" UBYTE RB_RBA_Common_CentralElements_CompuMethods_Identical 1 100 0.0 255.00 FORMAT "%8.2" ECU_ADDRESS 0xfe403068 /end MEASUREMENT
/begin MEASUREMENT Tlib_HfaActr14MovDir_ZCR_LIN6 "" UBYTE RB_RBA_Common_CentralElements_CompuMethods_Identical 1 100 0.0 255.00 FORMAT "%8.2" ECU_ADDRESS 0xfe403069 /end MEASUREMENT
/begin MEASUREMENT Tlib_HfaActr14SpdSts_ZCR_LIN6 "" UBYTE RB_RBA_Common_CentralElements_CompuMethods_Identical 1 100 0.0 255.00 FORMAT "%8.2" ECU_ADDRESS 0xfe40306a /end MEASUREMENT
/begin MEASUREMENT Tlib_HfaActr14VoltErr_ZCR_LIN6 "" UBYTE RB_RBA_Common_CentralElements_CompuMethods_Identical 1 100 0.0 255.00 FORMAT "%8.2" ECU_ADDRESS 0xfe40306b /end MEASUREMENT
/begin MEASUREMENT Tlib_HfaActr14OvrTempErr_ZCR_LIN6 "" UBYTE RB_RBA_Common_CentralElements_CompuMethods_Identical 1 100 0.0 255.00 FORMAT "%8.2" ECU_ADDRESS 0xfe40306c /end MEASUREMENT
/begin MEASUREMENT Tlib_HfaActr14UrgcSts_ZCR_LIN6 "" UBYTE RB_RBA_Common_CentralElements_CompuMethods_Identical 1 100 0.0 255.00 FORMAT "%8.2" ECU_ADDRESS 0xfe40306d /end MEASUREMENT
/begin MEASUREMENT Tlib_HfaActr14BlckInd_ZCR_LIN6 "" UBYTE RB_RBA_Common_CentralElements_CompuMethods_Identical 1 100 0.0 255.00 FORMAT "%8.2" ECU_ADDRESS 0xfe40306e /end MEASUREMENT
/begin MEASUREMENT Tlib_HfaActr14DrvDir_ZCR_LIN6 "" UBYTE RB_RBA_Common_CentralElements_CompuMethods_Identical 1 100 0.0 255.00 FORMAT "%8.2" ECU_ADDRESS 0xfe40306f /end MEASUREMENT
/begin MEASUREMENT Tlib_HfaActr05ElecErr_ZCR_LIN6 "" UBYTE RB_RBA_Common_CentralElements_CompuMethods_Identical 1 100 0.0 255.00 FORMAT "%8.2" ECU_ADDRESS 0xfe403070 /end MEASUREMENT
/begin MEASUREMENT Tlib_HfaActr05BlckInd_ZCR_LIN6 "" UBYTE RB_RBA_Common_CentralElements_CompuMethods_Identical 1 100 0.0 255.00 FORMAT "%8.2" ECU_ADDRESS 0xfe403071 /end MEASUREMENT
/begin MEASUREMENT Tlib_HfaActr05SpclFct_ZCR_LIN6 "" UBYTE RB_RBA_Common_CentralElements_CompuMethods_Identical 1 100 0.0 255.00 FORMAT "%8.2" ECU_ADDRESS 0xfe403072 /end MEASUREMENT
/begin MEASUREMENT Tlib_HfaActr05BlckSts_ZCR_LIN6 "" UBYTE RB_RBA_Common_CentralElements_CompuMethods_Identical 1 100 0.0 255.00 FORMAT "%8.2" ECU_ADDRESS 0xfe403073 /end MEASUREMENT
/begin MEASUREMENT Tlib_HfaActr05VoltErr_ZCR_LIN6 "" UBYTE RB_RBA_Common_CentralElements_CompuMethods_Identical 1 100 0.0 255.00 FORMAT "%8.2" ECU_ADDRESS 0xfe403074 /end MEASUREMENT
/begin MEASUREMENT Tlib_HfaActr05TrqSts_ZCR_LIN6 "" UBYTE RB_RBA_Common_CentralElements_CompuMethods_Identical 1 100 0.0 255.00 FORMAT "%8.2" ECU_ADDRESS 0xfe403075 /end MEASUREMENT
/begin MEASUREMENT Tlib_HfaActr05CoilSts_ZCR_LIN6 "" UBYTE RB_RBA_Common_CentralElements_CompuMethods_Identical 1 100 0.0 255.00 FORMAT "%8.2" ECU_ADDRESS 0xfe403076 /end MEASUREMENT
/begin MEASUREMENT Tlib_HfaActr05OvrTempErr_ZCR_LIN6 "" UBYTE RB_RBA_Common_CentralElements_CompuMethods_Identical 1 100 0.0 255.00 FORMAT "%8.2" ECU_ADDRESS 0xfe403077 /end MEASUREMENT
/begin MEASUREMENT Tlib_HfaActr05PsonSts_ZCR_LIN6 "" UBYTE RB_RBA_Common_CentralElements_CompuMethods_Identical 1 100 0.0 255.00 FORMAT "%8.2" ECU_ADDRESS 0xfe403078 /end MEASUREMENT
/begin MEASUREMENT Tlib_HfaActr05BusAdr_ZCR_LIN6 "" UBYTE RB_RBA_Common_CentralElements_CompuMethods_Identical 1 100 0.0 255.00 FORMAT "%8.2" ECU_ADDRESS 0xfe403079 /end MEASUREMENT
/begin MEASUREMENT Tlib_HfaActr05MovDir_ZCR_LIN6 "" UBYTE RB_RBA_Common_CentralElements_CompuMethods_Identical 1 100 0.0 255.00 FORMAT "%8.2" ECU_ADDRESS 0xfe40307a /end MEASUREMENT
/begin MEASUREMENT Tlib_HfaActr05Mode_ZCR_LIN6 "" UBYTE RB_RBA_Common_CentralElements_CompuMethods_Identical 1 100 0.0 255.00 FORMAT "%8.2" ECU_ADDRESS 0xfe40307b /end MEASUREMENT
/begin MEASUREMENT Tlib_HfaActr05ActPson_ZCR_LIN6 "" UWORD RB_RBA_Common_CentralElements_CompuMethods_Identical 1 100 0.0 65535 FORMAT "%8.2" ECU_ADDRESS 0xfe4028a8 /end MEASUREMENT
/begin MEASUREMENT Tlib_HfaActr05ResetSts_ZCR_LIN6 "" UBYTE RB_RBA_Common_CentralElements_CompuMethods_Identical 1 100 0.0 255.00 FORMAT "%8.2" ECU_ADDRESS 0xfe40307c /end MEASUREMENT
/begin MEASUREMENT Tlib_HfaActr05SpdSts_ZCR_LIN6 "" UBYTE RB_RBA_Common_CentralElements_CompuMethods_Identical 1 100 0.0 255.00 FORMAT "%8.2" ECU_ADDRESS 0xfe40307d /end MEASUREMENT
/begin MEASUREMENT Tlib_HfaActr05UrgcSts_ZCR_LIN6 "" UBYTE RB_RBA_Common_CentralElements_CompuMethods_Identical 1 100 0.0 255.00 FORMAT "%8.2" ECU_ADDRESS 0xfe40307e /end MEASUREMENT
/begin MEASUREMENT Tlib_HfaActr05DrvDir_ZCR_LIN6 "" UBYTE RB_RBA_Common_CentralElements_CompuMethods_Identical 1 100 0.0 255.00 FORMAT "%8.2" ECU_ADDRESS 0xfe40307f /end MEASUREMENT
/begin MEASUREMENT Tlib_HfaActr05UrgcPson_ZCR_LIN6 "" UBYTE RB_RBA_Common_CentralElements_CompuMethods_Identical 1 100 0.0 255.00 FORMAT "%8.2" ECU_ADDRESS 0xfe403080 /end MEASUREMENT
/begin MEASUREMENT Tlib_HfaActr05UrgcExist_ZCR_LIN6 "" UBYTE RB_RBA_Common_CentralElements_CompuMethods_Identical 1 100 0.0 255.00 FORMAT "%8.2" ECU_ADDRESS 0xfe403081 /end MEASUREMENT
/begin MEASUREMENT Tlib_HfaActr10ActPson_ZCR_LIN6 "" UWORD RB_RBA_Common_CentralElements_CompuMethods_Identical 1 100 0.0 65535 FORMAT "%8.2" ECU_ADDRESS 0xfe4028aa /end MEASUREMENT
/begin MEASUREMENT Tlib_HfaActr10TrqSts_ZCR_LIN6 "" UBYTE RB_RBA_Common_CentralElements_CompuMethods_Identical 1 100 0.0 255.00 FORMAT "%8.2" ECU_ADDRESS 0xfe403082 /end MEASUREMENT
/begin MEASUREMENT Tlib_HfaActr10CoilSts_ZCR_LIN6 "" UBYTE RB_RBA_Common_CentralElements_CompuMethods_Identical 1 100 0.0 255.00 FORMAT "%8.2" ECU_ADDRESS 0xfe403083 /end MEASUREMENT
/begin MEASUREMENT Tlib_HfaActr10ResetSts_ZCR_LIN6 "" UBYTE RB_RBA_Common_CentralElements_CompuMethods_Identical 1 100 0.0 255.00 FORMAT "%8.2" ECU_ADDRESS 0xfe403084 /end MEASUREMENT
/begin MEASUREMENT Tlib_HfaActr10PsonSts_ZCR_LIN6 "" UBYTE RB_RBA_Common_CentralElements_CompuMethods_Identical 1 100 0.0 255.00 FORMAT "%8.2" ECU_ADDRESS 0xfe403085 /end MEASUREMENT
/begin MEASUREMENT Tlib_HfaActr10UrgcPson_ZCR_LIN6 "" UBYTE RB_RBA_Common_CentralElements_CompuMethods_Identical 1 100 0.0 255.00 FORMAT "%8.2" ECU_ADDRESS 0xfe403086 /end MEASUREMENT
/begin MEASUREMENT Tlib_HfaActr10BusAdr_ZCR_LIN6 "" UBYTE RB_RBA_Common_CentralElements_CompuMethods_Identical 1 100 0.0 255.00 FORMAT "%8.2" ECU_ADDRESS 0xfe403087 /end MEASUREMENT
/begin MEASUREMENT Tlib_HfaActr10UrgcSts_ZCR_LIN6 "" UBYTE RB_RBA_Common_CentralElements_CompuMethods_Identical 1 100 0.0 255.00 FORMAT "%8.2" ECU_ADDRESS 0xfe403088 /end MEASUREMENT
/begin MEASUREMENT Tlib_HfaActr10MovDir_ZCR_LIN6 "" UBYTE RB_RBA_Common_CentralElements_CompuMethods_Identical 1 100 0.0 255.00 FORMAT "%8.2" ECU_ADDRESS 0xfe403089 /end MEASUREMENT
/begin MEASUREMENT Tlib_HfaActr10BlckSts_ZCR_LIN6 "" UBYTE RB_RBA_Common_CentralElements_CompuMethods_Identical 1 100 0.0 255.00 FORMAT "%8.2" ECU_ADDRESS 0xfe40308a /end MEASUREMENT
/begin MEASUREMENT Tlib_HfaActr10SpclFct_ZCR_LIN6 "" UBYTE RB_RBA_Common_CentralElements_CompuMethods_Identical 1 100 0.0 255.00 FORMAT "%8.2" ECU_ADDRESS 0xfe40308b /end MEASUREMENT
/begin MEASUREMENT Tlib_HfaActr10ElecErr_ZCR_LIN6 "" UBYTE RB_RBA_Common_CentralElements_CompuMethods_Identical 1 100 0.0 255.00 FORMAT "%8.2" ECU_ADDRESS 0xfe40308c /end MEASUREMENT
/begin MEASUREMENT Tlib_HfaActr10UrgcExist_ZCR_LIN6 "" UBYTE RB_RBA_Common_CentralElements_CompuMethods_Identical 1 100 0.0 255.00 FORMAT "%8.2" ECU_ADDRESS 0xfe40308d /end MEASUREMENT
/begin MEASUREMENT Tlib_HfaActr10DrvDir_ZCR_LIN6 "" UBYTE RB_RBA_Common_CentralElements_CompuMethods_Identical 1 100 0.0 255.00 FORMAT "%8.2" ECU_ADDRESS 0xfe40308e /end MEASUREMENT
/begin MEASUREMENT Tlib_HfaActr10BlckInd_ZCR_LIN6 "" UBYTE RB_RBA_Common_CentralElements_CompuMethods_Identical 1 100 0.0 255.00 FORMAT "%8.2" ECU_ADDRESS 0xfe40308f /end MEASUREMENT
/begin MEASUREMENT Tlib_HfaActr10OvrTempErr_ZCR_LIN6 "" UBYTE RB_RBA_Common_CentralElements_CompuMethods_Identical 1 100 0.0 255.00 FORMAT "%8.2" ECU_ADDRESS 0xfe403090 /end MEASUREMENT
/begin MEASUREMENT Tlib_HfaActr10VoltErr_ZCR_LIN6 "" UBYTE RB_RBA_Common_CentralElements_CompuMethods_Identical 1 100 0.0 255.00 FORMAT "%8.2" ECU_ADDRESS 0xfe403091 /end MEASUREMENT
/begin MEASUREMENT Tlib_HfaActr10Mode_ZCR_LIN6 "" UBYTE RB_RBA_Common_CentralElements_CompuMethods_Identical 1 100 0.0 255.00 FORMAT "%8.2" ECU_ADDRESS 0xfe403092 /end MEASUREMENT
/begin MEASUREMENT Tlib_HfaActr10SpdSts_ZCR_LIN6 "" UBYTE RB_RBA_Common_CentralElements_CompuMethods_Identical 1 100 0.0 255.00 FORMAT "%8.2" ECU_ADDRESS 0xfe403093 /end MEASUREMENT
/begin MEASUREMENT Tlib_HfaActr08SpdSts_ZCR_LIN6 "" UBYTE RB_RBA_Common_CentralElements_CompuMethods_Identical 1 100 0.0 255.00 FORMAT "%8.2" ECU_ADDRESS 0xfe403094 /end MEASUREMENT
/begin MEASUREMENT Tlib_HfaActr08DrvDir_ZCR_LIN6 "" UBYTE RB_RBA_Common_CentralElements_CompuMethods_Identical 1 100 0.0 255.00 FORMAT "%8.2" ECU_ADDRESS 0xfe403095 /end MEASUREMENT
/begin MEASUREMENT Tlib_HfaActr08BlckSts_ZCR_LIN6 "" UBYTE RB_RBA_Common_CentralElements_CompuMethods_Identical 1 100 0.0 255.00 FORMAT "%8.2" ECU_ADDRESS 0xfe403096 /end MEASUREMENT
/begin MEASUREMENT Tlib_HfaActr08Mode_ZCR_LIN6 "" UBYTE RB_RBA_Common_CentralElements_CompuMethods_Identical 1 100 0.0 255.00 FORMAT "%8.2" ECU_ADDRESS 0xfe403097 /end MEASUREMENT
/begin MEASUREMENT Tlib_HfaActr08PsonSts_ZCR_LIN6 "" UBYTE RB_RBA_Common_CentralElements_CompuMethods_Identical 1 100 0.0 255.00 FORMAT "%8.2" ECU_ADDRESS 0xfe403098 /end MEASUREMENT
/begin MEASUREMENT Tlib_HfaActr08UrgcPson_ZCR_LIN6 "" UBYTE RB_RBA_Common_CentralElements_CompuMethods_Identical 1 100 0.0 255.00 FORMAT "%8.2" ECU_ADDRESS 0xfe403099 /end MEASUREMENT
/begin MEASUREMENT Tlib_HfaActr08ElecErr_ZCR_LIN6 "" UBYTE RB_RBA_Common_CentralElements_CompuMethods_Identical 1 100 0.0 255.00 FORMAT "%8.2" ECU_ADDRESS 0xfe40309a /end MEASUREMENT
/begin MEASUREMENT Tlib_HfaActr08CoilSts_ZCR_LIN6 "" UBYTE RB_RBA_Common_CentralElements_CompuMethods_Identical 1 100 0.0 255.00 FORMAT "%8.2" ECU_ADDRESS 0xfe40309b /end MEASUREMENT
/begin MEASUREMENT Tlib_HfaActr08BlckInd_ZCR_LIN6 "" UBYTE RB_RBA_Common_CentralElements_CompuMethods_Identical 1 100 0.0 255.00 FORMAT "%8.2" ECU_ADDRESS 0xfe40309c /end MEASUREMENT
/begin MEASUREMENT Tlib_HfaActr08ResetSts_ZCR_LIN6 "" UBYTE RB_RBA_Common_CentralElements_CompuMethods_Identical 1 100 0.0 255.00 FORMAT "%8.2" ECU_ADDRESS 0xfe40309d /end MEASUREMENT
/begin MEASUREMENT Tlib_HfaActr08VoltErr_ZCR_LIN6 "" UBYTE RB_RBA_Common_CentralElements_CompuMethods_Identical 1 100 0.0 255.00 FORMAT "%8.2" ECU_ADDRESS 0xfe40309e /end MEASUREMENT
/begin MEASUREMENT Tlib_HfaActr08SpclFct_ZCR_LIN6 "" UBYTE RB_RBA_Common_CentralElements_CompuMethods_Identical 1 100 0.0 255.00 FORMAT "%8.2" ECU_ADDRESS 0xfe40309f /end MEASUREMENT
/begin MEASUREMENT Tlib_HfaActr08TrqSts_ZCR_LIN6 "" UBYTE RB_RBA_Common_CentralElements_CompuMethods_Identical 1 100 0.0 255.00 FORMAT "%8.2" ECU_ADDRESS 0xfe4030a0 /end MEASUREMENT
/begin MEASUREMENT Tlib_HfaActr08UrgcSts_ZCR_LIN6 "" UBYTE RB_RBA_Common_CentralElements_CompuMethods_Identical 1 100 0.0 255.00 FORMAT "%8.2" ECU_ADDRESS 0xfe4030a1 /end MEASUREMENT
/begin MEASUREMENT Tlib_HfaActr08UrgcExist_ZCR_LIN6 "" UBYTE RB_RBA_Common_CentralElements_CompuMethods_Identical 1 100 0.0 255.00 FORMAT "%8.2" ECU_ADDRESS 0xfe4030a2 /end MEASUREMENT
/begin MEASUREMENT Tlib_HfaActr08MovDir_ZCR_LIN6 "" UBYTE RB_RBA_Common_CentralElements_CompuMethods_Identical 1 100 0.0 255.00 FORMAT "%8.2" ECU_ADDRESS 0xfe4030a3 /end MEASUREMENT
/begin MEASUREMENT Tlib_HfaActr08OvrTempErr_ZCR_LIN6 "" UBYTE RB_RBA_Common_CentralElements_CompuMethods_Identical 1 100 0.0 255.00 FORMAT "%8.2" ECU_ADDRESS 0xfe4030a4 /end MEASUREMENT
/begin MEASUREMENT Tlib_HfaActr08BusAdr_ZCR_LIN6 "" UBYTE RB_RBA_Common_CentralElements_CompuMethods_Identical 1 100 0.0 255.00 FORMAT "%8.2" ECU_ADDRESS 0xfe4030a5 /end MEASUREMENT
/begin MEASUREMENT Tlib_HfaActr08ActPson_ZCR_LIN6 "" UWORD RB_RBA_Common_CentralElements_CompuMethods_Identical 1 100 0.0 65535 FORMAT "%8.2" ECU_ADDRESS 0xfe4028ac /end MEASUREMENT
/begin MEASUREMENT Tlib_HfaActr12Mode_ZCR_LIN6 "" UBYTE RB_RBA_Common_CentralElements_CompuMethods_Identical 1 100 0.0 255.00 FORMAT "%8.2" ECU_ADDRESS 0xfe4030a6 /end MEASUREMENT
/begin MEASUREMENT Tlib_HfaActr12BusAdr_ZCR_LIN6 "" UBYTE RB_RBA_Common_CentralElements_CompuMethods_Identical 1 100 0.0 255.00 FORMAT "%8.2" ECU_ADDRESS 0xfe4030a7 /end MEASUREMENT
/begin MEASUREMENT Tlib_HfaActr12BlckInd_ZCR_LIN6 "" UBYTE RB_RBA_Common_CentralElements_CompuMethods_Identical 1 100 0.0 255.00 FORMAT "%8.2" ECU_ADDRESS 0xfe4030a8 /end MEASUREMENT
/begin MEASUREMENT Tlib_HfaActr12ResetSts_ZCR_LIN6 "" UBYTE RB_RBA_Common_CentralElements_CompuMethods_Identical 1 100 0.0 255.00 FORMAT "%8.2" ECU_ADDRESS 0xfe4030a9 /end MEASUREMENT
/begin MEASUREMENT Tlib_HfaActr12UrgcExist_ZCR_LIN6 "" UBYTE RB_RBA_Common_CentralElements_CompuMethods_Identical 1 100 0.0 255.00 FORMAT "%8.2" ECU_ADDRESS 0xfe4030aa /end MEASUREMENT
/begin MEASUREMENT Tlib_HfaActr12VoltErr_ZCR_LIN6 "" UBYTE RB_RBA_Common_CentralElements_CompuMethods_Identical 1 100 0.0 255.00 FORMAT "%8.2" ECU_ADDRESS 0xfe4030ab /end MEASUREMENT
/begin MEASUREMENT Tlib_HfaActr12BlckSts_ZCR_LIN6 "" UBYTE RB_RBA_Common_CentralElements_CompuMethods_Identical 1 100 0.0 255.00 FORMAT "%8.2" ECU_ADDRESS 0xfe4030ac /end MEASUREMENT
/begin MEASUREMENT Tlib_HfaActr12MovDir_ZCR_LIN6 "" UBYTE RB_RBA_Common_CentralElements_CompuMethods_Identical 1 100 0.0 255.00 FORMAT "%8.2" ECU_ADDRESS 0xfe4030ad /end MEASUREMENT
/begin MEASUREMENT Tlib_HfaActr12ElecErr_ZCR_LIN6 "" UBYTE RB_RBA_Common_CentralElements_CompuMethods_Identical 1 100 0.0 255.00 FORMAT "%8.2" ECU_ADDRESS 0xfe4030ae /end MEASUREMENT
/begin MEASUREMENT Tlib_HfaActr12TrqSts_ZCR_LIN6 "" UBYTE RB_RBA_Common_CentralElements_CompuMethods_Identical 1 100 0.0 255.00 FORMAT "%8.2" ECU_ADDRESS 0xfe4030af /end MEASUREMENT
/begin MEASUREMENT Tlib_HfaActr12OvrTempErr_ZCR_LIN6 "" UBYTE RB_RBA_Common_CentralElements_CompuMethods_Identical 1 100 0.0 255.00 FORMAT "%8.2" ECU_ADDRESS 0xfe4030b0 /end MEASUREMENT
/begin MEASUREMENT Tlib_HfaActr12CoilSts_ZCR_LIN6 "" UBYTE RB_RBA_Common_CentralElements_CompuMethods_Identical 1 100 0.0 255.00 FORMAT "%8.2" ECU_ADDRESS 0xfe4030b1 /end MEASUREMENT
/begin MEASUREMENT Tlib_HfaActr12SpclFct_ZCR_LIN6 "" UBYTE RB_RBA_Common_CentralElements_CompuMethods_Identical 1 100 0.0 255.00 FORMAT "%8.2" ECU_ADDRESS 0xfe4030b2 /end MEASUREMENT
/begin MEASUREMENT Tlib_HfaActr12DrvDir_ZCR_LIN6 "" UBYTE RB_RBA_Common_CentralElements_CompuMethods_Identical 1 100 0.0 255.00 FORMAT "%8.2" ECU_ADDRESS 0xfe4030b3 /end MEASUREMENT
/begin MEASUREMENT Tlib_HfaActr12SpdSts_ZCR_LIN6 "" UBYTE RB_RBA_Common_CentralElements_CompuMethods_Identical 1 100 0.0 255.00 FORMAT "%8.2" ECU_ADDRESS 0xfe4030b4 /end MEASUREMENT
/begin MEASUREMENT Tlib_HfaActr12PsonSts_ZCR_LIN6 "" UBYTE RB_RBA_Common_CentralElements_CompuMethods_Identical 1 100 0.0 255.00 FORMAT "%8.2" ECU_ADDRESS 0xfe4030b5 /end MEASUREMENT
/begin MEASUREMENT Tlib_HfaActr12ActPson_ZCR_LIN6 "" UWORD RB_RBA_Common_CentralElements_CompuMethods_Identical 1 100 0.0 65535 FORMAT "%8.2" ECU_ADDRESS 0xfe4028ae /end MEASUREMENT
/begin MEASUREMENT Tlib_HfaActr12UrgcSts_ZCR_LIN6 "" UBYTE RB_RBA_Common_CentralElements_CompuMethods_Identical 1 100 0.0 255.00 FORMAT "%8.2" ECU_ADDRESS 0xfe4030b6 /end MEASUREMENT
/begin MEASUREMENT Tlib_HfaActr12UrgcPson_ZCR_LIN6 "" UBYTE RB_RBA_Common_CentralElements_CompuMethods_Identical 1 100 0.0 255.00 FORMAT "%8.2" ECU_ADDRESS 0xfe4030b7 /end MEASUREMENT
/begin MEASUREMENT Tlib_HfaActr13SpclFct_ZCR_LIN6 "" UBYTE RB_RBA_Common_CentralElements_CompuMethods_Identical 1 100 0.0 255.00 FORMAT "%8.2" ECU_ADDRESS 0xfe4030b8 /end MEASUREMENT
/begin MEASUREMENT Tlib_HfaActr13ElecErr_ZCR_LIN6 "" UBYTE RB_RBA_Common_CentralElements_CompuMethods_Identical 1 100 0.0 255.00 FORMAT "%8.2" ECU_ADDRESS 0xfe4030b9 /end MEASUREMENT
/begin MEASUREMENT Tlib_HfaActr13MovDir_ZCR_LIN6 "" UBYTE RB_RBA_Common_CentralElements_CompuMethods_Identical 1 100 0.0 255.00 FORMAT "%8.2" ECU_ADDRESS 0xfe4030ba /end MEASUREMENT
/begin MEASUREMENT Tlib_HfaActr13BusAdr_ZCR_LIN6 "" UBYTE RB_RBA_Common_CentralElements_CompuMethods_Identical 1 100 0.0 255.00 FORMAT "%8.2" ECU_ADDRESS 0xfe4030bb /end MEASUREMENT
/begin MEASUREMENT Tlib_HfaActr13OvrTempErr_ZCR_LIN6 "" UBYTE RB_RBA_Common_CentralElements_CompuMethods_Identical 1 100 0.0 255.00 FORMAT "%8.2" ECU_ADDRESS 0xfe4030bc /end MEASUREMENT
/begin MEASUREMENT Tlib_HfaActr13TrqSts_ZCR_LIN6 "" UBYTE RB_RBA_Common_CentralElements_CompuMethods_Identical 1 100 0.0 255.00 FORMAT "%8.2" ECU_ADDRESS 0xfe4030bd /end MEASUREMENT
/begin MEASUREMENT Tlib_HfaActr13BlckInd_ZCR_LIN6 "" UBYTE RB_RBA_Common_CentralElements_CompuMethods_Identical 1 100 0.0 255.00 FORMAT "%8.2" ECU_ADDRESS 0xfe4030be /end MEASUREMENT
/begin MEASUREMENT Tlib_HfaActr13UrgcSts_ZCR_LIN6 "" UBYTE RB_RBA_Common_CentralElements_CompuMethods_Identical 1 100 0.0 255.00 FORMAT "%8.2" ECU_ADDRESS 0xfe4030bf /end MEASUREMENT
/begin MEASUREMENT Tlib_HfaActr13Mode_ZCR_LIN6 "" UBYTE RB_RBA_Common_CentralElements_CompuMethods_Identical 1 100 0.0 255.00 FORMAT "%8.2" ECU_ADDRESS 0xfe4030c0 /end MEASUREMENT
/begin MEASUREMENT Tlib_HfaActr13CoilSts_ZCR_LIN6 "" UBYTE RB_RBA_Common_CentralElements_CompuMethods_Identical 1 100 0.0 255.00 FORMAT "%8.2" ECU_ADDRESS 0xfe4030c1 /end MEASUREMENT
/begin MEASUREMENT Tlib_HfaActr13PsonSts_ZCR_LIN6 "" UBYTE RB_RBA_Common_CentralElements_CompuMethods_Identical 1 100 0.0 255.00 FORMAT "%8.2" ECU_ADDRESS 0xfe4030c2 /end MEASUREMENT
/begin MEASUREMENT Tlib_HfaActr13SpdSts_ZCR_LIN6 "" UBYTE RB_RBA_Common_CentralElements_CompuMethods_Identical 1 100 0.0 255.00 FORMAT "%8.2" ECU_ADDRESS 0xfe4030c3 /end MEASUREMENT
/begin MEASUREMENT Tlib_HfaActr13UrgcExist_ZCR_LIN6 "" UBYTE RB_RBA_Common_CentralElements_CompuMethods_Identical 1 100 0.0 255.00 FORMAT "%8.2" ECU_ADDRESS 0xfe4030c4 /end MEASUREMENT
/begin MEASUREMENT Tlib_HfaActr13BlckSts_ZCR_LIN6 "" UBYTE RB_RBA_Common_CentralElements_CompuMethods_Identical 1 100 0.0 255.00 FORMAT "%8.2" ECU_ADDRESS 0xfe4030c5 /end MEASUREMENT
/begin MEASUREMENT Tlib_HfaActr13VoltErr_ZCR_LIN6 "" UBYTE RB_RBA_Common_CentralElements_CompuMethods_Identical 1 100 0.0 255.00 FORMAT "%8.2" ECU_ADDRESS 0xfe4030c6 /end MEASUREMENT
/begin MEASUREMENT Tlib_HfaActr13ActPson_ZCR_LIN6 "" UWORD RB_RBA_Common_CentralElements_CompuMethods_Identical 1 100 0.0 65535 FORMAT "%8.2" ECU_ADDRESS 0xfe4028b0 /end MEASUREMENT
/begin MEASUREMENT Tlib_HfaActr13UrgcPson_ZCR_LIN6 "" UBYTE RB_RBA_Common_CentralElements_CompuMethods_Identical 1 100 0.0 255.00 FORMAT "%8.2" ECU_ADDRESS 0xfe4030c7 /end MEASUREMENT
/begin MEASUREMENT Tlib_HfaActr13ResetSts_ZCR_LIN6 "" UBYTE RB_RBA_Common_CentralElements_CompuMethods_Identical 1 100 0.0 255.00 FORMAT "%8.2" ECU_ADDRESS 0xfe4030c8 /end MEASUREMENT
/begin MEASUREMENT Tlib_HfaActr13DrvDir_ZCR_LIN6 "" UBYTE RB_RBA_Common_CentralElements_CompuMethods_Identical 1 100 0.0 255.00 FORMAT "%8.2" ECU_ADDRESS 0xfe4030c9 /end MEASUREMENT
/begin MEASUREMENT Tlib_HfaActr01BusAdr_ZCR_LIN6 "" UBYTE RB_RBA_Common_CentralElements_CompuMethods_Identical 1 100 0.0 255.00 FORMAT "%8.2" ECU_ADDRESS 0xfe4030ca /end MEASUREMENT
/begin MEASUREMENT Tlib_HfaActr01SpclFct_ZCR_LIN6 "" UBYTE RB_RBA_Common_CentralElements_CompuMethods_Identical 1 100 0.0 255.00 FORMAT "%8.2" ECU_ADDRESS 0xfe4030cb /end MEASUREMENT
/begin MEASUREMENT Tlib_HfaActr01BlckInd_ZCR_LIN6 "" UBYTE RB_RBA_Common_CentralElements_CompuMethods_Identical 1 100 0.0 255.00 FORMAT "%8.2" ECU_ADDRESS 0xfe4030cc /end MEASUREMENT
/begin MEASUREMENT Tlib_HfaActr01ActPson_ZCR_LIN6 "" UWORD RB_RBA_Common_CentralElements_CompuMethods_Identical 1 100 0.0 65535 FORMAT "%8.2" ECU_ADDRESS 0xfe4028b2 /end MEASUREMENT
/begin MEASUREMENT Tlib_HfaActr01UrgcSts_ZCR_LIN6 "" UBYTE RB_RBA_Common_CentralElements_CompuMethods_Identical 1 100 0.0 255.00 FORMAT "%8.2" ECU_ADDRESS 0xfe4030cd /end MEASUREMENT
/begin MEASUREMENT Tlib_HfaActr01UrgcPson_ZCR_LIN6 "" UBYTE RB_RBA_Common_CentralElements_CompuMethods_Identical 1 100 0.0 255.00 FORMAT "%8.2" ECU_ADDRESS 0xfe4030ce /end MEASUREMENT
/begin MEASUREMENT Tlib_HfaActr01UrgcExist_ZCR_LIN6 "" UBYTE RB_RBA_Common_CentralElements_CompuMethods_Identical 1 100 0.0 255.00 FORMAT "%8.2" ECU_ADDRESS 0xfe4030cf /end MEASUREMENT
/begin MEASUREMENT Tlib_HfaActr01VoltErr_ZCR_LIN6 "" UBYTE RB_RBA_Common_CentralElements_CompuMethods_Identical 1 100 0.0 255.00 FORMAT "%8.2" ECU_ADDRESS 0xfe4030d0 /end MEASUREMENT
/begin MEASUREMENT Tlib_HfaActr01BlckSts_ZCR_LIN6 "" UBYTE RB_RBA_Common_CentralElements_CompuMethods_Identical 1 100 0.0 255.00 FORMAT "%8.2" ECU_ADDRESS 0xfe4030d1 /end MEASUREMENT
/begin MEASUREMENT Tlib_HfaActr01DrvDir_ZCR_LIN6 "" UBYTE RB_RBA_Common_CentralElements_CompuMethods_Identical 1 100 0.0 255.00 FORMAT "%8.2" ECU_ADDRESS 0xfe4030d2 /end MEASUREMENT
/begin MEASUREMENT Tlib_HfaActr01TrqSts_ZCR_LIN6 "" UBYTE RB_RBA_Common_CentralElements_CompuMethods_Identical 1 100 0.0 255.00 FORMAT "%8.2" ECU_ADDRESS 0xfe4030d3 /end MEASUREMENT
/begin MEASUREMENT Tlib_HfaActr01MovDir_ZCR_LIN6 "" UBYTE RB_RBA_Common_CentralElements_CompuMethods_Identical 1 100 0.0 255.00 FORMAT "%8.2" ECU_ADDRESS 0xfe4030d4 /end MEASUREMENT
/begin MEASUREMENT Tlib_HfaActr01ResetSts_ZCR_LIN6 "" UBYTE RB_RBA_Common_CentralElements_CompuMethods_Identical 1 100 0.0 255.00 FORMAT "%8.2" ECU_ADDRESS 0xfe4030d5 /end MEASUREMENT
/begin MEASUREMENT Tlib_HfaActr01ElecErr_ZCR_LIN6 "" UBYTE RB_RBA_Common_CentralElements_CompuMethods_Identical 1 100 0.0 255.00 FORMAT "%8.2" ECU_ADDRESS 0xfe4030d6 /end MEASUREMENT
/begin MEASUREMENT Tlib_HfaActr01SpdSts_ZCR_LIN6 "" UBYTE RB_RBA_Common_CentralElements_CompuMethods_Identical 1 100 0.0 255.00 FORMAT "%8.2" ECU_ADDRESS 0xfe4030d7 /end MEASUREMENT
/begin MEASUREMENT Tlib_HfaActr01PsonSts_ZCR_LIN6 "" UBYTE RB_RBA_Common_CentralElements_CompuMethods_Identical 1 100 0.0 255.00 FORMAT "%8.2" ECU_ADDRESS 0xfe4030d8 /end MEASUREMENT
/begin MEASUREMENT Tlib_HfaActr01CoilSts_ZCR_LIN6 "" UBYTE RB_RBA_Common_CentralElements_CompuMethods_Identical 1 100 0.0 255.00 FORMAT "%8.2" ECU_ADDRESS 0xfe4030d9 /end MEASUREMENT
/begin MEASUREMENT Tlib_HfaActr01Mode_ZCR_LIN6 "" UBYTE RB_RBA_Common_CentralElements_CompuMethods_Identical 1 100 0.0 255.00 FORMAT "%8.2" ECU_ADDRESS 0xfe4030da /end MEASUREMENT
/begin MEASUREMENT Tlib_HfaActr01OvrTempErr_ZCR_LIN6 "" UBYTE RB_RBA_Common_CentralElements_CompuMethods_Identical 1 100 0.0 255.00 FORMAT "%8.2" ECU_ADDRESS 0xfe4030db /end MEASUREMENT
/begin MEASUREMENT Tlib_HfaActr15Mode_ZCR_LIN6 "" UBYTE RB_RBA_Common_CentralElements_CompuMethods_Identical 1 100 0.0 255.00 FORMAT "%8.2" ECU_ADDRESS 0xfe4030dc /end MEASUREMENT
/begin MEASUREMENT Tlib_HfaActr15UrgcPson_ZCR_LIN6 "" UBYTE RB_RBA_Common_CentralElements_CompuMethods_Identical 1 100 0.0 255.00 FORMAT "%8.2" ECU_ADDRESS 0xfe4030dd /end MEASUREMENT
/begin MEASUREMENT Tlib_HfaActr15MovDir_ZCR_LIN6 "" UBYTE RB_RBA_Common_CentralElements_CompuMethods_Identical 1 100 0.0 255.00 FORMAT "%8.2" ECU_ADDRESS 0xfe4030de /end MEASUREMENT
/begin MEASUREMENT Tlib_HfaActr15BlckSts_ZCR_LIN6 "" UBYTE RB_RBA_Common_CentralElements_CompuMethods_Identical 1 100 0.0 255.00 FORMAT "%8.2" ECU_ADDRESS 0xfe4030df /end MEASUREMENT
/begin MEASUREMENT Tlib_HfaActr15DrvDir_ZCR_LIN6 "" UBYTE RB_RBA_Common_CentralElements_CompuMethods_Identical 1 100 0.0 255.00 FORMAT "%8.2" ECU_ADDRESS 0xfe4030e0 /end MEASUREMENT
/*********** End of merged FUNCTION blocks ***********/ /*********** Start of merged COMPU_METHOD blocks ***********/
/begin COMPU_METHOD RB_RBA_Common_CentralElements_CompuMethods_Identical "The internal value and the physical one are identical. No physical unit available" RAT_FUNC "%10.5" "noUnit" COEFFS 0.0 1.0 0.0 0.0 0.0 1.0 REF_UNIT RB_RBA_Common_CentralElements_Units_NoUnit /end COMPU_METHOD
/begin RECORD_LAYOUT __UInt64_Value_ColumnDir FNC_VALUES 1 A_UINT64 COLUMN_DIR DIRECT /end RECORD_LAYOUT
/begin RECORD_LAYOUT __Int64_Value_ColumnDir FNC_VALUES 1 A_INT64 COLUMN_DIR DIRECT /end RECORD_LAYOUT
/begin RECORD_LAYOUT __Float32_Value_ColumnDir FNC_VALUES 1 FLOAT32_IEEE COLUMN_DIR DIRECT /end RECORD_LAYOUT
/begin RECORD_LAYOUT __Double_Value_ColumnDir FNC_VALUES 1 FLOAT64_IEEE COLUMN_DIR DIRECT /end RECORD_LAYOUT
/*********** Start of merged UNIT blocks ***********/
/begin UNIT RB_RBA_Common_CentralElements_Units_NoUnit "No Unit" "noUnit" EXTENDED_SI SI_EXPONENTS 0 0 0 0 0 0 0 /end UNIT
/begin UNIT AUTOSAR_Can_Units_NoUnit "No Unit" "noUnit" EXTENDED_SI SI_EXPONENTS 0 0 0 0 0 0 0 /end UNIT
/end MODULE
/end PROJECT
