ASAP2_VERSION 1 61
/begin PROJECT ZCU "ZCU"
/begin HEADER "" VERSION "ZCU" PROJECT_NO ZCU /end HEADER
/begin MODULE DIM ""
/begin MOD_COMMON "" BYTE_ORDER MSB_LAST ALIGNMENT_BYTE 1 ALIGNMENT_WORD 2 ALIGNMENT_LONG 4 ALIGNMENT_INT64 4 ALIGNMENT_FLOAT32_IEEE 4 ALIGNMENT_FLOAT64_IEEE 4 DATA_SIZE 32 /end MOD_COMMON
/begin MEASUREMENT Tlib_PassDoorRdrObj22RdrObjSpeedY_ZCR_CANFD5 "" UWORD RB_RBA_Common_CentralElements_CompuMethods_Identical 1 100 0.0 65535 FORMAT "%8.2" ECU_ADDRESS 0xfe402a78 /end MEASUREMENT
/begin MEASUREMENT Tlib_PassDoorRdrObj22RdrObjConfidLvl_ZCR_CANFD5 "" UBYTE RB_RBA_Common_CentralElements_CompuMethods_Identical 1 100 0.0 255.00 FORMAT "%8.2" ECU_ADDRESS 0xfe4033e6 /end MEASUREMENT
/begin MEASUREMENT Tlib_PassDoorRdrObj22RdrObjRangeX_ZCR_CANFD5 "" UWORD RB_RBA_Common_CentralElements_CompuMethods_Identical 1 100 0.0 65535 FORMAT "%8.2" ECU_ADDRESS 0xfe402a7a /end MEASUREMENT
/begin MEASUREMENT Tlib_PassDoorRdrObj22RdrObjAccY_ZCR_CANFD5 "" UWORD RB_RBA_Common_CentralElements_CompuMethods_Identical 1 100 0.0 65535 FORMAT "%8.2" ECU_ADDRESS 0xfe402a7c /end MEASUREMENT
/begin MEASUREMENT Tlib_PassDoorRdrObj22RdrObjIdx_ZCR_CANFD5 "" UBYTE RB_RBA_Common_CentralElements_CompuMethods_Identical 1 100 0.0 255.00 FORMAT "%8.2" ECU_ADDRESS 0xfe4033e7 /end MEASUREMENT
/begin MEASUREMENT Tlib_PassDoorRdrObj21RdrObjSpeedStdY_ZCR_CANFD5 "" UBYTE RB_RBA_Common_CentralElements_CompuMethods_Identical 1 100 0.0 255.00 FORMAT "%8.2" ECU_ADDRESS 0xfe4033e8 /end MEASUREMENT
/begin MEASUREMENT Tlib_PassDoorRdrObj21RdrObjRangeY_ZCR_CANFD5 "" UWORD RB_RBA_Common_CentralElements_CompuMethods_Identical 1 100 0.0 65535 FORMAT "%8.2" ECU_ADDRESS 0xfe402a7e /end MEASUREMENT
/begin MEASUREMENT Tlib_PassDoorRdrObj21RdrObjSpeedStdX_ZCR_CANFD5 "" UBYTE RB_RBA_Common_CentralElements_CompuMethods_Identical 1 100 0.0 255.00 FORMAT "%8.2" ECU_ADDRESS 0xfe4033e9 /end MEASUREMENT
/begin MEASUREMENT Tlib_PassDoorRdrObj21RdrObjAccStdX_ZCR_CANFD5 "" UBYTE RB_RBA_Common_CentralElements_CompuMethods_Identical 1 100 0.0 255.00 FORMAT "%8.2" ECU_ADDRESS 0xfe4033ea /end MEASUREMENT
/begin MEASUREMENT Tlib_PassDoorRdrObj21RdrObjAccX_ZCR_CANFD5 "" UWORD RB_RBA_Common_CentralElements_CompuMethods_Identical 1 100 0.0 65535 FORMAT "%8.2" ECU_ADDRESS 0xfe402a80 /end MEASUREMENT
/begin MEASUREMENT Tlib_PassDoorRdrObj21RdrObjSpeedX_ZCR_CANFD5 "" UWORD RB_RBA_Common_CentralElements_CompuMethods_Identical 1 100 0.0 65535 FORMAT "%8.2" ECU_ADDRESS 0xfe402a82 /end MEASUREMENT
/begin MEASUREMENT Tlib_PassDoorRdrObj21RdrObjDataMode_ZCR_CANFD5 "" UBYTE RB_RBA_Common_CentralElements_CompuMethods_Identical 1 100 0.0 255.00 FORMAT "%8.2" ECU_ADDRESS 0xfe4033eb /end MEASUREMENT
/begin MEASUREMENT Tlib_PassDoorRdrObj21RdrObjRangeZ_ZCR_CANFD5 "" UWORD RB_RBA_Common_CentralElements_CompuMethods_Identical 1 100 0.0 65535 FORMAT "%8.2" ECU_ADDRESS 0xfe402a84 /end MEASUREMENT
/begin MEASUREMENT Tlib_PassDoorRdrObj21RdrObjIdx_ZCR_CANFD5 "" UBYTE RB_RBA_Common_CentralElements_CompuMethods_Identical 1 100 0.0 255.00 FORMAT "%8.2" ECU_ADDRESS 0xfe4033ec /end MEASUREMENT
/begin MEASUREMENT Tlib_PassDoorRdrObj21RdrObjSpeedY_ZCR_CANFD5 "" UWORD RB_RBA_Common_CentralElements_CompuMethods_Identical 1 100 0.0 65535 FORMAT "%8.2" ECU_ADDRESS 0xfe402a86 /end MEASUREMENT
/begin MEASUREMENT Tlib_PassDoorRdrObj21RdrObjMotionPattern_ZCR_CANFD5 "" UBYTE RB_RBA_Common_CentralElements_CompuMethods_Identical 1 100 0.0 255.00 FORMAT "%8.2" ECU_ADDRESS 0xfe4033ed /end MEASUREMENT
/begin MEASUREMENT Tlib_PassDoorRdrObj21RdrObjRangeX_ZCR_CANFD5 "" UWORD RB_RBA_Common_CentralElements_CompuMethods_Identical 1 100 0.0 65535 FORMAT "%8.2" ECU_ADDRESS 0xfe402a88 /end MEASUREMENT
/begin MEASUREMENT Tlib_PassDoorRdrObj21RdrObjTrackAge_ZCR_CANFD5 "" UBYTE RB_RBA_Common_CentralElements_CompuMethods_Identical 1 100 0.0 255.00 FORMAT "%8.2" ECU_ADDRESS 0xfe4033ee /end MEASUREMENT
/begin MEASUREMENT Tlib_PassDoorRdrObj21RdrObjTrackClass_ZCR_CANFD5 "" UBYTE RB_RBA_Common_CentralElements_CompuMethods_Identical 1 100 0.0 255.00 FORMAT "%8.2" ECU_ADDRESS 0xfe4033ef /end MEASUREMENT
/begin MEASUREMENT Tlib_PassDoorRdrObj21RdrObjAccStdY_ZCR_CANFD5 "" UBYTE RB_RBA_Common_CentralElements_CompuMethods_Identical 1 100 0.0 255.00 FORMAT "%8.2" ECU_ADDRESS 0xfe4033f0 /end MEASUREMENT
/begin MEASUREMENT Tlib_PassDoorRdrObj21RdrObjRangeStdX_ZCR_CANFD5 "" UBYTE RB_RBA_Common_CentralElements_CompuMethods_Identical 1 100 0.0 255.00 FORMAT "%8.2" ECU_ADDRESS 0xfe4033f1 /end MEASUREMENT
/begin MEASUREMENT Tlib_PassDoorRdrObj21RdrObjRangeStdY_ZCR_CANFD5 "" UBYTE RB_RBA_Common_CentralElements_CompuMethods_Identical 1 100 0.0 255.00 FORMAT "%8.2" ECU_ADDRESS 0xfe4033f2 /end MEASUREMENT
/begin MEASUREMENT Tlib_PassDoorRdrObj21RdrObjAccY_ZCR_CANFD5 "" UWORD RB_RBA_Common_CentralElements_CompuMethods_Identical 1 100 0.0 65535 FORMAT "%8.2" ECU_ADDRESS 0xfe402a8a /end MEASUREMENT
/begin MEASUREMENT Tlib_PassDoorRdrObj21RdrObjRangeStdZ_ZCR_CANFD5 "" UBYTE RB_RBA_Common_CentralElements_CompuMethods_Identical 1 100 0.0 255.00 FORMAT "%8.2" ECU_ADDRESS 0xfe4033f3 /end MEASUREMENT
/begin MEASUREMENT Tlib_PassDoorRdrObj21RdrObjConfidLvl_ZCR_CANFD5 "" UBYTE RB_RBA_Common_CentralElements_CompuMethods_Identical 1 100 0.0 255.00 FORMAT "%8.2" ECU_ADDRESS 0xfe4033f4 /end MEASUREMENT
/begin MEASUREMENT Tlib_PassDoorRdrObj5RdrObjIdx_ZCR_CANFD5 "" UBYTE RB_RBA_Common_CentralElements_CompuMethods_Identical 1 100 0.0 255.00 FORMAT "%8.2" ECU_ADDRESS 0xfe4033f5 /end MEASUREMENT
/begin MEASUREMENT Tlib_PassDoorRdrObj5RdrObjAccX_ZCR_CANFD5 "" UWORD RB_RBA_Common_CentralElements_CompuMethods_Identical 1 100 0.0 65535 FORMAT "%8.2" ECU_ADDRESS 0xfe402a8c /end MEASUREMENT
/begin MEASUREMENT Tlib_PassDoorRdrObj5RdrObjTrackAge_ZCR_CANFD5 "" UBYTE RB_RBA_Common_CentralElements_CompuMethods_Identical 1 100 0.0 255.00 FORMAT "%8.2" ECU_ADDRESS 0xfe4033f6 /end MEASUREMENT
/begin MEASUREMENT Tlib_PassDoorRdrObj5RdrObjSpeedY_ZCR_CANFD5 "" UWORD RB_RBA_Common_CentralElements_CompuMethods_Identical 1 100 0.0 65535 FORMAT "%8.2" ECU_ADDRESS 0xfe402a8e /end MEASUREMENT
/begin MEASUREMENT Tlib_PassDoorRdrObj5RdrObjTrackClass_ZCR_CANFD5 "" UBYTE RB_RBA_Common_CentralElements_CompuMethods_Identical 1 100 0.0 255.00 FORMAT "%8.2" ECU_ADDRESS 0xfe4033f7 /end MEASUREMENT
/begin MEASUREMENT Tlib_PassDoorRdrObj5RdrObjConfidLvl_ZCR_CANFD5 "" UBYTE RB_RBA_Common_CentralElements_CompuMethods_Identical 1 100 0.0 255.00 FORMAT "%8.2" ECU_ADDRESS 0xfe4033f8 /end MEASUREMENT
/begin MEASUREMENT Tlib_PassDoorRdrObj5RdrObjAccY_ZCR_CANFD5 "" UWORD RB_RBA_Common_CentralElements_CompuMethods_Identical 1 100 0.0 65535 FORMAT "%8.2" ECU_ADDRESS 0xfe402a90 /end MEASUREMENT
/begin MEASUREMENT Tlib_PassDoorRdrObj5RdrObjRangeStdZ_ZCR_CANFD5 "" UBYTE RB_RBA_Common_CentralElements_CompuMethods_Identical 1 100 0.0 255.00 FORMAT "%8.2" ECU_ADDRESS 0xfe4033f9 /end MEASUREMENT
/begin MEASUREMENT Tlib_PassDoorRdrObj5RdrObjRangeStdY_ZCR_CANFD5 "" UBYTE RB_RBA_Common_CentralElements_CompuMethods_Identical 1 100 0.0 255.00 FORMAT "%8.2" ECU_ADDRESS 0xfe4033fa /end MEASUREMENT
/begin MEASUREMENT Tlib_PassDoorRdrObj5RdrObjSpeedStdY_ZCR_CANFD5 "" UBYTE RB_RBA_Common_CentralElements_CompuMethods_Identical 1 100 0.0 255.00 FORMAT "%8.2" ECU_ADDRESS 0xfe4033fb /end MEASUREMENT
/begin MEASUREMENT Tlib_PassDoorRdrObj5RdrObjAccStdX_ZCR_CANFD5 "" UBYTE RB_RBA_Common_CentralElements_CompuMethods_Identical 1 100 0.0 255.00 FORMAT "%8.2" ECU_ADDRESS 0xfe4033fc /end MEASUREMENT
/begin MEASUREMENT Tlib_PassDoorRdrObj5RdrObjRangeY_ZCR_CANFD5 "" UWORD RB_RBA_Common_CentralElements_CompuMethods_Identical 1 100 0.0 65535 FORMAT "%8.2" ECU_ADDRESS 0xfe402a92 /end MEASUREMENT
/begin MEASUREMENT Tlib_PassDoorRdrObj5RdrObjSpeedStdX_ZCR_CANFD5 "" UBYTE RB_RBA_Common_CentralElements_CompuMethods_Identical 1 100 0.0 255.00 FORMAT "%8.2" ECU_ADDRESS 0xfe4033fd /end MEASUREMENT
/begin MEASUREMENT Tlib_PassDoorRdrObj5RdrObjRangeStdX_ZCR_CANFD5 "" UBYTE RB_RBA_Common_CentralElements_CompuMethods_Identical 1 100 0.0 255.00 FORMAT "%8.2" ECU_ADDRESS 0xfe4033fe /end MEASUREMENT
/begin MEASUREMENT Tlib_PassDoorRdrObj5RdrObjRangeX_ZCR_CANFD5 "" UWORD RB_RBA_Common_CentralElements_CompuMethods_Identical 1 100 0.0 65535 FORMAT "%8.2" ECU_ADDRESS 0xfe402a94 /end MEASUREMENT
/begin MEASUREMENT Tlib_PassDoorRdrObj5RdrObjAccStdY_ZCR_CANFD5 "" UBYTE RB_RBA_Common_CentralElements_CompuMethods_Identical 1 100 0.0 255.00 FORMAT "%8.2" ECU_ADDRESS 0xfe4033ff /end MEASUREMENT
/begin MEASUREMENT Tlib_PassDoorRdrObj5RdrObjRangeZ_ZCR_CANFD5 "" UWORD RB_RBA_Common_CentralElements_CompuMethods_Identical 1 100 0.0 65535 FORMAT "%8.2" ECU_ADDRESS 0xfe402a96 /end MEASUREMENT
/begin MEASUREMENT Tlib_PassDoorRdrObj5RdrObjDataMode_ZCR_CANFD5 "" UBYTE RB_RBA_Common_CentralElements_CompuMethods_Identical 1 100 0.0 255.00 FORMAT "%8.2" ECU_ADDRESS 0xfe403400 /end MEASUREMENT
/begin MEASUREMENT Tlib_PassDoorRdrObj5RdrObjMotionPattern_ZCR_CANFD5 "" UBYTE RB_RBA_Common_CentralElements_CompuMethods_Identical 1 100 0.0 255.00 FORMAT "%8.2" ECU_ADDRESS 0xfe403401 /end MEASUREMENT
/begin MEASUREMENT Tlib_PassDoorRdrObj5RdrObjSpeedX_ZCR_CANFD5 "" UWORD RB_RBA_Common_CentralElements_CompuMethods_Identical 1 100 0.0 65535 FORMAT "%8.2" ECU_ADDRESS 0xfe402a98 /end MEASUREMENT
/begin MEASUREMENT Tlib_PassDoorRdrObj7RdrObjRangeStdZ_ZCR_CANFD5 "" UBYTE RB_RBA_Common_CentralElements_CompuMethods_Identical 1 100 0.0 255.00 FORMAT "%8.2" ECU_ADDRESS 0xfe403402 /end MEASUREMENT
/begin MEASUREMENT Tlib_PassDoorRdrObj7RdrObjAccStdX_ZCR_CANFD5 "" UBYTE RB_RBA_Common_CentralElements_CompuMethods_Identical 1 100 0.0 255.00 FORMAT "%8.2" ECU_ADDRESS 0xfe403403 /end MEASUREMENT
/begin MEASUREMENT Tlib_PassDoorRdrObj7RdrObjSpeedStdX_ZCR_CANFD5 "" UBYTE RB_RBA_Common_CentralElements_CompuMethods_Identical 1 100 0.0 255.00 FORMAT "%8.2" ECU_ADDRESS 0xfe403404 /end MEASUREMENT
/begin MEASUREMENT Tlib_PassDoorRdrObj7RdrObjTrackAge_ZCR_CANFD5 "" UBYTE RB_RBA_Common_CentralElements_CompuMethods_Identical 1 100 0.0 255.00 FORMAT "%8.2" ECU_ADDRESS 0xfe403405 /end MEASUREMENT
/begin MEASUREMENT Tlib_PassDoorRdrObj7RdrObjAccStdY_ZCR_CANFD5 "" UBYTE RB_RBA_Common_CentralElements_CompuMethods_Identical 1 100 0.0 255.00 FORMAT "%8.2" ECU_ADDRESS 0xfe403406 /end MEASUREMENT
/begin MEASUREMENT Tlib_PassDoorRdrObj7RdrObjIdx_ZCR_CANFD5 "" UBYTE RB_RBA_Common_CentralElements_CompuMethods_Identical 1 100 0.0 255.00 FORMAT "%8.2" ECU_ADDRESS 0xfe403407 /end MEASUREMENT
/begin MEASUREMENT Tlib_PassDoorRdrObj7RdrObjSpeedY_ZCR_CANFD5 "" UWORD RB_RBA_Common_CentralElements_CompuMethods_Identical 1 100 0.0 65535 FORMAT "%8.2" ECU_ADDRESS 0xfe402a9a /end MEASUREMENT
/begin MEASUREMENT Tlib_PassDoorRdrObj7RdrObjRangeStdX_ZCR_CANFD5 "" UBYTE RB_RBA_Common_CentralElements_CompuMethods_Identical 1 100 0.0 255.00 FORMAT "%8.2" ECU_ADDRESS 0xfe403408 /end MEASUREMENT
/begin MEASUREMENT Tlib_PassDoorRdrObj7RdrObjTrackClass_ZCR_CANFD5 "" UBYTE RB_RBA_Common_CentralElements_CompuMethods_Identical 1 100 0.0 255.00 FORMAT "%8.2" ECU_ADDRESS 0xfe403409 /end MEASUREMENT
/begin MEASUREMENT Tlib_PassDoorRdrObj7RdrObjDataMode_ZCR_CANFD5 "" UBYTE RB_RBA_Common_CentralElements_CompuMethods_Identical 1 100 0.0 255.00 FORMAT "%8.2" ECU_ADDRESS 0xfe40340a /end MEASUREMENT
/begin MEASUREMENT Tlib_PassDoorRdrObj7RdrObjMotionPattern_ZCR_CANFD5 "" UBYTE RB_RBA_Common_CentralElements_CompuMethods_Identical 1 100 0.0 255.00 FORMAT "%8.2" ECU_ADDRESS 0xfe40340b /end MEASUREMENT
/begin MEASUREMENT Tlib_PassDoorRdrObj7RdrObjAccY_ZCR_CANFD5 "" UWORD RB_RBA_Common_CentralElements_CompuMethods_Identical 1 100 0.0 65535 FORMAT "%8.2" ECU_ADDRESS 0xfe402a9c /end MEASUREMENT
/begin MEASUREMENT Tlib_PassDoorRdrObj7RdrObjRangeStdY_ZCR_CANFD5 "" UBYTE RB_RBA_Common_CentralElements_CompuMethods_Identical 1 100 0.0 255.00 FORMAT "%8.2" ECU_ADDRESS 0xfe40340c /end MEASUREMENT
/begin MEASUREMENT Tlib_PassDoorRdrObj7RdrObjSpeedX_ZCR_CANFD5 "" UWORD RB_RBA_Common_CentralElements_CompuMethods_Identical 1 100 0.0 65535 FORMAT "%8.2" ECU_ADDRESS 0xfe402a9e /end MEASUREMENT
/begin MEASUREMENT Tlib_PassDoorRdrObj7RdrObjAccX_ZCR_CANFD5 "" UWORD RB_RBA_Common_CentralElements_CompuMethods_Identical 1 100 0.0 65535 FORMAT "%8.2" ECU_ADDRESS 0xfe402aa0 /end MEASUREMENT
/begin MEASUREMENT Tlib_PassDoorRdrObj7RdrObjConfidLvl_ZCR_CANFD5 "" UBYTE RB_RBA_Common_CentralElements_CompuMethods_Identical 1 100 0.0 255.00 FORMAT "%8.2" ECU_ADDRESS 0xfe40340d /end MEASUREMENT
/begin MEASUREMENT Tlib_PassDoorRdrObj7RdrObjRangeX_ZCR_CANFD5 "" UWORD RB_RBA_Common_CentralElements_CompuMethods_Identical 1 100 0.0 65535 FORMAT "%8.2" ECU_ADDRESS 0xfe402aa2 /end MEASUREMENT
/begin MEASUREMENT Tlib_PassDoorRdrObj7RdrObjRangeZ_ZCR_CANFD5 "" UWORD RB_RBA_Common_CentralElements_CompuMethods_Identical 1 100 0.0 65535 FORMAT "%8.2" ECU_ADDRESS 0xfe402aa4 /end MEASUREMENT
/begin MEASUREMENT Tlib_PassDoorRdrObj7RdrObjSpeedStdY_ZCR_CANFD5 "" UBYTE RB_RBA_Common_CentralElements_CompuMethods_Identical 1 100 0.0 255.00 FORMAT "%8.2" ECU_ADDRESS 0xfe40340e /end MEASUREMENT
/begin MEASUREMENT Tlib_PassDoorRdrObj7RdrObjRangeY_ZCR_CANFD5 "" UWORD RB_RBA_Common_CentralElements_CompuMethods_Identical 1 100 0.0 65535 FORMAT "%8.2" ECU_ADDRESS 0xfe402aa6 /end MEASUREMENT
/begin MEASUREMENT Tlib_PassDoorRdrObj6RdrObjConfidLvl_ZCR_CANFD5 "" UBYTE RB_RBA_Common_CentralElements_CompuMethods_Identical 1 100 0.0 255.00 FORMAT "%8.2" ECU_ADDRESS 0xfe40340f /end MEASUREMENT
/begin MEASUREMENT Tlib_PassDoorRdrObj6RdrObjAccY_ZCR_CANFD5 "" UWORD RB_RBA_Common_CentralElements_CompuMethods_Identical 1 100 0.0 65535 FORMAT "%8.2" ECU_ADDRESS 0xfe402aa8 /end MEASUREMENT
/begin MEASUREMENT Tlib_PassDoorRdrObj6RdrObjSpeedStdX_ZCR_CANFD5 "" UBYTE RB_RBA_Common_CentralElements_CompuMethods_Identical 1 100 0.0 255.00 FORMAT "%8.2" ECU_ADDRESS 0xfe403410 /end MEASUREMENT
/begin MEASUREMENT Tlib_PassDoorRdrObj6RdrObjIdx_ZCR_CANFD5 "" UBYTE RB_RBA_Common_CentralElements_CompuMethods_Identical 1 100 0.0 255.00 FORMAT "%8.2" ECU_ADDRESS 0xfe403411 /end MEASUREMENT
/begin MEASUREMENT Tlib_PassDoorRdrObj6RdrObjRangeZ_ZCR_CANFD5 "" UWORD RB_RBA_Common_CentralElements_CompuMethods_Identical 1 100 0.0 65535 FORMAT "%8.2" ECU_ADDRESS 0xfe402aaa /end MEASUREMENT
/begin MEASUREMENT Tlib_PassDoorRdrObj6RdrObjRangeStdY_ZCR_CANFD5 "" UBYTE RB_RBA_Common_CentralElements_CompuMethods_Identical 1 100 0.0 255.00 FORMAT "%8.2" ECU_ADDRESS 0xfe403412 /end MEASUREMENT
/begin MEASUREMENT Tlib_PassDoorRdrObj6RdrObjSpeedY_ZCR_CANFD5 "" UWORD RB_RBA_Common_CentralElements_CompuMethods_Identical 1 100 0.0 65535 FORMAT "%8.2" ECU_ADDRESS 0xfe402aac /end MEASUREMENT
/begin MEASUREMENT Tlib_PassDoorRdrObj6RdrObjRangeStdZ_ZCR_CANFD5 "" UBYTE RB_RBA_Common_CentralElements_CompuMethods_Identical 1 100 0.0 255.00 FORMAT "%8.2" ECU_ADDRESS 0xfe403413 /end MEASUREMENT
/begin MEASUREMENT Tlib_PassDoorRdrObj6RdrObjRangeY_ZCR_CANFD5 "" UWORD RB_RBA_Common_CentralElements_CompuMethods_Identical 1 100 0.0 65535 FORMAT "%8.2" ECU_ADDRESS 0xfe402aae /end MEASUREMENT
/begin MEASUREMENT Tlib_PassDoorRdrObj6RdrObjMotionPattern_ZCR_CANFD5 "" UBYTE RB_RBA_Common_CentralElements_CompuMethods_Identical 1 100 0.0 255.00 FORMAT "%8.2" ECU_ADDRESS 0xfe403414 /end MEASUREMENT
/begin MEASUREMENT Tlib_PassDoorRdrObj6RdrObjAccStdX_ZCR_CANFD5 "" UBYTE RB_RBA_Common_CentralElements_CompuMethods_Identical 1 100 0.0 255.00 FORMAT "%8.2" ECU_ADDRESS 0xfe403415 /end MEASUREMENT
/begin MEASUREMENT Tlib_PassDoorRdrObj6RdrObjAccStdY_ZCR_CANFD5 "" UBYTE RB_RBA_Common_CentralElements_CompuMethods_Identical 1 100 0.0 255.00 FORMAT "%8.2" ECU_ADDRESS 0xfe403416 /end MEASUREMENT
/begin MEASUREMENT Tlib_PassDoorRdrObj6RdrObjSpeedX_ZCR_CANFD5 "" UWORD RB_RBA_Common_CentralElements_CompuMethods_Identical 1 100 0.0 65535 FORMAT "%8.2" ECU_ADDRESS 0xfe402ab0 /end MEASUREMENT
/begin MEASUREMENT Tlib_PassDoorRdrObj6RdrObjSpeedStdY_ZCR_CANFD5 "" UBYTE RB_RBA_Common_CentralElements_CompuMethods_Identical 1 100 0.0 255.00 FORMAT "%8.2" ECU_ADDRESS 0xfe403417 /end MEASUREMENT
/begin MEASUREMENT Tlib_PassDoorRdrObj6RdrObjRangeX_ZCR_CANFD5 "" UWORD RB_RBA_Common_CentralElements_CompuMethods_Identical 1 100 0.0 65535 FORMAT "%8.2" ECU_ADDRESS 0xfe402ab2 /end MEASUREMENT
/begin MEASUREMENT Tlib_PassDoorRdrObj6RdrObjDataMode_ZCR_CANFD5 "" UBYTE RB_RBA_Common_CentralElements_CompuMethods_Identical 1 100 0.0 255.00 FORMAT "%8.2" ECU_ADDRESS 0xfe403418 /end MEASUREMENT
/begin MEASUREMENT Tlib_PassDoorRdrObj6RdrObjRangeStdX_ZCR_CANFD5 "" UBYTE RB_RBA_Common_CentralElements_CompuMethods_Identical 1 100 0.0 255.00 FORMAT "%8.2" ECU_ADDRESS 0xfe403419 /end MEASUREMENT
/begin MEASUREMENT Tlib_PassDoorRdrObj6RdrObjAccX_ZCR_CANFD5 "" UWORD RB_RBA_Common_CentralElements_CompuMethods_Identical 1 100 0.0 65535 FORMAT "%8.2" ECU_ADDRESS 0xfe402ab4 /end MEASUREMENT
/begin MEASUREMENT Tlib_PassDoorRdrObj6RdrObjTrackAge_ZCR_CANFD5 "" UBYTE RB_RBA_Common_CentralElements_CompuMethods_Identical 1 100 0.0 255.00 FORMAT "%8.2" ECU_ADDRESS 0xfe40341a /end MEASUREMENT
/begin MEASUREMENT Tlib_PassDoorRdrObj6RdrObjTrackClass_ZCR_CANFD5 "" UBYTE RB_RBA_Common_CentralElements_CompuMethods_Identical 1 100 0.0 255.00 FORMAT "%8.2" ECU_ADDRESS 0xfe40341b /end MEASUREMENT
/begin MEASUREMENT Tlib_RiReDoorRdrObj18RdrObjAccStdX_ZCR_CANFD5 "" UBYTE RB_RBA_Common_CentralElements_CompuMethods_Identical 1 100 0.0 255.00 FORMAT "%8.2" ECU_ADDRESS 0xfe40341c /end MEASUREMENT
/begin MEASUREMENT Tlib_RiReDoorRdrObj18RdrObjAccStdY_ZCR_CANFD5 "" UBYTE RB_RBA_Common_CentralElements_CompuMethods_Identical 1 100 0.0 255.00 FORMAT "%8.2" ECU_ADDRESS 0xfe40341d /end MEASUREMENT
/begin MEASUREMENT Tlib_RiReDoorRdrObj18RdrObjAccX_ZCR_CANFD5 "" UWORD RB_RBA_Common_CentralElements_CompuMethods_Identical 1 100 0.0 65535 FORMAT "%8.2" ECU_ADDRESS 0xfe402ab6 /end MEASUREMENT
/begin MEASUREMENT Tlib_RiReDoorRdrObj18RdrObjRangeStdX_ZCR_CANFD5 "" UBYTE RB_RBA_Common_CentralElements_CompuMethods_Identical 1 100 0.0 255.00 FORMAT "%8.2" ECU_ADDRESS 0xfe40341e /end MEASUREMENT
/begin MEASUREMENT Tlib_RiReDoorRdrObj18RdrObjTrackAge_ZCR_CANFD5 "" UBYTE RB_RBA_Common_CentralElements_CompuMethods_Identical 1 100 0.0 255.00 FORMAT "%8.2" ECU_ADDRESS 0xfe40341f /end MEASUREMENT
/begin MEASUREMENT Tlib_RiReDoorRdrObj18RdrObjIdx_ZCR_CANFD5 "" UBYTE RB_RBA_Common_CentralElements_CompuMethods_Identical 1 100 0.0 255.00 FORMAT "%8.2" ECU_ADDRESS 0xfe403420 /end MEASUREMENT
/begin MEASUREMENT Tlib_RiReDoorRdrObj18RdrObjRangeStdY_ZCR_CANFD5 "" UBYTE RB_RBA_Common_CentralElements_CompuMethods_Identical 1 100 0.0 255.00 FORMAT "%8.2" ECU_ADDRESS 0xfe403421 /end MEASUREMENT
/begin MEASUREMENT Tlib_RiReDoorRdrObj18RdrObjRangeX_ZCR_CANFD5 "" UWORD RB_RBA_Common_CentralElements_CompuMethods_Identical 1 100 0.0 65535 FORMAT "%8.2" ECU_ADDRESS 0xfe402ab8 /end MEASUREMENT
/begin MEASUREMENT Tlib_RiReDoorRdrObj18RdrObjRangeY_ZCR_CANFD5 "" UWORD RB_RBA_Common_CentralElements_CompuMethods_Identical 1 100 0.0 65535 FORMAT "%8.2" ECU_ADDRESS 0xfe402aba /end MEASUREMENT
/begin MEASUREMENT Tlib_RiReDoorRdrObj18RdrObjSpeedX_ZCR_CANFD5 "" UWORD RB_RBA_Common_CentralElements_CompuMethods_Identical 1 100 0.0 65535 FORMAT "%8.2" ECU_ADDRESS 0xfe402abc /end MEASUREMENT
/begin MEASUREMENT Tlib_RiReDoorRdrObj18RdrObjMotionPattern_ZCR_CANFD5 "" UBYTE RB_RBA_Common_CentralElements_CompuMethods_Identical 1 100 0.0 255.00 FORMAT "%8.2" ECU_ADDRESS 0xfe403422 /end MEASUREMENT
/begin MEASUREMENT Tlib_RiReDoorRdrObj18RdrObjDataMode_ZCR_CANFD5 "" UBYTE RB_RBA_Common_CentralElements_CompuMethods_Identical 1 100 0.0 255.00 FORMAT "%8.2" ECU_ADDRESS 0xfe403423 /end MEASUREMENT
/begin MEASUREMENT Tlib_RiReDoorRdrObj18RdrObjTrackClass_ZCR_CANFD5 "" UBYTE RB_RBA_Common_CentralElements_CompuMethods_Identical 1 100 0.0 255.00 FORMAT "%8.2" ECU_ADDRESS 0xfe403424 /end MEASUREMENT
/begin MEASUREMENT Tlib_RiReDoorRdrObj18RdrObjRangeStdZ_ZCR_CANFD5 "" UBYTE RB_RBA_Common_CentralElements_CompuMethods_Identical 1 100 0.0 255.00 FORMAT "%8.2" ECU_ADDRESS 0xfe403425 /end MEASUREMENT
/begin MEASUREMENT Tlib_RiReDoorRdrObj18RdrObjSpeedY_ZCR_CANFD5 "" UWORD RB_RBA_Common_CentralElements_CompuMethods_Identical 1 100 0.0 65535 FORMAT "%8.2" ECU_ADDRESS 0xfe402abe /end MEASUREMENT
/begin MEASUREMENT Tlib_RiReDoorRdrObj18RdrObjConfidLvl_ZCR_CANFD5 "" UBYTE RB_RBA_Common_CentralElements_CompuMethods_Identical 1 100 0.0 255.00 FORMAT "%8.2" ECU_ADDRESS 0xfe403426 /end MEASUREMENT
/begin MEASUREMENT Tlib_RiReDoorRdrObj18RdrObjAccY_ZCR_CANFD5 "" UWORD RB_RBA_Common_CentralElements_CompuMethods_Identical 1 100 0.0 65535 FORMAT "%8.2" ECU_ADDRESS 0xfe402ac0 /end MEASUREMENT
/begin MEASUREMENT Tlib_RiReDoorRdrObj18RdrObjSpeedStdY_ZCR_CANFD5 "" UBYTE RB_RBA_Common_CentralElements_CompuMethods_Identical 1 100 0.0 255.00 FORMAT "%8.2" ECU_ADDRESS 0xfe403427 /end MEASUREMENT
/begin MEASUREMENT Tlib_RiReDoorRdrObj18RdrObjRangeZ_ZCR_CANFD5 "" UWORD RB_RBA_Common_CentralElements_CompuMethods_Identical 1 100 0.0 65535 FORMAT "%8.2" ECU_ADDRESS 0xfe402ac2 /end MEASUREMENT
/begin MEASUREMENT Tlib_RiReDoorRdrObj18RdrObjSpeedStdX_ZCR_CANFD5 "" UBYTE RB_RBA_Common_CentralElements_CompuMethods_Identical 1 100 0.0 255.00 FORMAT "%8.2" ECU_ADDRESS 0xfe403428 /end MEASUREMENT
/begin MEASUREMENT Tlib_RiReDoorRdrObj2RdrObjSpeedStdY_ZCR_CANFD5 "" UBYTE RB_RBA_Common_CentralElements_CompuMethods_Identical 1 100 0.0 255.00 FORMAT "%8.2" ECU_ADDRESS 0xfe403429 /end MEASUREMENT
/begin MEASUREMENT Tlib_RiReDoorRdrObj2RdrObjMotionPattern_ZCR_CANFD5 "" UBYTE RB_RBA_Common_CentralElements_CompuMethods_Identical 1 100 0.0 255.00 FORMAT "%8.2" ECU_ADDRESS 0xfe40342a /end MEASUREMENT
/begin MEASUREMENT Tlib_RiReDoorRdrObj2RdrObjAccX_ZCR_CANFD5 "" UWORD RB_RBA_Common_CentralElements_CompuMethods_Identical 1 100 0.0 65535 FORMAT "%8.2" ECU_ADDRESS 0xfe402ac4 /end MEASUREMENT
/begin MEASUREMENT Tlib_RiReDoorRdrObj2RdrObjRangeZ_ZCR_CANFD5 "" UWORD RB_RBA_Common_CentralElements_CompuMethods_Identical 1 100 0.0 65535 FORMAT "%8.2" ECU_ADDRESS 0xfe402ac6 /end MEASUREMENT
/begin MEASUREMENT Tlib_RiReDoorRdrObj2RdrObjRangeStdY_ZCR_CANFD5 "" UBYTE RB_RBA_Common_CentralElements_CompuMethods_Identical 1 100 0.0 255.00 FORMAT "%8.2" ECU_ADDRESS 0xfe40342b /end MEASUREMENT
/begin MEASUREMENT Tlib_RiReDoorRdrObj2RdrObjAccY_ZCR_CANFD5 "" UWORD RB_RBA_Common_CentralElements_CompuMethods_Identical 1 100 0.0 65535 FORMAT "%8.2" ECU_ADDRESS 0xfe402ac8 /end MEASUREMENT
/begin MEASUREMENT Tlib_RiReDoorRdrObj2RdrObjAccStdX_ZCR_CANFD5 "" UBYTE RB_RBA_Common_CentralElements_CompuMethods_Identical 1 100 0.0 255.00 FORMAT "%8.2" ECU_ADDRESS 0xfe40342c /end MEASUREMENT
/begin MEASUREMENT Tlib_RiReDoorRdrObj2RdrObjRangeY_ZCR_CANFD5 "" UWORD RB_RBA_Common_CentralElements_CompuMethods_Identical 1 100 0.0 65535 FORMAT "%8.2" ECU_ADDRESS 0xfe402aca /end MEASUREMENT
/begin MEASUREMENT Tlib_RiReDoorRdrObj2RdrObjAccStdY_ZCR_CANFD5 "" UBYTE RB_RBA_Common_CentralElements_CompuMethods_Identical 1 100 0.0 255.00 FORMAT "%8.2" ECU_ADDRESS 0xfe40342d /end MEASUREMENT
/begin MEASUREMENT Tlib_RiReDoorRdrObj2RdrObjIdx_ZCR_CANFD5 "" UBYTE RB_RBA_Common_CentralElements_CompuMethods_Identical 1 100 0.0 255.00 FORMAT "%8.2" ECU_ADDRESS 0xfe40342e /end MEASUREMENT
/begin MEASUREMENT Tlib_RiReDoorRdrObj2RdrObjConfidLvl_ZCR_CANFD5 "" UBYTE RB_RBA_Common_CentralElements_CompuMethods_Identical 1 100 0.0 255.00 FORMAT "%8.2" ECU_ADDRESS 0xfe40342f /end MEASUREMENT
/begin MEASUREMENT Tlib_RiReDoorRdrObj2RdrObjSpeedX_ZCR_CANFD5 "" UWORD RB_RBA_Common_CentralElements_CompuMethods_Identical 1 100 0.0 65535 FORMAT "%8.2" ECU_ADDRESS 0xfe402acc /end MEASUREMENT
/begin MEASUREMENT Tlib_RiReDoorRdrObj2RdrObjTrackAge_ZCR_CANFD5 "" UBYTE RB_RBA_Common_CentralElements_CompuMethods_Identical 1 100 0.0 255.00 FORMAT "%8.2" ECU_ADDRESS 0xfe403430 /end MEASUREMENT
/begin MEASUREMENT Tlib_RiReDoorRdrObj2RdrObjTrackClass_ZCR_CANFD5 "" UBYTE RB_RBA_Common_CentralElements_CompuMethods_Identical 1 100 0.0 255.00 FORMAT "%8.2" ECU_ADDRESS 0xfe403431 /end MEASUREMENT
/begin MEASUREMENT Tlib_RiReDoorRdrObj2RdrObjSpeedStdX_ZCR_CANFD5 "" UBYTE RB_RBA_Common_CentralElements_CompuMethods_Identical 1 100 0.0 255.00 FORMAT "%8.2" ECU_ADDRESS 0xfe403432 /end MEASUREMENT
/begin MEASUREMENT Tlib_RiReDoorRdrObj2RdrObjRangeStdZ_ZCR_CANFD5 "" UBYTE RB_RBA_Common_CentralElements_CompuMethods_Identical 1 100 0.0 255.00 FORMAT "%8.2" ECU_ADDRESS 0xfe403433 /end MEASUREMENT
/begin MEASUREMENT Tlib_RiReDoorRdrObj2RdrObjRangeStdX_ZCR_CANFD5 "" UBYTE RB_RBA_Common_CentralElements_CompuMethods_Identical 1 100 0.0 255.00 FORMAT "%8.2" ECU_ADDRESS 0xfe403434 /end MEASUREMENT
/begin MEASUREMENT Tlib_RiReDoorRdrObj2RdrObjRangeX_ZCR_CANFD5 "" UWORD RB_RBA_Common_CentralElements_CompuMethods_Identical 1 100 0.0 65535 FORMAT "%8.2" ECU_ADDRESS 0xfe402ace /end MEASUREMENT
/begin MEASUREMENT Tlib_RiReDoorRdrObj2RdrObjSpeedY_ZCR_CANFD5 "" UWORD RB_RBA_Common_CentralElements_CompuMethods_Identical 1 100 0.0 65535 FORMAT "%8.2" ECU_ADDRESS 0xfe402ad0 /end MEASUREMENT
/begin MEASUREMENT Tlib_RiReDoorRdrObj2RdrObjDataMode_ZCR_CANFD5 "" UBYTE RB_RBA_Common_CentralElements_CompuMethods_Identical 1 100 0.0 255.00 FORMAT "%8.2" ECU_ADDRESS 0xfe403435 /end MEASUREMENT
/begin MEASUREMENT Tlib_RiReDoorRdrObj19RdrObjIdx_ZCR_CANFD5 "" UBYTE RB_RBA_Common_CentralElements_CompuMethods_Identical 1 100 0.0 255.00 FORMAT "%8.2" ECU_ADDRESS 0xfe403436 /end MEASUREMENT
/begin MEASUREMENT Tlib_RiReDoorRdrObj19RdrObjRangeX_ZCR_CANFD5 "" UWORD RB_RBA_Common_CentralElements_CompuMethods_Identical 1 100 0.0 65535 FORMAT "%8.2" ECU_ADDRESS 0xfe402ad2 /end MEASUREMENT
/begin MEASUREMENT Tlib_RiReDoorRdrObj19RdrObjMotionPattern_ZCR_CANFD5 "" UBYTE RB_RBA_Common_CentralElements_CompuMethods_Identical 1 100 0.0 255.00 FORMAT "%8.2" ECU_ADDRESS 0xfe403437 /end MEASUREMENT
/begin MEASUREMENT Tlib_RiReDoorRdrObj19RdrObjSpeedX_ZCR_CANFD5 "" UWORD RB_RBA_Common_CentralElements_CompuMethods_Identical 1 100 0.0 65535 FORMAT "%8.2" ECU_ADDRESS 0xfe402ad4 /end MEASUREMENT
/begin MEASUREMENT Tlib_RiReDoorRdrObj19RdrObjRangeStdY_ZCR_CANFD5 "" UBYTE RB_RBA_Common_CentralElements_CompuMethods_Identical 1 100 0.0 255.00 FORMAT "%8.2" ECU_ADDRESS 0xfe403438 /end MEASUREMENT
/begin MEASUREMENT Tlib_RiReDoorRdrObj19RdrObjAccStdX_ZCR_CANFD5 "" UBYTE RB_RBA_Common_CentralElements_CompuMethods_Identical 1 100 0.0 255.00 FORMAT "%8.2" ECU_ADDRESS 0xfe403439 /end MEASUREMENT
/begin MEASUREMENT Tlib_RiReDoorRdrObj19RdrObjAccStdY_ZCR_CANFD5 "" UBYTE RB_RBA_Common_CentralElements_CompuMethods_Identical 1 100 0.0 255.00 FORMAT "%8.2" ECU_ADDRESS 0xfe40343a /end MEASUREMENT
/begin MEASUREMENT Tlib_RiReDoorRdrObj19RdrObjSpeedY_ZCR_CANFD5 "" UWORD RB_RBA_Common_CentralElements_CompuMethods_Identical 1 100 0.0 65535 FORMAT "%8.2" ECU_ADDRESS 0xfe402ad6 /end MEASUREMENT
/begin MEASUREMENT Tlib_RiReDoorRdrObj19RdrObjTrackAge_ZCR_CANFD5 "" UBYTE RB_RBA_Common_CentralElements_CompuMethods_Identical 1 100 0.0 255.00 FORMAT "%8.2" ECU_ADDRESS 0xfe40343b /end MEASUREMENT
/begin MEASUREMENT Tlib_RiReDoorRdrObj19RdrObjRangeZ_ZCR_CANFD5 "" UWORD RB_RBA_Common_CentralElements_CompuMethods_Identical 1 100 0.0 65535 FORMAT "%8.2" ECU_ADDRESS 0xfe402ad8 /end MEASUREMENT
/begin MEASUREMENT Tlib_RiReDoorRdrObj19RdrObjSpeedStdX_ZCR_CANFD5 "" UBYTE RB_RBA_Common_CentralElements_CompuMethods_Identical 1 100 0.0 255.00 FORMAT "%8.2" ECU_ADDRESS 0xfe40343c /end MEASUREMENT
/begin MEASUREMENT Tlib_RiReDoorRdrObj19RdrObjDataMode_ZCR_CANFD5 "" UBYTE RB_RBA_Common_CentralElements_CompuMethods_Identical 1 100 0.0 255.00 FORMAT "%8.2" ECU_ADDRESS 0xfe40343d /end MEASUREMENT
/begin MEASUREMENT Tlib_RiReDoorRdrObj19RdrObjRangeStdX_ZCR_CANFD5 "" UBYTE RB_RBA_Common_CentralElements_CompuMethods_Identical 1 100 0.0 255.00 FORMAT "%8.2" ECU_ADDRESS 0xfe40343e /end MEASUREMENT
/begin MEASUREMENT Tlib_RiReDoorRdrObj19RdrObjConfidLvl_ZCR_CANFD5 "" UBYTE RB_RBA_Common_CentralElements_CompuMethods_Identical 1 100 0.0 255.00 FORMAT "%8.2" ECU_ADDRESS 0xfe40343f /end MEASUREMENT
/begin MEASUREMENT Tlib_RiReDoorRdrObj19RdrObjAccY_ZCR_CANFD5 "" UWORD RB_RBA_Common_CentralElements_CompuMethods_Identical 1 100 0.0 65535 FORMAT "%8.2" ECU_ADDRESS 0xfe402ada /end MEASUREMENT
/begin MEASUREMENT Tlib_RiReDoorRdrObj19RdrObjRangeY_ZCR_CANFD5 "" UWORD RB_RBA_Common_CentralElements_CompuMethods_Identical 1 100 0.0 65535 FORMAT "%8.2" ECU_ADDRESS 0xfe402adc /end MEASUREMENT
/begin MEASUREMENT Tlib_RiReDoorRdrObj19RdrObjTrackClass_ZCR_CANFD5 "" UBYTE RB_RBA_Common_CentralElements_CompuMethods_Identical 1 100 0.0 255.00 FORMAT "%8.2" ECU_ADDRESS 0xfe403440 /end MEASUREMENT
/begin MEASUREMENT Tlib_RiReDoorRdrObj19RdrObjRangeStdZ_ZCR_CANFD5 "" UBYTE RB_RBA_Common_CentralElements_CompuMethods_Identical 1 100 0.0 255.00 FORMAT "%8.2" ECU_ADDRESS 0xfe403441 /end MEASUREMENT
/begin MEASUREMENT Tlib_RiReDoorRdrObj19RdrObjSpeedStdY_ZCR_CANFD5 "" UBYTE RB_RBA_Common_CentralElements_CompuMethods_Identical 1 100 0.0 255.00 FORMAT "%8.2" ECU_ADDRESS 0xfe403442 /end MEASUREMENT
/begin MEASUREMENT Tlib_RiReDoorRdrObj19RdrObjAccX_ZCR_CANFD5 "" UWORD RB_RBA_Common_CentralElements_CompuMethods_Identical 1 100 0.0 65535 FORMAT "%8.2" ECU_ADDRESS 0xfe402ade /end MEASUREMENT
/begin MEASUREMENT Tlib_RiReDoorRdrObj1RdrObjConfidLvl_ZCR_CANFD5 "" UBYTE RB_RBA_Common_CentralElements_CompuMethods_Identical 1 100 0.0 255.00 FORMAT "%8.2" ECU_ADDRESS 0xfe403443 /end MEASUREMENT
/begin MEASUREMENT Tlib_RiReDoorRdrObj1RdrObjMotionPattern_ZCR_CANFD5 "" UBYTE RB_RBA_Common_CentralElements_CompuMethods_Identical 1 100 0.0 255.00 FORMAT "%8.2" ECU_ADDRESS 0xfe403444 /end MEASUREMENT
/begin MEASUREMENT Tlib_RiReDoorRdrObj1RdrObjRangeY_ZCR_CANFD5 "" UWORD RB_RBA_Common_CentralElements_CompuMethods_Identical 1 100 0.0 65535 FORMAT "%8.2" ECU_ADDRESS 0xfe402ae0 /end MEASUREMENT
/begin MEASUREMENT Tlib_RiReDoorRdrObj1RdrObjRangeStdZ_ZCR_CANFD5 "" UBYTE RB_RBA_Common_CentralElements_CompuMethods_Identical 1 100 0.0 255.00 FORMAT "%8.2" ECU_ADDRESS 0xfe403445 /end MEASUREMENT
/begin MEASUREMENT Tlib_RiReDoorRdrObj1RdrObjAccY_ZCR_CANFD5 "" UWORD RB_RBA_Common_CentralElements_CompuMethods_Identical 1 100 0.0 65535 FORMAT "%8.2" ECU_ADDRESS 0xfe402ae2 /end MEASUREMENT
/begin MEASUREMENT Tlib_RiReDoorRdrObj1RdrObjTrackClass_ZCR_CANFD5 "" UBYTE RB_RBA_Common_CentralElements_CompuMethods_Identical 1 100 0.0 255.00 FORMAT "%8.2" ECU_ADDRESS 0xfe403446 /end MEASUREMENT
/begin MEASUREMENT Tlib_RiReDoorRdrObj1RdrObjAccStdX_ZCR_CANFD5 "" UBYTE RB_RBA_Common_CentralElements_CompuMethods_Identical 1 100 0.0 255.00 FORMAT "%8.2" ECU_ADDRESS 0xfe403447 /end MEASUREMENT
/begin MEASUREMENT Tlib_RiReDoorRdrObj1RdrObjAccX_ZCR_CANFD5 "" UWORD RB_RBA_Common_CentralElements_CompuMethods_Identical 1 100 0.0 65535 FORMAT "%8.2" ECU_ADDRESS 0xfe402ae4 /end MEASUREMENT
/begin MEASUREMENT Tlib_RiReDoorRdrObj1RdrObjDataMode_ZCR_CANFD5 "" UBYTE RB_RBA_Common_CentralElements_CompuMethods_Identical 1 100 0.0 255.00 FORMAT "%8.2" ECU_ADDRESS 0xfe403448 /end MEASUREMENT
/begin MEASUREMENT Tlib_RiReDoorRdrObj1RdrObjRangeX_ZCR_CANFD5 "" UWORD RB_RBA_Common_CentralElements_CompuMethods_Identical 1 100 0.0 65535 FORMAT "%8.2" ECU_ADDRESS 0xfe402ae6 /end MEASUREMENT
/begin MEASUREMENT Tlib_RiReDoorRdrObj1RdrObjRangeStdY_ZCR_CANFD5 "" UBYTE RB_RBA_Common_CentralElements_CompuMethods_Identical 1 100 0.0 255.00 FORMAT "%8.2" ECU_ADDRESS 0xfe403449 /end MEASUREMENT
/begin MEASUREMENT Tlib_RiReDoorRdrObj1RdrObjAccStdY_ZCR_CANFD5 "" UBYTE RB_RBA_Common_CentralElements_CompuMethods_Identical 1 100 0.0 255.00 FORMAT "%8.2" ECU_ADDRESS 0xfe40344a /end MEASUREMENT
/begin MEASUREMENT Tlib_RiReDoorRdrObj1RdrObjSpeedY_ZCR_CANFD5 "" UWORD RB_RBA_Common_CentralElements_CompuMethods_Identical 1 100 0.0 65535 FORMAT "%8.2" ECU_ADDRESS 0xfe402ae8 /end MEASUREMENT
/begin MEASUREMENT Tlib_RiReDoorRdrObj1RdrObjSpeedStdY_ZCR_CANFD5 "" UBYTE RB_RBA_Common_CentralElements_CompuMethods_Identical 1 100 0.0 255.00 FORMAT "%8.2" ECU_ADDRESS 0xfe40344b /end MEASUREMENT
/begin MEASUREMENT Tlib_RiReDoorRdrObj1RdrObjRangeStdX_ZCR_CANFD5 "" UBYTE RB_RBA_Common_CentralElements_CompuMethods_Identical 1 100 0.0 255.00 FORMAT "%8.2" ECU_ADDRESS 0xfe40344c /end MEASUREMENT
/begin MEASUREMENT Tlib_RiReDoorRdrObj1RdrObjIdx_ZCR_CANFD5 "" UBYTE RB_RBA_Common_CentralElements_CompuMethods_Identical 1 100 0.0 255.00 FORMAT "%8.2" ECU_ADDRESS 0xfe40344d /end MEASUREMENT
/begin MEASUREMENT Tlib_RiReDoorRdrObj1RdrObjSpeedStdX_ZCR_CANFD5 "" UBYTE RB_RBA_Common_CentralElements_CompuMethods_Identical 1 100 0.0 255.00 FORMAT "%8.2" ECU_ADDRESS 0xfe40344e /end MEASUREMENT
/begin MEASUREMENT Tlib_RiReDoorRdrObj1RdrObjTrackAge_ZCR_CANFD5 "" UBYTE RB_RBA_Common_CentralElements_CompuMethods_Identical 1 100 0.0 255.00 FORMAT "%8.2" ECU_ADDRESS 0xfe40344f /end MEASUREMENT
/begin MEASUREMENT Tlib_RiReDoorRdrObj1RdrObjSpeedX_ZCR_CANFD5 "" UWORD RB_RBA_Common_CentralElements_CompuMethods_Identical 1 100 0.0 65535 FORMAT "%8.2" ECU_ADDRESS 0xfe402aea /end MEASUREMENT
/begin MEASUREMENT Tlib_RiReDoorRdrObj1RdrObjRangeZ_ZCR_CANFD5 "" UWORD RB_RBA_Common_CentralElements_CompuMethods_Identical 1 100 0.0 65535 FORMAT "%8.2" ECU_ADDRESS 0xfe402aec /end MEASUREMENT
/begin MEASUREMENT Tlib_RiReDoorRdrObj10RdrObjRangeX_ZCR_CANFD5 "" UWORD RB_RBA_Common_CentralElements_CompuMethods_Identical 1 100 0.0 65535 FORMAT "%8.2" ECU_ADDRESS 0xfe402aee /end MEASUREMENT
/begin MEASUREMENT Tlib_RiReDoorRdrObj10RdrObjAccStdY_ZCR_CANFD5 "" UBYTE RB_RBA_Common_CentralElements_CompuMethods_Identical 1 100 0.0 255.00 FORMAT "%8.2" ECU_ADDRESS 0xfe403450 /end MEASUREMENT
/begin MEASUREMENT Tlib_RiReDoorRdrObj10RdrObjRangeStdX_ZCR_CANFD5 "" UBYTE RB_RBA_Common_CentralElements_CompuMethods_Identical 1 100 0.0 255.00 FORMAT "%8.2" ECU_ADDRESS 0xfe403451 /end MEASUREMENT
/begin MEASUREMENT Tlib_RiReDoorRdrObj10RdrObjRangeStdY_ZCR_CANFD5 "" UBYTE RB_RBA_Common_CentralElements_CompuMethods_Identical 1 100 0.0 255.00 FORMAT "%8.2" ECU_ADDRESS 0xfe403452 /end MEASUREMENT
/begin MEASUREMENT Tlib_RiReDoorRdrObj10RdrObjRangeZ_ZCR_CANFD5 "" UWORD RB_RBA_Common_CentralElements_CompuMethods_Identical 1 100 0.0 65535 FORMAT "%8.2" ECU_ADDRESS 0xfe402af0 /end MEASUREMENT
/begin MEASUREMENT Tlib_RiReDoorRdrObj10RdrObjIdx_ZCR_CANFD5 "" UBYTE RB_RBA_Common_CentralElements_CompuMethods_Identical 1 100 0.0 255.00 FORMAT "%8.2" ECU_ADDRESS 0xfe403453 /end MEASUREMENT
/begin MEASUREMENT Tlib_RiReDoorRdrObj10RdrObjTrackClass_ZCR_CANFD5 "" UBYTE RB_RBA_Common_CentralElements_CompuMethods_Identical 1 100 0.0 255.00 FORMAT "%8.2" ECU_ADDRESS 0xfe403454 /end MEASUREMENT
/begin MEASUREMENT Tlib_RiReDoorRdrObj10RdrObjSpeedStdY_ZCR_CANFD5 "" UBYTE RB_RBA_Common_CentralElements_CompuMethods_Identical 1 100 0.0 255.00 FORMAT "%8.2" ECU_ADDRESS 0xfe403455 /end MEASUREMENT
/begin MEASUREMENT Tlib_RiReDoorRdrObj10RdrObjAccX_ZCR_CANFD5 "" UWORD RB_RBA_Common_CentralElements_CompuMethods_Identical 1 100 0.0 65535 FORMAT "%8.2" ECU_ADDRESS 0xfe402af2 /end MEASUREMENT
/begin MEASUREMENT Tlib_RiReDoorRdrObj10RdrObjRangeY_ZCR_CANFD5 "" UWORD RB_RBA_Common_CentralElements_CompuMethods_Identical 1 100 0.0 65535 FORMAT "%8.2" ECU_ADDRESS 0xfe402af4 /end MEASUREMENT
/begin MEASUREMENT Tlib_RiReDoorRdrObj10RdrObjTrackAge_ZCR_CANFD5 "" UBYTE RB_RBA_Common_CentralElements_CompuMethods_Identical 1 100 0.0 255.00 FORMAT "%8.2" ECU_ADDRESS 0xfe403456 /end MEASUREMENT
/begin MEASUREMENT Tlib_RiReDoorRdrObj10RdrObjAccStdX_ZCR_CANFD5 "" UBYTE RB_RBA_Common_CentralElements_CompuMethods_Identical 1 100 0.0 255.00 FORMAT "%8.2" ECU_ADDRESS 0xfe403457 /end MEASUREMENT
/begin MEASUREMENT Tlib_RiReDoorRdrObj10RdrObjSpeedY_ZCR_CANFD5 "" UWORD RB_RBA_Common_CentralElements_CompuMethods_Identical 1 100 0.0 65535 FORMAT "%8.2" ECU_ADDRESS 0xfe402af6 /end MEASUREMENT
/begin MEASUREMENT Tlib_RiReDoorRdrObj10RdrObjMotionPattern_ZCR_CANFD5 "" UBYTE RB_RBA_Common_CentralElements_CompuMethods_Identical 1 100 0.0 255.00 FORMAT "%8.2" ECU_ADDRESS 0xfe403458 /end MEASUREMENT
/begin MEASUREMENT Tlib_RiReDoorRdrObj10RdrObjSpeedStdX_ZCR_CANFD5 "" UBYTE RB_RBA_Common_CentralElements_CompuMethods_Identical 1 100 0.0 255.00 FORMAT "%8.2" ECU_ADDRESS 0xfe403459 /end MEASUREMENT
/begin MEASUREMENT Tlib_RiReDoorRdrObj10RdrObjDataMode_ZCR_CANFD5 "" UBYTE RB_RBA_Common_CentralElements_CompuMethods_Identical 1 100 0.0 255.00 FORMAT "%8.2" ECU_ADDRESS 0xfe40345a /end MEASUREMENT
/begin MEASUREMENT Tlib_RiReDoorRdrObj10RdrObjAccY_ZCR_CANFD5 "" UWORD RB_RBA_Common_CentralElements_CompuMethods_Identical 1 100 0.0 65535 FORMAT "%8.2" ECU_ADDRESS 0xfe402af8 /end MEASUREMENT
/begin MEASUREMENT Tlib_RiReDoorRdrObj10RdrObjConfidLvl_ZCR_CANFD5 "" UBYTE RB_RBA_Common_CentralElements_CompuMethods_Identical 1 100 0.0 255.00 FORMAT "%8.2" ECU_ADDRESS 0xfe40345b /end MEASUREMENT
/begin MEASUREMENT Tlib_RiReDoorRdrObj10RdrObjRangeStdZ_ZCR_CANFD5 "" UBYTE RB_RBA_Common_CentralElements_CompuMethods_Identical 1 100 0.0 255.00 FORMAT "%8.2" ECU_ADDRESS 0xfe40345c /end MEASUREMENT
/begin MEASUREMENT Tlib_RiReDoorRdrObj10RdrObjSpeedX_ZCR_CANFD5 "" UWORD RB_RBA_Common_CentralElements_CompuMethods_Identical 1 100 0.0 65535 FORMAT "%8.2" ECU_ADDRESS 0xfe402afa /end MEASUREMENT
/begin MEASUREMENT Tlib_RiReDoorRdrObj11RdrObjRangeStdZ_ZCR_CANFD5 "" UBYTE RB_RBA_Common_CentralElements_CompuMethods_Identical 1 100 0.0 255.00 FORMAT "%8.2" ECU_ADDRESS 0xfe40345d /end MEASUREMENT
/begin MEASUREMENT Tlib_RiReDoorRdrObj11RdrObjRangeX_ZCR_CANFD5 "" UWORD RB_RBA_Common_CentralElements_CompuMethods_Identical 1 100 0.0 65535 FORMAT "%8.2" ECU_ADDRESS 0xfe402afc /end MEASUREMENT
/begin MEASUREMENT Tlib_RiReDoorRdrObj11RdrObjAccX_ZCR_CANFD5 "" UWORD RB_RBA_Common_CentralElements_CompuMethods_Identical 1 100 0.0 65535 FORMAT "%8.2" ECU_ADDRESS 0xfe402afe /end MEASUREMENT
/begin MEASUREMENT Tlib_RiReDoorRdrObj11RdrObjSpeedStdY_ZCR_CANFD5 "" UBYTE RB_RBA_Common_CentralElements_CompuMethods_Identical 1 100 0.0 255.00 FORMAT "%8.2" ECU_ADDRESS 0xfe40345e /end MEASUREMENT
/begin MEASUREMENT Tlib_RiReDoorRdrObj11RdrObjDataMode_ZCR_CANFD5 "" UBYTE RB_RBA_Common_CentralElements_CompuMethods_Identical 1 100 0.0 255.00 FORMAT "%8.2" ECU_ADDRESS 0xfe40345f /end MEASUREMENT
/begin MEASUREMENT Tlib_RiReDoorRdrObj11RdrObjConfidLvl_ZCR_CANFD5 "" UBYTE RB_RBA_Common_CentralElements_CompuMethods_Identical 1 100 0.0 255.00 FORMAT "%8.2" ECU_ADDRESS 0xfe403460 /end MEASUREMENT
/begin MEASUREMENT Tlib_RiReDoorRdrObj11RdrObjRangeY_ZCR_CANFD5 "" UWORD RB_RBA_Common_CentralElements_CompuMethods_Identical 1 100 0.0 65535 FORMAT "%8.2" ECU_ADDRESS 0xfe402b00 /end MEASUREMENT
/begin MEASUREMENT Tlib_RiReDoorRdrObj11RdrObjAccY_ZCR_CANFD5 "" UWORD RB_RBA_Common_CentralElements_CompuMethods_Identical 1 100 0.0 65535 FORMAT "%8.2" ECU_ADDRESS 0xfe402b02 /end MEASUREMENT
/begin MEASUREMENT Tlib_RiReDoorRdrObj11RdrObjAccStdX_ZCR_CANFD5 "" UBYTE RB_RBA_Common_CentralElements_CompuMethods_Identical 1 100 0.0 255.00 FORMAT "%8.2" ECU_ADDRESS 0xfe403461 /end MEASUREMENT
/begin MEASUREMENT Tlib_RiReDoorRdrObj11RdrObjIdx_ZCR_CANFD5 "" UBYTE RB_RBA_Common_CentralElements_CompuMethods_Identical 1 100 0.0 255.00 FORMAT "%8.2" ECU_ADDRESS 0xfe403462 /end MEASUREMENT
/begin MEASUREMENT Tlib_RiReDoorRdrObj11RdrObjMotionPattern_ZCR_CANFD5 "" UBYTE RB_RBA_Common_CentralElements_CompuMethods_Identical 1 100 0.0 255.00 FORMAT "%8.2" ECU_ADDRESS 0xfe403463 /end MEASUREMENT
/begin MEASUREMENT Tlib_RiReDoorRdrObj11RdrObjRangeStdY_ZCR_CANFD5 "" UBYTE RB_RBA_Common_CentralElements_CompuMethods_Identical 1 100 0.0 255.00 FORMAT "%8.2" ECU_ADDRESS 0xfe403464 /end MEASUREMENT
/begin MEASUREMENT Tlib_RiReDoorRdrObj11RdrObjAccStdY_ZCR_CANFD5 "" UBYTE RB_RBA_Common_CentralElements_CompuMethods_Identical 1 100 0.0 255.00 FORMAT "%8.2" ECU_ADDRESS 0xfe403465 /end MEASUREMENT
/begin MEASUREMENT Tlib_RiReDoorRdrObj11RdrObjTrackClass_ZCR_CANFD5 "" UBYTE RB_RBA_Common_CentralElements_CompuMethods_Identical 1 100 0.0 255.00 FORMAT "%8.2" ECU_ADDRESS 0xfe403466 /end MEASUREMENT
/begin MEASUREMENT Tlib_RiReDoorRdrObj11RdrObjSpeedStdX_ZCR_CANFD5 "" UBYTE RB_RBA_Common_CentralElements_CompuMethods_Identical 1 100 0.0 255.00 FORMAT "%8.2" ECU_ADDRESS 0xfe403467 /end MEASUREMENT
/begin MEASUREMENT Tlib_RiReDoorRdrObj11RdrObjRangeZ_ZCR_CANFD5 "" UWORD RB_RBA_Common_CentralElements_CompuMethods_Identical 1 100 0.0 65535 FORMAT "%8.2" ECU_ADDRESS 0xfe402b04 /end MEASUREMENT
/begin MEASUREMENT Tlib_RiReDoorRdrObj11RdrObjRangeStdX_ZCR_CANFD5 "" UBYTE RB_RBA_Common_CentralElements_CompuMethods_Identical 1 100 0.0 255.00 FORMAT "%8.2" ECU_ADDRESS 0xfe403468 /end MEASUREMENT
/begin MEASUREMENT Tlib_RiReDoorRdrObj11RdrObjSpeedX_ZCR_CANFD5 "" UWORD RB_RBA_Common_CentralElements_CompuMethods_Identical 1 100 0.0 65535 FORMAT "%8.2" ECU_ADDRESS 0xfe402b06 /end MEASUREMENT
/begin MEASUREMENT Tlib_RiReDoorRdrObj11RdrObjSpeedY_ZCR_CANFD5 "" UWORD RB_RBA_Common_CentralElements_CompuMethods_Identical 1 100 0.0 65535 FORMAT "%8.2" ECU_ADDRESS 0xfe402b08 /end MEASUREMENT
/begin MEASUREMENT Tlib_RiReDoorRdrObj11RdrObjTrackAge_ZCR_CANFD5 "" UBYTE RB_RBA_Common_CentralElements_CompuMethods_Identical 1 100 0.0 255.00 FORMAT "%8.2" ECU_ADDRESS 0xfe403469 /end MEASUREMENT
/begin MEASUREMENT Tlib_RiReDoorRdrObj5RdrObjRangeStdX_ZCR_CANFD5 "" UBYTE RB_RBA_Common_CentralElements_CompuMethods_Identical 1 100 0.0 255.00 FORMAT "%8.2" ECU_ADDRESS 0xfe40346a /end MEASUREMENT
/begin MEASUREMENT Tlib_RiReDoorRdrObj5RdrObjRangeStdZ_ZCR_CANFD5 "" UBYTE RB_RBA_Common_CentralElements_CompuMethods_Identical 1 100 0.0 255.00 FORMAT "%8.2" ECU_ADDRESS 0xfe40346b /end MEASUREMENT
/begin MEASUREMENT Tlib_RiReDoorRdrObj5RdrObjTrackAge_ZCR_CANFD5 "" UBYTE RB_RBA_Common_CentralElements_CompuMethods_Identical 1 100 0.0 255.00 FORMAT "%8.2" ECU_ADDRESS 0xfe40346c /end MEASUREMENT
/begin MEASUREMENT Tlib_RiReDoorRdrObj5RdrObjAccY_ZCR_CANFD5 "" UWORD RB_RBA_Common_CentralElements_CompuMethods_Identical 1 100 0.0 65535 FORMAT "%8.2" ECU_ADDRESS 0xfe402b0a /end MEASUREMENT
/begin MEASUREMENT Tlib_RiReDoorRdrObj5RdrObjSpeedX_ZCR_CANFD5 "" UWORD RB_RBA_Common_CentralElements_CompuMethods_Identical 1 100 0.0 65535 FORMAT "%8.2" ECU_ADDRESS 0xfe402b0c /end MEASUREMENT
/begin MEASUREMENT Tlib_RiReDoorRdrObj5RdrObjRangeY_ZCR_CANFD5 "" UWORD RB_RBA_Common_CentralElements_CompuMethods_Identical 1 100 0.0 65535 FORMAT "%8.2" ECU_ADDRESS 0xfe402b0e /end MEASUREMENT
/begin MEASUREMENT Tlib_RiReDoorRdrObj5RdrObjMotionPattern_ZCR_CANFD5 "" UBYTE RB_RBA_Common_CentralElements_CompuMethods_Identical 1 100 0.0 255.00 FORMAT "%8.2" ECU_ADDRESS 0xfe40346d /end MEASUREMENT
/begin MEASUREMENT Tlib_RiReDoorRdrObj5RdrObjTrackClass_ZCR_CANFD5 "" UBYTE RB_RBA_Common_CentralElements_CompuMethods_Identical 1 100 0.0 255.00 FORMAT "%8.2" ECU_ADDRESS 0xfe40346e /end MEASUREMENT
/begin MEASUREMENT Tlib_RiReDoorRdrObj5RdrObjSpeedStdX_ZCR_CANFD5 "" UBYTE RB_RBA_Common_CentralElements_CompuMethods_Identical 1 100 0.0 255.00 FORMAT "%8.2" ECU_ADDRESS 0xfe40346f /end MEASUREMENT
/begin MEASUREMENT Tlib_RiReDoorRdrObj5RdrObjIdx_ZCR_CANFD5 "" UBYTE RB_RBA_Common_CentralElements_CompuMethods_Identical 1 100 0.0 255.00 FORMAT "%8.2" ECU_ADDRESS 0xfe403470 /end MEASUREMENT
/begin MEASUREMENT Tlib_RiReDoorRdrObj5RdrObjRangeStdY_ZCR_CANFD5 "" UBYTE RB_RBA_Common_CentralElements_CompuMethods_Identical 1 100 0.0 255.00 FORMAT "%8.2" ECU_ADDRESS 0xfe403471 /end MEASUREMENT
/begin MEASUREMENT Tlib_RiReDoorRdrObj5RdrObjAccStdX_ZCR_CANFD5 "" UBYTE RB_RBA_Common_CentralElements_CompuMethods_Identical 1 100 0.0 255.00 FORMAT "%8.2" ECU_ADDRESS 0xfe403472 /end MEASUREMENT
/begin MEASUREMENT Tlib_RiReDoorRdrObj5RdrObjDataMode_ZCR_CANFD5 "" UBYTE RB_RBA_Common_CentralElements_CompuMethods_Identical 1 100 0.0 255.00 FORMAT "%8.2" ECU_ADDRESS 0xfe403473 /end MEASUREMENT
/begin MEASUREMENT Tlib_RiReDoorRdrObj5RdrObjSpeedY_ZCR_CANFD5 "" UWORD RB_RBA_Common_CentralElements_CompuMethods_Identical 1 100 0.0 65535 FORMAT "%8.2" ECU_ADDRESS 0xfe402b10 /end MEASUREMENT
/begin MEASUREMENT Tlib_RiReDoorRdrObj5RdrObjConfidLvl_ZCR_CANFD5 "" UBYTE RB_RBA_Common_CentralElements_CompuMethods_Identical 1 100 0.0 255.00 FORMAT "%8.2" ECU_ADDRESS 0xfe403474 /end MEASUREMENT
/begin MEASUREMENT Tlib_RiReDoorRdrObj5RdrObjRangeZ_ZCR_CANFD5 "" UWORD RB_RBA_Common_CentralElements_CompuMethods_Identical 1 100 0.0 65535 FORMAT "%8.2" ECU_ADDRESS 0xfe402b12 /end MEASUREMENT
/begin MEASUREMENT Tlib_RiReDoorRdrObj5RdrObjSpeedStdY_ZCR_CANFD5 "" UBYTE RB_RBA_Common_CentralElements_CompuMethods_Identical 1 100 0.0 255.00 FORMAT "%8.2" ECU_ADDRESS 0xfe403475 /end MEASUREMENT
/begin MEASUREMENT Tlib_RiReDoorRdrObj5RdrObjAccStdY_ZCR_CANFD5 "" UBYTE RB_RBA_Common_CentralElements_CompuMethods_Identical 1 100 0.0 255.00 FORMAT "%8.2" ECU_ADDRESS 0xfe403476 /end MEASUREMENT
/begin MEASUREMENT Tlib_RiReDoorRdrObj5RdrObjAccX_ZCR_CANFD5 "" UWORD RB_RBA_Common_CentralElements_CompuMethods_Identical 1 100 0.0 65535 FORMAT "%8.2" ECU_ADDRESS 0xfe402b14 /end MEASUREMENT
/begin MEASUREMENT Tlib_RiReDoorRdrObj5RdrObjRangeX_ZCR_CANFD5 "" UWORD RB_RBA_Common_CentralElements_CompuMethods_Identical 1 100 0.0 65535 FORMAT "%8.2" ECU_ADDRESS 0xfe402b16 /end MEASUREMENT
/begin MEASUREMENT Tlib_RiReDoorRdrObj6RdrObjAccY_ZCR_CANFD5 "" UWORD RB_RBA_Common_CentralElements_CompuMethods_Identical 1 100 0.0 65535 FORMAT "%8.2" ECU_ADDRESS 0xfe402b18 /end MEASUREMENT
/begin MEASUREMENT Tlib_RiReDoorRdrObj6RdrObjIdx_ZCR_CANFD5 "" UBYTE RB_RBA_Common_CentralElements_CompuMethods_Identical 1 100 0.0 255.00 FORMAT "%8.2" ECU_ADDRESS 0xfe403477 /end MEASUREMENT
/begin MEASUREMENT Tlib_RiReDoorRdrObj6RdrObjMotionPattern_ZCR_CANFD5 "" UBYTE RB_RBA_Common_CentralElements_CompuMethods_Identical 1 100 0.0 255.00 FORMAT "%8.2" ECU_ADDRESS 0xfe403478 /end MEASUREMENT
/begin MEASUREMENT Tlib_RiReDoorRdrObj6RdrObjRangeX_ZCR_CANFD5 "" UWORD RB_RBA_Common_CentralElements_CompuMethods_Identical 1 100 0.0 65535 FORMAT "%8.2" ECU_ADDRESS 0xfe402b1a /end MEASUREMENT
/begin MEASUREMENT Tlib_RiReDoorRdrObj6RdrObjRangeStdZ_ZCR_CANFD5 "" UBYTE RB_RBA_Common_CentralElements_CompuMethods_Identical 1 100 0.0 255.00 FORMAT "%8.2" ECU_ADDRESS 0xfe403479 /end MEASUREMENT
/begin MEASUREMENT Tlib_RiReDoorRdrObj6RdrObjRangeZ_ZCR_CANFD5 "" UWORD RB_RBA_Common_CentralElements_CompuMethods_Identical 1 100 0.0 65535 FORMAT "%8.2" ECU_ADDRESS 0xfe402b1c /end MEASUREMENT
/begin MEASUREMENT Tlib_RiReDoorRdrObj6RdrObjSpeedStdY_ZCR_CANFD5 "" UBYTE RB_RBA_Common_CentralElements_CompuMethods_Identical 1 100 0.0 255.00 FORMAT "%8.2" ECU_ADDRESS 0xfe40347a /end MEASUREMENT
/begin MEASUREMENT Tlib_RiReDoorRdrObj6RdrObjConfidLvl_ZCR_CANFD5 "" UBYTE RB_RBA_Common_CentralElements_CompuMethods_Identical 1 100 0.0 255.00 FORMAT "%8.2" ECU_ADDRESS 0xfe40347b /end MEASUREMENT
/begin MEASUREMENT Tlib_RiReDoorRdrObj6RdrObjTrackAge_ZCR_CANFD5 "" UBYTE RB_RBA_Common_CentralElements_CompuMethods_Identical 1 100 0.0 255.00 FORMAT "%8.2" ECU_ADDRESS 0xfe40347c /end MEASUREMENT
/begin MEASUREMENT Tlib_RiReDoorRdrObj6RdrObjAccStdX_ZCR_CANFD5 "" UBYTE RB_RBA_Common_CentralElements_CompuMethods_Identical 1 100 0.0 255.00 FORMAT "%8.2" ECU_ADDRESS 0xfe40347d /end MEASUREMENT
/begin MEASUREMENT Tlib_RiReDoorRdrObj6RdrObjRangeY_ZCR_CANFD5 "" UWORD RB_RBA_Common_CentralElements_CompuMethods_Identical 1 100 0.0 65535 FORMAT "%8.2" ECU_ADDRESS 0xfe402b1e /end MEASUREMENT
/begin MEASUREMENT Tlib_RiReDoorRdrObj6RdrObjAccStdY_ZCR_CANFD5 "" UBYTE RB_RBA_Common_CentralElements_CompuMethods_Identical 1 100 0.0 255.00 FORMAT "%8.2" ECU_ADDRESS 0xfe40347e /end MEASUREMENT
/begin MEASUREMENT Tlib_RiReDoorRdrObj6RdrObjDataMode_ZCR_CANFD5 "" UBYTE RB_RBA_Common_CentralElements_CompuMethods_Identical 1 100 0.0 255.00 FORMAT "%8.2" ECU_ADDRESS 0xfe40347f /end MEASUREMENT
/begin MEASUREMENT Tlib_RiReDoorRdrObj6RdrObjRangeStdY_ZCR_CANFD5 "" UBYTE RB_RBA_Common_CentralElements_CompuMethods_Identical 1 100 0.0 255.00 FORMAT "%8.2" ECU_ADDRESS 0xfe403480 /end MEASUREMENT
/begin MEASUREMENT Tlib_RiReDoorRdrObj6RdrObjSpeedStdX_ZCR_CANFD5 "" UBYTE RB_RBA_Common_CentralElements_CompuMethods_Identical 1 100 0.0 255.00 FORMAT "%8.2" ECU_ADDRESS 0xfe403481 /end MEASUREMENT
/begin MEASUREMENT Tlib_RiReDoorRdrObj6RdrObjSpeedX_ZCR_CANFD5 "" UWORD RB_RBA_Common_CentralElements_CompuMethods_Identical 1 100 0.0 65535 FORMAT "%8.2" ECU_ADDRESS 0xfe402b20 /end MEASUREMENT
/begin MEASUREMENT Tlib_RiReDoorRdrObj6RdrObjTrackClass_ZCR_CANFD5 "" UBYTE RB_RBA_Common_CentralElements_CompuMethods_Identical 1 100 0.0 255.00 FORMAT "%8.2" ECU_ADDRESS 0xfe403482 /end MEASUREMENT
/begin MEASUREMENT Tlib_RiReDoorRdrObj6RdrObjAccX_ZCR_CANFD5 "" UWORD RB_RBA_Common_CentralElements_CompuMethods_Identical 1 100 0.0 65535 FORMAT "%8.2" ECU_ADDRESS 0xfe402b22 /end MEASUREMENT
/begin MEASUREMENT Tlib_RiReDoorRdrObj6RdrObjRangeStdX_ZCR_CANFD5 "" UBYTE RB_RBA_Common_CentralElements_CompuMethods_Identical 1 100 0.0 255.00 FORMAT "%8.2" ECU_ADDRESS 0xfe403483 /end MEASUREMENT
/begin MEASUREMENT Tlib_RiReDoorRdrObj6RdrObjSpeedY_ZCR_CANFD5 "" UWORD RB_RBA_Common_CentralElements_CompuMethods_Identical 1 100 0.0 65535 FORMAT "%8.2" ECU_ADDRESS 0xfe402b24 /end MEASUREMENT
/begin MEASUREMENT Tlib_RiReDoorRdrObj7RdrObjRangeStdY_ZCR_CANFD5 "" UBYTE RB_RBA_Common_CentralElements_CompuMethods_Identical 1 100 0.0 255.00 FORMAT "%8.2" ECU_ADDRESS 0xfe403484 /end MEASUREMENT
/begin MEASUREMENT Tlib_RiReDoorRdrObj7RdrObjRangeStdZ_ZCR_CANFD5 "" UBYTE RB_RBA_Common_CentralElements_CompuMethods_Identical 1 100 0.0 255.00 FORMAT "%8.2" ECU_ADDRESS 0xfe403485 /end MEASUREMENT
/begin MEASUREMENT Tlib_RiReDoorRdrObj7RdrObjSpeedY_ZCR_CANFD5 "" UWORD RB_RBA_Common_CentralElements_CompuMethods_Identical 1 100 0.0 65535 FORMAT "%8.2" ECU_ADDRESS 0xfe402b26 /end MEASUREMENT
/begin MEASUREMENT Tlib_RiReDoorRdrObj7RdrObjAccX_ZCR_CANFD5 "" UWORD RB_RBA_Common_CentralElements_CompuMethods_Identical 1 100 0.0 65535 FORMAT "%8.2" ECU_ADDRESS 0xfe402b28 /end MEASUREMENT
/begin MEASUREMENT Tlib_RiReDoorRdrObj7RdrObjTrackAge_ZCR_CANFD5 "" UBYTE RB_RBA_Common_CentralElements_CompuMethods_Identical 1 100 0.0 255.00 FORMAT "%8.2" ECU_ADDRESS 0xfe403486 /end MEASUREMENT
/begin MEASUREMENT Tlib_RiReDoorRdrObj7RdrObjDataMode_ZCR_CANFD5 "" UBYTE RB_RBA_Common_CentralElements_CompuMethods_Identical 1 100 0.0 255.00 FORMAT "%8.2" ECU_ADDRESS 0xfe403487 /end MEASUREMENT
/begin MEASUREMENT Tlib_RiReDoorRdrObj7RdrObjRangeZ_ZCR_CANFD5 "" UWORD RB_RBA_Common_CentralElements_CompuMethods_Identical 1 100 0.0 65535 FORMAT "%8.2" ECU_ADDRESS 0xfe402b2a /end MEASUREMENT
/begin MEASUREMENT Tlib_RiReDoorRdrObj7RdrObjRangeY_ZCR_CANFD5 "" UWORD RB_RBA_Common_CentralElements_CompuMethods_Identical 1 100 0.0 65535 FORMAT "%8.2" ECU_ADDRESS 0xfe402b2c /end MEASUREMENT
/begin MEASUREMENT Tlib_RiReDoorRdrObj7RdrObjSpeedX_ZCR_CANFD5 "" UWORD RB_RBA_Common_CentralElements_CompuMethods_Identical 1 100 0.0 65535 FORMAT "%8.2" ECU_ADDRESS 0xfe402b2e /end MEASUREMENT
/begin MEASUREMENT Tlib_RiReDoorRdrObj7RdrObjAccStdY_ZCR_CANFD5 "" UBYTE RB_RBA_Common_CentralElements_CompuMethods_Identical 1 100 0.0 255.00 FORMAT "%8.2" ECU_ADDRESS 0xfe403488 /end MEASUREMENT
/begin MEASUREMENT Tlib_RiReDoorRdrObj7RdrObjConfidLvl_ZCR_CANFD5 "" UBYTE RB_RBA_Common_CentralElements_CompuMethods_Identical 1 100 0.0 255.00 FORMAT "%8.2" ECU_ADDRESS 0xfe403489 /end MEASUREMENT
/begin MEASUREMENT Tlib_RiReDoorRdrObj7RdrObjRangeStdX_ZCR_CANFD5 "" UBYTE RB_RBA_Common_CentralElements_CompuMethods_Identical 1 100 0.0 255.00 FORMAT "%8.2" ECU_ADDRESS 0xfe40348a /end MEASUREMENT
/begin MEASUREMENT Tlib_RiReDoorRdrObj7RdrObjRangeX_ZCR_CANFD5 "" UWORD RB_RBA_Common_CentralElements_CompuMethods_Identical 1 100 0.0 65535 FORMAT "%8.2" ECU_ADDRESS 0xfe402b30 /end MEASUREMENT
/begin MEASUREMENT Tlib_RiReDoorRdrObj7RdrObjAccStdX_ZCR_CANFD5 "" UBYTE RB_RBA_Common_CentralElements_CompuMethods_Identical 1 100 0.0 255.00 FORMAT "%8.2" ECU_ADDRESS 0xfe40348b /end MEASUREMENT
/begin MEASUREMENT Tlib_RiReDoorRdrObj7RdrObjSpeedStdY_ZCR_CANFD5 "" UBYTE RB_RBA_Common_CentralElements_CompuMethods_Identical 1 100 0.0 255.00 FORMAT "%8.2" ECU_ADDRESS 0xfe40348c /end MEASUREMENT
/begin MEASUREMENT Tlib_RiReDoorRdrObj7RdrObjAccY_ZCR_CANFD5 "" UWORD RB_RBA_Common_CentralElements_CompuMethods_Identical 1 100 0.0 65535 FORMAT "%8.2" ECU_ADDRESS 0xfe402b32 /end MEASUREMENT
/begin MEASUREMENT Tlib_RiReDoorRdrObj7RdrObjTrackClass_ZCR_CANFD5 "" UBYTE RB_RBA_Common_CentralElements_CompuMethods_Identical 1 100 0.0 255.00 FORMAT "%8.2" ECU_ADDRESS 0xfe40348d /end MEASUREMENT
/begin MEASUREMENT Tlib_RiReDoorRdrObj7RdrObjMotionPattern_ZCR_CANFD5 "" UBYTE RB_RBA_Common_CentralElements_CompuMethods_Identical 1 100 0.0 255.00 FORMAT "%8.2" ECU_ADDRESS 0xfe40348e /end MEASUREMENT
/begin MEASUREMENT Tlib_RiReDoorRdrObj7RdrObjSpeedStdX_ZCR_CANFD5 "" UBYTE RB_RBA_Common_CentralElements_CompuMethods_Identical 1 100 0.0 255.00 FORMAT "%8.2" ECU_ADDRESS 0xfe40348f /end MEASUREMENT
/begin MEASUREMENT Tlib_RiReDoorRdrObj7RdrObjIdx_ZCR_CANFD5 "" UBYTE RB_RBA_Common_CentralElements_CompuMethods_Identical 1 100 0.0 255.00 FORMAT "%8.2" ECU_ADDRESS 0xfe403490 /end MEASUREMENT
/begin MEASUREMENT Tlib_PassDoorRdrObj25RdrObjRangeX_ZCR_CANFD5 "" UWORD RB_RBA_Common_CentralElements_CompuMethods_Identical 1 100 0.0 65535 FORMAT "%8.2" ECU_ADDRESS 0xfe402b34 /end MEASUREMENT
/begin MEASUREMENT Tlib_PassDoorRdrObj25RdrObjSpeedStdY_ZCR_CANFD5 "" UBYTE RB_RBA_Common_CentralElements_CompuMethods_Identical 1 100 0.0 255.00 FORMAT "%8.2" ECU_ADDRESS 0xfe403491 /end MEASUREMENT
/begin MEASUREMENT Tlib_PassDoorRdrObj25RdrObjAccY_ZCR_CANFD5 "" UWORD RB_RBA_Common_CentralElements_CompuMethods_Identical 1 100 0.0 65535 FORMAT "%8.2" ECU_ADDRESS 0xfe402b36 /end MEASUREMENT
/begin MEASUREMENT Tlib_PassDoorRdrObj25RdrObjRangeY_ZCR_CANFD5 "" UWORD RB_RBA_Common_CentralElements_CompuMethods_Identical 1 100 0.0 65535 FORMAT "%8.2" ECU_ADDRESS 0xfe402b38 /end MEASUREMENT
/begin MEASUREMENT Tlib_PassDoorRdrObj25RdrObjAccX_ZCR_CANFD5 "" UWORD RB_RBA_Common_CentralElements_CompuMethods_Identical 1 100 0.0 65535 FORMAT "%8.2" ECU_ADDRESS 0xfe402b3a /end MEASUREMENT
/begin MEASUREMENT Tlib_PassDoorRdrObj25RdrObjRangeStdY_ZCR_CANFD5 "" UBYTE RB_RBA_Common_CentralElements_CompuMethods_Identical 1 100 0.0 255.00 FORMAT "%8.2" ECU_ADDRESS 0xfe403492 /end MEASUREMENT
/begin MEASUREMENT Tlib_PassDoorRdrObj25RdrObjRangeStdZ_ZCR_CANFD5 "" UBYTE RB_RBA_Common_CentralElements_CompuMethods_Identical 1 100 0.0 255.00 FORMAT "%8.2" ECU_ADDRESS 0xfe403493 /end MEASUREMENT
/begin MEASUREMENT Tlib_PassDoorRdrObj25RdrObjSpeedX_ZCR_CANFD5 "" UWORD RB_RBA_Common_CentralElements_CompuMethods_Identical 1 100 0.0 65535 FORMAT "%8.2" ECU_ADDRESS 0xfe402b3c /end MEASUREMENT
/begin MEASUREMENT Tlib_PassDoorRdrObj25RdrObjAccStdX_ZCR_CANFD5 "" UBYTE RB_RBA_Common_CentralElements_CompuMethods_Identical 1 100 0.0 255.00 FORMAT "%8.2" ECU_ADDRESS 0xfe403494 /end MEASUREMENT
/begin MEASUREMENT Tlib_PassDoorRdrObj25RdrObjConfidLvl_ZCR_CANFD5 "" UBYTE RB_RBA_Common_CentralElements_CompuMethods_Identical 1 100 0.0 255.00 FORMAT "%8.2" ECU_ADDRESS 0xfe403495 /end MEASUREMENT
/begin MEASUREMENT Tlib_PassDoorRdrObj25RdrObjDataMode_ZCR_CANFD5 "" UBYTE RB_RBA_Common_CentralElements_CompuMethods_Identical 1 100 0.0 255.00 FORMAT "%8.2" ECU_ADDRESS 0xfe403496 /end MEASUREMENT
/begin MEASUREMENT Tlib_PassDoorRdrObj25RdrObjMotionPattern_ZCR_CANFD5 "" UBYTE RB_RBA_Common_CentralElements_CompuMethods_Identical 1 100 0.0 255.00 FORMAT "%8.2" ECU_ADDRESS 0xfe403497 /end MEASUREMENT
/begin MEASUREMENT Tlib_PassDoorRdrObj25RdrObjRangeStdX_ZCR_CANFD5 "" UBYTE RB_RBA_Common_CentralElements_CompuMethods_Identical 1 100 0.0 255.00 FORMAT "%8.2" ECU_ADDRESS 0xfe403498 /end MEASUREMENT
/begin MEASUREMENT Tlib_PassDoorRdrObj25RdrObjRangeZ_ZCR_CANFD5 "" UWORD RB_RBA_Common_CentralElements_CompuMethods_Identical 1 100 0.0 65535 FORMAT "%8.2" ECU_ADDRESS 0xfe402b3e /end MEASUREMENT
/begin MEASUREMENT Tlib_PassDoorRdrObj25RdrObjSpeedY_ZCR_CANFD5 "" UWORD RB_RBA_Common_CentralElements_CompuMethods_Identical 1 100 0.0 65535 FORMAT "%8.2" ECU_ADDRESS 0xfe402b40 /end MEASUREMENT
/begin MEASUREMENT Tlib_PassDoorRdrObj25RdrObjTrackAge_ZCR_CANFD5 "" UBYTE RB_RBA_Common_CentralElements_CompuMethods_Identical 1 100 0.0 255.00 FORMAT "%8.2" ECU_ADDRESS 0xfe403499 /end MEASUREMENT
/begin MEASUREMENT Tlib_PassDoorRdrObj25RdrObjAccStdY_ZCR_CANFD5 "" UBYTE RB_RBA_Common_CentralElements_CompuMethods_Identical 1 100 0.0 255.00 FORMAT "%8.2" ECU_ADDRESS 0xfe40349a /end MEASUREMENT
/begin MEASUREMENT Tlib_PassDoorRdrObj25RdrObjIdx_ZCR_CANFD5 "" UBYTE RB_RBA_Common_CentralElements_CompuMethods_Identical 1 100 0.0 255.00 FORMAT "%8.2" ECU_ADDRESS 0xfe40349b /end MEASUREMENT
/begin MEASUREMENT Tlib_PassDoorRdrObj25RdrObjTrackClass_ZCR_CANFD5 "" UBYTE RB_RBA_Common_CentralElements_CompuMethods_Identical 1 100 0.0 255.00 FORMAT "%8.2" ECU_ADDRESS 0xfe40349c /end MEASUREMENT
/begin MEASUREMENT Tlib_PassDoorRdrObj25RdrObjSpeedStdX_ZCR_CANFD5 "" UBYTE RB_RBA_Common_CentralElements_CompuMethods_Identical 1 100 0.0 255.00 FORMAT "%8.2" ECU_ADDRESS 0xfe40349d /end MEASUREMENT
/begin MEASUREMENT Tlib_PassDoorRdrObj24RdrObjSpeedStdX_ZCR_CANFD5 "" UBYTE RB_RBA_Common_CentralElements_CompuMethods_Identical 1 100 0.0 255.00 FORMAT "%8.2" ECU_ADDRESS 0xfe40349e /end MEASUREMENT
/begin MEASUREMENT Tlib_PassDoorRdrObj24RdrObjAccStdY_ZCR_CANFD5 "" UBYTE RB_RBA_Common_CentralElements_CompuMethods_Identical 1 100 0.0 255.00 FORMAT "%8.2" ECU_ADDRESS 0xfe40349f /end MEASUREMENT
/begin MEASUREMENT Tlib_PassDoorRdrObj24RdrObjMotionPattern_ZCR_CANFD5 "" UBYTE RB_RBA_Common_CentralElements_CompuMethods_Identical 1 100 0.0 255.00 FORMAT "%8.2" ECU_ADDRESS 0xfe4034a0 /end MEASUREMENT
/begin MEASUREMENT Tlib_PassDoorRdrObj24RdrObjIdx_ZCR_CANFD5 "" UBYTE RB_RBA_Common_CentralElements_CompuMethods_Identical 1 100 0.0 255.00 FORMAT "%8.2" ECU_ADDRESS 0xfe4034a1 /end MEASUREMENT
/begin MEASUREMENT Tlib_PassDoorRdrObj24RdrObjDataMode_ZCR_CANFD5 "" UBYTE RB_RBA_Common_CentralElements_CompuMethods_Identical 1 100 0.0 255.00 FORMAT "%8.2" ECU_ADDRESS 0xfe4034a2 /end MEASUREMENT
/begin MEASUREMENT Tlib_PassDoorRdrObj24RdrObjSpeedStdY_ZCR_CANFD5 "" UBYTE RB_RBA_Common_CentralElements_CompuMethods_Identical 1 100 0.0 255.00 FORMAT "%8.2" ECU_ADDRESS 0xfe4034a3 /end MEASUREMENT
/begin MEASUREMENT Tlib_PassDoorRdrObj24RdrObjSpeedX_ZCR_CANFD5 "" UWORD RB_RBA_Common_CentralElements_CompuMethods_Identical 1 100 0.0 65535 FORMAT "%8.2" ECU_ADDRESS 0xfe402b42 /end MEASUREMENT
/begin MEASUREMENT Tlib_PassDoorRdrObj24RdrObjRangeX_ZCR_CANFD5 "" UWORD RB_RBA_Common_CentralElements_CompuMethods_Identical 1 100 0.0 65535 FORMAT "%8.2" ECU_ADDRESS 0xfe402b44 /end MEASUREMENT
/begin MEASUREMENT Tlib_PassDoorRdrObj24RdrObjTrackAge_ZCR_CANFD5 "" UBYTE RB_RBA_Common_CentralElements_CompuMethods_Identical 1 100 0.0 255.00 FORMAT "%8.2" ECU_ADDRESS 0xfe4034a4 /end MEASUREMENT
/begin MEASUREMENT Tlib_PassDoorRdrObj24RdrObjRangeY_ZCR_CANFD5 "" UWORD RB_RBA_Common_CentralElements_CompuMethods_Identical 1 100 0.0 65535 FORMAT "%8.2" ECU_ADDRESS 0xfe402b46 /end MEASUREMENT
/begin MEASUREMENT Tlib_PassDoorRdrObj24RdrObjConfidLvl_ZCR_CANFD5 "" UBYTE RB_RBA_Common_CentralElements_CompuMethods_Identical 1 100 0.0 255.00 FORMAT "%8.2" ECU_ADDRESS 0xfe4034a5 /end MEASUREMENT
/begin MEASUREMENT Tlib_PassDoorRdrObj24RdrObjRangeStdZ_ZCR_CANFD5 "" UBYTE RB_RBA_Common_CentralElements_CompuMethods_Identical 1 100 0.0 255.00 FORMAT "%8.2" ECU_ADDRESS 0xfe4034a6 /end MEASUREMENT
/begin MEASUREMENT Tlib_PassDoorRdrObj24RdrObjAccX_ZCR_CANFD5 "" UWORD RB_RBA_Common_CentralElements_CompuMethods_Identical 1 100 0.0 65535 FORMAT "%8.2" ECU_ADDRESS 0xfe402b48 /end MEASUREMENT
/begin MEASUREMENT Tlib_PassDoorRdrObj24RdrObjRangeZ_ZCR_CANFD5 "" UWORD RB_RBA_Common_CentralElements_CompuMethods_Identical 1 100 0.0 65535 FORMAT "%8.2" ECU_ADDRESS 0xfe402b4a /end MEASUREMENT
/begin MEASUREMENT Tlib_PassDoorRdrObj24RdrObjAccStdX_ZCR_CANFD5 "" UBYTE RB_RBA_Common_CentralElements_CompuMethods_Identical 1 100 0.0 255.00 FORMAT "%8.2" ECU_ADDRESS 0xfe4034a7 /end MEASUREMENT
/begin MEASUREMENT Tlib_PassDoorRdrObj24RdrObjRangeStdX_ZCR_CANFD5 "" UBYTE RB_RBA_Common_CentralElements_CompuMethods_Identical 1 100 0.0 255.00 FORMAT "%8.2" ECU_ADDRESS 0xfe4034a8 /end MEASUREMENT
/begin MEASUREMENT Tlib_PassDoorRdrObj24RdrObjSpeedY_ZCR_CANFD5 "" UWORD RB_RBA_Common_CentralElements_CompuMethods_Identical 1 100 0.0 65535 FORMAT "%8.2" ECU_ADDRESS 0xfe402b4c /end MEASUREMENT
/begin MEASUREMENT Tlib_PassDoorRdrObj24RdrObjAccY_ZCR_CANFD5 "" UWORD RB_RBA_Common_CentralElements_CompuMethods_Identical 1 100 0.0 65535 FORMAT "%8.2" ECU_ADDRESS 0xfe402b4e /end MEASUREMENT
/begin MEASUREMENT Tlib_PassDoorRdrObj24RdrObjTrackClass_ZCR_CANFD5 "" UBYTE RB_RBA_Common_CentralElements_CompuMethods_Identical 1 100 0.0 255.00 FORMAT "%8.2" ECU_ADDRESS 0xfe4034a9 /end MEASUREMENT
/begin MEASUREMENT Tlib_PassDoorRdrObj24RdrObjRangeStdY_ZCR_CANFD5 "" UBYTE RB_RBA_Common_CentralElements_CompuMethods_Identical 1 100 0.0 255.00 FORMAT "%8.2" ECU_ADDRESS 0xfe4034aa /end MEASUREMENT
/begin MEASUREMENT Tlib_PassDoorRdrObj23RdrObjSpeedX_ZCR_CANFD5 "" UWORD RB_RBA_Common_CentralElements_CompuMethods_Identical 1 100 0.0 65535 FORMAT "%8.2" ECU_ADDRESS 0xfe402b50 /end MEASUREMENT
/begin MEASUREMENT Tlib_PassDoorRdrObj23RdrObjRangeX_ZCR_CANFD5 "" UWORD RB_RBA_Common_CentralElements_CompuMethods_Identical 1 100 0.0 65535 FORMAT "%8.2" ECU_ADDRESS 0xfe402b52 /end MEASUREMENT
/begin MEASUREMENT Tlib_PassDoorRdrObj23RdrObjDataMode_ZCR_CANFD5 "" UBYTE RB_RBA_Common_CentralElements_CompuMethods_Identical 1 100 0.0 255.00 FORMAT "%8.2" ECU_ADDRESS 0xfe4034ab /end MEASUREMENT
/begin MEASUREMENT Tlib_PassDoorRdrObj23RdrObjTrackAge_ZCR_CANFD5 "" UBYTE RB_RBA_Common_CentralElements_CompuMethods_Identical 1 100 0.0 255.00 FORMAT "%8.2" ECU_ADDRESS 0xfe4034ac /end MEASUREMENT
/begin MEASUREMENT Tlib_PassDoorRdrObj23RdrObjRangeY_ZCR_CANFD5 "" UWORD RB_RBA_Common_CentralElements_CompuMethods_Identical 1 100 0.0 65535 FORMAT "%8.2" ECU_ADDRESS 0xfe402b54 /end MEASUREMENT
/begin MEASUREMENT Tlib_PassDoorRdrObj23RdrObjRangeStdX_ZCR_CANFD5 "" UBYTE RB_RBA_Common_CentralElements_CompuMethods_Identical 1 100 0.0 255.00 FORMAT "%8.2" ECU_ADDRESS 0xfe4034ad /end MEASUREMENT
/begin MEASUREMENT Tlib_PassDoorRdrObj23RdrObjSpeedY_ZCR_CANFD5 "" UWORD RB_RBA_Common_CentralElements_CompuMethods_Identical 1 100 0.0 65535 FORMAT "%8.2" ECU_ADDRESS 0xfe402b56 /end MEASUREMENT
/begin MEASUREMENT Tlib_PassDoorRdrObj23RdrObjAccStdY_ZCR_CANFD5 "" UBYTE RB_RBA_Common_CentralElements_CompuMethods_Identical 1 100 0.0 255.00 FORMAT "%8.2" ECU_ADDRESS 0xfe4034ae /end MEASUREMENT
/begin MEASUREMENT Tlib_PassDoorRdrObj23RdrObjRangeZ_ZCR_CANFD5 "" UWORD RB_RBA_Common_CentralElements_CompuMethods_Identical 1 100 0.0 65535 FORMAT "%8.2" ECU_ADDRESS 0xfe402b58 /end MEASUREMENT
/begin MEASUREMENT Tlib_PassDoorRdrObj23RdrObjIdx_ZCR_CANFD5 "" UBYTE RB_RBA_Common_CentralElements_CompuMethods_Identical 1 100 0.0 255.00 FORMAT "%8.2" ECU_ADDRESS 0xfe4034af /end MEASUREMENT
/begin MEASUREMENT Tlib_PassDoorRdrObj23RdrObjSpeedStdY_ZCR_CANFD5 "" UBYTE RB_RBA_Common_CentralElements_CompuMethods_Identical 1 100 0.0 255.00 FORMAT "%8.2" ECU_ADDRESS 0xfe4034b0 /end MEASUREMENT
/begin MEASUREMENT Tlib_PassDoorRdrObj23RdrObjMotionPattern_ZCR_CANFD5 "" UBYTE RB_RBA_Common_CentralElements_CompuMethods_Identical 1 100 0.0 255.00 FORMAT "%8.2" ECU_ADDRESS 0xfe4034b1 /end MEASUREMENT
/begin MEASUREMENT Tlib_PassDoorRdrObj23RdrObjRangeStdZ_ZCR_CANFD5 "" UBYTE RB_RBA_Common_CentralElements_CompuMethods_Identical 1 100 0.0 255.00 FORMAT "%8.2" ECU_ADDRESS 0xfe4034b2 /end MEASUREMENT
/begin MEASUREMENT Tlib_PassDoorRdrObj23RdrObjAccY_ZCR_CANFD5 "" UWORD RB_RBA_Common_CentralElements_CompuMethods_Identical 1 100 0.0 65535 FORMAT "%8.2" ECU_ADDRESS 0xfe402b5a /end MEASUREMENT
/begin MEASUREMENT Tlib_PassDoorRdrObj23RdrObjConfidLvl_ZCR_CANFD5 "" UBYTE RB_RBA_Common_CentralElements_CompuMethods_Identical 1 100 0.0 255.00 FORMAT "%8.2" ECU_ADDRESS 0xfe4034b3 /end MEASUREMENT
/begin MEASUREMENT Tlib_PassDoorRdrObj23RdrObjAccX_ZCR_CANFD5 "" UWORD RB_RBA_Common_CentralElements_CompuMethods_Identical 1 100 0.0 65535 FORMAT "%8.2" ECU_ADDRESS 0xfe402b5c /end MEASUREMENT
/begin MEASUREMENT Tlib_PassDoorRdrObj23RdrObjSpeedStdX_ZCR_CANFD5 "" UBYTE RB_RBA_Common_CentralElements_CompuMethods_Identical 1 100 0.0 255.00 FORMAT "%8.2" ECU_ADDRESS 0xfe4034b4 /end MEASUREMENT
/begin MEASUREMENT Tlib_PassDoorRdrObj23RdrObjTrackClass_ZCR_CANFD5 "" UBYTE RB_RBA_Common_CentralElements_CompuMethods_Identical 1 100 0.0 255.00 FORMAT "%8.2" ECU_ADDRESS 0xfe4034b5 /end MEASUREMENT
/begin MEASUREMENT Tlib_PassDoorRdrObj23RdrObjAccStdX_ZCR_CANFD5 "" UBYTE RB_RBA_Common_CentralElements_CompuMethods_Identical 1 100 0.0 255.00 FORMAT "%8.2" ECU_ADDRESS 0xfe4034b6 /end MEASUREMENT
/begin MEASUREMENT Tlib_PassDoorRdrObj23RdrObjRangeStdY_ZCR_CANFD5 "" UBYTE RB_RBA_Common_CentralElements_CompuMethods_Identical 1 100 0.0 255.00 FORMAT "%8.2" ECU_ADDRESS 0xfe4034b7 /end MEASUREMENT
/begin MEASUREMENT Tlib_RiReDoorRdrObj13RdrObjAccStdX_ZCR_CANFD5 "" UBYTE RB_RBA_Common_CentralElements_CompuMethods_Identical 1 100 0.0 255.00 FORMAT "%8.2" ECU_ADDRESS 0xfe4034b8 /end MEASUREMENT
/begin MEASUREMENT Tlib_RiReDoorRdrObj13RdrObjAccStdY_ZCR_CANFD5 "" UBYTE RB_RBA_Common_CentralElements_CompuMethods_Identical 1 100 0.0 255.00 FORMAT "%8.2" ECU_ADDRESS 0xfe4034b9 /end MEASUREMENT
/begin MEASUREMENT Tlib_RiReDoorRdrObj13RdrObjTrackAge_ZCR_CANFD5 "" UBYTE RB_RBA_Common_CentralElements_CompuMethods_Identical 1 100 0.0 255.00 FORMAT "%8.2" ECU_ADDRESS 0xfe4034ba /end MEASUREMENT
/begin MEASUREMENT Tlib_RiReDoorRdrObj13RdrObjDataMode_ZCR_CANFD5 "" UBYTE RB_RBA_Common_CentralElements_CompuMethods_Identical 1 100 0.0 255.00 FORMAT "%8.2" ECU_ADDRESS 0xfe4034bb /end MEASUREMENT
/begin MEASUREMENT Tlib_RiReDoorRdrObj13RdrObjRangeStdY_ZCR_CANFD5 "" UBYTE RB_RBA_Common_CentralElements_CompuMethods_Identical 1 100 0.0 255.00 FORMAT "%8.2" ECU_ADDRESS 0xfe4034bc /end MEASUREMENT
/begin MEASUREMENT Tlib_RiReDoorRdrObj13RdrObjRangeX_ZCR_CANFD5 "" UWORD RB_RBA_Common_CentralElements_CompuMethods_Identical 1 100 0.0 65535 FORMAT "%8.2" ECU_ADDRESS 0xfe402b5e /end MEASUREMENT
/begin MEASUREMENT Tlib_RiReDoorRdrObj13RdrObjRangeY_ZCR_CANFD5 "" UWORD RB_RBA_Common_CentralElements_CompuMethods_Identical 1 100 0.0 65535 FORMAT "%8.2" ECU_ADDRESS 0xfe402b60 /end MEASUREMENT
/begin MEASUREMENT Tlib_RiReDoorRdrObj13RdrObjAccX_ZCR_CANFD5 "" UWORD RB_RBA_Common_CentralElements_CompuMethods_Identical 1 100 0.0 65535 FORMAT "%8.2" ECU_ADDRESS 0xfe402b62 /end MEASUREMENT
/begin MEASUREMENT Tlib_RiReDoorRdrObj13RdrObjRangeStdX_ZCR_CANFD5 "" UBYTE RB_RBA_Common_CentralElements_CompuMethods_Identical 1 100 0.0 255.00 FORMAT "%8.2" ECU_ADDRESS 0xfe4034bd /end MEASUREMENT
/begin MEASUREMENT Tlib_RiReDoorRdrObj13RdrObjSpeedX_ZCR_CANFD5 "" UWORD RB_RBA_Common_CentralElements_CompuMethods_Identical 1 100 0.0 65535 FORMAT "%8.2" ECU_ADDRESS 0xfe402b64 /end MEASUREMENT
/begin MEASUREMENT Tlib_RiReDoorRdrObj13RdrObjSpeedStdY_ZCR_CANFD5 "" UBYTE RB_RBA_Common_CentralElements_CompuMethods_Identical 1 100 0.0 255.00 FORMAT "%8.2" ECU_ADDRESS 0xfe4034be /end MEASUREMENT
/begin MEASUREMENT Tlib_RiReDoorRdrObj13RdrObjTrackClass_ZCR_CANFD5 "" UBYTE RB_RBA_Common_CentralElements_CompuMethods_Identical 1 100 0.0 255.00 FORMAT "%8.2" ECU_ADDRESS 0xfe4034bf /end MEASUREMENT
/begin MEASUREMENT Tlib_RiReDoorRdrObj13RdrObjIdx_ZCR_CANFD5 "" UBYTE RB_RBA_Common_CentralElements_CompuMethods_Identical 1 100 0.0 255.00 FORMAT "%8.2" ECU_ADDRESS 0xfe4034c0 /end MEASUREMENT
/begin MEASUREMENT Tlib_RiReDoorRdrObj13RdrObjRangeZ_ZCR_CANFD5 "" UWORD RB_RBA_Common_CentralElements_CompuMethods_Identical 1 100 0.0 65535 FORMAT "%8.2" ECU_ADDRESS 0xfe402b66 /end MEASUREMENT
/begin MEASUREMENT Tlib_RiReDoorRdrObj13RdrObjSpeedY_ZCR_CANFD5 "" UWORD RB_RBA_Common_CentralElements_CompuMethods_Identical 1 100 0.0 65535 FORMAT "%8.2" ECU_ADDRESS 0xfe402b68 /end MEASUREMENT
/begin MEASUREMENT Tlib_RiReDoorRdrObj13RdrObjAccY_ZCR_CANFD5 "" UWORD RB_RBA_Common_CentralElements_CompuMethods_Identical 1 100 0.0 65535 FORMAT "%8.2" ECU_ADDRESS 0xfe402b6a /end MEASUREMENT
/begin MEASUREMENT Tlib_RiReDoorRdrObj13RdrObjConfidLvl_ZCR_CANFD5 "" UBYTE RB_RBA_Common_CentralElements_CompuMethods_Identical 1 100 0.0 255.00 FORMAT "%8.2" ECU_ADDRESS 0xfe4034c1 /end MEASUREMENT
/begin MEASUREMENT Tlib_RiReDoorRdrObj13RdrObjMotionPattern_ZCR_CANFD5 "" UBYTE RB_RBA_Common_CentralElements_CompuMethods_Identical 1 100 0.0 255.00 FORMAT "%8.2" ECU_ADDRESS 0xfe4034c2 /end MEASUREMENT
/begin MEASUREMENT Tlib_RiReDoorRdrObj13RdrObjRangeStdZ_ZCR_CANFD5 "" UBYTE RB_RBA_Common_CentralElements_CompuMethods_Identical 1 100 0.0 255.00 FORMAT "%8.2" ECU_ADDRESS 0xfe4034c3 /end MEASUREMENT
/begin MEASUREMENT Tlib_RiReDoorRdrObj13RdrObjSpeedStdX_ZCR_CANFD5 "" UBYTE RB_RBA_Common_CentralElements_CompuMethods_Identical 1 100 0.0 255.00 FORMAT "%8.2" ECU_ADDRESS 0xfe4034c4 /end MEASUREMENT
/begin MEASUREMENT Tlib_RiReDoorRdrObj14RdrObjAccX_ZCR_CANFD5 "" UWORD RB_RBA_Common_CentralElements_CompuMethods_Identical 1 100 0.0 65535 FORMAT "%8.2" ECU_ADDRESS 0xfe402b6c /end MEASUREMENT
/begin MEASUREMENT Tlib_RiReDoorRdrObj14RdrObjSpeedStdY_ZCR_CANFD5 "" UBYTE RB_RBA_Common_CentralElements_CompuMethods_Identical 1 100 0.0 255.00 FORMAT "%8.2" ECU_ADDRESS 0xfe4034c5 /end MEASUREMENT
/begin MEASUREMENT Tlib_RiReDoorRdrObj14RdrObjAccStdY_ZCR_CANFD5 "" UBYTE RB_RBA_Common_CentralElements_CompuMethods_Identical 1 100 0.0 255.00 FORMAT "%8.2" ECU_ADDRESS 0xfe4034c6 /end MEASUREMENT
/begin MEASUREMENT Tlib_RiReDoorRdrObj14RdrObjTrackAge_ZCR_CANFD5 "" UBYTE RB_RBA_Common_CentralElements_CompuMethods_Identical 1 100 0.0 255.00 FORMAT "%8.2" ECU_ADDRESS 0xfe4034c7 /end MEASUREMENT
/begin MEASUREMENT Tlib_RiReDoorRdrObj14RdrObjRangeStdX_ZCR_CANFD5 "" UBYTE RB_RBA_Common_CentralElements_CompuMethods_Identical 1 100 0.0 255.00 FORMAT "%8.2" ECU_ADDRESS 0xfe4034c8 /end MEASUREMENT
/begin MEASUREMENT Tlib_RiReDoorRdrObj14RdrObjRangeY_ZCR_CANFD5 "" UWORD RB_RBA_Common_CentralElements_CompuMethods_Identical 1 100 0.0 65535 FORMAT "%8.2" ECU_ADDRESS 0xfe402b6e /end MEASUREMENT
/begin MEASUREMENT Tlib_RiReDoorRdrObj14RdrObjAccStdX_ZCR_CANFD5 "" UBYTE RB_RBA_Common_CentralElements_CompuMethods_Identical 1 100 0.0 255.00 FORMAT "%8.2" ECU_ADDRESS 0xfe4034c9 /end MEASUREMENT
/begin MEASUREMENT Tlib_RiReDoorRdrObj14RdrObjRangeStdY_ZCR_CANFD5 "" UBYTE RB_RBA_Common_CentralElements_CompuMethods_Identical 1 100 0.0 255.00 FORMAT "%8.2" ECU_ADDRESS 0xfe4034ca /end MEASUREMENT
/begin MEASUREMENT Tlib_RiReDoorRdrObj14RdrObjRangeStdZ_ZCR_CANFD5 "" UBYTE RB_RBA_Common_CentralElements_CompuMethods_Identical 1 100 0.0 255.00 FORMAT "%8.2" ECU_ADDRESS 0xfe4034cb /end MEASUREMENT
/begin MEASUREMENT Tlib_RiReDoorRdrObj14RdrObjAccY_ZCR_CANFD5 "" UWORD RB_RBA_Common_CentralElements_CompuMethods_Identical 1 100 0.0 65535 FORMAT "%8.2" ECU_ADDRESS 0xfe402b70 /end MEASUREMENT
/begin MEASUREMENT Tlib_RiReDoorRdrObj14RdrObjRangeZ_ZCR_CANFD5 "" UWORD RB_RBA_Common_CentralElements_CompuMethods_Identical 1 100 0.0 65535 FORMAT "%8.2" ECU_ADDRESS 0xfe402b72 /end MEASUREMENT
/begin MEASUREMENT Tlib_RiReDoorRdrObj14RdrObjSpeedY_ZCR_CANFD5 "" UWORD RB_RBA_Common_CentralElements_CompuMethods_Identical 1 100 0.0 65535 FORMAT "%8.2" ECU_ADDRESS 0xfe402b74 /end MEASUREMENT
/begin MEASUREMENT Tlib_RiReDoorRdrObj14RdrObjSpeedStdX_ZCR_CANFD5 "" UBYTE RB_RBA_Common_CentralElements_CompuMethods_Identical 1 100 0.0 255.00 FORMAT "%8.2" ECU_ADDRESS 0xfe4034cc /end MEASUREMENT
/begin MEASUREMENT Tlib_RiReDoorRdrObj14RdrObjIdx_ZCR_CANFD5 "" UBYTE RB_RBA_Common_CentralElements_CompuMethods_Identical 1 100 0.0 255.00 FORMAT "%8.2" ECU_ADDRESS 0xfe4034cd /end MEASUREMENT
/begin MEASUREMENT Tlib_RiReDoorRdrObj14RdrObjTrackClass_ZCR_CANFD5 "" UBYTE RB_RBA_Common_CentralElements_CompuMethods_Identical 1 100 0.0 255.00 FORMAT "%8.2" ECU_ADDRESS 0xfe4034ce /end MEASUREMENT
/begin MEASUREMENT Tlib_RiReDoorRdrObj14RdrObjConfidLvl_ZCR_CANFD5 "" UBYTE RB_RBA_Common_CentralElements_CompuMethods_Identical 1 100 0.0 255.00 FORMAT "%8.2" ECU_ADDRESS 0xfe4034cf /end MEASUREMENT
/begin MEASUREMENT Tlib_RiReDoorRdrObj14RdrObjDataMode_ZCR_CANFD5 "" UBYTE RB_RBA_Common_CentralElements_CompuMethods_Identical 1 100 0.0 255.00 FORMAT "%8.2" ECU_ADDRESS 0xfe4034d0 /end MEASUREMENT
/begin MEASUREMENT Tlib_RiReDoorRdrObj14RdrObjRangeX_ZCR_CANFD5 "" UWORD RB_RBA_Common_CentralElements_CompuMethods_Identical 1 100 0.0 65535 FORMAT "%8.2" ECU_ADDRESS 0xfe402b76 /end MEASUREMENT
/begin MEASUREMENT Tlib_RiReDoorRdrObj14RdrObjSpeedX_ZCR_CANFD5 "" UWORD RB_RBA_Common_CentralElements_CompuMethods_Identical 1 100 0.0 65535 FORMAT "%8.2" ECU_ADDRESS 0xfe402b78 /end MEASUREMENT
/begin MEASUREMENT Tlib_RiReDoorRdrObj14RdrObjMotionPattern_ZCR_CANFD5 "" UBYTE RB_RBA_Common_CentralElements_CompuMethods_Identical 1 100 0.0 255.00 FORMAT "%8.2" ECU_ADDRESS 0xfe4034d1 /end MEASUREMENT
/begin MEASUREMENT Tlib_RiReDoorRdrObj12RdrObjAccStdX_ZCR_CANFD5 "" UBYTE RB_RBA_Common_CentralElements_CompuMethods_Identical 1 100 0.0 255.00 FORMAT "%8.2" ECU_ADDRESS 0xfe4034d2 /end MEASUREMENT
/begin MEASUREMENT Tlib_RiReDoorRdrObj12RdrObjAccStdY_ZCR_CANFD5 "" UBYTE RB_RBA_Common_CentralElements_CompuMethods_Identical 1 100 0.0 255.00 FORMAT "%8.2" ECU_ADDRESS 0xfe4034d3 /end MEASUREMENT
/begin MEASUREMENT Tlib_RiReDoorRdrObj12RdrObjSpeedStdX_ZCR_CANFD5 "" UBYTE RB_RBA_Common_CentralElements_CompuMethods_Identical 1 100 0.0 255.00 FORMAT "%8.2" ECU_ADDRESS 0xfe4034d4 /end MEASUREMENT
/begin MEASUREMENT Tlib_RiReDoorRdrObj12RdrObjRangeStdZ_ZCR_CANFD5 "" UBYTE RB_RBA_Common_CentralElements_CompuMethods_Identical 1 100 0.0 255.00 FORMAT "%8.2" ECU_ADDRESS 0xfe4034d5 /end MEASUREMENT
/begin MEASUREMENT Tlib_RiReDoorRdrObj12RdrObjRangeZ_ZCR_CANFD5 "" UWORD RB_RBA_Common_CentralElements_CompuMethods_Identical 1 100 0.0 65535 FORMAT "%8.2" ECU_ADDRESS 0xfe402b7a /end MEASUREMENT
/begin MEASUREMENT Tlib_RiReDoorRdrObj12RdrObjConfidLvl_ZCR_CANFD5 "" UBYTE RB_RBA_Common_CentralElements_CompuMethods_Identical 1 100 0.0 255.00 FORMAT "%8.2" ECU_ADDRESS 0xfe4034d6 /end MEASUREMENT
/begin MEASUREMENT Tlib_RiReDoorRdrObj12RdrObjTrackAge_ZCR_CANFD5 "" UBYTE RB_RBA_Common_CentralElements_CompuMethods_Identical 1 100 0.0 255.00 FORMAT "%8.2" ECU_ADDRESS 0xfe4034d7 /end MEASUREMENT
/begin MEASUREMENT Tlib_RiReDoorRdrObj12RdrObjAccY_ZCR_CANFD5 "" UWORD RB_RBA_Common_CentralElements_CompuMethods_Identical 1 100 0.0 65535 FORMAT "%8.2" ECU_ADDRESS 0xfe402b7c /end MEASUREMENT
/begin MEASUREMENT Tlib_RiReDoorRdrObj12RdrObjSpeedStdY_ZCR_CANFD5 "" UBYTE RB_RBA_Common_CentralElements_CompuMethods_Identical 1 100 0.0 255.00 FORMAT "%8.2" ECU_ADDRESS 0xfe4034d8 /end MEASUREMENT
/begin MEASUREMENT Tlib_RiReDoorRdrObj12RdrObjDataMode_ZCR_CANFD5 "" UBYTE RB_RBA_Common_CentralElements_CompuMethods_Identical 1 100 0.0 255.00 FORMAT "%8.2" ECU_ADDRESS 0xfe4034d9 /end MEASUREMENT
/begin MEASUREMENT Tlib_RiReDoorRdrObj12RdrObjSpeedY_ZCR_CANFD5 "" UWORD RB_RBA_Common_CentralElements_CompuMethods_Identical 1 100 0.0 65535 FORMAT "%8.2" ECU_ADDRESS 0xfe402b7e /end MEASUREMENT
/begin MEASUREMENT Tlib_RiReDoorRdrObj12RdrObjAccX_ZCR_CANFD5 "" UWORD RB_RBA_Common_CentralElements_CompuMethods_Identical 1 100 0.0 65535 FORMAT "%8.2" ECU_ADDRESS 0xfe402b80 /end MEASUREMENT
/begin MEASUREMENT Tlib_RiReDoorRdrObj12RdrObjRangeX_ZCR_CANFD5 "" UWORD RB_RBA_Common_CentralElements_CompuMethods_Identical 1 100 0.0 65535 FORMAT "%8.2" ECU_ADDRESS 0xfe402b82 /end MEASUREMENT
/begin MEASUREMENT Tlib_RiReDoorRdrObj12RdrObjIdx_ZCR_CANFD5 "" UBYTE RB_RBA_Common_CentralElements_CompuMethods_Identical 1 100 0.0 255.00 FORMAT "%8.2" ECU_ADDRESS 0xfe4034da /end MEASUREMENT
/begin MEASUREMENT Tlib_RiReDoorRdrObj12RdrObjMotionPattern_ZCR_CANFD5 "" UBYTE RB_RBA_Common_CentralElements_CompuMethods_Identical 1 100 0.0 255.00 FORMAT "%8.2" ECU_ADDRESS 0xfe4034db /end MEASUREMENT
/begin MEASUREMENT Tlib_RiReDoorRdrObj12RdrObjRangeStdY_ZCR_CANFD5 "" UBYTE RB_RBA_Common_CentralElements_CompuMethods_Identical 1 100 0.0 255.00 FORMAT "%8.2" ECU_ADDRESS 0xfe4034dc /end MEASUREMENT
/begin MEASUREMENT Tlib_RiReDoorRdrObj12RdrObjSpeedX_ZCR_CANFD5 "" UWORD RB_RBA_Common_CentralElements_CompuMethods_Identical 1 100 0.0 65535 FORMAT "%8.2" ECU_ADDRESS 0xfe402b84 /end MEASUREMENT
/begin MEASUREMENT Tlib_RiReDoorRdrObj12RdrObjRangeStdX_ZCR_CANFD5 "" UBYTE RB_RBA_Common_CentralElements_CompuMethods_Identical 1 100 0.0 255.00 FORMAT "%8.2" ECU_ADDRESS 0xfe4034dd /end MEASUREMENT
/begin MEASUREMENT Tlib_RiReDoorRdrObj12RdrObjTrackClass_ZCR_CANFD5 "" UBYTE RB_RBA_Common_CentralElements_CompuMethods_Identical 1 100 0.0 255.00 FORMAT "%8.2" ECU_ADDRESS 0xfe4034de /end MEASUREMENT
/begin MEASUREMENT Tlib_RiReDoorRdrObj12RdrObjRangeY_ZCR_CANFD5 "" UWORD RB_RBA_Common_CentralElements_CompuMethods_Identical 1 100 0.0 65535 FORMAT "%8.2" ECU_ADDRESS 0xfe402b86 /end MEASUREMENT
/begin MEASUREMENT Tlib_PassDoorRdrObj17RdrObjSpeedStdY_ZCR_CANFD5 "" UBYTE RB_RBA_Common_CentralElements_CompuMethods_Identical 1 100 0.0 255.00 FORMAT "%8.2" ECU_ADDRESS 0xfe4034df /end MEASUREMENT
/begin MEASUREMENT Tlib_PassDoorRdrObj17RdrObjRangeStdX_ZCR_CANFD5 "" UBYTE RB_RBA_Common_CentralElements_CompuMethods_Identical 1 100 0.0 255.00 FORMAT "%8.2" ECU_ADDRESS 0xfe4034e0 /end MEASUREMENT
/begin MEASUREMENT Tlib_PassDoorRdrObj17RdrObjRangeStdY_ZCR_CANFD5 "" UBYTE RB_RBA_Common_CentralElements_CompuMethods_Identical 1 100 0.0 255.00 FORMAT "%8.2" ECU_ADDRESS 0xfe4034e1 /end MEASUREMENT
/begin MEASUREMENT Tlib_PassDoorRdrObj17RdrObjAccX_ZCR_CANFD5 "" UWORD RB_RBA_Common_CentralElements_CompuMethods_Identical 1 100 0.0 65535 FORMAT "%8.2" ECU_ADDRESS 0xfe402b88 /end MEASUREMENT
/begin MEASUREMENT Tlib_PassDoorRdrObj17RdrObjSpeedStdX_ZCR_CANFD5 "" UBYTE RB_RBA_Common_CentralElements_CompuMethods_Identical 1 100 0.0 255.00 FORMAT "%8.2" ECU_ADDRESS 0xfe4034e2 /end MEASUREMENT
/begin MEASUREMENT Tlib_PassDoorRdrObj17RdrObjRangeZ_ZCR_CANFD5 "" UWORD RB_RBA_Common_CentralElements_CompuMethods_Identical 1 100 0.0 65535 FORMAT "%8.2" ECU_ADDRESS 0xfe402b8a /end MEASUREMENT
/begin MEASUREMENT Tlib_PassDoorRdrObj17RdrObjAccY_ZCR_CANFD5 "" UWORD RB_RBA_Common_CentralElements_CompuMethods_Identical 1 100 0.0 65535 FORMAT "%8.2" ECU_ADDRESS 0xfe402b8c /end MEASUREMENT
/begin MEASUREMENT Tlib_PassDoorRdrObj17RdrObjAccStdY_ZCR_CANFD5 "" UBYTE RB_RBA_Common_CentralElements_CompuMethods_Identical 1 100 0.0 255.00 FORMAT "%8.2" ECU_ADDRESS 0xfe4034e3 /end MEASUREMENT
/begin MEASUREMENT Tlib_PassDoorRdrObj17RdrObjRangeStdZ_ZCR_CANFD5 "" UBYTE RB_RBA_Common_CentralElements_CompuMethods_Identical 1 100 0.0 255.00 FORMAT "%8.2" ECU_ADDRESS 0xfe4034e4 /end MEASUREMENT
/begin MEASUREMENT Tlib_PassDoorRdrObj17RdrObjIdx_ZCR_CANFD5 "" UBYTE RB_RBA_Common_CentralElements_CompuMethods_Identical 1 100 0.0 255.00 FORMAT "%8.2" ECU_ADDRESS 0xfe4034e5 /end MEASUREMENT
/begin MEASUREMENT Tlib_PassDoorRdrObj17RdrObjConfidLvl_ZCR_CANFD5 "" UBYTE RB_RBA_Common_CentralElements_CompuMethods_Identical 1 100 0.0 255.00 FORMAT "%8.2" ECU_ADDRESS 0xfe4034e6 /end MEASUREMENT
/begin MEASUREMENT Tlib_PassDoorRdrObj17RdrObjAccStdX_ZCR_CANFD5 "" UBYTE RB_RBA_Common_CentralElements_CompuMethods_Identical 1 100 0.0 255.00 FORMAT "%8.2" ECU_ADDRESS 0xfe4034e7 /end MEASUREMENT
/begin MEASUREMENT Tlib_PassDoorRdrObj17RdrObjTrackAge_ZCR_CANFD5 "" UBYTE RB_RBA_Common_CentralElements_CompuMethods_Identical 1 100 0.0 255.00 FORMAT "%8.2" ECU_ADDRESS 0xfe4034e8 /end MEASUREMENT
/begin MEASUREMENT Tlib_PassDoorRdrObj17RdrObjSpeedX_ZCR_CANFD5 "" UWORD RB_RBA_Common_CentralElements_CompuMethods_Identical 1 100 0.0 65535 FORMAT "%8.2" ECU_ADDRESS 0xfe402b8e /end MEASUREMENT
/begin MEASUREMENT Tlib_PassDoorRdrObj17RdrObjRangeY_ZCR_CANFD5 "" UWORD RB_RBA_Common_CentralElements_CompuMethods_Identical 1 100 0.0 65535 FORMAT "%8.2" ECU_ADDRESS 0xfe402b90 /end MEASUREMENT
/begin MEASUREMENT Tlib_PassDoorRdrObj17RdrObjSpeedY_ZCR_CANFD5 "" UWORD RB_RBA_Common_CentralElements_CompuMethods_Identical 1 100 0.0 65535 FORMAT "%8.2" ECU_ADDRESS 0xfe402b92 /end MEASUREMENT
/begin MEASUREMENT Tlib_PassDoorRdrObj17RdrObjRangeX_ZCR_CANFD5 "" UWORD RB_RBA_Common_CentralElements_CompuMethods_Identical 1 100 0.0 65535 FORMAT "%8.2" ECU_ADDRESS 0xfe402b94 /end MEASUREMENT
/begin MEASUREMENT Tlib_PassDoorRdrObj17RdrObjTrackClass_ZCR_CANFD5 "" UBYTE RB_RBA_Common_CentralElements_CompuMethods_Identical 1 100 0.0 255.00 FORMAT "%8.2" ECU_ADDRESS 0xfe4034e9 /end MEASUREMENT
/begin MEASUREMENT Tlib_PassDoorRdrObj17RdrObjDataMode_ZCR_CANFD5 "" UBYTE RB_RBA_Common_CentralElements_CompuMethods_Identical 1 100 0.0 255.00 FORMAT "%8.2" ECU_ADDRESS 0xfe4034ea /end MEASUREMENT
/begin MEASUREMENT Tlib_PassDoorRdrObj17RdrObjMotionPattern_ZCR_CANFD5 "" UBYTE RB_RBA_Common_CentralElements_CompuMethods_Identical 1 100 0.0 255.00 FORMAT "%8.2" ECU_ADDRESS 0xfe4034eb /end MEASUREMENT
/begin MEASUREMENT Tlib_PassDoorRdrObj16RdrObjAccStdX_ZCR_CANFD5 "" UBYTE RB_RBA_Common_CentralElements_CompuMethods_Identical 1 100 0.0 255.00 FORMAT "%8.2" ECU_ADDRESS 0xfe4034ec /end MEASUREMENT
/begin MEASUREMENT Tlib_PassDoorRdrObj16RdrObjTrackAge_ZCR_CANFD5 "" UBYTE RB_RBA_Common_CentralElements_CompuMethods_Identical 1 100 0.0 255.00 FORMAT "%8.2" ECU_ADDRESS 0xfe4034ed /end MEASUREMENT
/begin MEASUREMENT Tlib_PassDoorRdrObj16RdrObjRangeX_ZCR_CANFD5 "" UWORD RB_RBA_Common_CentralElements_CompuMethods_Identical 1 100 0.0 65535 FORMAT "%8.2" ECU_ADDRESS 0xfe402b96 /end MEASUREMENT
/begin MEASUREMENT Tlib_PassDoorRdrObj16RdrObjRangeY_ZCR_CANFD5 "" UWORD RB_RBA_Common_CentralElements_CompuMethods_Identical 1 100 0.0 65535 FORMAT "%8.2" ECU_ADDRESS 0xfe402b98 /end MEASUREMENT
/begin MEASUREMENT Tlib_PassDoorRdrObj16RdrObjIdx_ZCR_CANFD5 "" UBYTE RB_RBA_Common_CentralElements_CompuMethods_Identical 1 100 0.0 255.00 FORMAT "%8.2" ECU_ADDRESS 0xfe4034ee /end MEASUREMENT
/begin MEASUREMENT Tlib_PassDoorRdrObj16RdrObjMotionPattern_ZCR_CANFD5 "" UBYTE RB_RBA_Common_CentralElements_CompuMethods_Identical 1 100 0.0 255.00 FORMAT "%8.2" ECU_ADDRESS 0xfe4034ef /end MEASUREMENT
/begin MEASUREMENT Tlib_PassDoorRdrObj16RdrObjRangeZ_ZCR_CANFD5 "" UWORD RB_RBA_Common_CentralElements_CompuMethods_Identical 1 100 0.0 65535 FORMAT "%8.2" ECU_ADDRESS 0xfe402b9a /end MEASUREMENT
/begin MEASUREMENT Tlib_PassDoorRdrObj16RdrObjAccY_ZCR_CANFD5 "" UWORD RB_RBA_Common_CentralElements_CompuMethods_Identical 1 100 0.0 65535 FORMAT "%8.2" ECU_ADDRESS 0xfe402b9c /end MEASUREMENT
/begin MEASUREMENT Tlib_PassDoorRdrObj16RdrObjRangeStdX_ZCR_CANFD5 "" UBYTE RB_RBA_Common_CentralElements_CompuMethods_Identical 1 100 0.0 255.00 FORMAT "%8.2" ECU_ADDRESS 0xfe4034f0 /end MEASUREMENT
/begin MEASUREMENT Tlib_PassDoorRdrObj16RdrObjRangeStdZ_ZCR_CANFD5 "" UBYTE RB_RBA_Common_CentralElements_CompuMethods_Identical 1 100 0.0 255.00 FORMAT "%8.2" ECU_ADDRESS 0xfe4034f1 /end MEASUREMENT
/begin MEASUREMENT Tlib_PassDoorRdrObj16RdrObjSpeedX_ZCR_CANFD5 "" UWORD RB_RBA_Common_CentralElements_CompuMethods_Identical 1 100 0.0 65535 FORMAT "%8.2" ECU_ADDRESS 0xfe402b9e /end MEASUREMENT
/begin MEASUREMENT Tlib_PassDoorRdrObj16RdrObjDataMode_ZCR_CANFD5 "" UBYTE RB_RBA_Common_CentralElements_CompuMethods_Identical 1 100 0.0 255.00 FORMAT "%8.2" ECU_ADDRESS 0xfe4034f2 /end MEASUREMENT
/begin MEASUREMENT Tlib_PassDoorRdrObj16RdrObjSpeedStdX_ZCR_CANFD5 "" UBYTE RB_RBA_Common_CentralElements_CompuMethods_Identical 1 100 0.0 255.00 FORMAT "%8.2" ECU_ADDRESS 0xfe4034f3 /end MEASUREMENT
/begin MEASUREMENT Tlib_PassDoorRdrObj16RdrObjAccX_ZCR_CANFD5 "" UWORD RB_RBA_Common_CentralElements_CompuMethods_Identical 1 100 0.0 65535 FORMAT "%8.2" ECU_ADDRESS 0xfe402ba0 /end MEASUREMENT
/begin MEASUREMENT Tlib_PassDoorRdrObj16RdrObjRangeStdY_ZCR_CANFD5 "" UBYTE RB_RBA_Common_CentralElements_CompuMethods_Identical 1 100 0.0 255.00 FORMAT "%8.2" ECU_ADDRESS 0xfe4034f4 /end MEASUREMENT
/begin MEASUREMENT Tlib_PassDoorRdrObj16RdrObjAccStdY_ZCR_CANFD5 "" UBYTE RB_RBA_Common_CentralElements_CompuMethods_Identical 1 100 0.0 255.00 FORMAT "%8.2" ECU_ADDRESS 0xfe4034f5 /end MEASUREMENT
/begin MEASUREMENT Tlib_PassDoorRdrObj16RdrObjSpeedY_ZCR_CANFD5 "" UWORD RB_RBA_Common_CentralElements_CompuMethods_Identical 1 100 0.0 65535 FORMAT "%8.2" ECU_ADDRESS 0xfe402ba2 /end MEASUREMENT
/begin MEASUREMENT Tlib_PassDoorRdrObj16RdrObjConfidLvl_ZCR_CANFD5 "" UBYTE RB_RBA_Common_CentralElements_CompuMethods_Identical 1 100 0.0 255.00 FORMAT "%8.2" ECU_ADDRESS 0xfe4034f6 /end MEASUREMENT
/begin MEASUREMENT Tlib_PassDoorRdrObj16RdrObjTrackClass_ZCR_CANFD5 "" UBYTE RB_RBA_Common_CentralElements_CompuMethods_Identical 1 100 0.0 255.00 FORMAT "%8.2" ECU_ADDRESS 0xfe4034f7 /end MEASUREMENT
/begin MEASUREMENT Tlib_PassDoorRdrObj16RdrObjSpeedStdY_ZCR_CANFD5 "" UBYTE RB_RBA_Common_CentralElements_CompuMethods_Identical 1 100 0.0 255.00 FORMAT "%8.2" ECU_ADDRESS 0xfe4034f8 /end MEASUREMENT
/begin MEASUREMENT Tlib_PassDoorRdrObj15RdrObjRangeStdX_ZCR_CANFD5 "" UBYTE RB_RBA_Common_CentralElements_CompuMethods_Identical 1 100 0.0 255.00 FORMAT "%8.2" ECU_ADDRESS 0xfe4034f9 /end MEASUREMENT
/begin MEASUREMENT Tlib_PassDoorRdrObj15RdrObjIdx_ZCR_CANFD5 "" UBYTE RB_RBA_Common_CentralElements_CompuMethods_Identical 1 100 0.0 255.00 FORMAT "%8.2" ECU_ADDRESS 0xfe4034fa /end MEASUREMENT
/begin MEASUREMENT Tlib_PassDoorRdrObj15RdrObjRangeStdY_ZCR_CANFD5 "" UBYTE RB_RBA_Common_CentralElements_CompuMethods_Identical 1 100 0.0 255.00 FORMAT "%8.2" ECU_ADDRESS 0xfe4034fb /end MEASUREMENT
/begin MEASUREMENT Tlib_PassDoorRdrObj15RdrObjRangeStdZ_ZCR_CANFD5 "" UBYTE RB_RBA_Common_CentralElements_CompuMethods_Identical 1 100 0.0 255.00 FORMAT "%8.2" ECU_ADDRESS 0xfe4034fc /end MEASUREMENT
/begin MEASUREMENT Tlib_PassDoorRdrObj15RdrObjMotionPattern_ZCR_CANFD5 "" UBYTE RB_RBA_Common_CentralElements_CompuMethods_Identical 1 100 0.0 255.00 FORMAT "%8.2" ECU_ADDRESS 0xfe4034fd /end MEASUREMENT
/begin MEASUREMENT Tlib_PassDoorRdrObj15RdrObjAccStdX_ZCR_CANFD5 "" UBYTE RB_RBA_Common_CentralElements_CompuMethods_Identical 1 100 0.0 255.00 FORMAT "%8.2" ECU_ADDRESS 0xfe4034fe /end MEASUREMENT
/begin MEASUREMENT Tlib_PassDoorRdrObj15RdrObjRangeZ_ZCR_CANFD5 "" UWORD RB_RBA_Common_CentralElements_CompuMethods_Identical 1 100 0.0 65535 FORMAT "%8.2" ECU_ADDRESS 0xfe402ba4 /end MEASUREMENT
/begin MEASUREMENT Tlib_PassDoorRdrObj15RdrObjAccY_ZCR_CANFD5 "" UWORD RB_RBA_Common_CentralElements_CompuMethods_Identical 1 100 0.0 65535 FORMAT "%8.2" ECU_ADDRESS 0xfe402ba6 /end MEASUREMENT
/begin MEASUREMENT Tlib_PassDoorRdrObj15RdrObjConfidLvl_ZCR_CANFD5 "" UBYTE RB_RBA_Common_CentralElements_CompuMethods_Identical 1 100 0.0 255.00 FORMAT "%8.2" ECU_ADDRESS 0xfe4034ff /end MEASUREMENT
/begin MEASUREMENT Tlib_PassDoorRdrObj15RdrObjRangeY_ZCR_CANFD5 "" UWORD RB_RBA_Common_CentralElements_CompuMethods_Identical 1 100 0.0 65535 FORMAT "%8.2" ECU_ADDRESS 0xfe402ba8 /end MEASUREMENT
/begin MEASUREMENT Tlib_PassDoorRdrObj15RdrObjSpeedX_ZCR_CANFD5 "" UWORD RB_RBA_Common_CentralElements_CompuMethods_Identical 1 100 0.0 65535 FORMAT "%8.2" ECU_ADDRESS 0xfe402baa /end MEASUREMENT
/begin MEASUREMENT Tlib_PassDoorRdrObj15RdrObjRangeX_ZCR_CANFD5 "" UWORD RB_RBA_Common_CentralElements_CompuMethods_Identical 1 100 0.0 65535 FORMAT "%8.2" ECU_ADDRESS 0xfe402bac /end MEASUREMENT
/begin MEASUREMENT Tlib_PassDoorRdrObj15RdrObjAccStdY_ZCR_CANFD5 "" UBYTE RB_RBA_Common_CentralElements_CompuMethods_Identical 1 100 0.0 255.00 FORMAT "%8.2" ECU_ADDRESS 0xfe403500 /end MEASUREMENT
/begin MEASUREMENT Tlib_PassDoorRdrObj15RdrObjSpeedY_ZCR_CANFD5 "" UWORD RB_RBA_Common_CentralElements_CompuMethods_Identical 1 100 0.0 65535 FORMAT "%8.2" ECU_ADDRESS 0xfe402bae /end MEASUREMENT
/begin MEASUREMENT Tlib_PassDoorRdrObj15RdrObjAccX_ZCR_CANFD5 "" UWORD RB_RBA_Common_CentralElements_CompuMethods_Identical 1 100 0.0 65535 FORMAT "%8.2" ECU_ADDRESS 0xfe402bb0 /end MEASUREMENT
/begin MEASUREMENT Tlib_PassDoorRdrObj15RdrObjSpeedStdX_ZCR_CANFD5 "" UBYTE RB_RBA_Common_CentralElements_CompuMethods_Identical 1 100 0.0 255.00 FORMAT "%8.2" ECU_ADDRESS 0xfe403501 /end MEASUREMENT
/begin MEASUREMENT Tlib_PassDoorRdrObj15RdrObjTrackAge_ZCR_CANFD5 "" UBYTE RB_RBA_Common_CentralElements_CompuMethods_Identical 1 100 0.0 255.00 FORMAT "%8.2" ECU_ADDRESS 0xfe403502 /end MEASUREMENT
/begin MEASUREMENT Tlib_PassDoorRdrObj15RdrObjSpeedStdY_ZCR_CANFD5 "" UBYTE RB_RBA_Common_CentralElements_CompuMethods_Identical 1 100 0.0 255.00 FORMAT "%8.2" ECU_ADDRESS 0xfe403503 /end MEASUREMENT
/begin MEASUREMENT Tlib_PassDoorRdrObj15RdrObjDataMode_ZCR_CANFD5 "" UBYTE RB_RBA_Common_CentralElements_CompuMethods_Identical 1 100 0.0 255.00 FORMAT "%8.2" ECU_ADDRESS 0xfe403504 /end MEASUREMENT
/begin MEASUREMENT Tlib_PassDoorRdrObj15RdrObjTrackClass_ZCR_CANFD5 "" UBYTE RB_RBA_Common_CentralElements_CompuMethods_Identical 1 100 0.0 255.00 FORMAT "%8.2" ECU_ADDRESS 0xfe403505 /end MEASUREMENT
/begin MEASUREMENT Tlib_DoorPassLockStsHi_ZCR_CANFD5 "" UBYTE RB_RBA_Common_CentralElements_CompuMethods_Identical 1 100 0.0 255.00 FORMAT "%8.2" ECU_ADDRESS 0xfe403506 /end MEASUREMENT
/begin MEASUREMENT Tlib_DoorPassStsHiDataID4_ZCR_CANFD5 "" UBYTE RB_RBA_Common_CentralElements_CompuMethods_Identical 1 100 0.0 255.00 FORMAT "%8.2" ECU_ADDRESS 0xfe403507 /end MEASUREMENT
/begin MEASUREMENT Tlib_DoorPassStsHiDoorSts2_ZCR_CANFD5 "" UBYTE RB_RBA_Common_CentralElements_CompuMethods_Identical 1 100 0.0 255.00 FORMAT "%8.2" ECU_ADDRESS 0xfe403508 /end MEASUREMENT
/begin MEASUREMENT Tlib_DoorPassStsHiCntr4_ZCR_CANFD5 "" UBYTE RB_RBA_Common_CentralElements_CompuMethods_Identical 1 100 0.0 255.00 FORMAT "%8.2" ECU_ADDRESS 0xfe403509 /end MEASUREMENT
/begin MEASUREMENT Tlib_DoorPassStsHiChks8_ZCR_CANFD5 "" UBYTE RB_RBA_Common_CentralElements_CompuMethods_Identical 1 100 0.0 255.00 FORMAT "%8.2" ECU_ADDRESS 0xfe40350a /end MEASUREMENT
/begin MEASUREMENT Tlib_RiReDoorRdrObj4RdrObjAccY_ZCR_CANFD5 "" UWORD RB_RBA_Common_CentralElements_CompuMethods_Identical 1 100 0.0 65535 FORMAT "%8.2" ECU_ADDRESS 0xfe402bb2 /end MEASUREMENT
/begin MEASUREMENT Tlib_RiReDoorRdrObj4RdrObjMotionPattern_ZCR_CANFD5 "" UBYTE RB_RBA_Common_CentralElements_CompuMethods_Identical 1 100 0.0 255.00 FORMAT "%8.2" ECU_ADDRESS 0xfe40350b /end MEASUREMENT
/begin MEASUREMENT Tlib_RiReDoorRdrObj4RdrObjSpeedStdX_ZCR_CANFD5 "" UBYTE RB_RBA_Common_CentralElements_CompuMethods_Identical 1 100 0.0 255.00 FORMAT "%8.2" ECU_ADDRESS 0xfe40350c /end MEASUREMENT
/begin MEASUREMENT Tlib_RiReDoorRdrObj4RdrObjTrackClass_ZCR_CANFD5 "" UBYTE RB_RBA_Common_CentralElements_CompuMethods_Identical 1 100 0.0 255.00 FORMAT "%8.2" ECU_ADDRESS 0xfe40350d /end MEASUREMENT
/begin MEASUREMENT Tlib_RiReDoorRdrObj4RdrObjRangeStdY_ZCR_CANFD5 "" UBYTE RB_RBA_Common_CentralElements_CompuMethods_Identical 1 100 0.0 255.00 FORMAT "%8.2" ECU_ADDRESS 0xfe40350e /end MEASUREMENT
/begin MEASUREMENT Tlib_RiReDoorRdrObj4RdrObjSpeedStdY_ZCR_CANFD5 "" UBYTE RB_RBA_Common_CentralElements_CompuMethods_Identical 1 100 0.0 255.00 FORMAT "%8.2" ECU_ADDRESS 0xfe40350f /end MEASUREMENT
/begin MEASUREMENT Tlib_RiReDoorRdrObj4RdrObjConfidLvl_ZCR_CANFD5 "" UBYTE RB_RBA_Common_CentralElements_CompuMethods_Identical 1 100 0.0 255.00 FORMAT "%8.2" ECU_ADDRESS 0xfe403510 /end MEASUREMENT
/begin MEASUREMENT Tlib_RiReDoorRdrObj4RdrObjRangeStdX_ZCR_CANFD5 "" UBYTE RB_RBA_Common_CentralElements_CompuMethods_Identical 1 100 0.0 255.00 FORMAT "%8.2" ECU_ADDRESS 0xfe403511 /end MEASUREMENT
/begin MEASUREMENT Tlib_RiReDoorRdrObj4RdrObjAccX_ZCR_CANFD5 "" UWORD RB_RBA_Common_CentralElements_CompuMethods_Identical 1 100 0.0 65535 FORMAT "%8.2" ECU_ADDRESS 0xfe402bb4 /end MEASUREMENT
/begin MEASUREMENT Tlib_RiReDoorRdrObj4RdrObjIdx_ZCR_CANFD5 "" UBYTE RB_RBA_Common_CentralElements_CompuMethods_Identical 1 100 0.0 255.00 FORMAT "%8.2" ECU_ADDRESS 0xfe403512 /end MEASUREMENT
/begin MEASUREMENT Tlib_RiReDoorRdrObj4RdrObjAccStdX_ZCR_CANFD5 "" UBYTE RB_RBA_Common_CentralElements_CompuMethods_Identical 1 100 0.0 255.00 FORMAT "%8.2" ECU_ADDRESS 0xfe403513 /end MEASUREMENT
/begin MEASUREMENT Tlib_RiReDoorRdrObj4RdrObjDataMode_ZCR_CANFD5 "" UBYTE RB_RBA_Common_CentralElements_CompuMethods_Identical 1 100 0.0 255.00 FORMAT "%8.2" ECU_ADDRESS 0xfe403514 /end MEASUREMENT
/begin MEASUREMENT Tlib_RiReDoorRdrObj4RdrObjRangeX_ZCR_CANFD5 "" UWORD RB_RBA_Common_CentralElements_CompuMethods_Identical 1 100 0.0 65535 FORMAT "%8.2" ECU_ADDRESS 0xfe402bb6 /end MEASUREMENT
/begin MEASUREMENT Tlib_RiReDoorRdrObj4RdrObjRangeY_ZCR_CANFD5 "" UWORD RB_RBA_Common_CentralElements_CompuMethods_Identical 1 100 0.0 65535 FORMAT "%8.2" ECU_ADDRESS 0xfe402bb8 /end MEASUREMENT
/begin MEASUREMENT Tlib_RiReDoorRdrObj4RdrObjTrackAge_ZCR_CANFD5 "" UBYTE RB_RBA_Common_CentralElements_CompuMethods_Identical 1 100 0.0 255.00 FORMAT "%8.2" ECU_ADDRESS 0xfe403515 /end MEASUREMENT
/begin MEASUREMENT Tlib_RiReDoorRdrObj4RdrObjAccStdY_ZCR_CANFD5 "" UBYTE RB_RBA_Common_CentralElements_CompuMethods_Identical 1 100 0.0 255.00 FORMAT "%8.2" ECU_ADDRESS 0xfe403516 /end MEASUREMENT
/begin MEASUREMENT Tlib_RiReDoorRdrObj4RdrObjRangeZ_ZCR_CANFD5 "" UWORD RB_RBA_Common_CentralElements_CompuMethods_Identical 1 100 0.0 65535 FORMAT "%8.2" ECU_ADDRESS 0xfe402bba /end MEASUREMENT
/begin MEASUREMENT Tlib_RiReDoorRdrObj4RdrObjRangeStdZ_ZCR_CANFD5 "" UBYTE RB_RBA_Common_CentralElements_CompuMethods_Identical 1 100 0.0 255.00 FORMAT "%8.2" ECU_ADDRESS 0xfe403517 /end MEASUREMENT
/begin MEASUREMENT Tlib_RiReDoorRdrObj4RdrObjSpeedX_ZCR_CANFD5 "" UWORD RB_RBA_Common_CentralElements_CompuMethods_Identical 1 100 0.0 65535 FORMAT "%8.2" ECU_ADDRESS 0xfe402bbc /end MEASUREMENT
/begin MEASUREMENT Tlib_RiReDoorRdrObj4RdrObjSpeedY_ZCR_CANFD5 "" UWORD RB_RBA_Common_CentralElements_CompuMethods_Identical 1 100 0.0 65535 FORMAT "%8.2" ECU_ADDRESS 0xfe402bbe /end MEASUREMENT
/begin MEASUREMENT Tlib_RiReDoorRdrObj31RdrObjAccStdX_ZCR_CANFD5 "" UBYTE RB_RBA_Common_CentralElements_CompuMethods_Identical 1 100 0.0 255.00 FORMAT "%8.2" ECU_ADDRESS 0xfe403518 /end MEASUREMENT
/begin MEASUREMENT Tlib_RiReDoorRdrObj31RdrObjSpeedStdY_ZCR_CANFD5 "" UBYTE RB_RBA_Common_CentralElements_CompuMethods_Identical 1 100 0.0 255.00 FORMAT "%8.2" ECU_ADDRESS 0xfe403519 /end MEASUREMENT
/begin MEASUREMENT Tlib_RiReDoorRdrObj31RdrObjRangeX_ZCR_CANFD5 "" UWORD RB_RBA_Common_CentralElements_CompuMethods_Identical 1 100 0.0 65535 FORMAT "%8.2" ECU_ADDRESS 0xfe402bc0 /end MEASUREMENT
/begin MEASUREMENT Tlib_RiReDoorRdrObj31RdrObjTrackClass_ZCR_CANFD5 "" UBYTE RB_RBA_Common_CentralElements_CompuMethods_Identical 1 100 0.0 255.00 FORMAT "%8.2" ECU_ADDRESS 0xfe40351a /end MEASUREMENT
/begin MEASUREMENT Tlib_RiReDoorRdrObj31RdrObjIdx_ZCR_CANFD5 "" UBYTE RB_RBA_Common_CentralElements_CompuMethods_Identical 1 100 0.0 255.00 FORMAT "%8.2" ECU_ADDRESS 0xfe40351b /end MEASUREMENT
/begin MEASUREMENT Tlib_RiReDoorRdrObj31RdrObjRangeZ_ZCR_CANFD5 "" UWORD RB_RBA_Common_CentralElements_CompuMethods_Identical 1 100 0.0 65535 FORMAT "%8.2" ECU_ADDRESS 0xfe402bc2 /end MEASUREMENT
/begin MEASUREMENT Tlib_RiReDoorRdrObj31RdrObjSpeedX_ZCR_CANFD5 "" UWORD RB_RBA_Common_CentralElements_CompuMethods_Identical 1 100 0.0 65535 FORMAT "%8.2" ECU_ADDRESS 0xfe402bc4 /end MEASUREMENT
/begin MEASUREMENT Tlib_RiReDoorRdrObj31RdrObjDataMode_ZCR_CANFD5 "" UBYTE RB_RBA_Common_CentralElements_CompuMethods_Identical 1 100 0.0 255.00 FORMAT "%8.2" ECU_ADDRESS 0xfe40351c /end MEASUREMENT
/begin MEASUREMENT Tlib_RiReDoorRdrObj31RdrObjConfidLvl_ZCR_CANFD5 "" UBYTE RB_RBA_Common_CentralElements_CompuMethods_Identical 1 100 0.0 255.00 FORMAT "%8.2" ECU_ADDRESS 0xfe40351d /end MEASUREMENT
/begin MEASUREMENT Tlib_RiReDoorRdrObj31RdrObjAccY_ZCR_CANFD5 "" UWORD RB_RBA_Common_CentralElements_CompuMethods_Identical 1 100 0.0 65535 FORMAT "%8.2" ECU_ADDRESS 0xfe402bc6 /end MEASUREMENT
/begin MEASUREMENT Tlib_RiReDoorRdrObj31RdrObjSpeedStdX_ZCR_CANFD5 "" UBYTE RB_RBA_Common_CentralElements_CompuMethods_Identical 1 100 0.0 255.00 FORMAT "%8.2" ECU_ADDRESS 0xfe40351e /end MEASUREMENT
/begin MEASUREMENT Tlib_RiReDoorRdrObj31RdrObjAccX_ZCR_CANFD5 "" UWORD RB_RBA_Common_CentralElements_CompuMethods_Identical 1 100 0.0 65535 FORMAT "%8.2" ECU_ADDRESS 0xfe402bc8 /end MEASUREMENT
/begin MEASUREMENT Tlib_RiReDoorRdrObj31RdrObjRangeStdY_ZCR_CANFD5 "" UBYTE RB_RBA_Common_CentralElements_CompuMethods_Identical 1 100 0.0 255.00 FORMAT "%8.2" ECU_ADDRESS 0xfe40351f /end MEASUREMENT
/begin MEASUREMENT Tlib_RiReDoorRdrObj31RdrObjAccStdY_ZCR_CANFD5 "" UBYTE RB_RBA_Common_CentralElements_CompuMethods_Identical 1 100 0.0 255.00 FORMAT "%8.2" ECU_ADDRESS 0xfe403520 /end MEASUREMENT
/begin MEASUREMENT Tlib_RiReDoorRdrObj31RdrObjRangeStdZ_ZCR_CANFD5 "" UBYTE RB_RBA_Common_CentralElements_CompuMethods_Identical 1 100 0.0 255.00 FORMAT "%8.2" ECU_ADDRESS 0xfe403521 /end MEASUREMENT
/begin MEASUREMENT Tlib_RiReDoorRdrObj31RdrObjRangeY_ZCR_CANFD5 "" UWORD RB_RBA_Common_CentralElements_CompuMethods_Identical 1 100 0.0 65535 FORMAT "%8.2" ECU_ADDRESS 0xfe402bca /end MEASUREMENT
/begin MEASUREMENT Tlib_RiReDoorRdrObj31RdrObjMotionPattern_ZCR_CANFD5 "" UBYTE RB_RBA_Common_CentralElements_CompuMethods_Identical 1 100 0.0 255.00 FORMAT "%8.2" ECU_ADDRESS 0xfe403522 /end MEASUREMENT
/begin MEASUREMENT Tlib_RiReDoorRdrObj31RdrObjTrackAge_ZCR_CANFD5 "" UBYTE RB_RBA_Common_CentralElements_CompuMethods_Identical 1 100 0.0 255.00 FORMAT "%8.2" ECU_ADDRESS 0xfe403523 /end MEASUREMENT
/begin MEASUREMENT Tlib_RiReDoorRdrObj31RdrObjRangeStdX_ZCR_CANFD5 "" UBYTE RB_RBA_Common_CentralElements_CompuMethods_Identical 1 100 0.0 255.00 FORMAT "%8.2" ECU_ADDRESS 0xfe403524 /end MEASUREMENT
/begin MEASUREMENT Tlib_RiReDoorRdrObj31RdrObjSpeedY_ZCR_CANFD5 "" UWORD RB_RBA_Common_CentralElements_CompuMethods_Identical 1 100 0.0 65535 FORMAT "%8.2" ECU_ADDRESS 0xfe402bcc /end MEASUREMENT
/begin MEASUREMENT Tlib_RiReDoorRdrObj32RdrObjRangeStdY_ZCR_CANFD5 "" UBYTE RB_RBA_Common_CentralElements_CompuMethods_Identical 1 100 0.0 255.00 FORMAT "%8.2" ECU_ADDRESS 0xfe403525 /end MEASUREMENT
/begin MEASUREMENT Tlib_RiReDoorRdrObj32RdrObjSpeedX_ZCR_CANFD5 "" UWORD RB_RBA_Common_CentralElements_CompuMethods_Identical 1 100 0.0 65535 FORMAT "%8.2" ECU_ADDRESS 0xfe402bce /end MEASUREMENT
/begin MEASUREMENT Tlib_RiReDoorRdrObj32RdrObjRangeStdZ_ZCR_CANFD5 "" UBYTE RB_RBA_Common_CentralElements_CompuMethods_Identical 1 100 0.0 255.00 FORMAT "%8.2" ECU_ADDRESS 0xfe403526 /end MEASUREMENT
/begin MEASUREMENT Tlib_RiReDoorRdrObj32RdrObjAccStdX_ZCR_CANFD5 "" UBYTE RB_RBA_Common_CentralElements_CompuMethods_Identical 1 100 0.0 255.00 FORMAT "%8.2" ECU_ADDRESS 0xfe403527 /end MEASUREMENT
/begin MEASUREMENT Tlib_RiReDoorRdrObj32RdrObjDataMode_ZCR_CANFD5 "" UBYTE RB_RBA_Common_CentralElements_CompuMethods_Identical 1 100 0.0 255.00 FORMAT "%8.2" ECU_ADDRESS 0xfe403528 /end MEASUREMENT
/begin MEASUREMENT Tlib_RiReDoorRdrObj32RdrObjSpeedStdX_ZCR_CANFD5 "" UBYTE RB_RBA_Common_CentralElements_CompuMethods_Identical 1 100 0.0 255.00 FORMAT "%8.2" ECU_ADDRESS 0xfe403529 /end MEASUREMENT
/begin MEASUREMENT Tlib_RiReDoorRdrObj32RdrObjRangeZ_ZCR_CANFD5 "" UWORD RB_RBA_Common_CentralElements_CompuMethods_Identical 1 100 0.0 65535 FORMAT "%8.2" ECU_ADDRESS 0xfe402bd0 /end MEASUREMENT
/begin MEASUREMENT Tlib_RiReDoorRdrObj32RdrObjConfidLvl_ZCR_CANFD5 "" UBYTE RB_RBA_Common_CentralElements_CompuMethods_Identical 1 100 0.0 255.00 FORMAT "%8.2" ECU_ADDRESS 0xfe40352a /end MEASUREMENT
/begin MEASUREMENT Tlib_RiReDoorRdrObj32RdrObjMotionPattern_ZCR_CANFD5 "" UBYTE RB_RBA_Common_CentralElements_CompuMethods_Identical 1 100 0.0 255.00 FORMAT "%8.2" ECU_ADDRESS 0xfe40352b /end MEASUREMENT
/begin MEASUREMENT Tlib_RiReDoorRdrObj32RdrObjTrackAge_ZCR_CANFD5 "" UBYTE RB_RBA_Common_CentralElements_CompuMethods_Identical 1 100 0.0 255.00 FORMAT "%8.2" ECU_ADDRESS 0xfe40352c /end MEASUREMENT
/begin MEASUREMENT Tlib_RiReDoorRdrObj32RdrObjRangeX_ZCR_CANFD5 "" UWORD RB_RBA_Common_CentralElements_CompuMethods_Identical 1 100 0.0 65535 FORMAT "%8.2" ECU_ADDRESS 0xfe402bd2 /end MEASUREMENT
/begin MEASUREMENT Tlib_RiReDoorRdrObj32RdrObjSpeedY_ZCR_CANFD5 "" UWORD RB_RBA_Common_CentralElements_CompuMethods_Identical 1 100 0.0 65535 FORMAT "%8.2" ECU_ADDRESS 0xfe402bd4 /end MEASUREMENT
/begin MEASUREMENT Tlib_RiReDoorRdrObj32RdrObjIdx_ZCR_CANFD5 "" UBYTE RB_RBA_Common_CentralElements_CompuMethods_Identical 1 100 0.0 255.00 FORMAT "%8.2" ECU_ADDRESS 0xfe40352d /end MEASUREMENT
/begin MEASUREMENT Tlib_RiReDoorRdrObj32RdrObjAccY_ZCR_CANFD5 "" UWORD RB_RBA_Common_CentralElements_CompuMethods_Identical 1 100 0.0 65535 FORMAT "%8.2" ECU_ADDRESS 0xfe402bd6 /end MEASUREMENT
/begin MEASUREMENT Tlib_RiReDoorRdrObj32RdrObjAccStdY_ZCR_CANFD5 "" UBYTE RB_RBA_Common_CentralElements_CompuMethods_Identical 1 100 0.0 255.00 FORMAT "%8.2" ECU_ADDRESS 0xfe40352e /end MEASUREMENT
/begin MEASUREMENT Tlib_RiReDoorRdrObj32RdrObjAccX_ZCR_CANFD5 "" UWORD RB_RBA_Common_CentralElements_CompuMethods_Identical 1 100 0.0 65535 FORMAT "%8.2" ECU_ADDRESS 0xfe402bd8 /end MEASUREMENT
/begin MEASUREMENT Tlib_RiReDoorRdrObj32RdrObjRangeStdX_ZCR_CANFD5 "" UBYTE RB_RBA_Common_CentralElements_CompuMethods_Identical 1 100 0.0 255.00 FORMAT "%8.2" ECU_ADDRESS 0xfe40352f /end MEASUREMENT
/begin MEASUREMENT Tlib_RiReDoorRdrObj32RdrObjTrackClass_ZCR_CANFD5 "" UBYTE RB_RBA_Common_CentralElements_CompuMethods_Identical 1 100 0.0 255.00 FORMAT "%8.2" ECU_ADDRESS 0xfe403530 /end MEASUREMENT
/begin MEASUREMENT Tlib_RiReDoorRdrObj32RdrObjRangeY_ZCR_CANFD5 "" UWORD RB_RBA_Common_CentralElements_CompuMethods_Identical 1 100 0.0 65535 FORMAT "%8.2" ECU_ADDRESS 0xfe402bda /end MEASUREMENT
/begin MEASUREMENT Tlib_RiReDoorRdrObj32RdrObjSpeedStdY_ZCR_CANFD5 "" UBYTE RB_RBA_Common_CentralElements_CompuMethods_Identical 1 100 0.0 255.00 FORMAT "%8.2" ECU_ADDRESS 0xfe403531 /end MEASUREMENT
/begin MEASUREMENT Tlib_PassDoorRdrObj30RdrObjAccY_ZCR_CANFD5 "" UWORD RB_RBA_Common_CentralElements_CompuMethods_Identical 1 100 0.0 65535 FORMAT "%8.2" ECU_ADDRESS 0xfe402bdc /end MEASUREMENT
/begin MEASUREMENT Tlib_PassDoorRdrObj30RdrObjRangeZ_ZCR_CANFD5 "" UWORD RB_RBA_Common_CentralElements_CompuMethods_Identical 1 100 0.0 65535 FORMAT "%8.2" ECU_ADDRESS 0xfe402bde /end MEASUREMENT
/begin MEASUREMENT Tlib_PassDoorRdrObj30RdrObjRangeX_ZCR_CANFD5 "" UWORD RB_RBA_Common_CentralElements_CompuMethods_Identical 1 100 0.0 65535 FORMAT "%8.2" ECU_ADDRESS 0xfe402be0 /end MEASUREMENT
/begin MEASUREMENT Tlib_PassDoorRdrObj30RdrObjTrackAge_ZCR_CANFD5 "" UBYTE RB_RBA_Common_CentralElements_CompuMethods_Identical 1 100 0.0 255.00 FORMAT "%8.2" ECU_ADDRESS 0xfe403532 /end MEASUREMENT
/begin MEASUREMENT Tlib_PassDoorRdrObj30RdrObjSpeedX_ZCR_CANFD5 "" UWORD RB_RBA_Common_CentralElements_CompuMethods_Identical 1 100 0.0 65535 FORMAT "%8.2" ECU_ADDRESS 0xfe402be2 /end MEASUREMENT
/begin MEASUREMENT Tlib_PassDoorRdrObj30RdrObjSpeedStdY_ZCR_CANFD5 "" UBYTE RB_RBA_Common_CentralElements_CompuMethods_Identical 1 100 0.0 255.00 FORMAT "%8.2" ECU_ADDRESS 0xfe403533 /end MEASUREMENT
/begin MEASUREMENT Tlib_PassDoorRdrObj30RdrObjMotionPattern_ZCR_CANFD5 "" UBYTE RB_RBA_Common_CentralElements_CompuMethods_Identical 1 100 0.0 255.00 FORMAT "%8.2" ECU_ADDRESS 0xfe403534 /end MEASUREMENT
/begin MEASUREMENT Tlib_PassDoorRdrObj30RdrObjConfidLvl_ZCR_CANFD5 "" UBYTE RB_RBA_Common_CentralElements_CompuMethods_Identical 1 100 0.0 255.00 FORMAT "%8.2" ECU_ADDRESS 0xfe403535 /end MEASUREMENT
/begin MEASUREMENT Tlib_PassDoorRdrObj30RdrObjRangeY_ZCR_CANFD5 "" UWORD RB_RBA_Common_CentralElements_CompuMethods_Identical 1 100 0.0 65535 FORMAT "%8.2" ECU_ADDRESS 0xfe402be4 /end MEASUREMENT
/begin MEASUREMENT Tlib_PassDoorRdrObj30RdrObjDataMode_ZCR_CANFD5 "" UBYTE RB_RBA_Common_CentralElements_CompuMethods_Identical 1 100 0.0 255.00 FORMAT "%8.2" ECU_ADDRESS 0xfe403536 /end MEASUREMENT
/begin MEASUREMENT Tlib_PassDoorRdrObj30RdrObjAccStdX_ZCR_CANFD5 "" UBYTE RB_RBA_Common_CentralElements_CompuMethods_Identical 1 100 0.0 255.00 FORMAT "%8.2" ECU_ADDRESS 0xfe403537 /end MEASUREMENT
/begin MEASUREMENT Tlib_PassDoorRdrObj30RdrObjRangeStdY_ZCR_CANFD5 "" UBYTE RB_RBA_Common_CentralElements_CompuMethods_Identical 1 100 0.0 255.00 FORMAT "%8.2" ECU_ADDRESS 0xfe403538 /end MEASUREMENT
/begin MEASUREMENT Tlib_PassDoorRdrObj30RdrObjRangeStdX_ZCR_CANFD5 "" UBYTE RB_RBA_Common_CentralElements_CompuMethods_Identical 1 100 0.0 255.00 FORMAT "%8.2" ECU_ADDRESS 0xfe403539 /end MEASUREMENT
/begin MEASUREMENT Tlib_PassDoorRdrObj30RdrObjRangeStdZ_ZCR_CANFD5 "" UBYTE RB_RBA_Common_CentralElements_CompuMethods_Identical 1 100 0.0 255.00 FORMAT "%8.2" ECU_ADDRESS 0xfe40353a /end MEASUREMENT
/begin MEASUREMENT Tlib_PassDoorRdrObj30RdrObjTrackClass_ZCR_CANFD5 "" UBYTE RB_RBA_Common_CentralElements_CompuMethods_Identical 1 100 0.0 255.00 FORMAT "%8.2" ECU_ADDRESS 0xfe40353b /end MEASUREMENT
/begin MEASUREMENT Tlib_PassDoorRdrObj30RdrObjSpeedY_ZCR_CANFD5 "" UWORD RB_RBA_Common_CentralElements_CompuMethods_Identical 1 100 0.0 65535 FORMAT "%8.2" ECU_ADDRESS 0xfe402be6 /end MEASUREMENT
/begin MEASUREMENT Tlib_PassDoorRdrObj30RdrObjIdx_ZCR_CANFD5 "" UBYTE RB_RBA_Common_CentralElements_CompuMethods_Identical 1 100 0.0 255.00 FORMAT "%8.2" ECU_ADDRESS 0xfe40353c /end MEASUREMENT
/begin MEASUREMENT Tlib_PassDoorRdrObj30RdrObjAccX_ZCR_CANFD5 "" UWORD RB_RBA_Common_CentralElements_CompuMethods_Identical 1 100 0.0 65535 FORMAT "%8.2" ECU_ADDRESS 0xfe402be8 /end MEASUREMENT
/begin MEASUREMENT Tlib_PassDoorRdrObj30RdrObjAccStdY_ZCR_CANFD5 "" UBYTE RB_RBA_Common_CentralElements_CompuMethods_Identical 1 100 0.0 255.00 FORMAT "%8.2" ECU_ADDRESS 0xfe40353d /end MEASUREMENT
/begin MEASUREMENT Tlib_PassDoorRdrObj30RdrObjSpeedStdX_ZCR_CANFD5 "" UBYTE RB_RBA_Common_CentralElements_CompuMethods_Identical 1 100 0.0 255.00 FORMAT "%8.2" ECU_ADDRESS 0xfe40353e /end MEASUREMENT
/begin MEASUREMENT Tlib_PassDoorRdrObj29RdrObjRangeStdX_ZCR_CANFD5 "" UBYTE RB_RBA_Common_CentralElements_CompuMethods_Identical 1 100 0.0 255.00 FORMAT "%8.2" ECU_ADDRESS 0xfe40353f /end MEASUREMENT
/begin MEASUREMENT Tlib_PassDoorRdrObj29RdrObjRangeX_ZCR_CANFD5 "" UWORD RB_RBA_Common_CentralElements_CompuMethods_Identical 1 100 0.0 65535 FORMAT "%8.2" ECU_ADDRESS 0xfe402bea /end MEASUREMENT
/begin MEASUREMENT Tlib_PassDoorRdrObj29RdrObjSpeedStdY_ZCR_CANFD5 "" UBYTE RB_RBA_Common_CentralElements_CompuMethods_Identical 1 100 0.0 255.00 FORMAT "%8.2" ECU_ADDRESS 0xfe403540 /end MEASUREMENT
/begin MEASUREMENT Tlib_PassDoorRdrObj29RdrObjSpeedY_ZCR_CANFD5 "" UWORD RB_RBA_Common_CentralElements_CompuMethods_Identical 1 100 0.0 65535 FORMAT "%8.2" ECU_ADDRESS 0xfe402bec /end MEASUREMENT
/begin MEASUREMENT Tlib_PassDoorRdrObj29RdrObjConfidLvl_ZCR_CANFD5 "" UBYTE RB_RBA_Common_CentralElements_CompuMethods_Identical 1 100 0.0 255.00 FORMAT "%8.2" ECU_ADDRESS 0xfe403541 /end MEASUREMENT
/begin MEASUREMENT Tlib_PassDoorRdrObj29RdrObjAccX_ZCR_CANFD5 "" UWORD RB_RBA_Common_CentralElements_CompuMethods_Identical 1 100 0.0 65535 FORMAT "%8.2" ECU_ADDRESS 0xfe402bee /end MEASUREMENT
/begin MEASUREMENT Tlib_PassDoorRdrObj29RdrObjRangeY_ZCR_CANFD5 "" UWORD RB_RBA_Common_CentralElements_CompuMethods_Identical 1 100 0.0 65535 FORMAT "%8.2" ECU_ADDRESS 0xfe402bf0 /end MEASUREMENT
/begin MEASUREMENT Tlib_PassDoorRdrObj29RdrObjTrackAge_ZCR_CANFD5 "" UBYTE RB_RBA_Common_CentralElements_CompuMethods_Identical 1 100 0.0 255.00 FORMAT "%8.2" ECU_ADDRESS 0xfe403542 /end MEASUREMENT
/begin MEASUREMENT Tlib_PassDoorRdrObj29RdrObjDataMode_ZCR_CANFD5 "" UBYTE RB_RBA_Common_CentralElements_CompuMethods_Identical 1 100 0.0 255.00 FORMAT "%8.2" ECU_ADDRESS 0xfe403543 /end MEASUREMENT
/begin MEASUREMENT Tlib_PassDoorRdrObj29RdrObjRangeZ_ZCR_CANFD5 "" UWORD RB_RBA_Common_CentralElements_CompuMethods_Identical 1 100 0.0 65535 FORMAT "%8.2" ECU_ADDRESS 0xfe402bf2 /end MEASUREMENT
/begin MEASUREMENT Tlib_PassDoorRdrObj29RdrObjAccStdY_ZCR_CANFD5 "" UBYTE RB_RBA_Common_CentralElements_CompuMethods_Identical 1 100 0.0 255.00 FORMAT "%8.2" ECU_ADDRESS 0xfe403544 /end MEASUREMENT
/begin MEASUREMENT Tlib_PassDoorRdrObj29RdrObjSpeedStdX_ZCR_CANFD5 "" UBYTE RB_RBA_Common_CentralElements_CompuMethods_Identical 1 100 0.0 255.00 FORMAT "%8.2" ECU_ADDRESS 0xfe403545 /end MEASUREMENT
/begin MEASUREMENT Tlib_PassDoorRdrObj29RdrObjMotionPattern_ZCR_CANFD5 "" UBYTE RB_RBA_Common_CentralElements_CompuMethods_Identical 1 100 0.0 255.00 FORMAT "%8.2" ECU_ADDRESS 0xfe403546 /end MEASUREMENT
/begin MEASUREMENT Tlib_PassDoorRdrObj29RdrObjSpeedX_ZCR_CANFD5 "" UWORD RB_RBA_Common_CentralElements_CompuMethods_Identical 1 100 0.0 65535 FORMAT "%8.2" ECU_ADDRESS 0xfe402bf4 /end MEASUREMENT
/begin MEASUREMENT Tlib_PassDoorRdrObj29RdrObjRangeStdZ_ZCR_CANFD5 "" UBYTE RB_RBA_Common_CentralElements_CompuMethods_Identical 1 100 0.0 255.00 FORMAT "%8.2" ECU_ADDRESS 0xfe403547 /end MEASUREMENT
/begin MEASUREMENT Tlib_PassDoorRdrObj29RdrObjAccStdX_ZCR_CANFD5 "" UBYTE RB_RBA_Common_CentralElements_CompuMethods_Identical 1 100 0.0 255.00 FORMAT "%8.2" ECU_ADDRESS 0xfe403548 /end MEASUREMENT
/begin MEASUREMENT Tlib_PassDoorRdrObj29RdrObjIdx_ZCR_CANFD5 "" UBYTE RB_RBA_Common_CentralElements_CompuMethods_Identical 1 100 0.0 255.00 FORMAT "%8.2" ECU_ADDRESS 0xfe403549 /end MEASUREMENT
/begin MEASUREMENT Tlib_PassDoorRdrObj29RdrObjRangeStdY_ZCR_CANFD5 "" UBYTE RB_RBA_Common_CentralElements_CompuMethods_Identical 1 100 0.0 255.00 FORMAT "%8.2" ECU_ADDRESS 0xfe40354a /end MEASUREMENT
/begin MEASUREMENT Tlib_PassDoorRdrObj29RdrObjTrackClass_ZCR_CANFD5 "" UBYTE RB_RBA_Common_CentralElements_CompuMethods_Identical 1 100 0.0 255.00 FORMAT "%8.2" ECU_ADDRESS 0xfe40354b /end MEASUREMENT
/begin MEASUREMENT Tlib_PassDoorRdrObj29RdrObjAccY_ZCR_CANFD5 "" UWORD RB_RBA_Common_CentralElements_CompuMethods_Identical 1 100 0.0 65535 FORMAT "%8.2" ECU_ADDRESS 0xfe402bf6 /end MEASUREMENT
/begin MEASUREMENT Tlib_PassDoorRdrObj3RdrObjTrackClass_ZCR_CANFD5 "" UBYTE RB_RBA_Common_CentralElements_CompuMethods_Identical 1 100 0.0 255.00 FORMAT "%8.2" ECU_ADDRESS 0xfe40354c /end MEASUREMENT
/begin MEASUREMENT Tlib_PassDoorRdrObj3RdrObjDataMode_ZCR_CANFD5 "" UBYTE RB_RBA_Common_CentralElements_CompuMethods_Identical 1 100 0.0 255.00 FORMAT "%8.2" ECU_ADDRESS 0xfe40354d /end MEASUREMENT
/begin MEASUREMENT Tlib_PassDoorRdrObj3RdrObjSpeedY_ZCR_CANFD5 "" UWORD RB_RBA_Common_CentralElements_CompuMethods_Identical 1 100 0.0 65535 FORMAT "%8.2" ECU_ADDRESS 0xfe402bf8 /end MEASUREMENT
/begin MEASUREMENT Tlib_PassDoorRdrObj3RdrObjAccStdY_ZCR_CANFD5 "" UBYTE RB_RBA_Common_CentralElements_CompuMethods_Identical 1 100 0.0 255.00 FORMAT "%8.2" ECU_ADDRESS 0xfe40354e /end MEASUREMENT
/begin MEASUREMENT Tlib_PassDoorRdrObj3RdrObjRangeStdZ_ZCR_CANFD5 "" UBYTE RB_RBA_Common_CentralElements_CompuMethods_Identical 1 100 0.0 255.00 FORMAT "%8.2" ECU_ADDRESS 0xfe40354f /end MEASUREMENT
/begin MEASUREMENT Tlib_PassDoorRdrObj3RdrObjAccStdX_ZCR_CANFD5 "" UBYTE RB_RBA_Common_CentralElements_CompuMethods_Identical 1 100 0.0 255.00 FORMAT "%8.2" ECU_ADDRESS 0xfe403550 /end MEASUREMENT
/begin MEASUREMENT Tlib_PassDoorRdrObj3RdrObjRangeX_ZCR_CANFD5 "" UWORD RB_RBA_Common_CentralElements_CompuMethods_Identical 1 100 0.0 65535 FORMAT "%8.2" ECU_ADDRESS 0xfe402bfa /end MEASUREMENT
/begin MEASUREMENT Tlib_PassDoorRdrObj3RdrObjSpeedStdY_ZCR_CANFD5 "" UBYTE RB_RBA_Common_CentralElements_CompuMethods_Identical 1 100 0.0 255.00 FORMAT "%8.2" ECU_ADDRESS 0xfe403551 /end MEASUREMENT
/begin MEASUREMENT Tlib_PassDoorRdrObj3RdrObjTrackAge_ZCR_CANFD5 "" UBYTE RB_RBA_Common_CentralElements_CompuMethods_Identical 1 100 0.0 255.00 FORMAT "%8.2" ECU_ADDRESS 0xfe403552 /end MEASUREMENT
/begin MEASUREMENT Tlib_PassDoorRdrObj3RdrObjIdx_ZCR_CANFD5 "" UBYTE RB_RBA_Common_CentralElements_CompuMethods_Identical 1 100 0.0 255.00 FORMAT "%8.2" ECU_ADDRESS 0xfe403553 /end MEASUREMENT
/begin MEASUREMENT Tlib_PassDoorRdrObj3RdrObjAccY_ZCR_CANFD5 "" UWORD RB_RBA_Common_CentralElements_CompuMethods_Identical 1 100 0.0 65535 FORMAT "%8.2" ECU_ADDRESS 0xfe402bfc /end MEASUREMENT
/begin MEASUREMENT Tlib_PassDoorRdrObj3RdrObjConfidLvl_ZCR_CANFD5 "" UBYTE RB_RBA_Common_CentralElements_CompuMethods_Identical 1 100 0.0 255.00 FORMAT "%8.2" ECU_ADDRESS 0xfe403554 /end MEASUREMENT
/begin MEASUREMENT Tlib_PassDoorRdrObj3RdrObjMotionPattern_ZCR_CANFD5 "" UBYTE RB_RBA_Common_CentralElements_CompuMethods_Identical 1 100 0.0 255.00 FORMAT "%8.2" ECU_ADDRESS 0xfe403555 /end MEASUREMENT
/begin MEASUREMENT Tlib_PassDoorRdrObj3RdrObjRangeZ_ZCR_CANFD5 "" UWORD RB_RBA_Common_CentralElements_CompuMethods_Identical 1 100 0.0 65535 FORMAT "%8.2" ECU_ADDRESS 0xfe402bfe /end MEASUREMENT
/begin MEASUREMENT Tlib_PassDoorRdrObj3RdrObjRangeY_ZCR_CANFD5 "" UWORD RB_RBA_Common_CentralElements_CompuMethods_Identical 1 100 0.0 65535 FORMAT "%8.2" ECU_ADDRESS 0xfe402c00 /end MEASUREMENT
/begin MEASUREMENT Tlib_PassDoorRdrObj3RdrObjSpeedStdX_ZCR_CANFD5 "" UBYTE RB_RBA_Common_CentralElements_CompuMethods_Identical 1 100 0.0 255.00 FORMAT "%8.2" ECU_ADDRESS 0xfe403556 /end MEASUREMENT
/begin MEASUREMENT Tlib_PassDoorRdrObj3RdrObjAccX_ZCR_CANFD5 "" UWORD RB_RBA_Common_CentralElements_CompuMethods_Identical 1 100 0.0 65535 FORMAT "%8.2" ECU_ADDRESS 0xfe402c02 /end MEASUREMENT
/begin MEASUREMENT Tlib_PassDoorRdrObj3RdrObjSpeedX_ZCR_CANFD5 "" UWORD RB_RBA_Common_CentralElements_CompuMethods_Identical 1 100 0.0 65535 FORMAT "%8.2" ECU_ADDRESS 0xfe402c04 /end MEASUREMENT
/begin MEASUREMENT Tlib_PassDoorRdrObj3RdrObjRangeStdY_ZCR_CANFD5 "" UBYTE RB_RBA_Common_CentralElements_CompuMethods_Identical 1 100 0.0 255.00 FORMAT "%8.2" ECU_ADDRESS 0xfe403557 /end MEASUREMENT
/begin MEASUREMENT Tlib_PassDoorRdrObj3RdrObjRangeStdX_ZCR_CANFD5 "" UBYTE RB_RBA_Common_CentralElements_CompuMethods_Identical 1 100 0.0 255.00 FORMAT "%8.2" ECU_ADDRESS 0xfe403558 /end MEASUREMENT
/begin MEASUREMENT Tlib_PassDoorRdrObj26RdrObjAccStdX_ZCR_CANFD5 "" UBYTE RB_RBA_Common_CentralElements_CompuMethods_Identical 1 100 0.0 255.00 FORMAT "%8.2" ECU_ADDRESS 0xfe403559 /end MEASUREMENT
/begin MEASUREMENT Tlib_PassDoorRdrObj26RdrObjSpeedStdX_ZCR_CANFD5 "" UBYTE RB_RBA_Common_CentralElements_CompuMethods_Identical 1 100 0.0 255.00 FORMAT "%8.2" ECU_ADDRESS 0xfe40355a /end MEASUREMENT
/begin MEASUREMENT Tlib_PassDoorRdrObj26RdrObjRangeStdZ_ZCR_CANFD5 "" UBYTE RB_RBA_Common_CentralElements_CompuMethods_Identical 1 100 0.0 255.00 FORMAT "%8.2" ECU_ADDRESS 0xfe40355b /end MEASUREMENT
/begin MEASUREMENT Tlib_PassDoorRdrObj26RdrObjRangeX_ZCR_CANFD5 "" UWORD RB_RBA_Common_CentralElements_CompuMethods_Identical 1 100 0.0 65535 FORMAT "%8.2" ECU_ADDRESS 0xfe402c06 /end MEASUREMENT
/begin MEASUREMENT Tlib_PassDoorRdrObj26RdrObjDataMode_ZCR_CANFD5 "" UBYTE RB_RBA_Common_CentralElements_CompuMethods_Identical 1 100 0.0 255.00 FORMAT "%8.2" ECU_ADDRESS 0xfe40355c /end MEASUREMENT
/begin MEASUREMENT Tlib_PassDoorRdrObj26RdrObjSpeedStdY_ZCR_CANFD5 "" UBYTE RB_RBA_Common_CentralElements_CompuMethods_Identical 1 100 0.0 255.00 FORMAT "%8.2" ECU_ADDRESS 0xfe40355d /end MEASUREMENT
/begin MEASUREMENT Tlib_PassDoorRdrObj26RdrObjAccY_ZCR_CANFD5 "" UWORD RB_RBA_Common_CentralElements_CompuMethods_Identical 1 100 0.0 65535 FORMAT "%8.2" ECU_ADDRESS 0xfe402c08 /end MEASUREMENT
/begin MEASUREMENT Tlib_PassDoorRdrObj26RdrObjRangeStdX_ZCR_CANFD5 "" UBYTE RB_RBA_Common_CentralElements_CompuMethods_Identical 1 100 0.0 255.00 FORMAT "%8.2" ECU_ADDRESS 0xfe40355e /end MEASUREMENT
/begin MEASUREMENT Tlib_PassDoorRdrObj26RdrObjRangeY_ZCR_CANFD5 "" UWORD RB_RBA_Common_CentralElements_CompuMethods_Identical 1 100 0.0 65535 FORMAT "%8.2" ECU_ADDRESS 0xfe402c0a /end MEASUREMENT
/begin MEASUREMENT Tlib_PassDoorRdrObj26RdrObjAccStdY_ZCR_CANFD5 "" UBYTE RB_RBA_Common_CentralElements_CompuMethods_Identical 1 100 0.0 255.00 FORMAT "%8.2" ECU_ADDRESS 0xfe40355f /end MEASUREMENT
/begin MEASUREMENT Tlib_PassDoorRdrObj26RdrObjTrackClass_ZCR_CANFD5 "" UBYTE RB_RBA_Common_CentralElements_CompuMethods_Identical 1 100 0.0 255.00 FORMAT "%8.2" ECU_ADDRESS 0xfe403560 /end MEASUREMENT
/begin MEASUREMENT Tlib_PassDoorRdrObj26RdrObjAccX_ZCR_CANFD5 "" UWORD RB_RBA_Common_CentralElements_CompuMethods_Identical 1 100 0.0 65535 FORMAT "%8.2" ECU_ADDRESS 0xfe402c0c /end MEASUREMENT
/begin MEASUREMENT Tlib_PassDoorRdrObj26RdrObjIdx_ZCR_CANFD5 "" UBYTE RB_RBA_Common_CentralElements_CompuMethods_Identical 1 100 0.0 255.00 FORMAT "%8.2" ECU_ADDRESS 0xfe403561 /end MEASUREMENT
/begin MEASUREMENT Tlib_PassDoorRdrObj26RdrObjMotionPattern_ZCR_CANFD5 "" UBYTE RB_RBA_Common_CentralElements_CompuMethods_Identical 1 100 0.0 255.00 FORMAT "%8.2" ECU_ADDRESS 0xfe403562 /end MEASUREMENT
/begin MEASUREMENT Tlib_PassDoorRdrObj26RdrObjSpeedY_ZCR_CANFD5 "" UWORD RB_RBA_Common_CentralElements_CompuMethods_Identical 1 100 0.0 65535 FORMAT "%8.2" ECU_ADDRESS 0xfe402c0e /end MEASUREMENT
/begin MEASUREMENT Tlib_PassDoorRdrObj26RdrObjTrackAge_ZCR_CANFD5 "" UBYTE RB_RBA_Common_CentralElements_CompuMethods_Identical 1 100 0.0 255.00 FORMAT "%8.2" ECU_ADDRESS 0xfe403563 /end MEASUREMENT
/begin MEASUREMENT Tlib_PassDoorRdrObj26RdrObjConfidLvl_ZCR_CANFD5 "" UBYTE RB_RBA_Common_CentralElements_CompuMethods_Identical 1 100 0.0 255.00 FORMAT "%8.2" ECU_ADDRESS 0xfe403564 /end MEASUREMENT
/begin MEASUREMENT Tlib_PassDoorRdrObj26RdrObjSpeedX_ZCR_CANFD5 "" UWORD RB_RBA_Common_CentralElements_CompuMethods_Identical 1 100 0.0 65535 FORMAT "%8.2" ECU_ADDRESS 0xfe402c10 /end MEASUREMENT
/begin MEASUREMENT Tlib_PassDoorRdrObj26RdrObjRangeStdY_ZCR_CANFD5 "" UBYTE RB_RBA_Common_CentralElements_CompuMethods_Identical 1 100 0.0 255.00 FORMAT "%8.2" ECU_ADDRESS 0xfe403565 /end MEASUREMENT
/begin MEASUREMENT Tlib_PassDoorRdrObj26RdrObjRangeZ_ZCR_CANFD5 "" UWORD RB_RBA_Common_CentralElements_CompuMethods_Identical 1 100 0.0 65535 FORMAT "%8.2" ECU_ADDRESS 0xfe402c12 /end MEASUREMENT
/begin MEASUREMENT Tlib_PassDoorRdrObj27RdrObjRangeStdY_ZCR_CANFD5 "" UBYTE RB_RBA_Common_CentralElements_CompuMethods_Identical 1 100 0.0 255.00 FORMAT "%8.2" ECU_ADDRESS 0xfe403566 /end MEASUREMENT
/begin MEASUREMENT Tlib_PassDoorRdrObj27RdrObjRangeStdZ_ZCR_CANFD5 "" UBYTE RB_RBA_Common_CentralElements_CompuMethods_Identical 1 100 0.0 255.00 FORMAT "%8.2" ECU_ADDRESS 0xfe403567 /end MEASUREMENT
/begin MEASUREMENT Tlib_PassDoorRdrObj27RdrObjSpeedY_ZCR_CANFD5 "" UWORD RB_RBA_Common_CentralElements_CompuMethods_Identical 1 100 0.0 65535 FORMAT "%8.2" ECU_ADDRESS 0xfe402c14 /end MEASUREMENT
/begin MEASUREMENT Tlib_PassDoorRdrObj27RdrObjAccY_ZCR_CANFD5 "" UWORD RB_RBA_Common_CentralElements_CompuMethods_Identical 1 100 0.0 65535 FORMAT "%8.2" ECU_ADDRESS 0xfe402c16 /end MEASUREMENT
/begin MEASUREMENT Tlib_PassDoorRdrObj27RdrObjRangeX_ZCR_CANFD5 "" UWORD RB_RBA_Common_CentralElements_CompuMethods_Identical 1 100 0.0 65535 FORMAT "%8.2" ECU_ADDRESS 0xfe402c18 /end MEASUREMENT
/begin MEASUREMENT Tlib_PassDoorRdrObj27RdrObjRangeZ_ZCR_CANFD5 "" UWORD RB_RBA_Common_CentralElements_CompuMethods_Identical 1 100 0.0 65535 FORMAT "%8.2" ECU_ADDRESS 0xfe402c1a /end MEASUREMENT
/begin MEASUREMENT Tlib_PassDoorRdrObj27RdrObjDataMode_ZCR_CANFD5 "" UBYTE RB_RBA_Common_CentralElements_CompuMethods_Identical 1 100 0.0 255.00 FORMAT "%8.2" ECU_ADDRESS 0xfe403568 /end MEASUREMENT
/begin MEASUREMENT Tlib_PassDoorRdrObj27RdrObjSpeedX_ZCR_CANFD5 "" UWORD RB_RBA_Common_CentralElements_CompuMethods_Identical 1 100 0.0 65535 FORMAT "%8.2" ECU_ADDRESS 0xfe402c1c /end MEASUREMENT
/begin MEASUREMENT Tlib_PassDoorRdrObj27RdrObjTrackAge_ZCR_CANFD5 "" UBYTE RB_RBA_Common_CentralElements_CompuMethods_Identical 1 100 0.0 255.00 FORMAT "%8.2" ECU_ADDRESS 0xfe403569 /end MEASUREMENT
/begin MEASUREMENT Tlib_PassDoorRdrObj27RdrObjSpeedStdX_ZCR_CANFD5 "" UBYTE RB_RBA_Common_CentralElements_CompuMethods_Identical 1 100 0.0 255.00 FORMAT "%8.2" ECU_ADDRESS 0xfe40356a /end MEASUREMENT
/begin MEASUREMENT Tlib_PassDoorRdrObj27RdrObjIdx_ZCR_CANFD5 "" UBYTE RB_RBA_Common_CentralElements_CompuMethods_Identical 1 100 0.0 255.00 FORMAT "%8.2" ECU_ADDRESS 0xfe40356b /end MEASUREMENT
/begin MEASUREMENT Tlib_PassDoorRdrObj27RdrObjMotionPattern_ZCR_CANFD5 "" UBYTE RB_RBA_Common_CentralElements_CompuMethods_Identical 1 100 0.0 255.00 FORMAT "%8.2" ECU_ADDRESS 0xfe40356c /end MEASUREMENT
/begin MEASUREMENT Tlib_PassDoorRdrObj27RdrObjRangeY_ZCR_CANFD5 "" UWORD RB_RBA_Common_CentralElements_CompuMethods_Identical 1 100 0.0 65535 FORMAT "%8.2" ECU_ADDRESS 0xfe402c1e /end MEASUREMENT
/begin MEASUREMENT Tlib_PassDoorRdrObj27RdrObjAccStdX_ZCR_CANFD5 "" UBYTE RB_RBA_Common_CentralElements_CompuMethods_Identical 1 100 0.0 255.00 FORMAT "%8.2" ECU_ADDRESS 0xfe40356d /end MEASUREMENT
/begin MEASUREMENT Tlib_PassDoorRdrObj27RdrObjConfidLvl_ZCR_CANFD5 "" UBYTE RB_RBA_Common_CentralElements_CompuMethods_Identical 1 100 0.0 255.00 FORMAT "%8.2" ECU_ADDRESS 0xfe40356e /end MEASUREMENT
/begin MEASUREMENT Tlib_PassDoorRdrObj27RdrObjAccStdY_ZCR_CANFD5 "" UBYTE RB_RBA_Common_CentralElements_CompuMethods_Identical 1 100 0.0 255.00 FORMAT "%8.2" ECU_ADDRESS 0xfe40356f /end MEASUREMENT
/begin MEASUREMENT Tlib_PassDoorRdrObj27RdrObjAccX_ZCR_CANFD5 "" UWORD RB_RBA_Common_CentralElements_CompuMethods_Identical 1 100 0.0 65535 FORMAT "%8.2" ECU_ADDRESS 0xfe402c20 /end MEASUREMENT
/begin MEASUREMENT Tlib_PassDoorRdrObj27RdrObjRangeStdX_ZCR_CANFD5 "" UBYTE RB_RBA_Common_CentralElements_CompuMethods_Identical 1 100 0.0 255.00 FORMAT "%8.2" ECU_ADDRESS 0xfe403570 /end MEASUREMENT
/begin MEASUREMENT Tlib_PassDoorRdrObj27RdrObjSpeedStdY_ZCR_CANFD5 "" UBYTE RB_RBA_Common_CentralElements_CompuMethods_Identical 1 100 0.0 255.00 FORMAT "%8.2" ECU_ADDRESS 0xfe403571 /end MEASUREMENT
/begin MEASUREMENT Tlib_PassDoorRdrObj27RdrObjTrackClass_ZCR_CANFD5 "" UBYTE RB_RBA_Common_CentralElements_CompuMethods_Identical 1 100 0.0 255.00 FORMAT "%8.2" ECU_ADDRESS 0xfe403572 /end MEASUREMENT
/begin MEASUREMENT Tlib_PassDoorRdrObj28RdrObjRangeZ_ZCR_CANFD5 "" UWORD RB_RBA_Common_CentralElements_CompuMethods_Identical 1 100 0.0 65535 FORMAT "%8.2" ECU_ADDRESS 0xfe402c22 /end MEASUREMENT
/begin MEASUREMENT Tlib_PassDoorRdrObj28RdrObjConfidLvl_ZCR_CANFD5 "" UBYTE RB_RBA_Common_CentralElements_CompuMethods_Identical 1 100 0.0 255.00 FORMAT "%8.2" ECU_ADDRESS 0xfe403573 /end MEASUREMENT
/begin MEASUREMENT Tlib_PassDoorRdrObj28RdrObjRangeY_ZCR_CANFD5 "" UWORD RB_RBA_Common_CentralElements_CompuMethods_Identical 1 100 0.0 65535 FORMAT "%8.2" ECU_ADDRESS 0xfe402c24 /end MEASUREMENT
/begin MEASUREMENT Tlib_PassDoorRdrObj28RdrObjTrackAge_ZCR_CANFD5 "" UBYTE RB_RBA_Common_CentralElements_CompuMethods_Identical 1 100 0.0 255.00 FORMAT "%8.2" ECU_ADDRESS 0xfe403574 /end MEASUREMENT
/begin MEASUREMENT Tlib_PassDoorRdrObj28RdrObjDataMode_ZCR_CANFD5 "" UBYTE RB_RBA_Common_CentralElements_CompuMethods_Identical 1 100 0.0 255.00 FORMAT "%8.2" ECU_ADDRESS 0xfe403575 /end MEASUREMENT
/begin MEASUREMENT Tlib_PassDoorRdrObj28RdrObjRangeStdY_ZCR_CANFD5 "" UBYTE RB_RBA_Common_CentralElements_CompuMethods_Identical 1 100 0.0 255.00 FORMAT "%8.2" ECU_ADDRESS 0xfe403576 /end MEASUREMENT
/begin MEASUREMENT Tlib_PassDoorRdrObj28RdrObjRangeStdZ_ZCR_CANFD5 "" UBYTE RB_RBA_Common_CentralElements_CompuMethods_Identical 1 100 0.0 255.00 FORMAT "%8.2" ECU_ADDRESS 0xfe403577 /end MEASUREMENT
/begin MEASUREMENT Tlib_PassDoorRdrObj28RdrObjAccStdY_ZCR_CANFD5 "" UBYTE RB_RBA_Common_CentralElements_CompuMethods_Identical 1 100 0.0 255.00 FORMAT "%8.2" ECU_ADDRESS 0xfe403578 /end MEASUREMENT
/begin MEASUREMENT Tlib_PassDoorRdrObj28RdrObjIdx_ZCR_CANFD5 "" UBYTE RB_RBA_Common_CentralElements_CompuMethods_Identical 1 100 0.0 255.00 FORMAT "%8.2" ECU_ADDRESS 0xfe403579 /end MEASUREMENT
/begin MEASUREMENT Tlib_PassDoorRdrObj28RdrObjRangeStdX_ZCR_CANFD5 "" UBYTE RB_RBA_Common_CentralElements_CompuMethods_Identical 1 100 0.0 255.00 FORMAT "%8.2" ECU_ADDRESS 0xfe40357a /end MEASUREMENT
/begin MEASUREMENT Tlib_PassDoorRdrObj28RdrObjSpeedStdX_ZCR_CANFD5 "" UBYTE RB_RBA_Common_CentralElements_CompuMethods_Identical 1 100 0.0 255.00 FORMAT "%8.2" ECU_ADDRESS 0xfe40357b /end MEASUREMENT
/begin MEASUREMENT Tlib_PassDoorRdrObj28RdrObjSpeedX_ZCR_CANFD5 "" UWORD RB_RBA_Common_CentralElements_CompuMethods_Identical 1 100 0.0 65535 FORMAT "%8.2" ECU_ADDRESS 0xfe402c26 /end MEASUREMENT
/begin MEASUREMENT Tlib_PassDoorRdrObj28RdrObjTrackClass_ZCR_CANFD5 "" UBYTE RB_RBA_Common_CentralElements_CompuMethods_Identical 1 100 0.0 255.00 FORMAT "%8.2" ECU_ADDRESS 0xfe40357c /end MEASUREMENT
/begin MEASUREMENT Tlib_PassDoorRdrObj28RdrObjMotionPattern_ZCR_CANFD5 "" UBYTE RB_RBA_Common_CentralElements_CompuMethods_Identical 1 100 0.0 255.00 FORMAT "%8.2" ECU_ADDRESS 0xfe40357d /end MEASUREMENT
/begin MEASUREMENT Tlib_PassDoorRdrObj28RdrObjAccX_ZCR_CANFD5 "" UWORD RB_RBA_Common_CentralElements_CompuMethods_Identical 1 100 0.0 65535 FORMAT "%8.2" ECU_ADDRESS 0xfe402c28 /end MEASUREMENT
/begin MEASUREMENT Tlib_PassDoorRdrObj28RdrObjSpeedY_ZCR_CANFD5 "" UWORD RB_RBA_Common_CentralElements_CompuMethods_Identical 1 100 0.0 65535 FORMAT "%8.2" ECU_ADDRESS 0xfe402c2a /end MEASUREMENT
/begin MEASUREMENT Tlib_PassDoorRdrObj28RdrObjRangeX_ZCR_CANFD5 "" UWORD RB_RBA_Common_CentralElements_CompuMethods_Identical 1 100 0.0 65535 FORMAT "%8.2" ECU_ADDRESS 0xfe402c2c /end MEASUREMENT
/begin MEASUREMENT Tlib_PassDoorRdrObj28RdrObjAccStdX_ZCR_CANFD5 "" UBYTE RB_RBA_Common_CentralElements_CompuMethods_Identical 1 100 0.0 255.00 FORMAT "%8.2" ECU_ADDRESS 0xfe40357e /end MEASUREMENT
/begin MEASUREMENT Tlib_PassDoorRdrObj28RdrObjSpeedStdY_ZCR_CANFD5 "" UBYTE RB_RBA_Common_CentralElements_CompuMethods_Identical 1 100 0.0 255.00 FORMAT "%8.2" ECU_ADDRESS 0xfe40357f /end MEASUREMENT
/begin MEASUREMENT Tlib_PassDoorRdrObj28RdrObjAccY_ZCR_CANFD5 "" UWORD RB_RBA_Common_CentralElements_CompuMethods_Identical 1 100 0.0 65535 FORMAT "%8.2" ECU_ADDRESS 0xfe402c2e /end MEASUREMENT
/begin MEASUREMENT Tlib_RiReDoorRdrWaveSync_ZCR_CANFD5 "" A_UINT64 RB_RBA_Common_CentralElements_CompuMethods_Identical 1 100 0.0 18446744073709551615 FORMAT "%8.2" ECU_ADDRESS 0xfe402718 /end MEASUREMENT
/begin MEASUREMENT Tlib_PassDoorRdrSaveNvmFlg_ZCR_CANFD5 "" UBYTE RB_RBA_Common_CentralElements_CompuMethods_Identical 1 100 0.0 255.00 FORMAT "%8.2" ECU_ADDRESS 0xfe403580 /end MEASUREMENT
/begin MEASUREMENT Tlib_PassDoorRdrObj2RdrObjAccStdY_ZCR_CANFD5 "" UBYTE RB_RBA_Common_CentralElements_CompuMethods_Identical 1 100 0.0 255.00 FORMAT "%8.2" ECU_ADDRESS 0xfe403581 /end MEASUREMENT
/begin MEASUREMENT Tlib_PassDoorRdrObj2RdrObjAccY_ZCR_CANFD5 "" UWORD RB_RBA_Common_CentralElements_CompuMethods_Identical 1 100 0.0 65535 FORMAT "%8.2" ECU_ADDRESS 0xfe402c30 /end MEASUREMENT
/begin MEASUREMENT Tlib_PassDoorRdrObj2RdrObjSpeedX_ZCR_CANFD5 "" UWORD RB_RBA_Common_CentralElements_CompuMethods_Identical 1 100 0.0 65535 FORMAT "%8.2" ECU_ADDRESS 0xfe402c32 /end MEASUREMENT
/begin MEASUREMENT Tlib_PassDoorRdrObj2RdrObjRangeStdZ_ZCR_CANFD5 "" UBYTE RB_RBA_Common_CentralElements_CompuMethods_Identical 1 100 0.0 255.00 FORMAT "%8.2" ECU_ADDRESS 0xfe403582 /end MEASUREMENT
/begin MEASUREMENT Tlib_PassDoorRdrObj2RdrObjRangeStdY_ZCR_CANFD5 "" UBYTE RB_RBA_Common_CentralElements_CompuMethods_Identical 1 100 0.0 255.00 FORMAT "%8.2" ECU_ADDRESS 0xfe403583 /end MEASUREMENT
/begin MEASUREMENT Tlib_PassDoorRdrObj2RdrObjTrackClass_ZCR_CANFD5 "" UBYTE RB_RBA_Common_CentralElements_CompuMethods_Identical 1 100 0.0 255.00 FORMAT "%8.2" ECU_ADDRESS 0xfe403584 /end MEASUREMENT
/begin MEASUREMENT Tlib_PassDoorRdrObj2RdrObjConfidLvl_ZCR_CANFD5 "" UBYTE RB_RBA_Common_CentralElements_CompuMethods_Identical 1 100 0.0 255.00 FORMAT "%8.2" ECU_ADDRESS 0xfe403585 /end MEASUREMENT
/begin MEASUREMENT Tlib_PassDoorRdrObj2RdrObjMotionPattern_ZCR_CANFD5 "" UBYTE RB_RBA_Common_CentralElements_CompuMethods_Identical 1 100 0.0 255.00 FORMAT "%8.2" ECU_ADDRESS 0xfe403586 /end MEASUREMENT
/begin MEASUREMENT Tlib_PassDoorRdrObj2RdrObjDataMode_ZCR_CANFD5 "" UBYTE RB_RBA_Common_CentralElements_CompuMethods_Identical 1 100 0.0 255.00 FORMAT "%8.2" ECU_ADDRESS 0xfe403587 /end MEASUREMENT
/begin MEASUREMENT Tlib_PassDoorRdrObj2RdrObjAccX_ZCR_CANFD5 "" UWORD RB_RBA_Common_CentralElements_CompuMethods_Identical 1 100 0.0 65535 FORMAT "%8.2" ECU_ADDRESS 0xfe402c34 /end MEASUREMENT
/begin MEASUREMENT Tlib_PassDoorRdrObj2RdrObjIdx_ZCR_CANFD5 "" UBYTE RB_RBA_Common_CentralElements_CompuMethods_Identical 1 100 0.0 255.00 FORMAT "%8.2" ECU_ADDRESS 0xfe403588 /end MEASUREMENT
/begin MEASUREMENT Tlib_PassDoorRdrObj2RdrObjSpeedStdX_ZCR_CANFD5 "" UBYTE RB_RBA_Common_CentralElements_CompuMethods_Identical 1 100 0.0 255.00 FORMAT "%8.2" ECU_ADDRESS 0xfe403589 /end MEASUREMENT
/begin MEASUREMENT Tlib_PassDoorRdrObj2RdrObjAccStdX_ZCR_CANFD5 "" UBYTE RB_RBA_Common_CentralElements_CompuMethods_Identical 1 100 0.0 255.00 FORMAT "%8.2" ECU_ADDRESS 0xfe40358a /end MEASUREMENT
/begin MEASUREMENT Tlib_PassDoorRdrObj2RdrObjSpeedStdY_ZCR_CANFD5 "" UBYTE RB_RBA_Common_CentralElements_CompuMethods_Identical 1 100 0.0 255.00 FORMAT "%8.2" ECU_ADDRESS 0xfe40358b /end MEASUREMENT
/begin MEASUREMENT Tlib_PassDoorRdrObj2RdrObjRangeY_ZCR_CANFD5 "" UWORD RB_RBA_Common_CentralElements_CompuMethods_Identical 1 100 0.0 65535 FORMAT "%8.2" ECU_ADDRESS 0xfe402c36 /end MEASUREMENT
/begin MEASUREMENT Tlib_PassDoorRdrObj2RdrObjSpeedY_ZCR_CANFD5 "" UWORD RB_RBA_Common_CentralElements_CompuMethods_Identical 1 100 0.0 65535 FORMAT "%8.2" ECU_ADDRESS 0xfe402c38 /end MEASUREMENT
/begin MEASUREMENT Tlib_PassDoorRdrObj2RdrObjRangeStdX_ZCR_CANFD5 "" UBYTE RB_RBA_Common_CentralElements_CompuMethods_Identical 1 100 0.0 255.00 FORMAT "%8.2" ECU_ADDRESS 0xfe40358c /end MEASUREMENT
/begin MEASUREMENT Tlib_PassDoorRdrObj2RdrObjTrackAge_ZCR_CANFD5 "" UBYTE RB_RBA_Common_CentralElements_CompuMethods_Identical 1 100 0.0 255.00 FORMAT "%8.2" ECU_ADDRESS 0xfe40358d /end MEASUREMENT
/begin MEASUREMENT Tlib_PassDoorRdrObj2RdrObjRangeX_ZCR_CANFD5 "" UWORD RB_RBA_Common_CentralElements_CompuMethods_Identical 1 100 0.0 65535 FORMAT "%8.2" ECU_ADDRESS 0xfe402c3a /end MEASUREMENT
/begin MEASUREMENT Tlib_PassDoorRdrObj2RdrObjRangeZ_ZCR_CANFD5 "" UWORD RB_RBA_Common_CentralElements_CompuMethods_Identical 1 100 0.0 65535 FORMAT "%8.2" ECU_ADDRESS 0xfe402c3c /end MEASUREMENT
/begin MEASUREMENT Tlib_PassDoorRdrObj19RdrObjRangeY_ZCR_CANFD5 "" UWORD RB_RBA_Common_CentralElements_CompuMethods_Identical 1 100 0.0 65535 FORMAT "%8.2" ECU_ADDRESS 0xfe402c3e /end MEASUREMENT
/begin MEASUREMENT Tlib_PassDoorRdrObj19RdrObjSpeedStdY_ZCR_CANFD5 "" UBYTE RB_RBA_Common_CentralElements_CompuMethods_Identical 1 100 0.0 255.00 FORMAT "%8.2" ECU_ADDRESS 0xfe40358e /end MEASUREMENT
/begin MEASUREMENT Tlib_PassDoorRdrObj19RdrObjAccStdY_ZCR_CANFD5 "" UBYTE RB_RBA_Common_CentralElements_CompuMethods_Identical 1 100 0.0 255.00 FORMAT "%8.2" ECU_ADDRESS 0xfe40358f /end MEASUREMENT
/begin MEASUREMENT Tlib_PassDoorRdrObj19RdrObjTrackAge_ZCR_CANFD5 "" UBYTE RB_RBA_Common_CentralElements_CompuMethods_Identical 1 100 0.0 255.00 FORMAT "%8.2" ECU_ADDRESS 0xfe403590 /end MEASUREMENT
/begin MEASUREMENT Tlib_PassDoorRdrObj19RdrObjMotionPattern_ZCR_CANFD5 "" UBYTE RB_RBA_Common_CentralElements_CompuMethods_Identical 1 100 0.0 255.00 FORMAT "%8.2" ECU_ADDRESS 0xfe403591 /end MEASUREMENT
/begin MEASUREMENT Tlib_PassDoorRdrObj19RdrObjAccX_ZCR_CANFD5 "" UWORD RB_RBA_Common_CentralElements_CompuMethods_Identical 1 100 0.0 65535 FORMAT "%8.2" ECU_ADDRESS 0xfe402c40 /end MEASUREMENT
/begin MEASUREMENT Tlib_PassDoorRdrObj19RdrObjIdx_ZCR_CANFD5 "" UBYTE RB_RBA_Common_CentralElements_CompuMethods_Identical 1 100 0.0 255.00 FORMAT "%8.2" ECU_ADDRESS 0xfe403592 /end MEASUREMENT
/begin MEASUREMENT Tlib_PassDoorRdrObj19RdrObjRangeX_ZCR_CANFD5 "" UWORD RB_RBA_Common_CentralElements_CompuMethods_Identical 1 100 0.0 65535 FORMAT "%8.2" ECU_ADDRESS 0xfe402c42 /end MEASUREMENT
/begin MEASUREMENT Tlib_PassDoorRdrObj19RdrObjRangeStdX_ZCR_CANFD5 "" UBYTE RB_RBA_Common_CentralElements_CompuMethods_Identical 1 100 0.0 255.00 FORMAT "%8.2" ECU_ADDRESS 0xfe403593 /end MEASUREMENT
/begin MEASUREMENT Tlib_PassDoorRdrObj19RdrObjAccStdX_ZCR_CANFD5 "" UBYTE RB_RBA_Common_CentralElements_CompuMethods_Identical 1 100 0.0 255.00 FORMAT "%8.2" ECU_ADDRESS 0xfe403594 /end MEASUREMENT
/begin MEASUREMENT Tlib_PassDoorRdrObj19RdrObjSpeedStdX_ZCR_CANFD5 "" UBYTE RB_RBA_Common_CentralElements_CompuMethods_Identical 1 100 0.0 255.00 FORMAT "%8.2" ECU_ADDRESS 0xfe403595 /end MEASUREMENT
/begin MEASUREMENT Tlib_PassDoorRdrObj19RdrObjSpeedY_ZCR_CANFD5 "" UWORD RB_RBA_Common_CentralElements_CompuMethods_Identical 1 100 0.0 65535 FORMAT "%8.2" ECU_ADDRESS 0xfe402c44 /end MEASUREMENT
/begin MEASUREMENT Tlib_PassDoorRdrObj19RdrObjRangeZ_ZCR_CANFD5 "" UWORD RB_RBA_Common_CentralElements_CompuMethods_Identical 1 100 0.0 65535 FORMAT "%8.2" ECU_ADDRESS 0xfe402c46 /end MEASUREMENT
/begin MEASUREMENT Tlib_PassDoorRdrObj19RdrObjConfidLvl_ZCR_CANFD5 "" UBYTE RB_RBA_Common_CentralElements_CompuMethods_Identical 1 100 0.0 255.00 FORMAT "%8.2" ECU_ADDRESS 0xfe403596 /end MEASUREMENT
/begin MEASUREMENT Tlib_PassDoorRdrObj19RdrObjRangeStdZ_ZCR_CANFD5 "" UBYTE RB_RBA_Common_CentralElements_CompuMethods_Identical 1 100 0.0 255.00 FORMAT "%8.2" ECU_ADDRESS 0xfe403597 /end MEASUREMENT
/begin MEASUREMENT Tlib_PassDoorRdrObj19RdrObjTrackClass_ZCR_CANFD5 "" UBYTE RB_RBA_Common_CentralElements_CompuMethods_Identical 1 100 0.0 255.00 FORMAT "%8.2" ECU_ADDRESS 0xfe403598 /end MEASUREMENT
/begin MEASUREMENT Tlib_PassDoorRdrObj19RdrObjAccY_ZCR_CANFD5 "" UWORD RB_RBA_Common_CentralElements_CompuMethods_Identical 1 100 0.0 65535 FORMAT "%8.2" ECU_ADDRESS 0xfe402c48 /end MEASUREMENT
/begin MEASUREMENT Tlib_PassDoorRdrObj19RdrObjDataMode_ZCR_CANFD5 "" UBYTE RB_RBA_Common_CentralElements_CompuMethods_Identical 1 100 0.0 255.00 FORMAT "%8.2" ECU_ADDRESS 0xfe403599 /end MEASUREMENT
/begin MEASUREMENT Tlib_PassDoorRdrObj19RdrObjRangeStdY_ZCR_CANFD5 "" UBYTE RB_RBA_Common_CentralElements_CompuMethods_Identical 1 100 0.0 255.00 FORMAT "%8.2" ECU_ADDRESS 0xfe40359a /end MEASUREMENT
/begin MEASUREMENT Tlib_PassDoorRdrObj19RdrObjSpeedX_ZCR_CANFD5 "" UWORD RB_RBA_Common_CentralElements_CompuMethods_Identical 1 100 0.0 65535 FORMAT "%8.2" ECU_ADDRESS 0xfe402c4a /end MEASUREMENT
/begin MEASUREMENT Tlib_PassDoorRdrObj18RdrObjAccX_ZCR_CANFD5 "" UWORD RB_RBA_Common_CentralElements_CompuMethods_Identical 1 100 0.0 65535 FORMAT "%8.2" ECU_ADDRESS 0xfe402c4c /end MEASUREMENT
/begin MEASUREMENT Tlib_PassDoorRdrObj18RdrObjTrackAge_ZCR_CANFD5 "" UBYTE RB_RBA_Common_CentralElements_CompuMethods_Identical 1 100 0.0 255.00 FORMAT "%8.2" ECU_ADDRESS 0xfe40359b /end MEASUREMENT
/begin MEASUREMENT Tlib_PassDoorRdrObj18RdrObjAccStdY_ZCR_CANFD5 "" UBYTE RB_RBA_Common_CentralElements_CompuMethods_Identical 1 100 0.0 255.00 FORMAT "%8.2" ECU_ADDRESS 0xfe40359c /end MEASUREMENT
/begin MEASUREMENT Tlib_PassDoorRdrObj18RdrObjDataMode_ZCR_CANFD5 "" UBYTE RB_RBA_Common_CentralElements_CompuMethods_Identical 1 100 0.0 255.00 FORMAT "%8.2" ECU_ADDRESS 0xfe40359d /end MEASUREMENT
/begin MEASUREMENT Tlib_PassDoorRdrObj18RdrObjRangeStdY_ZCR_CANFD5 "" UBYTE RB_RBA_Common_CentralElements_CompuMethods_Identical 1 100 0.0 255.00 FORMAT "%8.2" ECU_ADDRESS 0xfe40359e /end MEASUREMENT
/begin MEASUREMENT Tlib_PassDoorRdrObj18RdrObjIdx_ZCR_CANFD5 "" UBYTE RB_RBA_Common_CentralElements_CompuMethods_Identical 1 100 0.0 255.00 FORMAT "%8.2" ECU_ADDRESS 0xfe40359f /end MEASUREMENT
/begin MEASUREMENT Tlib_PassDoorRdrObj18RdrObjRangeStdZ_ZCR_CANFD5 "" UBYTE RB_RBA_Common_CentralElements_CompuMethods_Identical 1 100 0.0 255.00 FORMAT "%8.2" ECU_ADDRESS 0xfe4035a0 /end MEASUREMENT
/begin MEASUREMENT Tlib_PassDoorRdrObj18RdrObjSpeedStdX_ZCR_CANFD5 "" UBYTE RB_RBA_Common_CentralElements_CompuMethods_Identical 1 100 0.0 255.00 FORMAT "%8.2" ECU_ADDRESS 0xfe4035a1 /end MEASUREMENT
/begin MEASUREMENT Tlib_PassDoorRdrObj18RdrObjSpeedStdY_ZCR_CANFD5 "" UBYTE RB_RBA_Common_CentralElements_CompuMethods_Identical 1 100 0.0 255.00 FORMAT "%8.2" ECU_ADDRESS 0xfe4035a2 /end MEASUREMENT
/begin MEASUREMENT Tlib_PassDoorRdrObj18RdrObjMotionPattern_ZCR_CANFD5 "" UBYTE RB_RBA_Common_CentralElements_CompuMethods_Identical 1 100 0.0 255.00 FORMAT "%8.2" ECU_ADDRESS 0xfe4035a3 /end MEASUREMENT
/begin MEASUREMENT Tlib_PassDoorRdrObj18RdrObjSpeedY_ZCR_CANFD5 "" UWORD RB_RBA_Common_CentralElements_CompuMethods_Identical 1 100 0.0 65535 FORMAT "%8.2" ECU_ADDRESS 0xfe402c4e /end MEASUREMENT
/begin MEASUREMENT Tlib_PassDoorRdrObj18RdrObjAccY_ZCR_CANFD5 "" UWORD RB_RBA_Common_CentralElements_CompuMethods_Identical 1 100 0.0 65535 FORMAT "%8.2" ECU_ADDRESS 0xfe402c50 /end MEASUREMENT
/begin MEASUREMENT Tlib_PassDoorRdrObj18RdrObjRangeZ_ZCR_CANFD5 "" UWORD RB_RBA_Common_CentralElements_CompuMethods_Identical 1 100 0.0 65535 FORMAT "%8.2" ECU_ADDRESS 0xfe402c52 /end MEASUREMENT
/begin MEASUREMENT Tlib_PassDoorRdrObj18RdrObjRangeX_ZCR_CANFD5 "" UWORD RB_RBA_Common_CentralElements_CompuMethods_Identical 1 100 0.0 65535 FORMAT "%8.2" ECU_ADDRESS 0xfe402c54 /end MEASUREMENT
/begin MEASUREMENT Tlib_PassDoorRdrObj18RdrObjRangeY_ZCR_CANFD5 "" UWORD RB_RBA_Common_CentralElements_CompuMethods_Identical 1 100 0.0 65535 FORMAT "%8.2" ECU_ADDRESS 0xfe402c56 /end MEASUREMENT
/begin MEASUREMENT Tlib_PassDoorRdrObj18RdrObjTrackClass_ZCR_CANFD5 "" UBYTE RB_RBA_Common_CentralElements_CompuMethods_Identical 1 100 0.0 255.00 FORMAT "%8.2" ECU_ADDRESS 0xfe4035a4 /end MEASUREMENT
/begin MEASUREMENT Tlib_PassDoorRdrObj18RdrObjRangeStdX_ZCR_CANFD5 "" UBYTE RB_RBA_Common_CentralElements_CompuMethods_Identical 1 100 0.0 255.00 FORMAT "%8.2" ECU_ADDRESS 0xfe4035a5 /end MEASUREMENT
/begin MEASUREMENT Tlib_PassDoorRdrObj18RdrObjAccStdX_ZCR_CANFD5 "" UBYTE RB_RBA_Common_CentralElements_CompuMethods_Identical 1 100 0.0 255.00 FORMAT "%8.2" ECU_ADDRESS 0xfe4035a6 /end MEASUREMENT
/begin MEASUREMENT Tlib_PassDoorRdrObj18RdrObjConfidLvl_ZCR_CANFD5 "" UBYTE RB_RBA_Common_CentralElements_CompuMethods_Identical 1 100 0.0 255.00 FORMAT "%8.2" ECU_ADDRESS 0xfe4035a7 /end MEASUREMENT
/begin MEASUREMENT Tlib_PassDoorRdrObj18RdrObjSpeedX_ZCR_CANFD5 "" UWORD RB_RBA_Common_CentralElements_CompuMethods_Identical 1 100 0.0 65535 FORMAT "%8.2" ECU_ADDRESS 0xfe402c58 /end MEASUREMENT
/begin MEASUREMENT Tlib_RiReDoorRdrObj15RdrObjAccStdX_ZCR_CANFD5 "" UBYTE RB_RBA_Common_CentralElements_CompuMethods_Identical 1 100 0.0 255.00 FORMAT "%8.2" ECU_ADDRESS 0xfe4035a8 /end MEASUREMENT
/begin MEASUREMENT Tlib_RiReDoorRdrObj15RdrObjAccY_ZCR_CANFD5 "" UWORD RB_RBA_Common_CentralElements_CompuMethods_Identical 1 100 0.0 65535 FORMAT "%8.2" ECU_ADDRESS 0xfe402c5a /end MEASUREMENT
/begin MEASUREMENT Tlib_RiReDoorRdrObj15RdrObjRangeStdY_ZCR_CANFD5 "" UBYTE RB_RBA_Common_CentralElements_CompuMethods_Identical 1 100 0.0 255.00 FORMAT "%8.2" ECU_ADDRESS 0xfe4035a9 /end MEASUREMENT
/begin MEASUREMENT Tlib_RiReDoorRdrObj15RdrObjRangeY_ZCR_CANFD5 "" UWORD RB_RBA_Common_CentralElements_CompuMethods_Identical 1 100 0.0 65535 FORMAT "%8.2" ECU_ADDRESS 0xfe402c5c /end MEASUREMENT
/begin MEASUREMENT Tlib_RiReDoorRdrObj15RdrObjConfidLvl_ZCR_CANFD5 "" UBYTE RB_RBA_Common_CentralElements_CompuMethods_Identical 1 100 0.0 255.00 FORMAT "%8.2" ECU_ADDRESS 0xfe4035aa /end MEASUREMENT
/begin MEASUREMENT Tlib_RiReDoorRdrObj15RdrObjRangeStdZ_ZCR_CANFD5 "" UBYTE RB_RBA_Common_CentralElements_CompuMethods_Identical 1 100 0.0 255.00 FORMAT "%8.2" ECU_ADDRESS 0xfe4035ab /end MEASUREMENT
/begin MEASUREMENT Tlib_RiReDoorRdrObj15RdrObjIdx_ZCR_CANFD5 "" UBYTE RB_RBA_Common_CentralElements_CompuMethods_Identical 1 100 0.0 255.00 FORMAT "%8.2" ECU_ADDRESS 0xfe4035ac /end MEASUREMENT
/begin MEASUREMENT Tlib_RiReDoorRdrObj15RdrObjRangeZ_ZCR_CANFD5 "" UWORD RB_RBA_Common_CentralElements_CompuMethods_Identical 1 100 0.0 65535 FORMAT "%8.2" ECU_ADDRESS 0xfe402c5e /end MEASUREMENT
/begin MEASUREMENT Tlib_RiReDoorRdrObj15RdrObjSpeedStdX_ZCR_CANFD5 "" UBYTE RB_RBA_Common_CentralElements_CompuMethods_Identical 1 100 0.0 255.00 FORMAT "%8.2" ECU_ADDRESS 0xfe4035ad /end MEASUREMENT
/begin MEASUREMENT Tlib_RiReDoorRdrObj15RdrObjSpeedY_ZCR_CANFD5 "" UWORD RB_RBA_Common_CentralElements_CompuMethods_Identical 1 100 0.0 65535 FORMAT "%8.2" ECU_ADDRESS 0xfe402c60 /end MEASUREMENT
/begin MEASUREMENT Tlib_RiReDoorRdrObj15RdrObjRangeStdX_ZCR_CANFD5 "" UBYTE RB_RBA_Common_CentralElements_CompuMethods_Identical 1 100 0.0 255.00 FORMAT "%8.2" ECU_ADDRESS 0xfe4035ae /end MEASUREMENT
/begin MEASUREMENT Tlib_RiReDoorRdrObj15RdrObjSpeedX_ZCR_CANFD5 "" UWORD RB_RBA_Common_CentralElements_CompuMethods_Identical 1 100 0.0 65535 FORMAT "%8.2" ECU_ADDRESS 0xfe402c62 /end MEASUREMENT
/begin MEASUREMENT Tlib_RiReDoorRdrObj15RdrObjMotionPattern_ZCR_CANFD5 "" UBYTE RB_RBA_Common_CentralElements_CompuMethods_Identical 1 100 0.0 255.00 FORMAT "%8.2" ECU_ADDRESS 0xfe4035af /end MEASUREMENT
/begin MEASUREMENT Tlib_RiReDoorRdrObj15RdrObjTrackAge_ZCR_CANFD5 "" UBYTE RB_RBA_Common_CentralElements_CompuMethods_Identical 1 100 0.0 255.00 FORMAT "%8.2" ECU_ADDRESS 0xfe4035b0 /end MEASUREMENT
/begin MEASUREMENT Tlib_RiReDoorRdrObj15RdrObjDataMode_ZCR_CANFD5 "" UBYTE RB_RBA_Common_CentralElements_CompuMethods_Identical 1 100 0.0 255.00 FORMAT "%8.2" ECU_ADDRESS 0xfe4035b1 /end MEASUREMENT
/begin MEASUREMENT Tlib_RiReDoorRdrObj15RdrObjAccStdY_ZCR_CANFD5 "" UBYTE RB_RBA_Common_CentralElements_CompuMethods_Identical 1 100 0.0 255.00 FORMAT "%8.2" ECU_ADDRESS 0xfe4035b2 /end MEASUREMENT
/begin MEASUREMENT Tlib_RiReDoorRdrObj15RdrObjRangeX_ZCR_CANFD5 "" UWORD RB_RBA_Common_CentralElements_CompuMethods_Identical 1 100 0.0 65535 FORMAT "%8.2" ECU_ADDRESS 0xfe402c64 /end MEASUREMENT
/begin MEASUREMENT Tlib_RiReDoorRdrObj15RdrObjAccX_ZCR_CANFD5 "" UWORD RB_RBA_Common_CentralElements_CompuMethods_Identical 1 100 0.0 65535 FORMAT "%8.2" ECU_ADDRESS 0xfe402c66 /end MEASUREMENT
/begin MEASUREMENT Tlib_RiReDoorRdrObj15RdrObjTrackClass_ZCR_CANFD5 "" UBYTE RB_RBA_Common_CentralElements_CompuMethods_Identical 1 100 0.0 255.00 FORMAT "%8.2" ECU_ADDRESS 0xfe4035b3 /end MEASUREMENT
/begin MEASUREMENT Tlib_RiReDoorRdrObj15RdrObjSpeedStdY_ZCR_CANFD5 "" UBYTE RB_RBA_Common_CentralElements_CompuMethods_Identical 1 100 0.0 255.00 FORMAT "%8.2" ECU_ADDRESS 0xfe4035b4 /end MEASUREMENT
/begin MEASUREMENT Tlib_RiReDoorRdrObj16RdrObjSpeedX_ZCR_CANFD5 "" UWORD RB_RBA_Common_CentralElements_CompuMethods_Identical 1 100 0.0 65535 FORMAT "%8.2" ECU_ADDRESS 0xfe402c68 /end MEASUREMENT
/begin MEASUREMENT Tlib_RiReDoorRdrObj16RdrObjRangeStdY_ZCR_CANFD5 "" UBYTE RB_RBA_Common_CentralElements_CompuMethods_Identical 1 100 0.0 255.00 FORMAT "%8.2" ECU_ADDRESS 0xfe4035b5 /end MEASUREMENT
/begin MEASUREMENT Tlib_RiReDoorRdrObj16RdrObjSpeedY_ZCR_CANFD5 "" UWORD RB_RBA_Common_CentralElements_CompuMethods_Identical 1 100 0.0 65535 FORMAT "%8.2" ECU_ADDRESS 0xfe402c6a /end MEASUREMENT
/begin MEASUREMENT Tlib_RiReDoorRdrObj16RdrObjRangeX_ZCR_CANFD5 "" UWORD RB_RBA_Common_CentralElements_CompuMethods_Identical 1 100 0.0 65535 FORMAT "%8.2" ECU_ADDRESS 0xfe402c6c /end MEASUREMENT
/begin MEASUREMENT Tlib_RiReDoorRdrObj16RdrObjAccStdX_ZCR_CANFD5 "" UBYTE RB_RBA_Common_CentralElements_CompuMethods_Identical 1 100 0.0 255.00 FORMAT "%8.2" ECU_ADDRESS 0xfe4035b6 /end MEASUREMENT
/begin MEASUREMENT Tlib_RiReDoorRdrObj16RdrObjRangeY_ZCR_CANFD5 "" UWORD RB_RBA_Common_CentralElements_CompuMethods_Identical 1 100 0.0 65535 FORMAT "%8.2" ECU_ADDRESS 0xfe402c6e /end MEASUREMENT
/begin MEASUREMENT Tlib_RiReDoorRdrObj16RdrObjDataMode_ZCR_CANFD5 "" UBYTE RB_RBA_Common_CentralElements_CompuMethods_Identical 1 100 0.0 255.00 FORMAT "%8.2" ECU_ADDRESS 0xfe4035b7 /end MEASUREMENT
/begin MEASUREMENT Tlib_RiReDoorRdrObj16RdrObjSpeedStdX_ZCR_CANFD5 "" UBYTE RB_RBA_Common_CentralElements_CompuMethods_Identical 1 100 0.0 255.00 FORMAT "%8.2" ECU_ADDRESS 0xfe4035b8 /end MEASUREMENT
/begin MEASUREMENT Tlib_RiReDoorRdrObj16RdrObjAccX_ZCR_CANFD5 "" UWORD RB_RBA_Common_CentralElements_CompuMethods_Identical 1 100 0.0 65535 FORMAT "%8.2" ECU_ADDRESS 0xfe402c70 /end MEASUREMENT
/begin MEASUREMENT Tlib_RiReDoorRdrObj16RdrObjSpeedStdY_ZCR_CANFD5 "" UBYTE RB_RBA_Common_CentralElements_CompuMethods_Identical 1 100 0.0 255.00 FORMAT "%8.2" ECU_ADDRESS 0xfe4035b9 /end MEASUREMENT
/begin MEASUREMENT Tlib_RiReDoorRdrObj16RdrObjAccY_ZCR_CANFD5 "" UWORD RB_RBA_Common_CentralElements_CompuMethods_Identical 1 100 0.0 65535 FORMAT "%8.2" ECU_ADDRESS 0xfe402c72 /end MEASUREMENT
/begin MEASUREMENT Tlib_RiReDoorRdrObj16RdrObjIdx_ZCR_CANFD5 "" UBYTE RB_RBA_Common_CentralElements_CompuMethods_Identical 1 100 0.0 255.00 FORMAT "%8.2" ECU_ADDRESS 0xfe4035ba /end MEASUREMENT
/begin MEASUREMENT Tlib_RiReDoorRdrObj16RdrObjMotionPattern_ZCR_CANFD5 "" UBYTE RB_RBA_Common_CentralElements_CompuMethods_Identical 1 100 0.0 255.00 FORMAT "%8.2" ECU_ADDRESS 0xfe4035bb /end MEASUREMENT
/begin MEASUREMENT Tlib_RiReDoorRdrObj16RdrObjConfidLvl_ZCR_CANFD5 "" UBYTE RB_RBA_Common_CentralElements_CompuMethods_Identical 1 100 0.0 255.00 FORMAT "%8.2" ECU_ADDRESS 0xfe4035bc /end MEASUREMENT
/begin MEASUREMENT Tlib_RiReDoorRdrObj16RdrObjRangeStdZ_ZCR_CANFD5 "" UBYTE RB_RBA_Common_CentralElements_CompuMethods_Identical 1 100 0.0 255.00 FORMAT "%8.2" ECU_ADDRESS 0xfe4035bd /end MEASUREMENT
/begin MEASUREMENT Tlib_RiReDoorRdrObj16RdrObjAccStdY_ZCR_CANFD5 "" UBYTE RB_RBA_Common_CentralElements_CompuMethods_Identical 1 100 0.0 255.00 FORMAT "%8.2" ECU_ADDRESS 0xfe4035be /end MEASUREMENT
/begin MEASUREMENT Tlib_RiReDoorRdrObj16RdrObjRangeStdX_ZCR_CANFD5 "" UBYTE RB_RBA_Common_CentralElements_CompuMethods_Identical 1 100 0.0 255.00 FORMAT "%8.2" ECU_ADDRESS 0xfe4035bf /end MEASUREMENT
/begin MEASUREMENT Tlib_RiReDoorRdrObj16RdrObjTrackClass_ZCR_CANFD5 "" UBYTE RB_RBA_Common_CentralElements_CompuMethods_Identical 1 100 0.0 255.00 FORMAT "%8.2" ECU_ADDRESS 0xfe4035c0 /end MEASUREMENT
/begin MEASUREMENT Tlib_RiReDoorRdrObj16RdrObjTrackAge_ZCR_CANFD5 "" UBYTE RB_RBA_Common_CentralElements_CompuMethods_Identical 1 100 0.0 255.00 FORMAT "%8.2" ECU_ADDRESS 0xfe4035c1 /end MEASUREMENT
/begin MEASUREMENT Tlib_RiReDoorRdrObj16RdrObjRangeZ_ZCR_CANFD5 "" UWORD RB_RBA_Common_CentralElements_CompuMethods_Identical 1 100 0.0 65535 FORMAT "%8.2" ECU_ADDRESS 0xfe402c74 /end MEASUREMENT
/begin MEASUREMENT Tlib_RiReDoorRdrObj17RdrObjMotionPattern_ZCR_CANFD5 "" UBYTE RB_RBA_Common_CentralElements_CompuMethods_Identical 1 100 0.0 255.00 FORMAT "%8.2" ECU_ADDRESS 0xfe4035c2 /end MEASUREMENT
/begin MEASUREMENT Tlib_RiReDoorRdrObj17RdrObjRangeY_ZCR_CANFD5 "" UWORD RB_RBA_Common_CentralElements_CompuMethods_Identical 1 100 0.0 65535 FORMAT "%8.2" ECU_ADDRESS 0xfe402c76 /end MEASUREMENT
/begin MEASUREMENT Tlib_RiReDoorRdrObj17RdrObjAccStdX_ZCR_CANFD5 "" UBYTE RB_RBA_Common_CentralElements_CompuMethods_Identical 1 100 0.0 255.00 FORMAT "%8.2" ECU_ADDRESS 0xfe4035c3 /end MEASUREMENT
/begin MEASUREMENT Tlib_RiReDoorRdrObj17RdrObjRangeStdY_ZCR_CANFD5 "" UBYTE RB_RBA_Common_CentralElements_CompuMethods_Identical 1 100 0.0 255.00 FORMAT "%8.2" ECU_ADDRESS 0xfe4035c4 /end MEASUREMENT
/begin MEASUREMENT Tlib_RiReDoorRdrObj17RdrObjRangeStdX_ZCR_CANFD5 "" UBYTE RB_RBA_Common_CentralElements_CompuMethods_Identical 1 100 0.0 255.00 FORMAT "%8.2" ECU_ADDRESS 0xfe4035c5 /end MEASUREMENT
/begin MEASUREMENT Tlib_RiReDoorRdrObj17RdrObjSpeedX_ZCR_CANFD5 "" UWORD RB_RBA_Common_CentralElements_CompuMethods_Identical 1 100 0.0 65535 FORMAT "%8.2" ECU_ADDRESS 0xfe402c78 /end MEASUREMENT
/begin MEASUREMENT Tlib_RiReDoorRdrObj17RdrObjRangeStdZ_ZCR_CANFD5 "" UBYTE RB_RBA_Common_CentralElements_CompuMethods_Identical 1 100 0.0 255.00 FORMAT "%8.2" ECU_ADDRESS 0xfe4035c6 /end MEASUREMENT
/begin MEASUREMENT Tlib_RiReDoorRdrObj17RdrObjRangeX_ZCR_CANFD5 "" UWORD RB_RBA_Common_CentralElements_CompuMethods_Identical 1 100 0.0 65535 FORMAT "%8.2" ECU_ADDRESS 0xfe402c7a /end MEASUREMENT
/begin MEASUREMENT Tlib_RiReDoorRdrObj17RdrObjDataMode_ZCR_CANFD5 "" UBYTE RB_RBA_Common_CentralElements_CompuMethods_Identical 1 100 0.0 255.00 FORMAT "%8.2" ECU_ADDRESS 0xfe4035c7 /end MEASUREMENT
/begin MEASUREMENT Tlib_RiReDoorRdrObj17RdrObjAccY_ZCR_CANFD5 "" UWORD RB_RBA_Common_CentralElements_CompuMethods_Identical 1 100 0.0 65535 FORMAT "%8.2" ECU_ADDRESS 0xfe402c7c /end MEASUREMENT
/begin MEASUREMENT Tlib_RiReDoorRdrObj17RdrObjSpeedStdX_ZCR_CANFD5 "" UBYTE RB_RBA_Common_CentralElements_CompuMethods_Identical 1 100 0.0 255.00 FORMAT "%8.2" ECU_ADDRESS 0xfe4035c8 /end MEASUREMENT
/begin MEASUREMENT Tlib_RiReDoorRdrObj17RdrObjIdx_ZCR_CANFD5 "" UBYTE RB_RBA_Common_CentralElements_CompuMethods_Identical 1 100 0.0 255.00 FORMAT "%8.2" ECU_ADDRESS 0xfe4035c9 /end MEASUREMENT
/begin MEASUREMENT Tlib_RiReDoorRdrObj17RdrObjConfidLvl_ZCR_CANFD5 "" UBYTE RB_RBA_Common_CentralElements_CompuMethods_Identical 1 100 0.0 255.00 FORMAT "%8.2" ECU_ADDRESS 0xfe4035ca /end MEASUREMENT
/begin MEASUREMENT Tlib_RiReDoorRdrObj17RdrObjAccStdY_ZCR_CANFD5 "" UBYTE RB_RBA_Common_CentralElements_CompuMethods_Identical 1 100 0.0 255.00 FORMAT "%8.2" ECU_ADDRESS 0xfe4035cb /end MEASUREMENT
/begin MEASUREMENT Tlib_RiReDoorRdrObj17RdrObjRangeZ_ZCR_CANFD5 "" UWORD RB_RBA_Common_CentralElements_CompuMethods_Identical 1 100 0.0 65535 FORMAT "%8.2" ECU_ADDRESS 0xfe402c7e /end MEASUREMENT
/begin MEASUREMENT Tlib_RiReDoorRdrObj17RdrObjSpeedY_ZCR_CANFD5 "" UWORD RB_RBA_Common_CentralElements_CompuMethods_Identical 1 100 0.0 65535 FORMAT "%8.2" ECU_ADDRESS 0xfe402c80 /end MEASUREMENT
/begin MEASUREMENT Tlib_RiReDoorRdrObj17RdrObjAccX_ZCR_CANFD5 "" UWORD RB_RBA_Common_CentralElements_CompuMethods_Identical 1 100 0.0 65535 FORMAT "%8.2" ECU_ADDRESS 0xfe402c82 /end MEASUREMENT
/begin MEASUREMENT Tlib_RiReDoorRdrObj17RdrObjSpeedStdY_ZCR_CANFD5 "" UBYTE RB_RBA_Common_CentralElements_CompuMethods_Identical 1 100 0.0 255.00 FORMAT "%8.2" ECU_ADDRESS 0xfe4035cc /end MEASUREMENT
/begin MEASUREMENT Tlib_RiReDoorRdrObj17RdrObjTrackAge_ZCR_CANFD5 "" UBYTE RB_RBA_Common_CentralElements_CompuMethods_Identical 1 100 0.0 255.00 FORMAT "%8.2" ECU_ADDRESS 0xfe4035cd /end MEASUREMENT
/begin MEASUREMENT Tlib_RiReDoorRdrObj17RdrObjTrackClass_ZCR_CANFD5 "" UBYTE RB_RBA_Common_CentralElements_CompuMethods_Identical 1 100 0.0 255.00 FORMAT "%8.2" ECU_ADDRESS 0xfe4035ce /end MEASUREMENT
/begin MEASUREMENT Tlib_DoorRiReSwtLockgStsHi_ZCR_CANFD5 "" UBYTE RB_RBA_Common_CentralElements_CompuMethods_Identical 1 100 0.0 255.00 FORMAT "%8.2" ECU_ADDRESS 0xfe4035cf /end MEASUREMENT
/begin MEASUREMENT Tlib_RiReDoorRdrObj25RdrObjSpeedY_ZCR_CANFD5 "" UWORD RB_RBA_Common_CentralElements_CompuMethods_Identical 1 100 0.0 65535 FORMAT "%8.2" ECU_ADDRESS 0xfe402c84 /end MEASUREMENT
/begin MEASUREMENT Tlib_RiReDoorRdrObj25RdrObjMotionPattern_ZCR_CANFD5 "" UBYTE RB_RBA_Common_CentralElements_CompuMethods_Identical 1 100 0.0 255.00 FORMAT "%8.2" ECU_ADDRESS 0xfe4035d0 /end MEASUREMENT
/begin MEASUREMENT Tlib_RiReDoorRdrObj25RdrObjIdx_ZCR_CANFD5 "" UBYTE RB_RBA_Common_CentralElements_CompuMethods_Identical 1 100 0.0 255.00 FORMAT "%8.2" ECU_ADDRESS 0xfe4035d1 /end MEASUREMENT
/begin MEASUREMENT Tlib_RiReDoorRdrObj25RdrObjRangeY_ZCR_CANFD5 "" UWORD RB_RBA_Common_CentralElements_CompuMethods_Identical 1 100 0.0 65535 FORMAT "%8.2" ECU_ADDRESS 0xfe402c86 /end MEASUREMENT
/begin MEASUREMENT Tlib_RiReDoorRdrObj25RdrObjRangeStdZ_ZCR_CANFD5 "" UBYTE RB_RBA_Common_CentralElements_CompuMethods_Identical 1 100 0.0 255.00 FORMAT "%8.2" ECU_ADDRESS 0xfe4035d2 /end MEASUREMENT
/begin MEASUREMENT Tlib_RiReDoorRdrObj25RdrObjAccX_ZCR_CANFD5 "" UWORD RB_RBA_Common_CentralElements_CompuMethods_Identical 1 100 0.0 65535 FORMAT "%8.2" ECU_ADDRESS 0xfe402c88 /end MEASUREMENT
/begin MEASUREMENT Tlib_RiReDoorRdrObj25RdrObjConfidLvl_ZCR_CANFD5 "" UBYTE RB_RBA_Common_CentralElements_CompuMethods_Identical 1 100 0.0 255.00 FORMAT "%8.2" ECU_ADDRESS 0xfe4035d3 /end MEASUREMENT
/begin MEASUREMENT Tlib_RiReDoorRdrObj25RdrObjSpeedX_ZCR_CANFD5 "" UWORD RB_RBA_Common_CentralElements_CompuMethods_Identical 1 100 0.0 65535 FORMAT "%8.2" ECU_ADDRESS 0xfe402c8a /end MEASUREMENT
/begin MEASUREMENT Tlib_RiReDoorRdrObj25RdrObjAccY_ZCR_CANFD5 "" UWORD RB_RBA_Common_CentralElements_CompuMethods_Identical 1 100 0.0 65535 FORMAT "%8.2" ECU_ADDRESS 0xfe402c8c /end MEASUREMENT
/begin MEASUREMENT Tlib_RiReDoorRdrObj25RdrObjRangeStdX_ZCR_CANFD5 "" UBYTE RB_RBA_Common_CentralElements_CompuMethods_Identical 1 100 0.0 255.00 FORMAT "%8.2" ECU_ADDRESS 0xfe4035d4 /end MEASUREMENT
/begin MEASUREMENT Tlib_RiReDoorRdrObj25RdrObjRangeStdY_ZCR_CANFD5 "" UBYTE RB_RBA_Common_CentralElements_CompuMethods_Identical 1 100 0.0 255.00 FORMAT "%8.2" ECU_ADDRESS 0xfe4035d5 /end MEASUREMENT
/begin MEASUREMENT Tlib_RiReDoorRdrObj25RdrObjRangeX_ZCR_CANFD5 "" UWORD RB_RBA_Common_CentralElements_CompuMethods_Identical 1 100 0.0 65535 FORMAT "%8.2" ECU_ADDRESS 0xfe402c8e /end MEASUREMENT
/begin MEASUREMENT Tlib_RiReDoorRdrObj25RdrObjSpeedStdY_ZCR_CANFD5 "" UBYTE RB_RBA_Common_CentralElements_CompuMethods_Identical 1 100 0.0 255.00 FORMAT "%8.2" ECU_ADDRESS 0xfe4035d6 /end MEASUREMENT
/begin MEASUREMENT Tlib_RiReDoorRdrObj25RdrObjRangeZ_ZCR_CANFD5 "" UWORD RB_RBA_Common_CentralElements_CompuMethods_Identical 1 100 0.0 65535 FORMAT "%8.2" ECU_ADDRESS 0xfe402c90 /end MEASUREMENT
/begin MEASUREMENT Tlib_RiReDoorRdrObj25RdrObjTrackAge_ZCR_CANFD5 "" UBYTE RB_RBA_Common_CentralElements_CompuMethods_Identical 1 100 0.0 255.00 FORMAT "%8.2" ECU_ADDRESS 0xfe4035d7 /end MEASUREMENT
/begin MEASUREMENT Tlib_RiReDoorRdrObj25RdrObjTrackClass_ZCR_CANFD5 "" UBYTE RB_RBA_Common_CentralElements_CompuMethods_Identical 1 100 0.0 255.00 FORMAT "%8.2" ECU_ADDRESS 0xfe4035d8 /end MEASUREMENT
/begin MEASUREMENT Tlib_RiReDoorRdrObj25RdrObjAccStdY_ZCR_CANFD5 "" UBYTE RB_RBA_Common_CentralElements_CompuMethods_Identical 1 100 0.0 255.00 FORMAT "%8.2" ECU_ADDRESS 0xfe4035d9 /end MEASUREMENT
/begin MEASUREMENT Tlib_RiReDoorRdrObj25RdrObjAccStdX_ZCR_CANFD5 "" UBYTE RB_RBA_Common_CentralElements_CompuMethods_Identical 1 100 0.0 255.00 FORMAT "%8.2" ECU_ADDRESS 0xfe4035da /end MEASUREMENT
/begin MEASUREMENT Tlib_RiReDoorRdrObj25RdrObjDataMode_ZCR_CANFD5 "" UBYTE RB_RBA_Common_CentralElements_CompuMethods_Identical 1 100 0.0 255.00 FORMAT "%8.2" ECU_ADDRESS 0xfe4035db /end MEASUREMENT
/begin MEASUREMENT Tlib_RiReDoorRdrObj25RdrObjSpeedStdX_ZCR_CANFD5 "" UBYTE RB_RBA_Common_CentralElements_CompuMethods_Identical 1 100 0.0 255.00 FORMAT "%8.2" ECU_ADDRESS 0xfe4035dc /end MEASUREMENT
/begin MEASUREMENT Tlib_RiReDoorRdrObj24RdrObjDataMode_ZCR_CANFD5 "" UBYTE RB_RBA_Common_CentralElements_CompuMethods_Identical 1 100 0.0 255.00 FORMAT "%8.2" ECU_ADDRESS 0xfe4035dd /end MEASUREMENT
/begin MEASUREMENT Tlib_RiReDoorRdrObj24RdrObjConfidLvl_ZCR_CANFD5 "" UBYTE RB_RBA_Common_CentralElements_CompuMethods_Identical 1 100 0.0 255.00 FORMAT "%8.2" ECU_ADDRESS 0xfe4035de /end MEASUREMENT
/begin MEASUREMENT Tlib_RiReDoorRdrObj24RdrObjSpeedX_ZCR_CANFD5 "" UWORD RB_RBA_Common_CentralElements_CompuMethods_Identical 1 100 0.0 65535 FORMAT "%8.2" ECU_ADDRESS 0xfe402c92 /end MEASUREMENT
/begin MEASUREMENT Tlib_RiReDoorRdrObj24RdrObjRangeStdZ_ZCR_CANFD5 "" UBYTE RB_RBA_Common_CentralElements_CompuMethods_Identical 1 100 0.0 255.00 FORMAT "%8.2" ECU_ADDRESS 0xfe4035df /end MEASUREMENT
/begin MEASUREMENT Tlib_RiReDoorRdrObj24RdrObjSpeedStdX_ZCR_CANFD5 "" UBYTE RB_RBA_Common_CentralElements_CompuMethods_Identical 1 100 0.0 255.00 FORMAT "%8.2" ECU_ADDRESS 0xfe4035e0 /end MEASUREMENT
/begin MEASUREMENT Tlib_RiReDoorRdrObj24RdrObjAccStdX_ZCR_CANFD5 "" UBYTE RB_RBA_Common_CentralElements_CompuMethods_Identical 1 100 0.0 255.00 FORMAT "%8.2" ECU_ADDRESS 0xfe4035e1 /end MEASUREMENT
/begin MEASUREMENT Tlib_RiReDoorRdrObj24RdrObjSpeedY_ZCR_CANFD5 "" UWORD RB_RBA_Common_CentralElements_CompuMethods_Identical 1 100 0.0 65535 FORMAT "%8.2" ECU_ADDRESS 0xfe402c94 /end MEASUREMENT
/begin MEASUREMENT Tlib_RiReDoorRdrObj24RdrObjMotionPattern_ZCR_CANFD5 "" UBYTE RB_RBA_Common_CentralElements_CompuMethods_Identical 1 100 0.0 255.00 FORMAT "%8.2" ECU_ADDRESS 0xfe4035e2 /end MEASUREMENT
/begin MEASUREMENT Tlib_RiReDoorRdrObj24RdrObjAccX_ZCR_CANFD5 "" UWORD RB_RBA_Common_CentralElements_CompuMethods_Identical 1 100 0.0 65535 FORMAT "%8.2" ECU_ADDRESS 0xfe402c96 /end MEASUREMENT
/begin MEASUREMENT Tlib_RiReDoorRdrObj24RdrObjTrackAge_ZCR_CANFD5 "" UBYTE RB_RBA_Common_CentralElements_CompuMethods_Identical 1 100 0.0 255.00 FORMAT "%8.2" ECU_ADDRESS 0xfe4035e3 /end MEASUREMENT
/begin MEASUREMENT Tlib_RiReDoorRdrObj24RdrObjRangeStdX_ZCR_CANFD5 "" UBYTE RB_RBA_Common_CentralElements_CompuMethods_Identical 1 100 0.0 255.00 FORMAT "%8.2" ECU_ADDRESS 0xfe4035e4 /end MEASUREMENT
/begin MEASUREMENT Tlib_RiReDoorRdrObj24RdrObjRangeX_ZCR_CANFD5 "" UWORD RB_RBA_Common_CentralElements_CompuMethods_Identical 1 100 0.0 65535 FORMAT "%8.2" ECU_ADDRESS 0xfe402c98 /end MEASUREMENT
/begin MEASUREMENT Tlib_RiReDoorRdrObj24RdrObjIdx_ZCR_CANFD5 "" UBYTE RB_RBA_Common_CentralElements_CompuMethods_Identical 1 100 0.0 255.00 FORMAT "%8.2" ECU_ADDRESS 0xfe4035e5 /end MEASUREMENT
/begin MEASUREMENT Tlib_RiReDoorRdrObj24RdrObjAccStdY_ZCR_CANFD5 "" UBYTE RB_RBA_Common_CentralElements_CompuMethods_Identical 1 100 0.0 255.00 FORMAT "%8.2" ECU_ADDRESS 0xfe4035e6 /end MEASUREMENT
/begin MEASUREMENT Tlib_RiReDoorRdrObj24RdrObjRangeZ_ZCR_CANFD5 "" UWORD RB_RBA_Common_CentralElements_CompuMethods_Identical 1 100 0.0 65535 FORMAT "%8.2" ECU_ADDRESS 0xfe402c9a /end MEASUREMENT
/begin MEASUREMENT Tlib_RiReDoorRdrObj24RdrObjAccY_ZCR_CANFD5 "" UWORD RB_RBA_Common_CentralElements_CompuMethods_Identical 1 100 0.0 65535 FORMAT "%8.2" ECU_ADDRESS 0xfe402c9c /end MEASUREMENT
/begin MEASUREMENT Tlib_RiReDoorRdrObj24RdrObjSpeedStdY_ZCR_CANFD5 "" UBYTE RB_RBA_Common_CentralElements_CompuMethods_Identical 1 100 0.0 255.00 FORMAT "%8.2" ECU_ADDRESS 0xfe4035e7 /end MEASUREMENT
/begin MEASUREMENT Tlib_RiReDoorRdrObj24RdrObjRangeStdY_ZCR_CANFD5 "" UBYTE RB_RBA_Common_CentralElements_CompuMethods_Identical 1 100 0.0 255.00 FORMAT "%8.2" ECU_ADDRESS 0xfe4035e8 /end MEASUREMENT
/begin MEASUREMENT Tlib_RiReDoorRdrObj24RdrObjRangeY_ZCR_CANFD5 "" UWORD RB_RBA_Common_CentralElements_CompuMethods_Identical 1 100 0.0 65535 FORMAT "%8.2" ECU_ADDRESS 0xfe402c9e /end MEASUREMENT
/begin MEASUREMENT Tlib_RiReDoorRdrObj24RdrObjTrackClass_ZCR_CANFD5 "" UBYTE RB_RBA_Common_CentralElements_CompuMethods_Identical 1 100 0.0 255.00 FORMAT "%8.2" ECU_ADDRESS 0xfe4035e9 /end MEASUREMENT
/begin MEASUREMENT Tlib_RiReDoorRdrObj23RdrObjIdx_ZCR_CANFD5 "" UBYTE RB_RBA_Common_CentralElements_CompuMethods_Identical 1 100 0.0 255.00 FORMAT "%8.2" ECU_ADDRESS 0xfe4035ea /end MEASUREMENT
/begin MEASUREMENT Tlib_RiReDoorRdrObj23RdrObjRangeStdY_ZCR_CANFD5 "" UBYTE RB_RBA_Common_CentralElements_CompuMethods_Identical 1 100 0.0 255.00 FORMAT "%8.2" ECU_ADDRESS 0xfe4035eb /end MEASUREMENT
/begin MEASUREMENT Tlib_RiReDoorRdrObj23RdrObjAccY_ZCR_CANFD5 "" UWORD RB_RBA_Common_CentralElements_CompuMethods_Identical 1 100 0.0 65535 FORMAT "%8.2" ECU_ADDRESS 0xfe402ca0 /end MEASUREMENT
/begin MEASUREMENT Tlib_RiReDoorRdrObj23RdrObjAccStdY_ZCR_CANFD5 "" UBYTE RB_RBA_Common_CentralElements_CompuMethods_Identical 1 100 0.0 255.00 FORMAT "%8.2" ECU_ADDRESS 0xfe4035ec /end MEASUREMENT
/begin MEASUREMENT Tlib_RiReDoorRdrObj23RdrObjSpeedStdY_ZCR_CANFD5 "" UBYTE RB_RBA_Common_CentralElements_CompuMethods_Identical 1 100 0.0 255.00 FORMAT "%8.2" ECU_ADDRESS 0xfe4035ed /end MEASUREMENT
/begin MEASUREMENT Tlib_RiReDoorRdrObj23RdrObjTrackAge_ZCR_CANFD5 "" UBYTE RB_RBA_Common_CentralElements_CompuMethods_Identical 1 100 0.0 255.00 FORMAT "%8.2" ECU_ADDRESS 0xfe4035ee /end MEASUREMENT
/begin MEASUREMENT Tlib_RiReDoorRdrObj23RdrObjMotionPattern_ZCR_CANFD5 "" UBYTE RB_RBA_Common_CentralElements_CompuMethods_Identical 1 100 0.0 255.00 FORMAT "%8.2" ECU_ADDRESS 0xfe4035ef /end MEASUREMENT
/begin MEASUREMENT Tlib_RiReDoorRdrObj23RdrObjRangeStdZ_ZCR_CANFD5 "" UBYTE RB_RBA_Common_CentralElements_CompuMethods_Identical 1 100 0.0 255.00 FORMAT "%8.2" ECU_ADDRESS 0xfe4035f0 /end MEASUREMENT
/begin MEASUREMENT Tlib_RiReDoorRdrObj23RdrObjConfidLvl_ZCR_CANFD5 "" UBYTE RB_RBA_Common_CentralElements_CompuMethods_Identical 1 100 0.0 255.00 FORMAT "%8.2" ECU_ADDRESS 0xfe4035f1 /end MEASUREMENT
/begin MEASUREMENT Tlib_RiReDoorRdrObj23RdrObjRangeStdX_ZCR_CANFD5 "" UBYTE RB_RBA_Common_CentralElements_CompuMethods_Identical 1 100 0.0 255.00 FORMAT "%8.2" ECU_ADDRESS 0xfe4035f2 /end MEASUREMENT
/begin MEASUREMENT Tlib_RiReDoorRdrObj23RdrObjAccX_ZCR_CANFD5 "" UWORD RB_RBA_Common_CentralElements_CompuMethods_Identical 1 100 0.0 65535 FORMAT "%8.2" ECU_ADDRESS 0xfe402ca2 /end MEASUREMENT
/begin MEASUREMENT Tlib_RiReDoorRdrObj23RdrObjSpeedStdX_ZCR_CANFD5 "" UBYTE RB_RBA_Common_CentralElements_CompuMethods_Identical 1 100 0.0 255.00 FORMAT "%8.2" ECU_ADDRESS 0xfe4035f3 /end MEASUREMENT
/begin MEASUREMENT Tlib_RiReDoorRdrObj23RdrObjAccStdX_ZCR_CANFD5 "" UBYTE RB_RBA_Common_CentralElements_CompuMethods_Identical 1 100 0.0 255.00 FORMAT "%8.2" ECU_ADDRESS 0xfe4035f4 /end MEASUREMENT
/begin MEASUREMENT Tlib_RiReDoorRdrObj23RdrObjRangeZ_ZCR_CANFD5 "" UWORD RB_RBA_Common_CentralElements_CompuMethods_Identical 1 100 0.0 65535 FORMAT "%8.2" ECU_ADDRESS 0xfe402ca4 /end MEASUREMENT
/begin MEASUREMENT Tlib_RiReDoorRdrObj23RdrObjRangeY_ZCR_CANFD5 "" UWORD RB_RBA_Common_CentralElements_CompuMethods_Identical 1 100 0.0 65535 FORMAT "%8.2" ECU_ADDRESS 0xfe402ca6 /end MEASUREMENT
/begin MEASUREMENT Tlib_RiReDoorRdrObj23RdrObjTrackClass_ZCR_CANFD5 "" UBYTE RB_RBA_Common_CentralElements_CompuMethods_Identical 1 100 0.0 255.00 FORMAT "%8.2" ECU_ADDRESS 0xfe4035f5 /end MEASUREMENT
/begin MEASUREMENT Tlib_RiReDoorRdrObj23RdrObjDataMode_ZCR_CANFD5 "" UBYTE RB_RBA_Common_CentralElements_CompuMethods_Identical 1 100 0.0 255.00 FORMAT "%8.2" ECU_ADDRESS 0xfe4035f6 /end MEASUREMENT
/begin MEASUREMENT Tlib_RiReDoorRdrObj23RdrObjSpeedX_ZCR_CANFD5 "" UWORD RB_RBA_Common_CentralElements_CompuMethods_Identical 1 100 0.0 65535 FORMAT "%8.2" ECU_ADDRESS 0xfe402ca8 /end MEASUREMENT
/begin MEASUREMENT Tlib_RiReDoorRdrObj23RdrObjSpeedY_ZCR_CANFD5 "" UWORD RB_RBA_Common_CentralElements_CompuMethods_Identical 1 100 0.0 65535 FORMAT "%8.2" ECU_ADDRESS 0xfe402caa /end MEASUREMENT
/begin MEASUREMENT Tlib_RiReDoorRdrObj23RdrObjRangeX_ZCR_CANFD5 "" UWORD RB_RBA_Common_CentralElements_CompuMethods_Identical 1 100 0.0 65535 FORMAT "%8.2" ECU_ADDRESS 0xfe402cac /end MEASUREMENT
/begin MEASUREMENT Tlib_FltOfIndcrTurnOnPassSide1_ZCR_CANFD5 "" UBYTE RB_RBA_Common_CentralElements_CompuMethods_Identical 1 100 0.0 255.00 FORMAT "%8.2" ECU_ADDRESS 0xfe4035f7 /end MEASUREMENT
/begin MEASUREMENT Tlib_WinMovStsAtPassHi_ZCR_CANFD5 "" UBYTE RB_RBA_Common_CentralElements_CompuMethods_Identical 1 100 0.0 255.00 FORMAT "%8.2" ECU_ADDRESS 0xfe4035f8 /end MEASUREMENT
/begin MEASUREMENT Tlib_MirrDwnStsAtPassHi_ZCR_CANFD5 "" UBYTE RB_RBA_Common_CentralElements_CompuMethods_Identical 1 100 0.0 255.00 FORMAT "%8.2" ECU_ADDRESS 0xfe4035f9 /end MEASUREMENT
/begin MEASUREMENT Tlib_WinPassAutoUpDiStsHi_ZCR_CANFD5 "" UBYTE RB_RBA_Common_CentralElements_CompuMethods_Identical 1 100 0.0 255.00 FORMAT "%8.2" ECU_ADDRESS 0xfe4035fa /end MEASUREMENT
/begin MEASUREMENT Tlib_WindowLearnStAtPassHi_ZCR_CANFD5 "" UBYTE RB_RBA_Common_CentralElements_CompuMethods_Identical 1 100 0.0 255.00 FORMAT "%8.2" ECU_ADDRESS 0xfe4035fb /end MEASUREMENT
/begin MEASUREMENT Tlib_MirrFoldStsAtPassHi_ZCR_CANFD5 "" UBYTE RB_RBA_Common_CentralElements_CompuMethods_Identical 1 100 0.0 255.00 FORMAT "%8.2" ECU_ADDRESS 0xfe4035fc /end MEASUREMENT
/begin MEASUREMENT Tlib_XMirrorMotDiagcAtPassHiXposSnsrShoToGnd_ZCR_CANFD5 "" UBYTE RB_RBA_Common_CentralElements_CompuMethods_Identical 1 100 0.0 255.00 FORMAT "%8.2" ECU_ADDRESS 0xfe4035fd /end MEASUREMENT
/begin MEASUREMENT Tlib_XMirrorMotDiagcAtPassHiXposSnsrShoBattOrOpen_ZCR_CANFD5 "" UBYTE RB_RBA_Common_CentralElements_CompuMethods_Identical 1 100 0.0 255.00 FORMAT "%8.2" ECU_ADDRESS 0xfe4035fe /end MEASUREMENT
/begin MEASUREMENT Tlib_XMirrorMotDiagcAtPassHiVccOutOfRng_ZCR_CANFD5 "" UBYTE RB_RBA_Common_CentralElements_CompuMethods_Identical 1 100 0.0 255.00 FORMAT "%8.2" ECU_ADDRESS 0xfe4035ff /end MEASUREMENT
/begin MEASUREMENT Tlib_XMirrorMotDiagcAtPassHiXMotShoToGnd_ZCR_CANFD5 "" UBYTE RB_RBA_Common_CentralElements_CompuMethods_Identical 1 100 0.0 255.00 FORMAT "%8.2" ECU_ADDRESS 0xfe403600 /end MEASUREMENT
/begin MEASUREMENT Tlib_XMirrorMotDiagcAtPassHiOverT_ZCR_CANFD5 "" UBYTE RB_RBA_Common_CentralElements_CompuMethods_Identical 1 100 0.0 255.00 FORMAT "%8.2" ECU_ADDRESS 0xfe403601 /end MEASUREMENT
/begin MEASUREMENT Tlib_XMirrorMotDiagcAtPassHiXMotShoBattOrOpen_ZCR_CANFD5 "" UBYTE RB_RBA_Common_CentralElements_CompuMethods_Identical 1 100 0.0 255.00 FORMAT "%8.2" ECU_ADDRESS 0xfe403602 /end MEASUREMENT
/begin MEASUREMENT Tlib_ActMirrStopReazonAtPassHiMirrStopReazonY_ZCR_CANFD5 "" UBYTE RB_RBA_Common_CentralElements_CompuMethods_Identical 1 100 0.0 255.00 FORMAT "%8.2" ECU_ADDRESS 0xfe403603 /end MEASUREMENT
/begin MEASUREMENT Tlib_ActMirrStopReazonAtPassHiMirrStopReazonX_ZCR_CANFD5 "" UBYTE RB_RBA_Common_CentralElements_CompuMethods_Identical 1 100 0.0 255.00 FORMAT "%8.2" ECU_ADDRESS 0xfe403604 /end MEASUREMENT
/begin MEASUREMENT Tlib_MirrXAdjPosnAtPassHi_ZCR_CANFD5 "" UBYTE RB_RBA_Common_CentralElements_CompuMethods_Identical 1 100 0.0 255.00 FORMAT "%8.2" ECU_ADDRESS 0xfe403605 /end MEASUREMENT
/begin MEASUREMENT Tlib_YMirrorMotDiagcAtPassHiXMotShoBattOrOpen_ZCR_CANFD5 "" UBYTE RB_RBA_Common_CentralElements_CompuMethods_Identical 1 100 0.0 255.00 FORMAT "%8.2" ECU_ADDRESS 0xfe403606 /end MEASUREMENT
/begin MEASUREMENT Tlib_YMirrorMotDiagcAtPassHiVccOutOfRng_ZCR_CANFD5 "" UBYTE RB_RBA_Common_CentralElements_CompuMethods_Identical 1 100 0.0 255.00 FORMAT "%8.2" ECU_ADDRESS 0xfe403607 /end MEASUREMENT
/begin MEASUREMENT Tlib_YMirrorMotDiagcAtPassHiXMotShoToGnd_ZCR_CANFD5 "" UBYTE RB_RBA_Common_CentralElements_CompuMethods_Identical 1 100 0.0 255.00 FORMAT "%8.2" ECU_ADDRESS 0xfe403608 /end MEASUREMENT
/begin MEASUREMENT Tlib_YMirrorMotDiagcAtPassHiOverT_ZCR_CANFD5 "" UBYTE RB_RBA_Common_CentralElements_CompuMethods_Identical 1 100 0.0 255.00 FORMAT "%8.2" ECU_ADDRESS 0xfe403609 /end MEASUREMENT
/begin MEASUREMENT Tlib_YMirrorMotDiagcAtPassHiXposSnsrShoToGnd_ZCR_CANFD5 "" UBYTE RB_RBA_Common_CentralElements_CompuMethods_Identical 1 100 0.0 255.00 FORMAT "%8.2" ECU_ADDRESS 0xfe40360a /end MEASUREMENT
/begin MEASUREMENT Tlib_YMirrorMotDiagcAtPassHiXposSnsrShoBattOrOpen_ZCR_CANFD5 "" UBYTE RB_RBA_Common_CentralElements_CompuMethods_Identical 1 100 0.0 255.00 FORMAT "%8.2" ECU_ADDRESS 0xfe40360b /end MEASUREMENT
/begin MEASUREMENT Tlib_WinDiagcAtPassHiMissCal_ZCR_CANFD5 "" UBYTE RB_RBA_Common_CentralElements_CompuMethods_Identical 1 100 0.0 255.00 FORMAT "%8.2" ECU_ADDRESS 0xfe40360c /end MEASUREMENT
/begin MEASUREMENT Tlib_WinDiagcAtPassHivoltageoutofrange_ZCR_CANFD5 "" UBYTE RB_RBA_Common_CentralElements_CompuMethods_Identical 1 100 0.0 255.00 FORMAT "%8.2" ECU_ADDRESS 0xfe40360d /end MEASUREMENT
/begin MEASUREMENT Tlib_WinDiagcAtPassHiOverTemperature_ZCR_CANFD5 "" UBYTE RB_RBA_Common_CentralElements_CompuMethods_Identical 1 100 0.0 255.00 FORMAT "%8.2" ECU_ADDRESS 0xfe40360e /end MEASUREMENT
/begin MEASUREMENT Tlib_WinDiagcAtPassHiIntElecFailr_ZCR_CANFD5 "" UBYTE RB_RBA_Common_CentralElements_CompuMethods_Identical 1 100 0.0 255.00 FORMAT "%8.2" ECU_ADDRESS 0xfe40360f /end MEASUREMENT
/begin MEASUREMENT Tlib_WinDiagcAtPassHiRipplefault_ZCR_CANFD5 "" UBYTE RB_RBA_Common_CentralElements_CompuMethods_Identical 1 100 0.0 255.00 FORMAT "%8.2" ECU_ADDRESS 0xfe403610 /end MEASUREMENT
/begin MEASUREMENT Tlib_WinDiagcAtPassHiOpenCirc_ZCR_CANFD5 "" UBYTE RB_RBA_Common_CentralElements_CompuMethods_Identical 1 100 0.0 255.00 FORMAT "%8.2" ECU_ADDRESS 0xfe403611 /end MEASUREMENT
/begin MEASUREMENT Tlib_WinDiagcAtPassHiOverCurrent_ZCR_CANFD5 "" UBYTE RB_RBA_Common_CentralElements_CompuMethods_Identical 1 100 0.0 255.00 FORMAT "%8.2" ECU_ADDRESS 0xfe403612 /end MEASUREMENT
/begin MEASUREMENT Tlib_WinDiagcAtPassHiMeclFailr_ZCR_CANFD5 "" UBYTE RB_RBA_Common_CentralElements_CompuMethods_Identical 1 100 0.0 255.00 FORMAT "%8.2" ECU_ADDRESS 0xfe403613 /end MEASUREMENT
/begin MEASUREMENT Tlib_WinPosnStsAtPassHi_ZCR_CANFD5 "" UBYTE RB_RBA_Common_CentralElements_CompuMethods_Identical 1 100 0.0 255.00 FORMAT "%8.2" ECU_ADDRESS 0xfe403614 /end MEASUREMENT
/begin MEASUREMENT Tlib_WinFailrStsAtPassHi_ZCR_CANFD5 "" UBYTE RB_RBA_Common_CentralElements_CompuMethods_Identical 1 100 0.0 255.00 FORMAT "%8.2" ECU_ADDRESS 0xfe403615 /end MEASUREMENT
/begin MEASUREMENT Tlib_ActrStopReazonAtPassWinHi_ZCR_CANFD5 "" UBYTE RB_RBA_Common_CentralElements_CompuMethods_Identical 1 100 0.0 255.00 FORMAT "%8.2" ECU_ADDRESS 0xfe403616 /end MEASUREMENT
/begin MEASUREMENT Tlib_MirrYAdjPosnAtPassHi_ZCR_CANFD5 "" UBYTE RB_RBA_Common_CentralElements_CompuMethods_Identical 1 100 0.0 255.00 FORMAT "%8.2" ECU_ADDRESS 0xfe403617 /end MEASUREMENT
/begin MEASUREMENT Tlib_AntiPinchDsblStsPassHi_ZCR_CANFD5 "" UBYTE RB_RBA_Common_CentralElements_CompuMethods_Identical 1 100 0.0 255.00 FORMAT "%8.2" ECU_ADDRESS 0xfe403618 /end MEASUREMENT
/begin MEASUREMENT Tlib_CexvStsExvMovSts_ZCR_LIN4 "" UBYTE RB_RBA_Common_CentralElements_CompuMethods_Identical 1 100 0.0 255.00 FORMAT "%8.2" ECU_ADDRESS 0xfe403619 /end MEASUREMENT
/begin MEASUREMENT Tlib_CexvStsExvOvrTempErr_ZCR_LIN4 "" UBYTE RB_RBA_Common_CentralElements_CompuMethods_Identical 1 100 0.0 255.00 FORMAT "%8.2" ECU_ADDRESS 0xfe40361a /end MEASUREMENT
/begin MEASUREMENT Tlib_CexvStsExvVoltgRangErr_ZCR_LIN4 "" UBYTE RB_RBA_Common_CentralElements_CompuMethods_Identical 1 100 0.0 255.00 FORMAT "%8.2" ECU_ADDRESS 0xfe40361b /end MEASUREMENT
/begin MEASUREMENT Tlib_CexvStsExvElecStsErr_ZCR_LIN4 "" UBYTE RB_RBA_Common_CentralElements_CompuMethods_Identical 1 100 0.0 255.00 FORMAT "%8.2" ECU_ADDRESS 0xfe40361c /end MEASUREMENT
/begin MEASUREMENT Tlib_CexvStsExvOvrTrvlErr_ZCR_LIN4 "" UBYTE RB_RBA_Common_CentralElements_CompuMethods_Identical 1 100 0.0 255.00 FORMAT "%8.2" ECU_ADDRESS 0xfe40361d /end MEASUREMENT
/begin MEASUREMENT Tlib_CexvStsExvPreHeatgSts_ZCR_LIN4 "" UBYTE RB_RBA_Common_CentralElements_CompuMethods_Identical 1 100 0.0 255.00 FORMAT "%8.2" ECU_ADDRESS 0xfe40361e /end MEASUREMENT
/begin MEASUREMENT Tlib_CexvStsExvBlkErr_ZCR_LIN4 "" UBYTE RB_RBA_Common_CentralElements_CompuMethods_Identical 1 100 0.0 255.00 FORMAT "%8.2" ECU_ADDRESS 0xfe40361f /end MEASUREMENT
/begin MEASUREMENT Tlib_CexvStsExvCalibSts_ZCR_LIN4 "" UBYTE RB_RBA_Common_CentralElements_CompuMethods_Identical 1 100 0.0 255.00 FORMAT "%8.2" ECU_ADDRESS 0xfe403620 /end MEASUREMENT
/begin MEASUREMENT Tlib_CexvStsExvPosn_ZCR_LIN4 "" UWORD RB_RBA_Common_CentralElements_CompuMethods_Identical 1 100 0.0 65535 FORMAT "%8.2" ECU_ADDRESS 0xfe402cae /end MEASUREMENT
/begin MEASUREMENT Tlib_CexvNVMFlt_ZCR_LIN4 "" UBYTE RB_RBA_Common_CentralElements_CompuMethods_Identical 1 100 0.0 255.00 FORMAT "%8.2" ECU_ADDRESS 0xfe403621 /end MEASUREMENT
/begin MEASUREMENT Tlib_EexvStsExvVoltgRangErr_ZCR_LIN4 "" UBYTE RB_RBA_Common_CentralElements_CompuMethods_Identical 1 100 0.0 255.00 FORMAT "%8.2" ECU_ADDRESS 0xfe403622 /end MEASUREMENT
/begin MEASUREMENT Tlib_EexvStsExvMovSts_ZCR_LIN4 "" UBYTE RB_RBA_Common_CentralElements_CompuMethods_Identical 1 100 0.0 255.00 FORMAT "%8.2" ECU_ADDRESS 0xfe403623 /end MEASUREMENT
/begin MEASUREMENT Tlib_EexvStsExvBlkErr_ZCR_LIN4 "" UBYTE RB_RBA_Common_CentralElements_CompuMethods_Identical 1 100 0.0 255.00 FORMAT "%8.2" ECU_ADDRESS 0xfe403624 /end MEASUREMENT
/begin MEASUREMENT Tlib_EexvStsExvElecStsErr_ZCR_LIN4 "" UBYTE RB_RBA_Common_CentralElements_CompuMethods_Identical 1 100 0.0 255.00 FORMAT "%8.2" ECU_ADDRESS 0xfe403625 /end MEASUREMENT
/begin MEASUREMENT Tlib_EexvStsExvOvrTempErr_ZCR_LIN4 "" UBYTE RB_RBA_Common_CentralElements_CompuMethods_Identical 1 100 0.0 255.00 FORMAT "%8.2" ECU_ADDRESS 0xfe403626 /end MEASUREMENT
/begin MEASUREMENT Tlib_EexvStsExvOvrTrvlErr_ZCR_LIN4 "" UBYTE RB_RBA_Common_CentralElements_CompuMethods_Identical 1 100 0.0 255.00 FORMAT "%8.2" ECU_ADDRESS 0xfe403627 /end MEASUREMENT
/begin MEASUREMENT Tlib_EexvStsExvCalibSts_ZCR_LIN4 "" UBYTE RB_RBA_Common_CentralElements_CompuMethods_Identical 1 100 0.0 255.00 FORMAT "%8.2" ECU_ADDRESS 0xfe403628 /end MEASUREMENT
/begin MEASUREMENT Tlib_EexvStsExvPreHeatgSts_ZCR_LIN4 "" UBYTE RB_RBA_Common_CentralElements_CompuMethods_Identical 1 100 0.0 255.00 FORMAT "%8.2" ECU_ADDRESS 0xfe403629 /end MEASUREMENT
/begin MEASUREMENT Tlib_EexvStsExvPosn_ZCR_LIN4 "" UWORD RB_RBA_Common_CentralElements_CompuMethods_Identical 1 100 0.0 65535 FORMAT "%8.2" ECU_ADDRESS 0xfe402cb0 /end MEASUREMENT
/begin MEASUREMENT Tlib_EexvNVMFlt_ZCR_LIN4 "" UBYTE RB_RBA_Common_CentralElements_CompuMethods_Identical 1 100 0.0 255.00 FORMAT "%8.2" ECU_ADDRESS 0xfe40362a /end MEASUREMENT
/begin MEASUREMENT Tlib_EexvPosnRngSts_ZCR_LIN4 "" UBYTE RB_RBA_Common_CentralElements_CompuMethods_Identical 1 100 0.0 255.00 FORMAT "%8.2" ECU_ADDRESS 0xfe40362b /end MEASUREMENT
/begin MEASUREMENT Tlib_RexvStsExvOvrTempErr_ZCR_LIN4 "" UBYTE RB_RBA_Common_CentralElements_CompuMethods_Identical 1 100 0.0 255.00 FORMAT "%8.2" ECU_ADDRESS 0xfe40362c /end MEASUREMENT
/begin MEASUREMENT Tlib_RexvStsExvBlkErr_ZCR_LIN4 "" UBYTE RB_RBA_Common_CentralElements_CompuMethods_Identical 1 100 0.0 255.00 FORMAT "%8.2" ECU_ADDRESS 0xfe40362d /end MEASUREMENT
/begin MEASUREMENT Tlib_RexvStsExvActrPosn_ZCR_LIN4 "" UWORD RB_RBA_Common_CentralElements_CompuMethods_Identical 1 100 0.0 65535 FORMAT "%8.2" ECU_ADDRESS 0xfe402cb2 /end MEASUREMENT
/begin MEASUREMENT Tlib_RexvStsExvVoltgRangErr_ZCR_LIN4 "" UBYTE RB_RBA_Common_CentralElements_CompuMethods_Identical 1 100 0.0 255.00 FORMAT "%8.2" ECU_ADDRESS 0xfe40362e /end MEASUREMENT
/begin MEASUREMENT Tlib_RexvStsExvCalibSts_ZCR_LIN4 "" UBYTE RB_RBA_Common_CentralElements_CompuMethods_Identical 1 100 0.0 255.00 FORMAT "%8.2" ECU_ADDRESS 0xfe40362f /end MEASUREMENT
/begin MEASUREMENT Tlib_RexvStsExvPreHeatgSts_ZCR_LIN4 "" UBYTE RB_RBA_Common_CentralElements_CompuMethods_Identical 1 100 0.0 255.00 FORMAT "%8.2" ECU_ADDRESS 0xfe403630 /end MEASUREMENT
/begin MEASUREMENT Tlib_RexvStsExvElecStsErr_ZCR_LIN4 "" UBYTE RB_RBA_Common_CentralElements_CompuMethods_Identical 1 100 0.0 255.00 FORMAT "%8.2" ECU_ADDRESS 0xfe403631 /end MEASUREMENT
/begin MEASUREMENT Tlib_RexvStsExvMovSts_ZCR_LIN4 "" UBYTE RB_RBA_Common_CentralElements_CompuMethods_Identical 1 100 0.0 255.00 FORMAT "%8.2" ECU_ADDRESS 0xfe403632 /end MEASUREMENT
/begin MEASUREMENT Tlib_RexvStsExvOvrTrvlErr_ZCR_LIN4 "" UBYTE RB_RBA_Common_CentralElements_CompuMethods_Identical 1 100 0.0 255.00 FORMAT "%8.2" ECU_ADDRESS 0xfe403633 /end MEASUREMENT
/begin MEASUREMENT Tlib_RexvNVMFlt_ZCR_LIN4 "" UBYTE RB_RBA_Common_CentralElements_CompuMethods_Identical 1 100 0.0 255.00 FORMAT "%8.2" ECU_ADDRESS 0xfe403634 /end MEASUREMENT
/begin MEASUREMENT Tlib_BexvStsExvBlkErr_ZCR_LIN4 "" UBYTE RB_RBA_Common_CentralElements_CompuMethods_Identical 1 100 0.0 255.00 FORMAT "%8.2" ECU_ADDRESS 0xfe403635 /end MEASUREMENT
/begin MEASUREMENT Tlib_BexvStsExvElecStsErr_ZCR_LIN4 "" UBYTE RB_RBA_Common_CentralElements_CompuMethods_Identical 1 100 0.0 255.00 FORMAT "%8.2" ECU_ADDRESS 0xfe403636 /end MEASUREMENT
/begin MEASUREMENT Tlib_BexvStsExvMovSts_ZCR_LIN4 "" UBYTE RB_RBA_Common_CentralElements_CompuMethods_Identical 1 100 0.0 255.00 FORMAT "%8.2" ECU_ADDRESS 0xfe403637 /end MEASUREMENT
/begin MEASUREMENT Tlib_BexvStsExvPreHeatgSts_ZCR_LIN4 "" UBYTE RB_RBA_Common_CentralElements_CompuMethods_Identical 1 100 0.0 255.00 FORMAT "%8.2" ECU_ADDRESS 0xfe403638 /end MEASUREMENT
/begin MEASUREMENT Tlib_BexvStsExvOvrTrvlErr_ZCR_LIN4 "" UBYTE RB_RBA_Common_CentralElements_CompuMethods_Identical 1 100 0.0 255.00 FORMAT "%8.2" ECU_ADDRESS 0xfe403639 /end MEASUREMENT
/begin MEASUREMENT Tlib_BexvStsExvVoltgRangErr_ZCR_LIN4 "" UBYTE RB_RBA_Common_CentralElements_CompuMethods_Identical 1 100 0.0 255.00 FORMAT "%8.2" ECU_ADDRESS 0xfe40363a /end MEASUREMENT
/begin MEASUREMENT Tlib_BexvStsExvOvrTempErr_ZCR_LIN4 "" UBYTE RB_RBA_Common_CentralElements_CompuMethods_Identical 1 100 0.0 255.00 FORMAT "%8.2" ECU_ADDRESS 0xfe40363b /end MEASUREMENT
/begin MEASUREMENT Tlib_BexvStsExvActrPosn_ZCR_LIN4 "" UWORD RB_RBA_Common_CentralElements_CompuMethods_Identical 1 100 0.0 65535 FORMAT "%8.2" ECU_ADDRESS 0xfe402cb4 /end MEASUREMENT
/begin MEASUREMENT Tlib_BexvStsExvCalibSts_ZCR_LIN4 "" UBYTE RB_RBA_Common_CentralElements_CompuMethods_Identical 1 100 0.0 255.00 FORMAT "%8.2" ECU_ADDRESS 0xfe40363c /end MEASUREMENT
/begin MEASUREMENT Tlib_BexvNVMFlt_ZCR_LIN4 "" UBYTE RB_RBA_Common_CentralElements_CompuMethods_Identical 1 100 0.0 255.00 FORMAT "%8.2" ECU_ADDRESS 0xfe40363d /end MEASUREMENT
/begin MEASUREMENT Tlib_AirPtcPCBTempActl_ZCR_LIN4 "" UBYTE RB_RBA_Common_CentralElements_CompuMethods_Identical 1 100 0.0 255.00 FORMAT "%8.2" ECU_ADDRESS 0xfe40363e /end MEASUREMENT
/begin MEASUREMENT Tlib_AirPtcPwrDerating_ZCR_LIN4 "" UBYTE RB_RBA_Common_CentralElements_CompuMethods_Identical 1 100 0.0 255.00 FORMAT "%8.2" ECU_ADDRESS 0xfe40363f /end MEASUREMENT
/begin MEASUREMENT Tlib_AirPtcOvrCurrFlt_ZCR_LIN4 "" UBYTE RB_RBA_Common_CentralElements_CompuMethods_Identical 1 100 0.0 255.00 FORMAT "%8.2" ECU_ADDRESS 0xfe403640 /end MEASUREMENT
/begin MEASUREMENT Tlib_AirPtcLINTimeOutFlt_ZCR_LIN4 "" UBYTE RB_RBA_Common_CentralElements_CompuMethods_Identical 1 100 0.0 255.00 FORMAT "%8.2" ECU_ADDRESS 0xfe403641 /end MEASUREMENT
/begin MEASUREMENT Tlib_AirPtc15VDrvrFlt_ZCR_LIN4 "" UBYTE RB_RBA_Common_CentralElements_CompuMethods_Identical 1 100 0.0 255.00 FORMAT "%8.2" ECU_ADDRESS 0xfe403642 /end MEASUREMENT
/begin MEASUREMENT Tlib_AirPtcPCBTempSnsrFlt_ZCR_LIN4 "" UBYTE RB_RBA_Common_CentralElements_CompuMethods_Identical 1 100 0.0 255.00 FORMAT "%8.2" ECU_ADDRESS 0xfe403643 /end MEASUREMENT
/begin MEASUREMENT Tlib_AirPtcOCPTempSnsrFlt_ZCR_LIN4 "" UBYTE RB_RBA_Common_CentralElements_CompuMethods_Identical 1 100 0.0 255.00 FORMAT "%8.2" ECU_ADDRESS 0xfe403644 /end MEASUREMENT
/begin MEASUREMENT Tlib_AirPtcOCPOvrTempFlt_ZCR_LIN4 "" UBYTE RB_RBA_Common_CentralElements_CompuMethods_Identical 1 100 0.0 255.00 FORMAT "%8.2" ECU_ADDRESS 0xfe403645 /end MEASUREMENT
/begin MEASUREMENT Tlib_AirPtcFlt_ZCR_LIN4 "" UBYTE RB_RBA_Common_CentralElements_CompuMethods_Identical 1 100 0.0 255.00 FORMAT "%8.2" ECU_ADDRESS 0xfe403646 /end MEASUREMENT
/begin MEASUREMENT Tlib_AirPtcPCBOvrTempFlt_ZCR_LIN4 "" UBYTE RB_RBA_Common_CentralElements_CompuMethods_Identical 1 100 0.0 255.00 FORMAT "%8.2" ECU_ADDRESS 0xfe403647 /end MEASUREMENT
/begin MEASUREMENT Tlib_AirPtcOCPTempActl_ZCR_LIN4 "" UBYTE RB_RBA_Common_CentralElements_CompuMethods_Identical 1 100 0.0 255.00 FORMAT "%8.2" ECU_ADDRESS 0xfe403648 /end MEASUREMENT
/begin MEASUREMENT Tlib_AirPtcInterTemp_ZCR_LIN4 "" SWORD RB_RBA_Common_CentralElements_CompuMethods_Identical 1 100 -32768 32767 FORMAT "%8.2" ECU_ADDRESS 0xfe402cb6 /end MEASUREMENT
/begin MEASUREMENT Tlib_AirPtcDutyFb_ZCR_LIN4 "" UBYTE RB_RBA_Common_CentralElements_CompuMethods_Identical 1 100 0.0 255.00 FORMAT "%8.2" ECU_ADDRESS 0xfe403649 /end MEASUREMENT
/begin MEASUREMENT Tlib_HvCooltHeatrICnsSig_ZCR_LIN4 "" UBYTE RB_RBA_Common_CentralElements_CompuMethods_Identical 1 100 0.0 255.00 FORMAT "%8.2" ECU_ADDRESS 0xfe40364a /end MEASUREMENT
/begin MEASUREMENT Tlib_HvCooltWtrHeatrWtrTInIntk_ZCR_LIN4 "" UBYTE RB_RBA_Common_CentralElements_CompuMethods_Identical 1 100 0.0 255.00 FORMAT "%8.2" ECU_ADDRESS 0xfe40364b /end MEASUREMENT
/begin MEASUREMENT Tlib_HvCooltHeatrSrvRqrdSigMemErr_ZCR_LIN4 "" UBYTE RB_RBA_Common_CentralElements_CompuMethods_Identical 1 100 0.0 255.00 FORMAT "%8.2" ECU_ADDRESS 0xfe40364c /end MEASUREMENT
/begin MEASUREMENT Tlib_HvCooltHeatrSrvRqrdSigSrvRqrdResd_ZCR_LIN4 "" UBYTE RB_RBA_Common_CentralElements_CompuMethods_Identical 1 100 0.0 255.00 FORMAT "%8.2" ECU_ADDRESS 0xfe40364d /end MEASUREMENT
/begin MEASUREMENT Tlib_HvCooltHeatrSrvRqrdSigICnsOutOfRng_ZCR_LIN4 "" UBYTE RB_RBA_Common_CentralElements_CompuMethods_Identical 1 100 0.0 255.00 FORMAT "%8.2" ECU_ADDRESS 0xfe40364e /end MEASUREMENT
/begin MEASUREMENT Tlib_HvCooltHeatrSrvRqrdSigSrvRqrd_ZCR_LIN4 "" UBYTE RB_RBA_Common_CentralElements_CompuMethods_Identical 1 100 0.0 255.00 FORMAT "%8.2" ECU_ADDRESS 0xfe40364f /end MEASUREMENT
/begin MEASUREMENT Tlib_HvCooltHeatrSrvRqrdSigCircForDrvrShoOrOpen_ZCR_LIN4 "" UBYTE RB_RBA_Common_CentralElements_CompuMethods_Identical 1 100 0.0 255.00 FORMAT "%8.2" ECU_ADDRESS 0xfe403650 /end MEASUREMENT
/begin MEASUREMENT Tlib_HvCooltHeatrWarnSigFltPrsnt_ZCR_LIN4 "" UBYTE RB_RBA_Common_CentralElements_CompuMethods_Identical 1 100 0.0 255.00 FORMAT "%8.2" ECU_ADDRESS 0xfe403651 /end MEASUREMENT
/begin MEASUREMENT Tlib_HvCooltHeatrWarnSigCooltTOutOfRng_ZCR_LIN4 "" UBYTE RB_RBA_Common_CentralElements_CompuMethods_Identical 1 100 0.0 255.00 FORMAT "%8.2" ECU_ADDRESS 0xfe403652 /end MEASUREMENT
/begin MEASUREMENT Tlib_HvCooltHeatrWarnSigULoOutOfRng_ZCR_LIN4 "" UBYTE RB_RBA_Common_CentralElements_CompuMethods_Identical 1 100 0.0 255.00 FORMAT "%8.2" ECU_ADDRESS 0xfe403653 /end MEASUREMENT
/begin MEASUREMENT Tlib_HvCooltHeatrWarnSigFltPrsntResd_ZCR_LIN4 "" UBYTE RB_RBA_Common_CentralElements_CompuMethods_Identical 1 100 0.0 255.00 FORMAT "%8.2" ECU_ADDRESS 0xfe403654 /end MEASUREMENT
/begin MEASUREMENT Tlib_HvCooltHeatrWarnSigHvOutOfRng_ZCR_LIN4 "" UBYTE RB_RBA_Common_CentralElements_CompuMethods_Identical 1 100 0.0 255.00 FORMAT "%8.2" ECU_ADDRESS 0xfe403655 /end MEASUREMENT
/begin MEASUREMENT Tlib_HvCooltHeatrWarnSigFltInCom_ZCR_LIN4 "" UBYTE RB_RBA_Common_CentralElements_CompuMethods_Identical 1 100 0.0 255.00 FORMAT "%8.2" ECU_ADDRESS 0xfe403656 /end MEASUREMENT
/begin MEASUREMENT Tlib_HvCooltWtrHeatrWtrTInOutl_ZCR_LIN4 "" UBYTE RB_RBA_Common_CentralElements_CompuMethods_Identical 1 100 0.0 255.00 FORMAT "%8.2" ECU_ADDRESS 0xfe403657 /end MEASUREMENT
/begin MEASUREMENT Tlib_HvCooltHeatrSplyUForCtrlUnitValSig_ZCR_LIN4 "" UBYTE RB_RBA_Common_CentralElements_CompuMethods_Identical 1 100 0.0 255.00 FORMAT "%8.2" ECU_ADDRESS 0xfe403658 /end MEASUREMENT
/begin MEASUREMENT Tlib_HvCooltHeatrSnsrFltSigResdForSnsrFlt_ZCR_LIN4 "" UBYTE RB_RBA_Common_CentralElements_CompuMethods_Identical 1 100 0.0 255.00 FORMAT "%8.2" ECU_ADDRESS 0xfe403659 /end MEASUREMENT
/begin MEASUREMENT Tlib_HvCooltHeatrSnsrFltSigCooltTInSnsrFlt_ZCR_LIN4 "" UBYTE RB_RBA_Common_CentralElements_CompuMethods_Identical 1 100 0.0 255.00 FORMAT "%8.2" ECU_ADDRESS 0xfe40365a /end MEASUREMENT
/begin MEASUREMENT Tlib_HvCooltHeatrSnsrFltSigCooltTOutSnsrFlt_ZCR_LIN4 "" UBYTE RB_RBA_Common_CentralElements_CompuMethods_Identical 1 100 0.0 255.00 FORMAT "%8.2" ECU_ADDRESS 0xfe40365b /end MEASUREMENT
/begin MEASUREMENT Tlib_HvCooltHeatrSnsrFltSigTInMtrlSnsrFlt_ZCR_LIN4 "" UBYTE RB_RBA_Common_CentralElements_CompuMethods_Identical 1 100 0.0 255.00 FORMAT "%8.2" ECU_ADDRESS 0xfe40365c /end MEASUREMENT
/begin MEASUREMENT Tlib_HvCooltHeatrStsSig_ZCR_LIN4 "" UBYTE RB_RBA_Common_CentralElements_CompuMethods_Identical 1 100 0.0 255.00 FORMAT "%8.2" ECU_ADDRESS 0xfe40365d /end MEASUREMENT
/begin MEASUREMENT Tlib_HvCooltHeatrProtnOfSelfTmpSigProtnOfSelfTmpResd_ZCR_LIN4 "" UBYTE RB_RBA_Common_CentralElements_CompuMethods_Identical 1 100 0.0 255.00 FORMAT "%8.2" ECU_ADDRESS 0xfe40365e /end MEASUREMENT
/begin MEASUREMENT Tlib_HvCooltHeatrProtnOfSelfTmpSigProtnOfSelfTmp_ZCR_LIN4 "" UBYTE RB_RBA_Common_CentralElements_CompuMethods_Identical 1 100 0.0 255.00 FORMAT "%8.2" ECU_ADDRESS 0xfe40365f /end MEASUREMENT
/begin MEASUREMENT Tlib_HvCooltHeatrProtnOfSelfTmpSigOvrheatg_ZCR_LIN4 "" UBYTE RB_RBA_Common_CentralElements_CompuMethods_Identical 1 100 0.0 255.00 FORMAT "%8.2" ECU_ADDRESS 0xfe403660 /end MEASUREMENT
/begin MEASUREMENT Tlib_HvCooltHeatrProtnOfSelfTmpSigHwProtn_ZCR_LIN4 "" UBYTE RB_RBA_Common_CentralElements_CompuMethods_Identical 1 100 0.0 255.00 FORMAT "%8.2" ECU_ADDRESS 0xfe403661 /end MEASUREMENT
/begin MEASUREMENT Tlib_HvCooltHeatrInfoCompProtn_ZCR_LIN4 "" UBYTE RB_RBA_Common_CentralElements_CompuMethods_Identical 1 100 0.0 255.00 FORMAT "%8.2" ECU_ADDRESS 0xfe403662 /end MEASUREMENT
/begin MEASUREMENT Tlib_CmprLostCommStat_ZCR_LIN4 "" UBYTE RB_RBA_Common_CentralElements_CompuMethods_Identical 1 100 0.0 255.00 FORMAT "%8.2" ECU_ADDRESS 0xfe403663 /end MEASUREMENT
/begin MEASUREMENT Tlib_CmprInCurrOverCurrStat_ZCR_LIN4 "" UBYTE RB_RBA_Common_CentralElements_CompuMethods_Identical 1 100 0.0 255.00 FORMAT "%8.2" ECU_ADDRESS 0xfe403664 /end MEASUREMENT
/begin MEASUREMENT Tlib_CmprOverPowerStat_ZCR_LIN4 "" UBYTE RB_RBA_Common_CentralElements_CompuMethods_Identical 1 100 0.0 255.00 FORMAT "%8.2" ECU_ADDRESS 0xfe403665 /end MEASUREMENT
/begin MEASUREMENT Tlib_CmprLiquidSluggingStat_ZCR_LIN4 "" UBYTE RB_RBA_Common_CentralElements_CompuMethods_Identical 1 100 0.0 255.00 FORMAT "%8.2" ECU_ADDRESS 0xfe403666 /end MEASUREMENT
/begin MEASUREMENT Tlib_CmprEEPROMFault_ZCR_LIN4 "" UBYTE RB_RBA_Common_CentralElements_CompuMethods_Identical 1 100 0.0 255.00 FORMAT "%8.2" ECU_ADDRESS 0xfe403667 /end MEASUREMENT
/begin MEASUREMENT Tlib_CmprHVoltResonanceStat_ZCR_LIN4 "" UBYTE RB_RBA_Common_CentralElements_CompuMethods_Identical 1 100 0.0 255.00 FORMAT "%8.2" ECU_ADDRESS 0xfe403668 /end MEASUREMENT
/begin MEASUREMENT Tlib_CmprSpdIncrReq_ZCR_LIN4 "" UBYTE RB_RBA_Common_CentralElements_CompuMethods_Identical 1 100 0.0 255.00 FORMAT "%8.2" ECU_ADDRESS 0xfe403669 /end MEASUREMENT
/begin MEASUREMENT Tlib_CmprRotorLockStat_ZCR_LIN4 "" UBYTE RB_RBA_Common_CentralElements_CompuMethods_Identical 1 100 0.0 255.00 FORMAT "%8.2" ECU_ADDRESS 0xfe40366a /end MEASUREMENT
/begin MEASUREMENT Tlib_CmprOverMotorCurrStat_ZCR_LIN4 "" UBYTE RB_RBA_Common_CentralElements_CompuMethods_Identical 1 100 0.0 255.00 FORMAT "%8.2" ECU_ADDRESS 0xfe40366b /end MEASUREMENT
/begin MEASUREMENT Tlib_CmprMotorCurrOverCurrStat_ZCR_LIN4 "" UBYTE RB_RBA_Common_CentralElements_CompuMethods_Identical 1 100 0.0 255.00 FORMAT "%8.2" ECU_ADDRESS 0xfe40366c /end MEASUREMENT
/begin MEASUREMENT Tlib_CmprSupplrNo_ZCR_LIN4 "" UBYTE RB_RBA_Common_CentralElements_CompuMethods_Identical 1 100 0.0 255.00 FORMAT "%8.2" ECU_ADDRESS 0xfe40366d /end MEASUREMENT
/begin MEASUREMENT Tlib_CmprRAMFault_ZCR_LIN4 "" UBYTE RB_RBA_Common_CentralElements_CompuMethods_Identical 1 100 0.0 255.00 FORMAT "%8.2" ECU_ADDRESS 0xfe40366e /end MEASUREMENT
/begin MEASUREMENT Tlib_CmprROMFault_ZCR_LIN4 "" UBYTE RB_RBA_Common_CentralElements_CompuMethods_Identical 1 100 0.0 255.00 FORMAT "%8.2" ECU_ADDRESS 0xfe40366f /end MEASUREMENT
/begin MEASUREMENT Tlib_AirPtcHVSnsrFlt_ZCR_LIN4 "" UBYTE RB_RBA_Common_CentralElements_CompuMethods_Identical 1 100 0.0 255.00 FORMAT "%8.2" ECU_ADDRESS 0xfe403670 /end MEASUREMENT
/begin MEASUREMENT Tlib_AirPtcIgbtShrtFlt_ZCR_LIN4 "" UBYTE RB_RBA_Common_CentralElements_CompuMethods_Identical 1 100 0.0 255.00 FORMAT "%8.2" ECU_ADDRESS 0xfe403671 /end MEASUREMENT
/begin MEASUREMENT Tlib_AirPtcIgbt2TempActl_ZCR_LIN4 "" UBYTE RB_RBA_Common_CentralElements_CompuMethods_Identical 1 100 0.0 255.00 FORMAT "%8.2" ECU_ADDRESS 0xfe403672 /end MEASUREMENT
/begin MEASUREMENT Tlib_AirPtcHVLowFlt_ZCR_LIN4 "" UBYTE RB_RBA_Common_CentralElements_CompuMethods_Identical 1 100 0.0 255.00 FORMAT "%8.2" ECU_ADDRESS 0xfe403673 /end MEASUREMENT
/begin MEASUREMENT Tlib_AirPtcHVCurrActl_ZCR_LIN4 "" UBYTE RB_RBA_Common_CentralElements_CompuMethods_Identical 1 100 0.0 255.00 FORMAT "%8.2" ECU_ADDRESS 0xfe403674 /end MEASUREMENT
/begin MEASUREMENT Tlib_AirPtcIgbt2TempSnsrFlt_ZCR_LIN4 "" UBYTE RB_RBA_Common_CentralElements_CompuMethods_Identical 1 100 0.0 255.00 FORMAT "%8.2" ECU_ADDRESS 0xfe403675 /end MEASUREMENT
/begin MEASUREMENT Tlib_AirPtcIgbt1TempSnsrFlt_ZCR_LIN4 "" UBYTE RB_RBA_Common_CentralElements_CompuMethods_Identical 1 100 0.0 255.00 FORMAT "%8.2" ECU_ADDRESS 0xfe403676 /end MEASUREMENT
/begin MEASUREMENT Tlib_AirPtcIgbt2OvrTempFlt_ZCR_LIN4 "" UBYTE RB_RBA_Common_CentralElements_CompuMethods_Identical 1 100 0.0 255.00 FORMAT "%8.2" ECU_ADDRESS 0xfe403677 /end MEASUREMENT
/begin MEASUREMENT Tlib_AirPtcHVPwrActl_ZCR_LIN4 "" UBYTE RB_RBA_Common_CentralElements_CompuMethods_Identical 1 100 0.0 255.00 FORMAT "%8.2" ECU_ADDRESS 0xfe403678 /end MEASUREMENT
/begin MEASUREMENT Tlib_AirPtcIgbt1OvrTempFlt_ZCR_LIN4 "" UBYTE RB_RBA_Common_CentralElements_CompuMethods_Identical 1 100 0.0 255.00 FORMAT "%8.2" ECU_ADDRESS 0xfe403679 /end MEASUREMENT
/begin MEASUREMENT Tlib_AirPtcHVHighFlt_ZCR_LIN4 "" UBYTE RB_RBA_Common_CentralElements_CompuMethods_Identical 1 100 0.0 255.00 FORMAT "%8.2" ECU_ADDRESS 0xfe40367a /end MEASUREMENT
/begin MEASUREMENT Tlib_AirPtcHVCurrSnsrFlt_ZCR_LIN4 "" UBYTE RB_RBA_Common_CentralElements_CompuMethods_Identical 1 100 0.0 255.00 FORMAT "%8.2" ECU_ADDRESS 0xfe40367b /end MEASUREMENT
/begin MEASUREMENT Tlib_AirPtcIgbtDrvrFlt_ZCR_LIN4 "" UBYTE RB_RBA_Common_CentralElements_CompuMethods_Identical 1 100 0.0 255.00 FORMAT "%8.2" ECU_ADDRESS 0xfe40367c /end MEASUREMENT
/begin MEASUREMENT Tlib_AirPtcHVVoltActl_ZCR_LIN4 "" UWORD RB_RBA_Common_CentralElements_CompuMethods_Identical 1 100 0.0 65535 FORMAT "%8.2" ECU_ADDRESS 0xfe402cb8 /end MEASUREMENT
/begin MEASUREMENT Tlib_AirPtcIgbt1TempActl_ZCR_LIN4 "" UBYTE RB_RBA_Common_CentralElements_CompuMethods_Identical 1 100 0.0 255.00 FORMAT "%8.2" ECU_ADDRESS 0xfe40367d /end MEASUREMENT
/begin MEASUREMENT Tlib_ExvNVMFlt_ZCR_LIN4 "" UBYTE RB_RBA_Common_CentralElements_CompuMethods_Identical 1 100 0.0 255.00 FORMAT "%8.2" ECU_ADDRESS 0xfe40367e /end MEASUREMENT
/begin MEASUREMENT Tlib_ExvStsExvPreHeatgSts_ZCR_LIN4 "" UBYTE RB_RBA_Common_CentralElements_CompuMethods_Identical 1 100 0.0 255.00 FORMAT "%8.2" ECU_ADDRESS 0xfe40367f /end MEASUREMENT
/begin MEASUREMENT Tlib_ExvStsExvOvrTrvlErr_ZCR_LIN4 "" UBYTE RB_RBA_Common_CentralElements_CompuMethods_Identical 1 100 0.0 255.00 FORMAT "%8.2" ECU_ADDRESS 0xfe403680 /end MEASUREMENT
/begin MEASUREMENT Tlib_ExvStsExvVoltgRangErr_ZCR_LIN4 "" UBYTE RB_RBA_Common_CentralElements_CompuMethods_Identical 1 100 0.0 255.00 FORMAT "%8.2" ECU_ADDRESS 0xfe403681 /end MEASUREMENT
/begin MEASUREMENT Tlib_ExvStsExvCalibSts_ZCR_LIN4 "" UBYTE RB_RBA_Common_CentralElements_CompuMethods_Identical 1 100 0.0 255.00 FORMAT "%8.2" ECU_ADDRESS 0xfe403682 /end MEASUREMENT
/begin MEASUREMENT Tlib_ExvStsExvElecStsErr_ZCR_LIN4 "" UBYTE RB_RBA_Common_CentralElements_CompuMethods_Identical 1 100 0.0 255.00 FORMAT "%8.2" ECU_ADDRESS 0xfe403683 /end MEASUREMENT
/begin MEASUREMENT Tlib_ExvStsExvActrPosn_ZCR_LIN4 "" UWORD RB_RBA_Common_CentralElements_CompuMethods_Identical 1 100 0.0 65535 FORMAT "%8.2" ECU_ADDRESS 0xfe402cba /end MEASUREMENT
/begin MEASUREMENT Tlib_ExvStsExvBlkErr_ZCR_LIN4 "" UBYTE RB_RBA_Common_CentralElements_CompuMethods_Identical 1 100 0.0 255.00 FORMAT "%8.2" ECU_ADDRESS 0xfe403684 /end MEASUREMENT
/begin MEASUREMENT Tlib_ExvStsExvOvrTempErr_ZCR_LIN4 "" UBYTE RB_RBA_Common_CentralElements_CompuMethods_Identical 1 100 0.0 255.00 FORMAT "%8.2" ECU_ADDRESS 0xfe403685 /end MEASUREMENT
/begin MEASUREMENT Tlib_ExvStsExvMovSts_ZCR_LIN4 "" UBYTE RB_RBA_Common_CentralElements_CompuMethods_Identical 1 100 0.0 255.00 FORMAT "%8.2" ECU_ADDRESS 0xfe403686 /end MEASUREMENT
/begin MEASUREMENT Tlib_EldtPmpStatCooltPmpPostRunSts_ZCR_LIN4 "" UBYTE RB_RBA_Common_CentralElements_CompuMethods_Identical 1 100 0.0 255.00 FORMAT "%8.2" ECU_ADDRESS 0xfe403687 /end MEASUREMENT
/begin MEASUREMENT Tlib_EldtPmpStatCooltPmpTErr_ZCR_LIN4 "" UBYTE RB_RBA_Common_CentralElements_CompuMethods_Identical 1 100 0.0 255.00 FORMAT "%8.2" ECU_ADDRESS 0xfe403688 /end MEASUREMENT
/begin MEASUREMENT Tlib_EldtPmpStatCooltPmpErrSts_ZCR_LIN4 "" UBYTE RB_RBA_Common_CentralElements_CompuMethods_Identical 1 100 0.0 255.00 FORMAT "%8.2" ECU_ADDRESS 0xfe403689 /end MEASUREMENT
/begin MEASUREMENT Tlib_EldtPmpStatCooltPmpSetSpdReq_ZCR_LIN4 "" UBYTE RB_RBA_Common_CentralElements_CompuMethods_Identical 1 100 0.0 255.00 FORMAT "%8.2" ECU_ADDRESS 0xfe40368a /end MEASUREMENT
/begin MEASUREMENT Tlib_EldtPmpStatCooltPmpU_ZCR_LIN4 "" UBYTE RB_RBA_Common_CentralElements_CompuMethods_Identical 1 100 0.0 255.00 FORMAT "%8.2" ECU_ADDRESS 0xfe40368b /end MEASUREMENT
/begin MEASUREMENT Tlib_EldtPmpStatCooltPmpEmgyModSts_ZCR_LIN4 "" UBYTE RB_RBA_Common_CentralElements_CompuMethods_Identical 1 100 0.0 255.00 FORMAT "%8.2" ECU_ADDRESS 0xfe40368c /end MEASUREMENT
/begin MEASUREMENT Tlib_EldtPmpStatCooltPmpUErr_ZCR_LIN4 "" UBYTE RB_RBA_Common_CentralElements_CompuMethods_Identical 1 100 0.0 255.00 FORMAT "%8.2" ECU_ADDRESS 0xfe40368d /end MEASUREMENT
/begin MEASUREMENT Tlib_EldtPmpStatCooltPmpSetPostRunReq_ZCR_LIN4 "" UBYTE RB_RBA_Common_CentralElements_CompuMethods_Identical 1 100 0.0 255.00 FORMAT "%8.2" ECU_ADDRESS 0xfe40368e /end MEASUREMENT
/begin MEASUREMENT Tlib_EldtPmpStatCooltPmpT_ZCR_LIN4 "" UBYTE RB_RBA_Common_CentralElements_CompuMethods_Identical 1 100 0.0 255.00 FORMAT "%8.2" ECU_ADDRESS 0xfe40368f /end MEASUREMENT
/begin MEASUREMENT Tlib_EldtPmpStatCooltPmpUnstallSts_ZCR_LIN4 "" UBYTE RB_RBA_Common_CentralElements_CompuMethods_Identical 1 100 0.0 255.00 FORMAT "%8.2" ECU_ADDRESS 0xfe403690 /end MEASUREMENT
/begin MEASUREMENT Tlib_EldtPmpStatCooltPmpDryErr_ZCR_LIN4 "" UBYTE RB_RBA_Common_CentralElements_CompuMethods_Identical 1 100 0.0 255.00 FORMAT "%8.2" ECU_ADDRESS 0xfe403691 /end MEASUREMENT
/begin MEASUREMENT Tlib_EldtPmpStatCooltPmpMonrSpd_ZCR_LIN4 "" UBYTE RB_RBA_Common_CentralElements_CompuMethods_Identical 1 100 0.0 255.00 FORMAT "%8.2" ECU_ADDRESS 0xfe403692 /end MEASUREMENT
/begin MEASUREMENT Tlib_EldtPmpStatCooltPmpSpd_ZCR_LIN4 "" UBYTE RB_RBA_Common_CentralElements_CompuMethods_Identical 1 100 0.0 255.00 FORMAT "%8.2" ECU_ADDRESS 0xfe403693 /end MEASUREMENT
/begin MEASUREMENT Tlib_EldtPmpStatCooltPmpIErr_ZCR_LIN4 "" UBYTE RB_RBA_Common_CentralElements_CompuMethods_Identical 1 100 0.0 255.00 FORMAT "%8.2" ECU_ADDRESS 0xfe403694 /end MEASUREMENT
/begin MEASUREMENT Tlib_EldtPmpStatCooltPmpI_ZCR_LIN4 "" UBYTE RB_RBA_Common_CentralElements_CompuMethods_Identical 1 100 0.0 255.00 FORMAT "%8.2" ECU_ADDRESS 0xfe403695 /end MEASUREMENT
/begin MEASUREMENT Tlib_HvCooltHeatrStsWhE2ECntr_ZCR_LIN4 "" UBYTE RB_RBA_Common_CentralElements_CompuMethods_Identical 1 100 0.0 255.00 FORMAT "%8.2" ECU_ADDRESS 0xfe403696 /end MEASUREMENT
/begin MEASUREMENT Tlib_HvCooltHeatrStsWhE2EHvchSts_ZCR_LIN4 "" UBYTE RB_RBA_Common_CentralElements_CompuMethods_Identical 1 100 0.0 255.00 FORMAT "%8.2" ECU_ADDRESS 0xfe403697 /end MEASUREMENT
/begin MEASUREMENT Tlib_HvCooltHeatrStsWhE2EChks_ZCR_LIN4 "" UBYTE RB_RBA_Common_CentralElements_CompuMethods_Identical 1 100 0.0 255.00 FORMAT "%8.2" ECU_ADDRESS 0xfe403698 /end MEASUREMENT
/begin MEASUREMENT Tlib_HvCooltHeatrSplyHighU_ZCR_LIN4 "" UWORD RB_RBA_Common_CentralElements_CompuMethods_Identical 1 100 0.0 65535 FORMAT "%8.2" ECU_ADDRESS 0xfe402cbc /end MEASUREMENT
/begin MEASUREMENT Tlib_HvHeatrPwrCnsDes_ZCR_LIN4 "" UWORD RB_RBA_Common_CentralElements_CompuMethods_Identical 1 100 0.0 65535 FORMAT "%8.2" ECU_ADDRESS 0xfe402cbe /end MEASUREMENT
/begin MEASUREMENT Tlib_HvHeatrPwrCns_ZCR_LIN4 "" UWORD RB_RBA_Common_CentralElements_CompuMethods_Identical 1 100 0.0 65535 FORMAT "%8.2" ECU_ADDRESS 0xfe402cc0 /end MEASUREMENT
/begin MEASUREMENT Tlib_CmprDiagcFbCmprDrvrCircSnsr_ZCR_LIN4 "" UBYTE RB_RBA_Common_CentralElements_CompuMethods_Identical 1 100 0.0 255.00 FORMAT "%8.2" ECU_ADDRESS 0xfe403699 /end MEASUREMENT
/begin MEASUREMENT Tlib_CmprDiagcFbCmprHvSnsr2_ZCR_LIN4 "" UBYTE RB_RBA_Common_CentralElements_CompuMethods_Identical 1 100 0.0 255.00 FORMAT "%8.2" ECU_ADDRESS 0xfe40369a /end MEASUREMENT
/begin MEASUREMENT Tlib_CmprDiagcFbCmprHvSnsr1_ZCR_LIN4 "" UBYTE RB_RBA_Common_CentralElements_CompuMethods_Identical 1 100 0.0 255.00 FORMAT "%8.2" ECU_ADDRESS 0xfe40369b /end MEASUREMENT
/begin MEASUREMENT Tlib_CmprDiagcFbCmprDrvrCircSnsrPlaus_ZCR_LIN4 "" UBYTE RB_RBA_Common_CentralElements_CompuMethods_Identical 1 100 0.0 255.00 FORMAT "%8.2" ECU_ADDRESS 0xfe40369c /end MEASUREMENT
/begin MEASUREMENT Tlib_CmprDiagcFbCmprT1_ZCR_LIN4 "" UBYTE RB_RBA_Common_CentralElements_CompuMethods_Identical 1 100 0.0 255.00 FORMAT "%8.2" ECU_ADDRESS 0xfe40369d /end MEASUREMENT
/begin MEASUREMENT Tlib_CmprDiagcFbCmprTPlaus_ZCR_LIN4 "" UBYTE RB_RBA_Common_CentralElements_CompuMethods_Identical 1 100 0.0 255.00 FORMAT "%8.2" ECU_ADDRESS 0xfe40369e /end MEASUREMENT
/begin MEASUREMENT Tlib_CmprDiagcFbCmprHvSnsrIPlaus_ZCR_LIN4 "" UBYTE RB_RBA_Common_CentralElements_CompuMethods_Identical 1 100 0.0 255.00 FORMAT "%8.2" ECU_ADDRESS 0xfe40369f /end MEASUREMENT
/begin MEASUREMENT Tlib_CmprDiagcFbCmprHvSnsrPlaus_ZCR_LIN4 "" UBYTE RB_RBA_Common_CentralElements_CompuMethods_Identical 1 100 0.0 255.00 FORMAT "%8.2" ECU_ADDRESS 0xfe4036a0 /end MEASUREMENT
/begin MEASUREMENT Tlib_CmprDiagcFbCmprUSplyErr_ZCR_LIN4 "" UBYTE RB_RBA_Common_CentralElements_CompuMethods_Identical 1 100 0.0 255.00 FORMAT "%8.2" ECU_ADDRESS 0xfe4036a1 /end MEASUREMENT
/begin MEASUREMENT Tlib_CmprDiagcFbCmprTOperErr1_ZCR_LIN4 "" UBYTE RB_RBA_Common_CentralElements_CompuMethods_Identical 1 100 0.0 255.00 FORMAT "%8.2" ECU_ADDRESS 0xfe4036a2 /end MEASUREMENT
/begin MEASUREMENT Tlib_CmprDiagcFbCmprCmprSpdErr_ZCR_LIN4 "" UBYTE RB_RBA_Common_CentralElements_CompuMethods_Identical 1 100 0.0 255.00 FORMAT "%8.2" ECU_ADDRESS 0xfe4036a3 /end MEASUREMENT
/begin MEASUREMENT Tlib_CmprDiagcFbCmprPhaseWire_ZCR_LIN4 "" UBYTE RB_RBA_Common_CentralElements_CompuMethods_Identical 1 100 0.0 255.00 FORMAT "%8.2" ECU_ADDRESS 0xfe4036a4 /end MEASUREMENT
/*********** End of merged FUNCTION blocks ***********/ /*********** Start of merged COMPU_METHOD blocks ***********/
/begin COMPU_METHOD RB_RBA_Common_CentralElements_CompuMethods_Identical "The internal value and the physical one are identical. No physical unit available" RAT_FUNC "%10.5" "noUnit" COEFFS 0.0 1.0 0.0 0.0 0.0 1.0 REF_UNIT RB_RBA_Common_CentralElements_Units_NoUnit /end COMPU_METHOD
/*********** Start of merged UNIT blocks ***********/
/begin UNIT RB_RBA_Common_CentralElements_Units_NoUnit "No Unit" "noUnit" EXTENDED_SI SI_EXPONENTS 0 0 0 0 0 0 0 /end UNIT
/begin UNIT AUTOSAR_LinIf_Units_NoUnit "No Unit" "noUnit" EXTENDED_SI SI_EXPONENTS 0 0 0 0 0 0 0 /end UNIT
/begin UNIT AUTOSAR_LinSM_Units_NoUnit "No Unit" "noUnit" EXTENDED_SI SI_EXPONENTS 0 0 0 0 0 0 0 /end UNIT
/begin UNIT AUTOSAR_PduR_Units_NoUnit "No Unit" "noUnit" EXTENDED_SI SI_EXPONENTS 0 0 0 0 0 0 0 /end UNIT
/begin UNIT RB_RBA_rba_CalWup_Units_NoUnit "No Unit" "noUnit" EXTENDED_SI SI_EXPONENTS 0 0 0 0 0 0 0 /end UNIT
/begin UNIT RB_RBA_rba_Dme_Units_NoUnit "" "noUnit" EXTENDED_SI SI_EXPONENTS 0 0 0 0 0 0 0 /end UNIT
/end MODULE
/end PROJECT
