ASAP2_VERSION 1 61
/begin PROJECT ZCU "ZCU"
/begin HEADER "" VERSION "ZCU" PROJECT_NO ZCU /end HEADER
/begin MODULE DIM ""
/begin MOD_COMMON "" BYTE_ORDER MSB_LAST ALIGNMENT_BYTE 1 ALIGNMENT_WORD 2 ALIGNMENT_LONG 4 ALIGNMENT_INT64 4 ALIGNMENT_FLOAT32_IEEE 4 ALIGNMENT_FLOAT64_IEEE 4 DATA_SIZE 32 /end MOD_COMMON
/begin MEASUREMENT Tlib_CmprDiagcFbCmprCtrlrErr_ZCR_LIN4 "" UBYTE RB_RBA_Common_CentralElements_CompuMethods_Identical 1 100 0.0 255.00 FORMAT "%8.2" ECU_ADDRESS 0xfe4036a5 /end MEASUREMENT
/begin MEASUREMENT Tlib_CmprDiagcFbCmprTOperErr2_ZCR_LIN4 "" UBYTE RB_RBA_Common_CentralElements_CompuMethods_Identical 1 100 0.0 255.00 FORMAT "%8.2" ECU_ADDRESS 0xfe4036a6 /end MEASUREMENT
/begin MEASUREMENT Tlib_CmprDiagcFbCmprHvSnsrICrct_ZCR_LIN4 "" UBYTE RB_RBA_Common_CentralElements_CompuMethods_Identical 1 100 0.0 255.00 FORMAT "%8.2" ECU_ADDRESS 0xfe4036a7 /end MEASUREMENT
/begin MEASUREMENT Tlib_CmprDiagcFbCmprHvSnsrI_ZCR_LIN4 "" UBYTE RB_RBA_Common_CentralElements_CompuMethods_Identical 1 100 0.0 255.00 FORMAT "%8.2" ECU_ADDRESS 0xfe4036a8 /end MEASUREMENT
/begin MEASUREMENT Tlib_CmprDiagcFbCmprHvSplyErr_ZCR_LIN4 "" UBYTE RB_RBA_Common_CentralElements_CompuMethods_Identical 1 100 0.0 255.00 FORMAT "%8.2" ECU_ADDRESS 0xfe4036a9 /end MEASUREMENT
/begin MEASUREMENT Tlib_CmprDiagcFbCmprT2_ZCR_LIN4 "" UBYTE RB_RBA_Common_CentralElements_CompuMethods_Identical 1 100 0.0 255.00 FORMAT "%8.2" ECU_ADDRESS 0xfe4036aa /end MEASUREMENT
/begin MEASUREMENT Tlib_CmprFbCmprSts2_ZCR_LIN4 "" UBYTE RB_RBA_Common_CentralElements_CompuMethods_Identical 1 100 0.0 255.00 FORMAT "%8.2" ECU_ADDRESS 0xfe4036ab /end MEASUREMENT
/begin MEASUREMENT Tlib_CmprFbCmprSts1_ZCR_LIN4 "" UBYTE RB_RBA_Common_CentralElements_CompuMethods_Identical 1 100 0.0 255.00 FORMAT "%8.2" ECU_ADDRESS 0xfe4036ac /end MEASUREMENT
/begin MEASUREMENT Tlib_CmprFbCmprU_ZCR_LIN4 "" UWORD RB_RBA_Common_CentralElements_CompuMethods_Identical 1 100 0.0 65535 FORMAT "%8.2" ECU_ADDRESS 0xfe402cc2 /end MEASUREMENT
/begin MEASUREMENT Tlib_CmprFbCmprT1_ZCR_LIN4 "" UBYTE RB_RBA_Common_CentralElements_CompuMethods_Identical 1 100 0.0 255.00 FORMAT "%8.2" ECU_ADDRESS 0xfe4036ad /end MEASUREMENT
/begin MEASUREMENT Tlib_CmprFbCmprT2_ZCR_LIN4 "" UBYTE RB_RBA_Common_CentralElements_CompuMethods_Identical 1 100 0.0 255.00 FORMAT "%8.2" ECU_ADDRESS 0xfe4036ae /end MEASUREMENT
/begin MEASUREMENT Tlib_CmprFbCmprSpd_ZCR_LIN4 "" UBYTE RB_RBA_Common_CentralElements_CompuMethods_Identical 1 100 0.0 255.00 FORMAT "%8.2" ECU_ADDRESS 0xfe4036af /end MEASUREMENT
/begin MEASUREMENT Tlib_CmprFbCmprI_ZCR_LIN4 "" UWORD RB_RBA_Common_CentralElements_CompuMethods_Identical 1 100 0.0 65535 FORMAT "%8.2" ECU_ADDRESS 0xfe402cc4 /end MEASUREMENT
/begin MEASUREMENT Tlib_CmprFbCmprIPha_ZCR_LIN4 "" UBYTE RB_RBA_Common_CentralElements_CompuMethods_Identical 1 100 0.0 255.00 FORMAT "%8.2" ECU_ADDRESS 0xfe4036b0 /end MEASUREMENT
/begin MEASUREMENT Tlib_EEXVPartNo10CmplEndSgn1_ZCR_LIN4 "" UBYTE RB_RBA_Common_CentralElements_CompuMethods_Identical 1 100 0.0 255.00 FORMAT "%8.2" ECU_ADDRESS 0xfe4036b1 /end MEASUREMENT
/begin MEASUREMENT Tlib_EEXVPartNo10CmplNr3_ZCR_LIN4 "" UBYTE RB_RBA_Common_CentralElements_CompuMethods_Identical 1 100 0.0 255.00 FORMAT "%8.2" ECU_ADDRESS 0xfe4036b2 /end MEASUREMENT
/begin MEASUREMENT Tlib_EEXVPartNo10CmplEndSgn2_ZCR_LIN4 "" UBYTE RB_RBA_Common_CentralElements_CompuMethods_Identical 1 100 0.0 255.00 FORMAT "%8.2" ECU_ADDRESS 0xfe4036b3 /end MEASUREMENT
/begin MEASUREMENT Tlib_EEXVPartNo10CmplNr4_ZCR_LIN4 "" UBYTE RB_RBA_Common_CentralElements_CompuMethods_Identical 1 100 0.0 255.00 FORMAT "%8.2" ECU_ADDRESS 0xfe4036b4 /end MEASUREMENT
/begin MEASUREMENT Tlib_EEXVPartNo10CmplNr1_ZCR_LIN4 "" UBYTE RB_RBA_Common_CentralElements_CompuMethods_Identical 1 100 0.0 255.00 FORMAT "%8.2" ECU_ADDRESS 0xfe4036b5 /end MEASUREMENT
/begin MEASUREMENT Tlib_EEXVPartNo10CmplNr2_ZCR_LIN4 "" UBYTE RB_RBA_Common_CentralElements_CompuMethods_Identical 1 100 0.0 255.00 FORMAT "%8.2" ECU_ADDRESS 0xfe4036b6 /end MEASUREMENT
/begin MEASUREMENT Tlib_EEXVPartNo10CmplEndSgn3_ZCR_LIN4 "" UBYTE RB_RBA_Common_CentralElements_CompuMethods_Identical 1 100 0.0 255.00 FORMAT "%8.2" ECU_ADDRESS 0xfe4036b7 /end MEASUREMENT
/begin MEASUREMENT Tlib_EEXVPartNo10CmplNr5_ZCR_LIN4 "" UBYTE RB_RBA_Common_CentralElements_CompuMethods_Identical 1 100 0.0 255.00 FORMAT "%8.2" ECU_ADDRESS 0xfe4036b8 /end MEASUREMENT
/begin MEASUREMENT Tlib_CEXVPartNoCmplNr3_ZCR_LIN4 "" UBYTE RB_RBA_Common_CentralElements_CompuMethods_Identical 1 100 0.0 255.00 FORMAT "%8.2" ECU_ADDRESS 0xfe4036b9 /end MEASUREMENT
/begin MEASUREMENT Tlib_CEXVPartNoCmplNr4_ZCR_LIN4 "" UBYTE RB_RBA_Common_CentralElements_CompuMethods_Identical 1 100 0.0 255.00 FORMAT "%8.2" ECU_ADDRESS 0xfe4036ba /end MEASUREMENT
/begin MEASUREMENT Tlib_CEXVPartNoCmplNr2_ZCR_LIN4 "" UBYTE RB_RBA_Common_CentralElements_CompuMethods_Identical 1 100 0.0 255.00 FORMAT "%8.2" ECU_ADDRESS 0xfe4036bb /end MEASUREMENT
/begin MEASUREMENT Tlib_CEXVPartNoCmplNr1_ZCR_LIN4 "" UBYTE RB_RBA_Common_CentralElements_CompuMethods_Identical 1 100 0.0 255.00 FORMAT "%8.2" ECU_ADDRESS 0xfe4036bc /end MEASUREMENT
/begin MEASUREMENT Tlib_CEXVPartNoCmplEndSgn1_ZCR_LIN4 "" UBYTE RB_RBA_Common_CentralElements_CompuMethods_Identical 1 100 0.0 255.00 FORMAT "%8.2" ECU_ADDRESS 0xfe4036bd /end MEASUREMENT
/begin MEASUREMENT Tlib_CEXVPartNoCmplEndSgn2_ZCR_LIN4 "" UBYTE RB_RBA_Common_CentralElements_CompuMethods_Identical 1 100 0.0 255.00 FORMAT "%8.2" ECU_ADDRESS 0xfe4036be /end MEASUREMENT
/begin MEASUREMENT Tlib_CEXVPartNoCmplEndSgn3_ZCR_LIN4 "" UBYTE RB_RBA_Common_CentralElements_CompuMethods_Identical 1 100 0.0 255.00 FORMAT "%8.2" ECU_ADDRESS 0xfe4036bf /end MEASUREMENT
/begin MEASUREMENT Tlib_REXVSerNoNr1_ZCR_LIN4 "" UBYTE RB_RBA_Common_CentralElements_CompuMethods_Identical 1 100 0.0 255.00 FORMAT "%8.2" ECU_ADDRESS 0xfe4036c0 /end MEASUREMENT
/begin MEASUREMENT Tlib_REXVSerNoNr2_ZCR_LIN4 "" UBYTE RB_RBA_Common_CentralElements_CompuMethods_Identical 1 100 0.0 255.00 FORMAT "%8.2" ECU_ADDRESS 0xfe4036c1 /end MEASUREMENT
/begin MEASUREMENT Tlib_REXVSerNoNr4_ZCR_LIN4 "" UBYTE RB_RBA_Common_CentralElements_CompuMethods_Identical 1 100 0.0 255.00 FORMAT "%8.2" ECU_ADDRESS 0xfe4036c2 /end MEASUREMENT
/begin MEASUREMENT Tlib_REXVSerNoNr3_ZCR_LIN4 "" UBYTE RB_RBA_Common_CentralElements_CompuMethods_Identical 1 100 0.0 255.00 FORMAT "%8.2" ECU_ADDRESS 0xfe4036c3 /end MEASUREMENT
/begin MEASUREMENT Tlib_REXVPartNo10CmplNr2_ZCR_LIN4 "" UBYTE RB_RBA_Common_CentralElements_CompuMethods_Identical 1 100 0.0 255.00 FORMAT "%8.2" ECU_ADDRESS 0xfe4036c4 /end MEASUREMENT
/begin MEASUREMENT Tlib_REXVPartNo10CmplNr4_ZCR_LIN4 "" UBYTE RB_RBA_Common_CentralElements_CompuMethods_Identical 1 100 0.0 255.00 FORMAT "%8.2" ECU_ADDRESS 0xfe4036c5 /end MEASUREMENT
/begin MEASUREMENT Tlib_REXVPartNo10CmplNr3_ZCR_LIN4 "" UBYTE RB_RBA_Common_CentralElements_CompuMethods_Identical 1 100 0.0 255.00 FORMAT "%8.2" ECU_ADDRESS 0xfe4036c6 /end MEASUREMENT
/begin MEASUREMENT Tlib_REXVPartNo10CmplNr5_ZCR_LIN4 "" UBYTE RB_RBA_Common_CentralElements_CompuMethods_Identical 1 100 0.0 255.00 FORMAT "%8.2" ECU_ADDRESS 0xfe4036c7 /end MEASUREMENT
/begin MEASUREMENT Tlib_REXVPartNo10CmplEndSgn1_ZCR_LIN4 "" UBYTE RB_RBA_Common_CentralElements_CompuMethods_Identical 1 100 0.0 255.00 FORMAT "%8.2" ECU_ADDRESS 0xfe4036c8 /end MEASUREMENT
/begin MEASUREMENT Tlib_REXVPartNo10CmplEndSgn2_ZCR_LIN4 "" UBYTE RB_RBA_Common_CentralElements_CompuMethods_Identical 1 100 0.0 255.00 FORMAT "%8.2" ECU_ADDRESS 0xfe4036c9 /end MEASUREMENT
/begin MEASUREMENT Tlib_REXVPartNo10CmplNr1_ZCR_LIN4 "" UBYTE RB_RBA_Common_CentralElements_CompuMethods_Identical 1 100 0.0 255.00 FORMAT "%8.2" ECU_ADDRESS 0xfe4036ca /end MEASUREMENT
/begin MEASUREMENT Tlib_REXVPartNo10CmplEndSgn3_ZCR_LIN4 "" UBYTE RB_RBA_Common_CentralElements_CompuMethods_Identical 1 100 0.0 255.00 FORMAT "%8.2" ECU_ADDRESS 0xfe4036cb /end MEASUREMENT
/begin MEASUREMENT Tlib_BEXVSerNoNr1_ZCR_LIN4 "" UBYTE RB_RBA_Common_CentralElements_CompuMethods_Identical 1 100 0.0 255.00 FORMAT "%8.2" ECU_ADDRESS 0xfe4036cc /end MEASUREMENT
/begin MEASUREMENT Tlib_BEXVSerNoNr4_ZCR_LIN4 "" UBYTE RB_RBA_Common_CentralElements_CompuMethods_Identical 1 100 0.0 255.00 FORMAT "%8.2" ECU_ADDRESS 0xfe4036cd /end MEASUREMENT
/begin MEASUREMENT Tlib_BEXVSerNoNr2_ZCR_LIN4 "" UBYTE RB_RBA_Common_CentralElements_CompuMethods_Identical 1 100 0.0 255.00 FORMAT "%8.2" ECU_ADDRESS 0xfe4036ce /end MEASUREMENT
/begin MEASUREMENT Tlib_BEXVSerNoNr3_ZCR_LIN4 "" UBYTE RB_RBA_Common_CentralElements_CompuMethods_Identical 1 100 0.0 255.00 FORMAT "%8.2" ECU_ADDRESS 0xfe4036cf /end MEASUREMENT
/begin MEASUREMENT Tlib_EXVPartNoCmplNr4_ZCR_LIN4 "" UBYTE RB_RBA_Common_CentralElements_CompuMethods_Identical 1 100 0.0 255.00 FORMAT "%8.2" ECU_ADDRESS 0xfe4036d0 /end MEASUREMENT
/begin MEASUREMENT Tlib_EXVPartNoCmplEndSgn2_ZCR_LIN4 "" UBYTE RB_RBA_Common_CentralElements_CompuMethods_Identical 1 100 0.0 255.00 FORMAT "%8.2" ECU_ADDRESS 0xfe4036d1 /end MEASUREMENT
/begin MEASUREMENT Tlib_EXVPartNoCmplNr2_ZCR_LIN4 "" UBYTE RB_RBA_Common_CentralElements_CompuMethods_Identical 1 100 0.0 255.00 FORMAT "%8.2" ECU_ADDRESS 0xfe4036d2 /end MEASUREMENT
/begin MEASUREMENT Tlib_EXVPartNoCmplEndSgn3_ZCR_LIN4 "" UBYTE RB_RBA_Common_CentralElements_CompuMethods_Identical 1 100 0.0 255.00 FORMAT "%8.2" ECU_ADDRESS 0xfe4036d3 /end MEASUREMENT
/begin MEASUREMENT Tlib_EXVPartNoCmplNr3_ZCR_LIN4 "" UBYTE RB_RBA_Common_CentralElements_CompuMethods_Identical 1 100 0.0 255.00 FORMAT "%8.2" ECU_ADDRESS 0xfe4036d4 /end MEASUREMENT
/begin MEASUREMENT Tlib_EXVPartNoCmplNr1_ZCR_LIN4 "" UBYTE RB_RBA_Common_CentralElements_CompuMethods_Identical 1 100 0.0 255.00 FORMAT "%8.2" ECU_ADDRESS 0xfe4036d5 /end MEASUREMENT
/begin MEASUREMENT Tlib_EXVPartNoCmplEndSgn1_ZCR_LIN4 "" UBYTE RB_RBA_Common_CentralElements_CompuMethods_Identical 1 100 0.0 255.00 FORMAT "%8.2" ECU_ADDRESS 0xfe4036d6 /end MEASUREMENT
/begin MEASUREMENT Tlib_EEXVSerNoNr1_ZCR_LIN4 "" UBYTE RB_RBA_Common_CentralElements_CompuMethods_Identical 1 100 0.0 255.00 FORMAT "%8.2" ECU_ADDRESS 0xfe4036d7 /end MEASUREMENT
/begin MEASUREMENT Tlib_EEXVSerNoNr2_ZCR_LIN4 "" UBYTE RB_RBA_Common_CentralElements_CompuMethods_Identical 1 100 0.0 255.00 FORMAT "%8.2" ECU_ADDRESS 0xfe4036d8 /end MEASUREMENT
/begin MEASUREMENT Tlib_EEXVSerNoNr3_ZCR_LIN4 "" UBYTE RB_RBA_Common_CentralElements_CompuMethods_Identical 1 100 0.0 255.00 FORMAT "%8.2" ECU_ADDRESS 0xfe4036d9 /end MEASUREMENT
/begin MEASUREMENT Tlib_EEXVSerNoNr4_ZCR_LIN4 "" UBYTE RB_RBA_Common_CentralElements_CompuMethods_Identical 1 100 0.0 255.00 FORMAT "%8.2" ECU_ADDRESS 0xfe4036da /end MEASUREMENT
/begin MEASUREMENT Tlib_BEXVPartNoCmplEndSgn3_ZCR_LIN4 "" UBYTE RB_RBA_Common_CentralElements_CompuMethods_Identical 1 100 0.0 255.00 FORMAT "%8.2" ECU_ADDRESS 0xfe4036db /end MEASUREMENT
/begin MEASUREMENT Tlib_BEXVPartNoCmplEndSgn1_ZCR_LIN4 "" UBYTE RB_RBA_Common_CentralElements_CompuMethods_Identical 1 100 0.0 255.00 FORMAT "%8.2" ECU_ADDRESS 0xfe4036dc /end MEASUREMENT
/begin MEASUREMENT Tlib_BEXVPartNoCmplNr4_ZCR_LIN4 "" UBYTE RB_RBA_Common_CentralElements_CompuMethods_Identical 1 100 0.0 255.00 FORMAT "%8.2" ECU_ADDRESS 0xfe4036dd /end MEASUREMENT
/begin MEASUREMENT Tlib_BEXVPartNoCmplNr1_ZCR_LIN4 "" UBYTE RB_RBA_Common_CentralElements_CompuMethods_Identical 1 100 0.0 255.00 FORMAT "%8.2" ECU_ADDRESS 0xfe4036de /end MEASUREMENT
/begin MEASUREMENT Tlib_BEXVPartNoCmplNr3_ZCR_LIN4 "" UBYTE RB_RBA_Common_CentralElements_CompuMethods_Identical 1 100 0.0 255.00 FORMAT "%8.2" ECU_ADDRESS 0xfe4036df /end MEASUREMENT
/begin MEASUREMENT Tlib_BEXVPartNoCmplEndSgn2_ZCR_LIN4 "" UBYTE RB_RBA_Common_CentralElements_CompuMethods_Identical 1 100 0.0 255.00 FORMAT "%8.2" ECU_ADDRESS 0xfe4036e0 /end MEASUREMENT
/begin MEASUREMENT Tlib_BEXVPartNoCmplNr2_ZCR_LIN4 "" UBYTE RB_RBA_Common_CentralElements_CompuMethods_Identical 1 100 0.0 255.00 FORMAT "%8.2" ECU_ADDRESS 0xfe4036e1 /end MEASUREMENT
/begin MEASUREMENT Tlib_EXVPartNo10CmplNr5_ZCR_LIN4 "" UBYTE RB_RBA_Common_CentralElements_CompuMethods_Identical 1 100 0.0 255.00 FORMAT "%8.2" ECU_ADDRESS 0xfe4036e2 /end MEASUREMENT
/begin MEASUREMENT Tlib_EXVPartNo10CmplNr2_ZCR_LIN4 "" UBYTE RB_RBA_Common_CentralElements_CompuMethods_Identical 1 100 0.0 255.00 FORMAT "%8.2" ECU_ADDRESS 0xfe4036e3 /end MEASUREMENT
/begin MEASUREMENT Tlib_EXVPartNo10CmplNr3_ZCR_LIN4 "" UBYTE RB_RBA_Common_CentralElements_CompuMethods_Identical 1 100 0.0 255.00 FORMAT "%8.2" ECU_ADDRESS 0xfe4036e4 /end MEASUREMENT
/begin MEASUREMENT Tlib_EXVPartNo10CmplEndSgn1_ZCR_LIN4 "" UBYTE RB_RBA_Common_CentralElements_CompuMethods_Identical 1 100 0.0 255.00 FORMAT "%8.2" ECU_ADDRESS 0xfe4036e5 /end MEASUREMENT
/begin MEASUREMENT Tlib_EXVPartNo10CmplEndSgn3_ZCR_LIN4 "" UBYTE RB_RBA_Common_CentralElements_CompuMethods_Identical 1 100 0.0 255.00 FORMAT "%8.2" ECU_ADDRESS 0xfe4036e6 /end MEASUREMENT
/begin MEASUREMENT Tlib_EXVPartNo10CmplNr4_ZCR_LIN4 "" UBYTE RB_RBA_Common_CentralElements_CompuMethods_Identical 1 100 0.0 255.00 FORMAT "%8.2" ECU_ADDRESS 0xfe4036e7 /end MEASUREMENT
/begin MEASUREMENT Tlib_EXVPartNo10CmplNr1_ZCR_LIN4 "" UBYTE RB_RBA_Common_CentralElements_CompuMethods_Identical 1 100 0.0 255.00 FORMAT "%8.2" ECU_ADDRESS 0xfe4036e8 /end MEASUREMENT
/begin MEASUREMENT Tlib_EXVPartNo10CmplEndSgn2_ZCR_LIN4 "" UBYTE RB_RBA_Common_CentralElements_CompuMethods_Identical 1 100 0.0 255.00 FORMAT "%8.2" ECU_ADDRESS 0xfe4036e9 /end MEASUREMENT
/begin MEASUREMENT Tlib_EEXVPartNoCmplEndSgn1_ZCR_LIN4 "" UBYTE RB_RBA_Common_CentralElements_CompuMethods_Identical 1 100 0.0 255.00 FORMAT "%8.2" ECU_ADDRESS 0xfe4036ea /end MEASUREMENT
/begin MEASUREMENT Tlib_EEXVPartNoCmplNr1_ZCR_LIN4 "" UBYTE RB_RBA_Common_CentralElements_CompuMethods_Identical 1 100 0.0 255.00 FORMAT "%8.2" ECU_ADDRESS 0xfe4036eb /end MEASUREMENT
/begin MEASUREMENT Tlib_EEXVPartNoCmplEndSgn3_ZCR_LIN4 "" UBYTE RB_RBA_Common_CentralElements_CompuMethods_Identical 1 100 0.0 255.00 FORMAT "%8.2" ECU_ADDRESS 0xfe4036ec /end MEASUREMENT
/begin MEASUREMENT Tlib_EEXVPartNoCmplEndSgn2_ZCR_LIN4 "" UBYTE RB_RBA_Common_CentralElements_CompuMethods_Identical 1 100 0.0 255.00 FORMAT "%8.2" ECU_ADDRESS 0xfe4036ed /end MEASUREMENT
/begin MEASUREMENT Tlib_EEXVPartNoCmplNr2_ZCR_LIN4 "" UBYTE RB_RBA_Common_CentralElements_CompuMethods_Identical 1 100 0.0 255.00 FORMAT "%8.2" ECU_ADDRESS 0xfe4036ee /end MEASUREMENT
/begin MEASUREMENT Tlib_EEXVPartNoCmplNr4_ZCR_LIN4 "" UBYTE RB_RBA_Common_CentralElements_CompuMethods_Identical 1 100 0.0 255.00 FORMAT "%8.2" ECU_ADDRESS 0xfe4036ef /end MEASUREMENT
/begin MEASUREMENT Tlib_EEXVPartNoCmplNr3_ZCR_LIN4 "" UBYTE RB_RBA_Common_CentralElements_CompuMethods_Identical 1 100 0.0 255.00 FORMAT "%8.2" ECU_ADDRESS 0xfe4036f0 /end MEASUREMENT
/begin MEASUREMENT Tlib_BEXVPartNo10CmplNr3_ZCR_LIN4 "" UBYTE RB_RBA_Common_CentralElements_CompuMethods_Identical 1 100 0.0 255.00 FORMAT "%8.2" ECU_ADDRESS 0xfe4036f1 /end MEASUREMENT
/begin MEASUREMENT Tlib_BEXVPartNo10CmplNr4_ZCR_LIN4 "" UBYTE RB_RBA_Common_CentralElements_CompuMethods_Identical 1 100 0.0 255.00 FORMAT "%8.2" ECU_ADDRESS 0xfe4036f2 /end MEASUREMENT
/begin MEASUREMENT Tlib_BEXVPartNo10CmplNr5_ZCR_LIN4 "" UBYTE RB_RBA_Common_CentralElements_CompuMethods_Identical 1 100 0.0 255.00 FORMAT "%8.2" ECU_ADDRESS 0xfe4036f3 /end MEASUREMENT
/begin MEASUREMENT Tlib_BEXVPartNo10CmplNr2_ZCR_LIN4 "" UBYTE RB_RBA_Common_CentralElements_CompuMethods_Identical 1 100 0.0 255.00 FORMAT "%8.2" ECU_ADDRESS 0xfe4036f4 /end MEASUREMENT
/begin MEASUREMENT Tlib_BEXVPartNo10CmplEndSgn2_ZCR_LIN4 "" UBYTE RB_RBA_Common_CentralElements_CompuMethods_Identical 1 100 0.0 255.00 FORMAT "%8.2" ECU_ADDRESS 0xfe4036f5 /end MEASUREMENT
/begin MEASUREMENT Tlib_BEXVPartNo10CmplEndSgn3_ZCR_LIN4 "" UBYTE RB_RBA_Common_CentralElements_CompuMethods_Identical 1 100 0.0 255.00 FORMAT "%8.2" ECU_ADDRESS 0xfe4036f6 /end MEASUREMENT
/begin MEASUREMENT Tlib_BEXVPartNo10CmplNr1_ZCR_LIN4 "" UBYTE RB_RBA_Common_CentralElements_CompuMethods_Identical 1 100 0.0 255.00 FORMAT "%8.2" ECU_ADDRESS 0xfe4036f7 /end MEASUREMENT
/begin MEASUREMENT Tlib_BEXVPartNo10CmplEndSgn1_ZCR_LIN4 "" UBYTE RB_RBA_Common_CentralElements_CompuMethods_Identical 1 100 0.0 255.00 FORMAT "%8.2" ECU_ADDRESS 0xfe4036f8 /end MEASUREMENT
/begin MEASUREMENT Tlib_CEXVPartNo10CmplEndSgn1_ZCR_LIN4 "" UBYTE RB_RBA_Common_CentralElements_CompuMethods_Identical 1 100 0.0 255.00 FORMAT "%8.2" ECU_ADDRESS 0xfe4036f9 /end MEASUREMENT
/begin MEASUREMENT Tlib_CEXVPartNo10CmplNr1_ZCR_LIN4 "" UBYTE RB_RBA_Common_CentralElements_CompuMethods_Identical 1 100 0.0 255.00 FORMAT "%8.2" ECU_ADDRESS 0xfe4036fa /end MEASUREMENT
/begin MEASUREMENT Tlib_CEXVPartNo10CmplNr2_ZCR_LIN4 "" UBYTE RB_RBA_Common_CentralElements_CompuMethods_Identical 1 100 0.0 255.00 FORMAT "%8.2" ECU_ADDRESS 0xfe4036fb /end MEASUREMENT
/begin MEASUREMENT Tlib_CEXVPartNo10CmplNr3_ZCR_LIN4 "" UBYTE RB_RBA_Common_CentralElements_CompuMethods_Identical 1 100 0.0 255.00 FORMAT "%8.2" ECU_ADDRESS 0xfe4036fc /end MEASUREMENT
/begin MEASUREMENT Tlib_CEXVPartNo10CmplEndSgn3_ZCR_LIN4 "" UBYTE RB_RBA_Common_CentralElements_CompuMethods_Identical 1 100 0.0 255.00 FORMAT "%8.2" ECU_ADDRESS 0xfe4036fd /end MEASUREMENT
/begin MEASUREMENT Tlib_CEXVPartNo10CmplEndSgn2_ZCR_LIN4 "" UBYTE RB_RBA_Common_CentralElements_CompuMethods_Identical 1 100 0.0 255.00 FORMAT "%8.2" ECU_ADDRESS 0xfe4036fe /end MEASUREMENT
/begin MEASUREMENT Tlib_CEXVPartNo10CmplNr5_ZCR_LIN4 "" UBYTE RB_RBA_Common_CentralElements_CompuMethods_Identical 1 100 0.0 255.00 FORMAT "%8.2" ECU_ADDRESS 0xfe4036ff /end MEASUREMENT
/begin MEASUREMENT Tlib_CEXVPartNo10CmplNr4_ZCR_LIN4 "" UBYTE RB_RBA_Common_CentralElements_CompuMethods_Identical 1 100 0.0 255.00 FORMAT "%8.2" ECU_ADDRESS 0xfe403700 /end MEASUREMENT
/begin MEASUREMENT Tlib_REXVPartNoCmplNr4_ZCR_LIN4 "" UBYTE RB_RBA_Common_CentralElements_CompuMethods_Identical 1 100 0.0 255.00 FORMAT "%8.2" ECU_ADDRESS 0xfe403701 /end MEASUREMENT
/begin MEASUREMENT Tlib_REXVPartNoCmplNr3_ZCR_LIN4 "" UBYTE RB_RBA_Common_CentralElements_CompuMethods_Identical 1 100 0.0 255.00 FORMAT "%8.2" ECU_ADDRESS 0xfe403702 /end MEASUREMENT
/begin MEASUREMENT Tlib_REXVPartNoCmplEndSgn1_ZCR_LIN4 "" UBYTE RB_RBA_Common_CentralElements_CompuMethods_Identical 1 100 0.0 255.00 FORMAT "%8.2" ECU_ADDRESS 0xfe403703 /end MEASUREMENT
/begin MEASUREMENT Tlib_REXVPartNoCmplNr2_ZCR_LIN4 "" UBYTE RB_RBA_Common_CentralElements_CompuMethods_Identical 1 100 0.0 255.00 FORMAT "%8.2" ECU_ADDRESS 0xfe403704 /end MEASUREMENT
/begin MEASUREMENT Tlib_REXVPartNoCmplEndSgn2_ZCR_LIN4 "" UBYTE RB_RBA_Common_CentralElements_CompuMethods_Identical 1 100 0.0 255.00 FORMAT "%8.2" ECU_ADDRESS 0xfe403705 /end MEASUREMENT
/begin MEASUREMENT Tlib_REXVPartNoCmplEndSgn3_ZCR_LIN4 "" UBYTE RB_RBA_Common_CentralElements_CompuMethods_Identical 1 100 0.0 255.00 FORMAT "%8.2" ECU_ADDRESS 0xfe403706 /end MEASUREMENT
/begin MEASUREMENT Tlib_REXVPartNoCmplNr1_ZCR_LIN4 "" UBYTE RB_RBA_Common_CentralElements_CompuMethods_Identical 1 100 0.0 255.00 FORMAT "%8.2" ECU_ADDRESS 0xfe403707 /end MEASUREMENT
/begin MEASUREMENT Tlib_CEXVSerNoNr4_ZCR_LIN4 "" UBYTE RB_RBA_Common_CentralElements_CompuMethods_Identical 1 100 0.0 255.00 FORMAT "%8.2" ECU_ADDRESS 0xfe403708 /end MEASUREMENT
/begin MEASUREMENT Tlib_CEXVSerNoNr2_ZCR_LIN4 "" UBYTE RB_RBA_Common_CentralElements_CompuMethods_Identical 1 100 0.0 255.00 FORMAT "%8.2" ECU_ADDRESS 0xfe403709 /end MEASUREMENT
/begin MEASUREMENT Tlib_CEXVSerNoNr1_ZCR_LIN4 "" UBYTE RB_RBA_Common_CentralElements_CompuMethods_Identical 1 100 0.0 255.00 FORMAT "%8.2" ECU_ADDRESS 0xfe40370a /end MEASUREMENT
/begin MEASUREMENT Tlib_CEXVSerNoNr3_ZCR_LIN4 "" UBYTE RB_RBA_Common_CentralElements_CompuMethods_Identical 1 100 0.0 255.00 FORMAT "%8.2" ECU_ADDRESS 0xfe40370b /end MEASUREMENT
/begin MEASUREMENT Tlib_EXVSerNoNr4_ZCR_LIN4 "" UBYTE RB_RBA_Common_CentralElements_CompuMethods_Identical 1 100 0.0 255.00 FORMAT "%8.2" ECU_ADDRESS 0xfe40370c /end MEASUREMENT
/begin MEASUREMENT Tlib_EXVSerNoNr2_ZCR_LIN4 "" UBYTE RB_RBA_Common_CentralElements_CompuMethods_Identical 1 100 0.0 255.00 FORMAT "%8.2" ECU_ADDRESS 0xfe40370d /end MEASUREMENT
/begin MEASUREMENT Tlib_EXVSerNoNr3_ZCR_LIN4 "" UBYTE RB_RBA_Common_CentralElements_CompuMethods_Identical 1 100 0.0 255.00 FORMAT "%8.2" ECU_ADDRESS 0xfe40370e /end MEASUREMENT
/begin MEASUREMENT Tlib_EXVSerNoNr1_ZCR_LIN4 "" UBYTE RB_RBA_Common_CentralElements_CompuMethods_Identical 1 100 0.0 255.00 FORMAT "%8.2" ECU_ADDRESS 0xfe40370f /end MEASUREMENT
/begin MEASUREMENT Tlib_CrashStsSafeSts_ZCR_CANFD4 "" UBYTE RB_RBA_Common_CentralElements_CompuMethods_Identical 1 100 0.0 255.00 FORMAT "%8.2" ECU_ADDRESS 0xfe403710 /end MEASUREMENT
/begin MEASUREMENT Tlib_CrashStsSafeCntr4_ZCR_CANFD4 "" UBYTE RB_RBA_Common_CentralElements_CompuMethods_Identical 1 100 0.0 255.00 FORMAT "%8.2" ECU_ADDRESS 0xfe403711 /end MEASUREMENT
/begin MEASUREMENT Tlib_CrashStsSafeDataID4_ZCR_CANFD4 "" UBYTE RB_RBA_Common_CentralElements_CompuMethods_Identical 1 100 0.0 255.00 FORMAT "%8.2" ECU_ADDRESS 0xfe403712 /end MEASUREMENT
/begin MEASUREMENT Tlib_CrashStsSafeChks8_ZCR_CANFD4 "" UBYTE RB_RBA_Common_CentralElements_CompuMethods_Identical 1 100 0.0 255.00 FORMAT "%8.2" ECU_ADDRESS 0xfe403713 /end MEASUREMENT
/begin MEASUREMENT Tlib_CrashSts3_ZCR_CANFD4 "" UBYTE RB_RBA_Common_CentralElements_CompuMethods_Identical 1 100 0.0 255.00 FORMAT "%8.2" ECU_ADDRESS 0xfe403714 /end MEASUREMENT
/begin MEASUREMENT Tlib_SecRiMassgPnmFailr_ZCR_LIN7 "" UBYTE RB_RBA_Common_CentralElements_CompuMethods_Identical 1 100 0.0 255.00 FORMAT "%8.2" ECU_ADDRESS 0xfe403715 /end MEASUREMENT
/begin MEASUREMENT Tlib_SecRiMassgFltStsForEcu_ZCR_LIN7 "" UBYTE RB_RBA_Common_CentralElements_CompuMethods_Identical 1 100 0.0 255.00 FORMAT "%8.2" ECU_ADDRESS 0xfe403716 /end MEASUREMENT
/begin MEASUREMENT Tlib_SecRiMassgCmftHwFailr_ZCR_LIN7 "" UBYTE RB_RBA_Common_CentralElements_CompuMethods_Identical 1 100 0.0 255.00 FORMAT "%8.2" ECU_ADDRESS 0xfe403717 /end MEASUREMENT
/begin MEASUREMENT Tlib_SecRiMassgCushBlstrFailr_ZCR_LIN7 "" UBYTE RB_RBA_Common_CentralElements_CompuMethods_Identical 1 100 0.0 255.00 FORMAT "%8.2" ECU_ADDRESS 0xfe403718 /end MEASUREMENT
/begin MEASUREMENT Tlib_SecRiMassgBackBlstrFailr_ZCR_LIN7 "" UBYTE RB_RBA_Common_CentralElements_CompuMethods_Identical 1 100 0.0 255.00 FORMAT "%8.2" ECU_ADDRESS 0xfe403719 /end MEASUREMENT
/begin MEASUREMENT Tlib_PassMassgFltStsForEcu_ZCR_LIN7 "" UBYTE RB_RBA_Common_CentralElements_CompuMethods_Identical 1 100 0.0 255.00 FORMAT "%8.2" ECU_ADDRESS 0xfe40371a /end MEASUREMENT
/begin MEASUREMENT Tlib_PassMassgPnmFailr_ZCR_LIN7 "" UBYTE RB_RBA_Common_CentralElements_CompuMethods_Identical 1 100 0.0 255.00 FORMAT "%8.2" ECU_ADDRESS 0xfe40371b /end MEASUREMENT
/begin MEASUREMENT Tlib_PassMassgCmftHwFailr_ZCR_LIN7 "" UBYTE RB_RBA_Common_CentralElements_CompuMethods_Identical 1 100 0.0 255.00 FORMAT "%8.2" ECU_ADDRESS 0xfe40371c /end MEASUREMENT
/begin MEASUREMENT Tlib_PassMassgBackBlstrFailr_ZCR_LIN7 "" UBYTE RB_RBA_Common_CentralElements_CompuMethods_Identical 1 100 0.0 255.00 FORMAT "%8.2" ECU_ADDRESS 0xfe40371d /end MEASUREMENT
/begin MEASUREMENT Tlib_PassMassgCushBlstrFailr_ZCR_LIN7 "" UBYTE RB_RBA_Common_CentralElements_CompuMethods_Identical 1 100 0.0 255.00 FORMAT "%8.2" ECU_ADDRESS 0xfe40371e /end MEASUREMENT
/begin MEASUREMENT Tlib_ElSPLeftDir_ZCR_LIN7 "" UBYTE RB_RBA_Common_CentralElements_CompuMethods_Identical 1 100 0.0 255.00 FORMAT "%8.2" ECU_ADDRESS 0xfe40371f /end MEASUREMENT
/begin MEASUREMENT Tlib_LeftElectricPedalIninSts_ZCR_LIN7 "" UBYTE RB_RBA_Common_CentralElements_CompuMethods_Identical 1 100 0.0 255.00 FORMAT "%8.2" ECU_ADDRESS 0xfe403720 /end MEASUREMENT
/begin MEASUREMENT Tlib_ElSPRightDir_ZCR_LIN7 "" UBYTE RB_RBA_Common_CentralElements_CompuMethods_Identical 1 100 0.0 255.00 FORMAT "%8.2" ECU_ADDRESS 0xfe403721 /end MEASUREMENT
/begin MEASUREMENT Tlib_LeftElectricPedalMotBlok_ZCR_LIN7 "" UBYTE RB_RBA_Common_CentralElements_CompuMethods_Identical 1 100 0.0 255.00 FORMAT "%8.2" ECU_ADDRESS 0xfe403722 /end MEASUREMENT
/begin MEASUREMENT Tlib_ElSPRightPosnSts_ZCR_LIN7 "" UBYTE RB_RBA_Common_CentralElements_CompuMethods_Identical 1 100 0.0 255.00 FORMAT "%8.2" ECU_ADDRESS 0xfe403723 /end MEASUREMENT
/begin MEASUREMENT Tlib_LeftElectricPedalDiagcLoadErr_ZCR_LIN7 "" UBYTE RB_RBA_Common_CentralElements_CompuMethods_Identical 1 100 0.0 255.00 FORMAT "%8.2" ECU_ADDRESS 0xfe403724 /end MEASUREMENT
/begin MEASUREMENT Tlib_LeftElectricPedalDiagcResvd_ZCR_LIN7 "" UBYTE RB_RBA_Common_CentralElements_CompuMethods_Identical 1 100 0.0 255.00 FORMAT "%8.2" ECU_ADDRESS 0xfe403725 /end MEASUREMENT
/begin MEASUREMENT Tlib_LeftElectricPedalDiagcOutOverCircuit_ZCR_LIN7 "" UBYTE RB_RBA_Common_CentralElements_CompuMethods_Identical 1 100 0.0 255.00 FORMAT "%8.2" ECU_ADDRESS 0xfe403726 /end MEASUREMENT
/begin MEASUREMENT Tlib_LeftElectricPedalDiagcOutOpenCircuit_ZCR_LIN7 "" UBYTE RB_RBA_Common_CentralElements_CompuMethods_Identical 1 100 0.0 255.00 FORMAT "%8.2" ECU_ADDRESS 0xfe403727 /end MEASUREMENT
/begin MEASUREMENT Tlib_LeftElectricPedalDiagcECUFailrGen_ZCR_LIN7 "" UBYTE RB_RBA_Common_CentralElements_CompuMethods_Identical 1 100 0.0 255.00 FORMAT "%8.2" ECU_ADDRESS 0xfe403728 /end MEASUREMENT
/begin MEASUREMENT Tlib_LeftElectricPedalDiagcIntHighVolt_ZCR_LIN7 "" UBYTE RB_RBA_Common_CentralElements_CompuMethods_Identical 1 100 0.0 255.00 FORMAT "%8.2" ECU_ADDRESS 0xfe403729 /end MEASUREMENT
/begin MEASUREMENT Tlib_LeftElectricPedalDiagcIntLowVolt_ZCR_LIN7 "" UBYTE RB_RBA_Common_CentralElements_CompuMethods_Identical 1 100 0.0 255.00 FORMAT "%8.2" ECU_ADDRESS 0xfe40372a /end MEASUREMENT
/begin MEASUREMENT Tlib_RightElectricPedalIninSts_ZCR_LIN7 "" UBYTE RB_RBA_Common_CentralElements_CompuMethods_Identical 1 100 0.0 255.00 FORMAT "%8.2" ECU_ADDRESS 0xfe40372b /end MEASUREMENT
/begin MEASUREMENT Tlib_ElSPLeftPosnSts_ZCR_LIN7 "" UBYTE RB_RBA_Common_CentralElements_CompuMethods_Identical 1 100 0.0 255.00 FORMAT "%8.2" ECU_ADDRESS 0xfe40372c /end MEASUREMENT
/begin MEASUREMENT Tlib_RightElectricPedalAntiPlay_ZCR_LIN7 "" UBYTE RB_RBA_Common_CentralElements_CompuMethods_Identical 1 100 0.0 255.00 FORMAT "%8.2" ECU_ADDRESS 0xfe40372d /end MEASUREMENT
/begin MEASUREMENT Tlib_RightElectricPedalDiagcECUFailrGen_ZCR_LIN7 "" UBYTE RB_RBA_Common_CentralElements_CompuMethods_Identical 1 100 0.0 255.00 FORMAT "%8.2" ECU_ADDRESS 0xfe40372e /end MEASUREMENT
/begin MEASUREMENT Tlib_RightElectricPedalDiagcIntLowVolt_ZCR_LIN7 "" UBYTE RB_RBA_Common_CentralElements_CompuMethods_Identical 1 100 0.0 255.00 FORMAT "%8.2" ECU_ADDRESS 0xfe40372f /end MEASUREMENT
/begin MEASUREMENT Tlib_RightElectricPedalDiagcIntHighVolt_ZCR_LIN7 "" UBYTE RB_RBA_Common_CentralElements_CompuMethods_Identical 1 100 0.0 255.00 FORMAT "%8.2" ECU_ADDRESS 0xfe403730 /end MEASUREMENT
/begin MEASUREMENT Tlib_RightElectricPedalDiagcLoadErr_ZCR_LIN7 "" UBYTE RB_RBA_Common_CentralElements_CompuMethods_Identical 1 100 0.0 255.00 FORMAT "%8.2" ECU_ADDRESS 0xfe403731 /end MEASUREMENT
/begin MEASUREMENT Tlib_RightElectricPedalDiagcResvd_ZCR_LIN7 "" UBYTE RB_RBA_Common_CentralElements_CompuMethods_Identical 1 100 0.0 255.00 FORMAT "%8.2" ECU_ADDRESS 0xfe403732 /end MEASUREMENT
/begin MEASUREMENT Tlib_RightElectricPedalDiagcOutOverCircuit_ZCR_LIN7 "" UBYTE RB_RBA_Common_CentralElements_CompuMethods_Identical 1 100 0.0 255.00 FORMAT "%8.2" ECU_ADDRESS 0xfe403733 /end MEASUREMENT
/begin MEASUREMENT Tlib_RightElectricPedalDiagcOutOpenCircuit_ZCR_LIN7 "" UBYTE RB_RBA_Common_CentralElements_CompuMethods_Identical 1 100 0.0 255.00 FORMAT "%8.2" ECU_ADDRESS 0xfe403734 /end MEASUREMENT
/begin MEASUREMENT Tlib_LeftElectricPedalAntiPlay_ZCR_LIN7 "" UBYTE RB_RBA_Common_CentralElements_CompuMethods_Identical 1 100 0.0 255.00 FORMAT "%8.2" ECU_ADDRESS 0xfe403735 /end MEASUREMENT
/begin MEASUREMENT Tlib_RightElectricPedalMotBlok_ZCR_LIN7 "" UBYTE RB_RBA_Common_CentralElements_CompuMethods_Identical 1 100 0.0 255.00 FORMAT "%8.2" ECU_ADDRESS 0xfe403736 /end MEASUREMENT
/begin MEASUREMENT Tlib_MMPSerNoNr3_ZCR_LIN7 "" UBYTE RB_RBA_Common_CentralElements_CompuMethods_Identical 1 100 0.0 255.00 FORMAT "%8.2" ECU_ADDRESS 0xfe403737 /end MEASUREMENT
/begin MEASUREMENT Tlib_MMPSerNoNr2_ZCR_LIN7 "" UBYTE RB_RBA_Common_CentralElements_CompuMethods_Identical 1 100 0.0 255.00 FORMAT "%8.2" ECU_ADDRESS 0xfe403738 /end MEASUREMENT
/begin MEASUREMENT Tlib_MMPSerNoNr1_ZCR_LIN7 "" UBYTE RB_RBA_Common_CentralElements_CompuMethods_Identical 1 100 0.0 255.00 FORMAT "%8.2" ECU_ADDRESS 0xfe403739 /end MEASUREMENT
/begin MEASUREMENT Tlib_MMPSerNoNr4_ZCR_LIN7 "" UBYTE RB_RBA_Common_CentralElements_CompuMethods_Identical 1 100 0.0 255.00 FORMAT "%8.2" ECU_ADDRESS 0xfe40373a /end MEASUREMENT
/begin MEASUREMENT Tlib_MMRRPartNoCmplNr1_ZCR_LIN7 "" UBYTE RB_RBA_Common_CentralElements_CompuMethods_Identical 1 100 0.0 255.00 FORMAT "%8.2" ECU_ADDRESS 0xfe40373b /end MEASUREMENT
/begin MEASUREMENT Tlib_MMRRPartNoCmplNr2_ZCR_LIN7 "" UBYTE RB_RBA_Common_CentralElements_CompuMethods_Identical 1 100 0.0 255.00 FORMAT "%8.2" ECU_ADDRESS 0xfe40373c /end MEASUREMENT
/begin MEASUREMENT Tlib_MMRRPartNoCmplEndSgn3_ZCR_LIN7 "" UBYTE RB_RBA_Common_CentralElements_CompuMethods_Identical 1 100 0.0 255.00 FORMAT "%8.2" ECU_ADDRESS 0xfe40373d /end MEASUREMENT
/begin MEASUREMENT Tlib_MMRRPartNoCmplNr4_ZCR_LIN7 "" UBYTE RB_RBA_Common_CentralElements_CompuMethods_Identical 1 100 0.0 255.00 FORMAT "%8.2" ECU_ADDRESS 0xfe40373e /end MEASUREMENT
/begin MEASUREMENT Tlib_MMRRPartNoCmplNr3_ZCR_LIN7 "" UBYTE RB_RBA_Common_CentralElements_CompuMethods_Identical 1 100 0.0 255.00 FORMAT "%8.2" ECU_ADDRESS 0xfe40373f /end MEASUREMENT
/begin MEASUREMENT Tlib_MMRRPartNoCmplEndSgn2_ZCR_LIN7 "" UBYTE RB_RBA_Common_CentralElements_CompuMethods_Identical 1 100 0.0 255.00 FORMAT "%8.2" ECU_ADDRESS 0xfe403740 /end MEASUREMENT
/begin MEASUREMENT Tlib_MMRRPartNoCmplEndSgn1_ZCR_LIN7 "" UBYTE RB_RBA_Common_CentralElements_CompuMethods_Identical 1 100 0.0 255.00 FORMAT "%8.2" ECU_ADDRESS 0xfe403741 /end MEASUREMENT
/begin MEASUREMENT Tlib_MMPPartNoCmplNr2_ZCR_LIN7 "" UBYTE RB_RBA_Common_CentralElements_CompuMethods_Identical 1 100 0.0 255.00 FORMAT "%8.2" ECU_ADDRESS 0xfe403742 /end MEASUREMENT
/begin MEASUREMENT Tlib_MMPPartNoCmplNr4_ZCR_LIN7 "" UBYTE RB_RBA_Common_CentralElements_CompuMethods_Identical 1 100 0.0 255.00 FORMAT "%8.2" ECU_ADDRESS 0xfe403743 /end MEASUREMENT
/begin MEASUREMENT Tlib_MMPPartNoCmplEndSgn1_ZCR_LIN7 "" UBYTE RB_RBA_Common_CentralElements_CompuMethods_Identical 1 100 0.0 255.00 FORMAT "%8.2" ECU_ADDRESS 0xfe403744 /end MEASUREMENT
/begin MEASUREMENT Tlib_MMPPartNoCmplEndSgn2_ZCR_LIN7 "" UBYTE RB_RBA_Common_CentralElements_CompuMethods_Identical 1 100 0.0 255.00 FORMAT "%8.2" ECU_ADDRESS 0xfe403745 /end MEASUREMENT
/begin MEASUREMENT Tlib_MMPPartNoCmplNr3_ZCR_LIN7 "" UBYTE RB_RBA_Common_CentralElements_CompuMethods_Identical 1 100 0.0 255.00 FORMAT "%8.2" ECU_ADDRESS 0xfe403746 /end MEASUREMENT
/begin MEASUREMENT Tlib_MMPPartNoCmplEndSgn3_ZCR_LIN7 "" UBYTE RB_RBA_Common_CentralElements_CompuMethods_Identical 1 100 0.0 255.00 FORMAT "%8.2" ECU_ADDRESS 0xfe403747 /end MEASUREMENT
/begin MEASUREMENT Tlib_MMPPartNoCmplNr1_ZCR_LIN7 "" UBYTE RB_RBA_Common_CentralElements_CompuMethods_Identical 1 100 0.0 255.00 FORMAT "%8.2" ECU_ADDRESS 0xfe403748 /end MEASUREMENT
/begin MEASUREMENT Tlib_MMRRPartNo10CmplNr3_ZCR_LIN7 "" UBYTE RB_RBA_Common_CentralElements_CompuMethods_Identical 1 100 0.0 255.00 FORMAT "%8.2" ECU_ADDRESS 0xfe403749 /end MEASUREMENT
/begin MEASUREMENT Tlib_MMRRPartNo10CmplNr2_ZCR_LIN7 "" UBYTE RB_RBA_Common_CentralElements_CompuMethods_Identical 1 100 0.0 255.00 FORMAT "%8.2" ECU_ADDRESS 0xfe40374a /end MEASUREMENT
/begin MEASUREMENT Tlib_MMRRPartNo10CmplEndSgn2_ZCR_LIN7 "" UBYTE RB_RBA_Common_CentralElements_CompuMethods_Identical 1 100 0.0 255.00 FORMAT "%8.2" ECU_ADDRESS 0xfe40374b /end MEASUREMENT
/begin MEASUREMENT Tlib_MMRRPartNo10CmplNr4_ZCR_LIN7 "" UBYTE RB_RBA_Common_CentralElements_CompuMethods_Identical 1 100 0.0 255.00 FORMAT "%8.2" ECU_ADDRESS 0xfe40374c /end MEASUREMENT
/begin MEASUREMENT Tlib_MMRRPartNo10CmplNr1_ZCR_LIN7 "" UBYTE RB_RBA_Common_CentralElements_CompuMethods_Identical 1 100 0.0 255.00 FORMAT "%8.2" ECU_ADDRESS 0xfe40374d /end MEASUREMENT
/begin MEASUREMENT Tlib_MMRRPartNo10CmplEndSgn1_ZCR_LIN7 "" UBYTE RB_RBA_Common_CentralElements_CompuMethods_Identical 1 100 0.0 255.00 FORMAT "%8.2" ECU_ADDRESS 0xfe40374e /end MEASUREMENT
/begin MEASUREMENT Tlib_MMRRPartNo10CmplNr5_ZCR_LIN7 "" UBYTE RB_RBA_Common_CentralElements_CompuMethods_Identical 1 100 0.0 255.00 FORMAT "%8.2" ECU_ADDRESS 0xfe40374f /end MEASUREMENT
/begin MEASUREMENT Tlib_MMRRPartNo10CmplEndSgn3_ZCR_LIN7 "" UBYTE RB_RBA_Common_CentralElements_CompuMethods_Identical 1 100 0.0 255.00 FORMAT "%8.2" ECU_ADDRESS 0xfe403750 /end MEASUREMENT
/begin MEASUREMENT Tlib_MMRRSerNoNr2_ZCR_LIN7 "" UBYTE RB_RBA_Common_CentralElements_CompuMethods_Identical 1 100 0.0 255.00 FORMAT "%8.2" ECU_ADDRESS 0xfe403751 /end MEASUREMENT
/begin MEASUREMENT Tlib_MMRRSerNoNr4_ZCR_LIN7 "" UBYTE RB_RBA_Common_CentralElements_CompuMethods_Identical 1 100 0.0 255.00 FORMAT "%8.2" ECU_ADDRESS 0xfe403752 /end MEASUREMENT
/begin MEASUREMENT Tlib_MMRRSerNoNr1_ZCR_LIN7 "" UBYTE RB_RBA_Common_CentralElements_CompuMethods_Identical 1 100 0.0 255.00 FORMAT "%8.2" ECU_ADDRESS 0xfe403753 /end MEASUREMENT
/begin MEASUREMENT Tlib_MMRRSerNoNr3_ZCR_LIN7 "" UBYTE RB_RBA_Common_CentralElements_CompuMethods_Identical 1 100 0.0 255.00 FORMAT "%8.2" ECU_ADDRESS 0xfe403754 /end MEASUREMENT
/begin MEASUREMENT Tlib_MMPPartNo10CmplEndSgn1_ZCR_LIN7 "" UBYTE RB_RBA_Common_CentralElements_CompuMethods_Identical 1 100 0.0 255.00 FORMAT "%8.2" ECU_ADDRESS 0xfe403755 /end MEASUREMENT
/begin MEASUREMENT Tlib_MMPPartNo10CmplEndSgn2_ZCR_LIN7 "" UBYTE RB_RBA_Common_CentralElements_CompuMethods_Identical 1 100 0.0 255.00 FORMAT "%8.2" ECU_ADDRESS 0xfe403756 /end MEASUREMENT
/begin MEASUREMENT Tlib_MMPPartNo10CmplEndSgn3_ZCR_LIN7 "" UBYTE RB_RBA_Common_CentralElements_CompuMethods_Identical 1 100 0.0 255.00 FORMAT "%8.2" ECU_ADDRESS 0xfe403757 /end MEASUREMENT
/begin MEASUREMENT Tlib_MMPPartNo10CmplNr5_ZCR_LIN7 "" UBYTE RB_RBA_Common_CentralElements_CompuMethods_Identical 1 100 0.0 255.00 FORMAT "%8.2" ECU_ADDRESS 0xfe403758 /end MEASUREMENT
/begin MEASUREMENT Tlib_MMPPartNo10CmplNr2_ZCR_LIN7 "" UBYTE RB_RBA_Common_CentralElements_CompuMethods_Identical 1 100 0.0 255.00 FORMAT "%8.2" ECU_ADDRESS 0xfe403759 /end MEASUREMENT
/begin MEASUREMENT Tlib_MMPPartNo10CmplNr3_ZCR_LIN7 "" UBYTE RB_RBA_Common_CentralElements_CompuMethods_Identical 1 100 0.0 255.00 FORMAT "%8.2" ECU_ADDRESS 0xfe40375a /end MEASUREMENT
/begin MEASUREMENT Tlib_MMPPartNo10CmplNr4_ZCR_LIN7 "" UBYTE RB_RBA_Common_CentralElements_CompuMethods_Identical 1 100 0.0 255.00 FORMAT "%8.2" ECU_ADDRESS 0xfe40375b /end MEASUREMENT
/begin MEASUREMENT Tlib_MMPPartNo10CmplNr1_ZCR_LIN7 "" UBYTE RB_RBA_Common_CentralElements_CompuMethods_Identical 1 100 0.0 255.00 FORMAT "%8.2" ECU_ADDRESS 0xfe40375c /end MEASUREMENT
/begin MEASUREMENT Tlib_CNSLSldDir_ZCR_LIN11 "" UBYTE RB_RBA_Common_CentralElements_CompuMethods_Identical 1 100 0.0 255.00 FORMAT "%8.2" ECU_ADDRESS 0xfe40375d /end MEASUREMENT
/begin MEASUREMENT Tlib_CNSLSldIntFltECUFailrGen_ZCR_LIN11 "" UBYTE RB_RBA_Common_CentralElements_CompuMethods_Identical 1 100 0.0 255.00 FORMAT "%8.2" ECU_ADDRESS 0xfe40375e /end MEASUREMENT
/begin MEASUREMENT Tlib_CNSLSldIntFltOutOverCircuit_ZCR_LIN11 "" UBYTE RB_RBA_Common_CentralElements_CompuMethods_Identical 1 100 0.0 255.00 FORMAT "%8.2" ECU_ADDRESS 0xfe40375f /end MEASUREMENT
/begin MEASUREMENT Tlib_CNSLSldIntFltIntHighVolt_ZCR_LIN11 "" UBYTE RB_RBA_Common_CentralElements_CompuMethods_Identical 1 100 0.0 255.00 FORMAT "%8.2" ECU_ADDRESS 0xfe403760 /end MEASUREMENT
/begin MEASUREMENT Tlib_CNSLSldIntFltResvd_ZCR_LIN11 "" UBYTE RB_RBA_Common_CentralElements_CompuMethods_Identical 1 100 0.0 255.00 FORMAT "%8.2" ECU_ADDRESS 0xfe403761 /end MEASUREMENT
/begin MEASUREMENT Tlib_CNSLSldIntFltIntLowVolt_ZCR_LIN11 "" UBYTE RB_RBA_Common_CentralElements_CompuMethods_Identical 1 100 0.0 255.00 FORMAT "%8.2" ECU_ADDRESS 0xfe403762 /end MEASUREMENT
/begin MEASUREMENT Tlib_CNSLSldIntFltLoadErr_ZCR_LIN11 "" UBYTE RB_RBA_Common_CentralElements_CompuMethods_Identical 1 100 0.0 255.00 FORMAT "%8.2" ECU_ADDRESS 0xfe403763 /end MEASUREMENT
/begin MEASUREMENT Tlib_CNSLSldIntFltOutOpenCircuit_ZCR_LIN11 "" UBYTE RB_RBA_Common_CentralElements_CompuMethods_Identical 1 100 0.0 255.00 FORMAT "%8.2" ECU_ADDRESS 0xfe403764 /end MEASUREMENT
/begin MEASUREMENT Tlib_CNSLLifDir_ZCR_LIN11 "" UBYTE RB_RBA_Common_CentralElements_CompuMethods_Identical 1 100 0.0 255.00 FORMAT "%8.2" ECU_ADDRESS 0xfe403765 /end MEASUREMENT
/begin MEASUREMENT Tlib_CNSLSldIninSts_ZCR_LIN11 "" UBYTE RB_RBA_Common_CentralElements_CompuMethods_Identical 1 100 0.0 255.00 FORMAT "%8.2" ECU_ADDRESS 0xfe403766 /end MEASUREMENT
/begin MEASUREMENT Tlib_SldMotBlok_ZCR_LIN11 "" UBYTE RB_RBA_Common_CentralElements_CompuMethods_Identical 1 100 0.0 255.00 FORMAT "%8.2" ECU_ADDRESS 0xfe403767 /end MEASUREMENT
/begin MEASUREMENT Tlib_CNSLLiftIninSts_ZCR_LIN11 "" UBYTE RB_RBA_Common_CentralElements_CompuMethods_Identical 1 100 0.0 255.00 FORMAT "%8.2" ECU_ADDRESS 0xfe403768 /end MEASUREMENT
/begin MEASUREMENT Tlib_CNSLLiftIntFltECUFailrGen_ZCR_LIN11 "" UBYTE RB_RBA_Common_CentralElements_CompuMethods_Identical 1 100 0.0 255.00 FORMAT "%8.2" ECU_ADDRESS 0xfe403769 /end MEASUREMENT
/begin MEASUREMENT Tlib_CNSLLiftIntFltOutOverCircuit_ZCR_LIN11 "" UBYTE RB_RBA_Common_CentralElements_CompuMethods_Identical 1 100 0.0 255.00 FORMAT "%8.2" ECU_ADDRESS 0xfe40376a /end MEASUREMENT
/begin MEASUREMENT Tlib_CNSLLiftIntFltLoadErr_ZCR_LIN11 "" UBYTE RB_RBA_Common_CentralElements_CompuMethods_Identical 1 100 0.0 255.00 FORMAT "%8.2" ECU_ADDRESS 0xfe40376b /end MEASUREMENT
/begin MEASUREMENT Tlib_CNSLLiftIntFltResvd_ZCR_LIN11 "" UBYTE RB_RBA_Common_CentralElements_CompuMethods_Identical 1 100 0.0 255.00 FORMAT "%8.2" ECU_ADDRESS 0xfe40376c /end MEASUREMENT
/begin MEASUREMENT Tlib_CNSLLiftIntFltIntLowVolt_ZCR_LIN11 "" UBYTE RB_RBA_Common_CentralElements_CompuMethods_Identical 1 100 0.0 255.00 FORMAT "%8.2" ECU_ADDRESS 0xfe40376d /end MEASUREMENT
/begin MEASUREMENT Tlib_CNSLLiftIntFltIntHighVolt_ZCR_LIN11 "" UBYTE RB_RBA_Common_CentralElements_CompuMethods_Identical 1 100 0.0 255.00 FORMAT "%8.2" ECU_ADDRESS 0xfe40376e /end MEASUREMENT
/begin MEASUREMENT Tlib_CNSLLiftIntFltOutOpenCircuit_ZCR_LIN11 "" UBYTE RB_RBA_Common_CentralElements_CompuMethods_Identical 1 100 0.0 255.00 FORMAT "%8.2" ECU_ADDRESS 0xfe40376f /end MEASUREMENT
/begin MEASUREMENT Tlib_LiftMotBlok_ZCR_LIN11 "" UBYTE RB_RBA_Common_CentralElements_CompuMethods_Identical 1 100 0.0 255.00 FORMAT "%8.2" ECU_ADDRESS 0xfe403770 /end MEASUREMENT
/begin MEASUREMENT Tlib_CNSLTblSts_ZCR_LIN11 "" UBYTE RB_RBA_Common_CentralElements_CompuMethods_Identical 1 100 0.0 255.00 FORMAT "%8.2" ECU_ADDRESS 0xfe403771 /end MEASUREMENT
/begin MEASUREMENT Tlib_CNSLSldPosn_ZCR_LIN11 "" UBYTE RB_RBA_Common_CentralElements_CompuMethods_Identical 1 100 0.0 255.00 FORMAT "%8.2" ECU_ADDRESS 0xfe403772 /end MEASUREMENT
/begin MEASUREMENT Tlib_CNSLLockSts_ZCR_LIN11 "" UBYTE RB_RBA_Common_CentralElements_CompuMethods_Identical 1 100 0.0 255.00 FORMAT "%8.2" ECU_ADDRESS 0xfe403773 /end MEASUREMENT
/begin MEASUREMENT Tlib_CNSLLiftPosn_ZCR_LIN11 "" UBYTE RB_RBA_Common_CentralElements_CompuMethods_Identical 1 100 0.0 255.00 FORMAT "%8.2" ECU_ADDRESS 0xfe403774 /end MEASUREMENT
/begin MEASUREMENT Tlib_RotaDispLRDiagcIntHighVolt_ZCR_LIN11 "" UBYTE RB_RBA_Common_CentralElements_CompuMethods_Identical 1 100 0.0 255.00 FORMAT "%8.2" ECU_ADDRESS 0xfe403775 /end MEASUREMENT
/begin MEASUREMENT Tlib_RotaDispLRDiagcLoadErr_ZCR_LIN11 "" UBYTE RB_RBA_Common_CentralElements_CompuMethods_Identical 1 100 0.0 255.00 FORMAT "%8.2" ECU_ADDRESS 0xfe403776 /end MEASUREMENT
/begin MEASUREMENT Tlib_RotaDispLRDiagcECUFailrGen_ZCR_LIN11 "" UBYTE RB_RBA_Common_CentralElements_CompuMethods_Identical 1 100 0.0 255.00 FORMAT "%8.2" ECU_ADDRESS 0xfe403777 /end MEASUREMENT
/begin MEASUREMENT Tlib_RotaDispLRDiagcOutOpenCircuit_ZCR_LIN11 "" UBYTE RB_RBA_Common_CentralElements_CompuMethods_Identical 1 100 0.0 255.00 FORMAT "%8.2" ECU_ADDRESS 0xfe403778 /end MEASUREMENT
/begin MEASUREMENT Tlib_RotaDispLRDiagcResvd_ZCR_LIN11 "" UBYTE RB_RBA_Common_CentralElements_CompuMethods_Identical 1 100 0.0 255.00 FORMAT "%8.2" ECU_ADDRESS 0xfe403779 /end MEASUREMENT
/begin MEASUREMENT Tlib_RotaDispLRDiagcIntLowVolt_ZCR_LIN11 "" UBYTE RB_RBA_Common_CentralElements_CompuMethods_Identical 1 100 0.0 255.00 FORMAT "%8.2" ECU_ADDRESS 0xfe40377a /end MEASUREMENT
/begin MEASUREMENT Tlib_RotaDispLRDiagcOutOverCircuit_ZCR_LIN11 "" UBYTE RB_RBA_Common_CentralElements_CompuMethods_Identical 1 100 0.0 255.00 FORMAT "%8.2" ECU_ADDRESS 0xfe40377b /end MEASUREMENT
/begin MEASUREMENT Tlib_CSDIninSts_ZCR_LIN11 "" UBYTE RB_RBA_Common_CentralElements_CompuMethods_Identical 1 100 0.0 255.00 FORMAT "%8.2" ECU_ADDRESS 0xfe40377c /end MEASUREMENT
/begin MEASUREMENT Tlib_VehThTSnsrVTMTSnsrQF_ZCR_LIN12 "" UBYTE RB_RBA_Common_CentralElements_CompuMethods_Identical 1 100 0.0 255.00 FORMAT "%8.2" ECU_ADDRESS 0xfe40377d /end MEASUREMENT
/begin MEASUREMENT Tlib_VehThTSnsrVTMTSnsrVal_ZCR_LIN12 "" UBYTE RB_RBA_Common_CentralElements_CompuMethods_Identical 1 100 0.0 255.00 FORMAT "%8.2" ECU_ADDRESS 0xfe40377e /end MEASUREMENT
/begin MEASUREMENT Tlib_VehThDoorOpenSts_ZCR_LIN12 "" UBYTE RB_RBA_Common_CentralElements_CompuMethods_Identical 1 100 0.0 255.00 FORMAT "%8.2" ECU_ADDRESS 0xfe40377f /end MEASUREMENT
/begin MEASUREMENT Tlib_VehThOnOffSts_ZCR_LIN12 "" UBYTE RB_RBA_Common_CentralElements_CompuMethods_Identical 1 100 0.0 255.00 FORMAT "%8.2" ECU_ADDRESS 0xfe403780 /end MEASUREMENT
/begin MEASUREMENT Tlib_VehThErrSts_ZCR_LIN12 "" UBYTE RB_RBA_Common_CentralElements_CompuMethods_Identical 1 100 0.0 255.00 FORMAT "%8.2" ECU_ADDRESS 0xfe403781 /end MEASUREMENT
/begin MEASUREMENT Tlib_SwtConsoleMovgDwn_ZCR_LIN8 "" UBYTE RB_RBA_Common_CentralElements_CompuMethods_Identical 1 100 0.0 255.00 FORMAT "%8.2" ECU_ADDRESS 0xfe403782 /end MEASUREMENT
/begin MEASUREMENT Tlib_SwtConsoleMovgUp_ZCR_LIN8 "" UBYTE RB_RBA_Common_CentralElements_CompuMethods_Identical 1 100 0.0 255.00 FORMAT "%8.2" ECU_ADDRESS 0xfe403783 /end MEASUREMENT
/begin MEASUREMENT Tlib_SwtConsoleMovgBack_ZCR_LIN8 "" UBYTE RB_RBA_Common_CentralElements_CompuMethods_Identical 1 100 0.0 255.00 FORMAT "%8.2" ECU_ADDRESS 0xfe403784 /end MEASUREMENT
/begin MEASUREMENT Tlib_SwtConsoleMovgFwd_ZCR_LIN8 "" UBYTE RB_RBA_Common_CentralElements_CompuMethods_Identical 1 100 0.0 255.00 FORMAT "%8.2" ECU_ADDRESS 0xfe403785 /end MEASUREMENT
/begin MEASUREMENT Tlib_SwtConsoleMovgBackw_ZCR_LIN8 "" UBYTE RB_RBA_Common_CentralElements_CompuMethods_Identical 1 100 0.0 255.00 FORMAT "%8.2" ECU_ADDRESS 0xfe403786 /end MEASUREMENT
/begin MEASUREMENT Tlib_SwtRefrigeratorTempDecrease_ZCR_LIN8 "" UBYTE RB_RBA_Common_CentralElements_CompuMethods_Identical 1 100 0.0 255.00 FORMAT "%8.2" ECU_ADDRESS 0xfe403787 /end MEASUREMENT
/begin MEASUREMENT Tlib_SwtRefrigeratorOnOff_ZCR_LIN8 "" UBYTE RB_RBA_Common_CentralElements_CompuMethods_Identical 1 100 0.0 255.00 FORMAT "%8.2" ECU_ADDRESS 0xfe403788 /end MEASUREMENT
/begin MEASUREMENT Tlib_DiagcSSRC_ZCR_LIN8 "" UBYTE RB_RBA_Common_CentralElements_CompuMethods_Identical 1 100 0.0 255.00 FORMAT "%8.2" ECU_ADDRESS 0xfe403789 /end MEASUREMENT
/begin MEASUREMENT Tlib_DiagcTRCP_ZCR_LIN8 "" UBYTE RB_RBA_Common_CentralElements_CompuMethods_Identical 1 100 0.0 255.00 FORMAT "%8.2" ECU_ADDRESS 0xfe40378a /end MEASUREMENT
/begin MEASUREMENT Tlib_DiagcCCSM_ZCR_LIN8 "" UBYTE RB_RBA_Common_CentralElements_CompuMethods_Identical 1 100 0.0 255.00 FORMAT "%8.2" ECU_ADDRESS 0xfe40378b /end MEASUREMENT
/begin MEASUREMENT Tlib_SeatVentnErrBackSecRi_ZCR_CANFD6 "" UBYTE RB_RBA_Common_CentralElements_CompuMethods_Identical 1 100 0.0 255.00 FORMAT "%8.2" ECU_ADDRESS 0xfe40378c /end MEASUREMENT
/begin MEASUREMENT Tlib_SeatHeatgErrBackSecRi_ZCR_CANFD6 "" UBYTE RB_RBA_Common_CentralElements_CompuMethods_Identical 1 100 0.0 255.00 FORMAT "%8.2" ECU_ADDRESS 0xfe40378d /end MEASUREMENT
/begin MEASUREMENT Tlib_SeatHeatgMatTempCushSecRiAmbTEstimd_ZCR_CANFD6 "" UWORD RB_RBA_Common_CentralElements_CompuMethods_Identical 1 100 0.0 65535 FORMAT "%8.2" ECU_ADDRESS 0xfe402cc6 /end MEASUREMENT
/begin MEASUREMENT Tlib_SeatHeatgMatTempCushSecRiAmbTEstimdQf_ZCR_CANFD6 "" UBYTE RB_RBA_Common_CentralElements_CompuMethods_Identical 1 100 0.0 255.00 FORMAT "%8.2" ECU_ADDRESS 0xfe40378e /end MEASUREMENT
/begin MEASUREMENT Tlib_SeatVentnPwrOnCushSecRi_ZCR_CANFD6 "" UBYTE RB_RBA_Common_CentralElements_CompuMethods_Identical 1 100 0.0 255.00 FORMAT "%8.2" ECU_ADDRESS 0xfe40378f /end MEASUREMENT
/begin MEASUREMENT Tlib_SeatHeatgPwrOnBackSecRi_ZCR_CANFD6 "" UBYTE RB_RBA_Common_CentralElements_CompuMethods_Identical 1 100 0.0 255.00 FORMAT "%8.2" ECU_ADDRESS 0xfe403790 /end MEASUREMENT
/begin MEASUREMENT Tlib_SeatHeatgPwrOnCushSecRi_ZCR_CANFD6 "" UBYTE RB_RBA_Common_CentralElements_CompuMethods_Identical 1 100 0.0 255.00 FORMAT "%8.2" ECU_ADDRESS 0xfe403791 /end MEASUREMENT
/begin MEASUREMENT Tlib_SeatHeatgErrCushSecRi_ZCR_CANFD6 "" UBYTE RB_RBA_Common_CentralElements_CompuMethods_Identical 1 100 0.0 255.00 FORMAT "%8.2" ECU_ADDRESS 0xfe403792 /end MEASUREMENT
/begin MEASUREMENT Tlib_SeatHeatgMatTempBackSecRiAmbTEstimd_ZCR_CANFD6 "" UWORD RB_RBA_Common_CentralElements_CompuMethods_Identical 1 100 0.0 65535 FORMAT "%8.2" ECU_ADDRESS 0xfe402cc8 /end MEASUREMENT
/begin MEASUREMENT Tlib_SeatHeatgMatTempBackSecRiAmbTEstimdQf_ZCR_CANFD6 "" UBYTE RB_RBA_Common_CentralElements_CompuMethods_Identical 1 100 0.0 255.00 FORMAT "%8.2" ECU_ADDRESS 0xfe403793 /end MEASUREMENT
/begin MEASUREMENT Tlib_SeatVentnPwrOnBackSecRi_ZCR_CANFD6 "" UBYTE RB_RBA_Common_CentralElements_CompuMethods_Identical 1 100 0.0 255.00 FORMAT "%8.2" ECU_ADDRESS 0xfe403794 /end MEASUREMENT
/begin MEASUREMENT Tlib_SeatVentnErrCushSecRi_ZCR_CANFD6 "" UBYTE RB_RBA_Common_CentralElements_CompuMethods_Identical 1 100 0.0 255.00 FORMAT "%8.2" ECU_ADDRESS 0xfe403795 /end MEASUREMENT
/begin MEASUREMENT Tlib_RofDispFoldingMotAntiPlay_ZCR_LIN10 "" UBYTE RB_RBA_Common_CentralElements_CompuMethods_Identical 1 100 0.0 255.00 FORMAT "%8.2" ECU_ADDRESS 0xfe403796 /end MEASUREMENT
/begin MEASUREMENT Tlib_RofDispSlidingMotAntiPlay_ZCR_LIN10 "" UBYTE RB_RBA_Common_CentralElements_CompuMethods_Identical 1 100 0.0 255.00 FORMAT "%8.2" ECU_ADDRESS 0xfe403797 /end MEASUREMENT
/begin MEASUREMENT Tlib_RoofDispFoldingDiagcIntLowVolt_ZCR_LIN10 "" UBYTE RB_RBA_Common_CentralElements_CompuMethods_Identical 1 100 0.0 255.00 FORMAT "%8.2" ECU_ADDRESS 0xfe403798 /end MEASUREMENT
/begin MEASUREMENT Tlib_RoofDispFoldingDiagcOutOverCircuit_ZCR_LIN10 "" UBYTE RB_RBA_Common_CentralElements_CompuMethods_Identical 1 100 0.0 255.00 FORMAT "%8.2" ECU_ADDRESS 0xfe403799 /end MEASUREMENT
/begin MEASUREMENT Tlib_RoofDispFoldingDiagcECUFailrGen_ZCR_LIN10 "" UBYTE RB_RBA_Common_CentralElements_CompuMethods_Identical 1 100 0.0 255.00 FORMAT "%8.2" ECU_ADDRESS 0xfe40379a /end MEASUREMENT
/begin MEASUREMENT Tlib_RoofDispFoldingDiagcOutOpenCircuit_ZCR_LIN10 "" UBYTE RB_RBA_Common_CentralElements_CompuMethods_Identical 1 100 0.0 255.00 FORMAT "%8.2" ECU_ADDRESS 0xfe40379b /end MEASUREMENT
/begin MEASUREMENT Tlib_RoofDispFoldingDiagcIntHighVolt_ZCR_LIN10 "" UBYTE RB_RBA_Common_CentralElements_CompuMethods_Identical 1 100 0.0 255.00 FORMAT "%8.2" ECU_ADDRESS 0xfe40379c /end MEASUREMENT
/begin MEASUREMENT Tlib_RoofDispFoldingDiagcResvd_ZCR_LIN10 "" UBYTE RB_RBA_Common_CentralElements_CompuMethods_Identical 1 100 0.0 255.00 FORMAT "%8.2" ECU_ADDRESS 0xfe40379d /end MEASUREMENT
/begin MEASUREMENT Tlib_RoofDispFoldingDiagcLoadErr_ZCR_LIN10 "" UBYTE RB_RBA_Common_CentralElements_CompuMethods_Identical 1 100 0.0 255.00 FORMAT "%8.2" ECU_ADDRESS 0xfe40379e /end MEASUREMENT
/begin MEASUREMENT Tlib_RoofCSDIninSts_ZCR_LIN10 "" UBYTE RB_RBA_Common_CentralElements_CompuMethods_Identical 1 100 0.0 255.00 FORMAT "%8.2" ECU_ADDRESS 0xfe40379f /end MEASUREMENT
/begin MEASUREMENT Tlib_RoofDispSlidingDiagcResvd_ZCR_LIN10 "" UBYTE RB_RBA_Common_CentralElements_CompuMethods_Identical 1 100 0.0 255.00 FORMAT "%8.2" ECU_ADDRESS 0xfe4037a0 /end MEASUREMENT
/begin MEASUREMENT Tlib_RoofDispSlidingDiagcIntHighVolt_ZCR_LIN10 "" UBYTE RB_RBA_Common_CentralElements_CompuMethods_Identical 1 100 0.0 255.00 FORMAT "%8.2" ECU_ADDRESS 0xfe4037a1 /end MEASUREMENT
/begin MEASUREMENT Tlib_RoofDispSlidingDiagcOutOverCircuit_ZCR_LIN10 "" UBYTE RB_RBA_Common_CentralElements_CompuMethods_Identical 1 100 0.0 255.00 FORMAT "%8.2" ECU_ADDRESS 0xfe4037a2 /end MEASUREMENT
/begin MEASUREMENT Tlib_RoofDispSlidingDiagcECUFailrGen_ZCR_LIN10 "" UBYTE RB_RBA_Common_CentralElements_CompuMethods_Identical 1 100 0.0 255.00 FORMAT "%8.2" ECU_ADDRESS 0xfe4037a3 /end MEASUREMENT
/begin MEASUREMENT Tlib_RoofDispSlidingDiagcLoadErr_ZCR_LIN10 "" UBYTE RB_RBA_Common_CentralElements_CompuMethods_Identical 1 100 0.0 255.00 FORMAT "%8.2" ECU_ADDRESS 0xfe4037a4 /end MEASUREMENT
/begin MEASUREMENT Tlib_RoofDispSlidingDiagcOutOpenCircuit_ZCR_LIN10 "" UBYTE RB_RBA_Common_CentralElements_CompuMethods_Identical 1 100 0.0 255.00 FORMAT "%8.2" ECU_ADDRESS 0xfe4037a5 /end MEASUREMENT
/begin MEASUREMENT Tlib_RoofDispSlidingDiagcIntLowVolt_ZCR_LIN10 "" UBYTE RB_RBA_Common_CentralElements_CompuMethods_Identical 1 100 0.0 255.00 FORMAT "%8.2" ECU_ADDRESS 0xfe4037a6 /end MEASUREMENT
/begin MEASUREMENT Tlib_ZCRCANFD1_Rx_ErrStatus "" UBYTE RB_RBA_Common_CentralElements_CompuMethods_Identical 1 100 0.0 255.00 FORMAT "%8.2" ECU_ADDRESS 0xfe4037a7 /end MEASUREMENT
/begin MEASUREMENT Tlib_ZCRCANFD2_Rx_ErrStatus "" UBYTE RB_RBA_Common_CentralElements_CompuMethods_Identical 1 100 0.0 255.00 FORMAT "%8.2" ECU_ADDRESS 0xfe4037a8 /end MEASUREMENT
/begin MEASUREMENT Tlib_ZCRCANFD3_Rx_ErrStatus "" UBYTE RB_RBA_Common_CentralElements_CompuMethods_Identical 1 100 0.0 255.00 FORMAT "%8.2" ECU_ADDRESS 0xfe4037a9 /end MEASUREMENT
/begin MEASUREMENT Tlib_ZCRCANFD4_Rx_ErrStatus "" UBYTE RB_RBA_Common_CentralElements_CompuMethods_Identical 1 100 0.0 255.00 FORMAT "%8.2" ECU_ADDRESS 0xfe4037aa /end MEASUREMENT
/begin MEASUREMENT Tlib_ZCRCANFD5_Rx_ErrStatus "" UBYTE RB_RBA_Common_CentralElements_CompuMethods_Identical 1 100 0.0 255.00 FORMAT "%8.2" ECU_ADDRESS 0xfe4037ab /end MEASUREMENT
/begin MEASUREMENT Tlib_ZCRCANFD6_Rx_ErrStatus "" UBYTE RB_RBA_Common_CentralElements_CompuMethods_Identical 1 100 0.0 255.00 FORMAT "%8.2" ECU_ADDRESS 0xfe4037ac /end MEASUREMENT
/begin MEASUREMENT Tlib_ZCRCANFD7_Rx_ErrStatus "" UBYTE RB_RBA_Common_CentralElements_CompuMethods_Identical 1 100 0.0 255.00 FORMAT "%8.2" ECU_ADDRESS 0xfe4037ad /end MEASUREMENT
/begin MEASUREMENT Tlib_ZCRCANFD8_Rx_ErrStatus "" UBYTE RB_RBA_Common_CentralElements_CompuMethods_Identical 1 100 0.0 255.00 FORMAT "%8.2" ECU_ADDRESS 0xfe4037ae /end MEASUREMENT
/begin MEASUREMENT Tlib_ZCRCANFD9_Rx_ErrStatus "" UBYTE RB_RBA_Common_CentralElements_CompuMethods_Identical 1 100 0.0 255.00 FORMAT "%8.2" ECU_ADDRESS 0xfe4037af /end MEASUREMENT
/begin MEASUREMENT Tlib_Fee_BlockID "" UBYTE RB_RBA_Common_CentralElements_CompuMethods_Identical 1 100 0.0 255.00 FORMAT "%8.2" ECU_ADDRESS 0xfe415cf6 /end MEASUREMENT
/begin MEASUREMENT Tlib_NvM_BlockID "" UWORD RB_RBA_Common_CentralElements_CompuMethods_Identical 1 100 0.0 65535 FORMAT "%8.2" ECU_ADDRESS 0xfe415cf4 /end MEASUREMENT
/begin MEASUREMENT Tlib_Eep_Test "" UBYTE RB_RBA_Common_CentralElements_CompuMethods_Identical 1 100 0.0 255.00 FORMAT "%8.2" ECU_ADDRESS 0xfe479354 /end MEASUREMENT
/begin MEASUREMENT Tlib_Ea_Test "" UBYTE RB_RBA_Common_CentralElements_CompuMethods_Identical 1 100 0.0 255.00 FORMAT "%8.2" ECU_ADDRESS 0xfe479355 /end MEASUREMENT
/begin MEASUREMENT Tlib_NvM_Test "" UBYTE RB_RBA_Common_CentralElements_CompuMethods_Identical 1 100 0.0 255.00 FORMAT "%8.2" ECU_ADDRESS 0xfe479356 /end MEASUREMENT
/begin MEASUREMENT Tst_Fls_Test "" UBYTE RB_RBA_Common_CentralElements_CompuMethods_Identical 1 100 0.0 255.00 FORMAT "%8.2" ECU_ADDRESS 0xfe479357 /end MEASUREMENT
/begin MEASUREMENT Tlib_Fee_Test "" UBYTE RB_RBA_Common_CentralElements_CompuMethods_Identical 1 100 0.0 255.00 FORMAT "%8.2" ECU_ADDRESS 0xfe479358 /end MEASUREMENT
/begin MEASUREMENT Tlib_Fls_Buffer_W "" UBYTE RB_RBA_Common_CentralElements_CompuMethods_Identical 1 100 0.0 255.00 FORMAT "%8.2" ARRAY_SIZE 256 ECU_ADDRESS 0xfe478140 /end MEASUREMENT
/begin MEASUREMENT Tlib_Fls_Buffer_R "" UBYTE RB_RBA_Common_CentralElements_CompuMethods_Identical 1 100 0.0 255.00 FORMAT "%8.2" ARRAY_SIZE 256 ECU_ADDRESS 0xfe478240 /end MEASUREMENT
/begin MEASUREMENT Tlib_Fls_Buffer_C "" UBYTE RB_RBA_Common_CentralElements_CompuMethods_Identical 1 100 0.0 255.00 FORMAT "%8.2" ARRAY_SIZE 256 ECU_ADDRESS 0xfe478340 /end MEASUREMENT
/begin MEASUREMENT Tlib_Fee_Buffer_W "" UBYTE RB_RBA_Common_CentralElements_CompuMethods_Identical 1 100 0.0 255.00 FORMAT "%8.2" ARRAY_SIZE 256 ECU_ADDRESS 0xfe478440 /end MEASUREMENT
/begin MEASUREMENT Tlib_Fee_Buffer_R "" UBYTE RB_RBA_Common_CentralElements_CompuMethods_Identical 1 100 0.0 255.00 FORMAT "%8.2" ARRAY_SIZE 256 ECU_ADDRESS 0xfe478540 /end MEASUREMENT
/begin MEASUREMENT Tlib_NvM_Buffer_W "" UBYTE RB_RBA_Common_CentralElements_CompuMethods_Identical 1 100 0.0 255.00 FORMAT "%8.2" ARRAY_SIZE 16 ECU_ADDRESS 0xfe478640 /end MEASUREMENT
/begin MEASUREMENT Tlib_NvM_Buffer_R "" UBYTE RB_RBA_Common_CentralElements_CompuMethods_Identical 1 100 0.0 255.00 FORMAT "%8.2" ARRAY_SIZE 256 ECU_ADDRESS 0xfe478650 /end MEASUREMENT
/begin MEASUREMENT Tlib_Eep_Buffer_W "" UBYTE RB_RBA_Common_CentralElements_CompuMethods_Identical 1 100 0.0 255.00 FORMAT "%8.2" ARRAY_SIZE 256 ECU_ADDRESS 0xfe478750 /end MEASUREMENT
/begin MEASUREMENT Tlib_Eep_Buffer_R "" UBYTE RB_RBA_Common_CentralElements_CompuMethods_Identical 1 100 0.0 255.00 FORMAT "%8.2" ARRAY_SIZE 256 ECU_ADDRESS 0xfe478850 /end MEASUREMENT
/begin MEASUREMENT Tlib_NvM_RamBuffer "" UBYTE RB_RBA_Common_CentralElements_CompuMethods_Identical 1 100 0.0 255.00 FORMAT "%8.2" ARRAY_SIZE 256 ECU_ADDRESS 0xfe478950 /end MEASUREMENT
/begin MEASUREMENT Tlib_Fls_WriteReturnSt "" UBYTE RB_RBA_Common_CentralElements_CompuMethods_Identical 1 100 0.0 255.00 FORMAT "%8.2" ECU_ADDRESS 0xfe479359 /end MEASUREMENT
/begin MEASUREMENT Tlib_Fls_ReadReturnSt "" UBYTE RB_RBA_Common_CentralElements_CompuMethods_Identical 1 100 0.0 255.00 FORMAT "%8.2" ECU_ADDRESS 0xfe47935a /end MEASUREMENT
/begin MEASUREMENT Tlib_Fls_EraseReturnSt "" UBYTE RB_RBA_Common_CentralElements_CompuMethods_Identical 1 100 0.0 255.00 FORMAT "%8.2" ECU_ADDRESS 0xfe47935b /end MEASUREMENT
/begin MEASUREMENT Tlib_Fls_CompareReturnSt "" UBYTE RB_RBA_Common_CentralElements_CompuMethods_Identical 1 100 0.0 255.00 FORMAT "%8.2" ECU_ADDRESS 0xfe47935c /end MEASUREMENT
/begin MEASUREMENT Tlib_EEP_WriteReturnSt "" UBYTE RB_RBA_Common_CentralElements_CompuMethods_Identical 1 100 0.0 255.00 FORMAT "%8.2" ECU_ADDRESS 0xfe47935d /end MEASUREMENT
/begin MEASUREMENT Tlib_EEP_ReadReturnSt "" UBYTE RB_RBA_Common_CentralElements_CompuMethods_Identical 1 100 0.0 255.00 FORMAT "%8.2" ECU_ADDRESS 0xfe47935e /end MEASUREMENT
/begin MEASUREMENT Tlib_EEP_GetErrorReturnSt "" UBYTE RB_RBA_Common_CentralElements_CompuMethods_Identical 1 100 0.0 255.00 FORMAT "%8.2" ECU_ADDRESS 0xfe47935f /end MEASUREMENT
/begin MEASUREMENT Tlib_EEP_ErrorStatus "" UBYTE RB_RBA_Common_CentralElements_CompuMethods_Identical 1 100 0.0 255.00 FORMAT "%8.2" ECU_ADDRESS 0xfe479360 /end MEASUREMENT
/begin MEASUREMENT Tlib_EEP_InvalidReturnSt "" UBYTE RB_RBA_Common_CentralElements_CompuMethods_Identical 1 100 0.0 255.00 FORMAT "%8.2" ECU_ADDRESS 0xfe479361 /end MEASUREMENT
/begin MEASUREMENT Tlib_Fee_WriteReturnSt "" UBYTE RB_RBA_Common_CentralElements_CompuMethods_Identical 1 100 0.0 255.00 FORMAT "%8.2" ECU_ADDRESS 0xfe479362 /end MEASUREMENT
/begin MEASUREMENT Tlib_Fee_ReadReturnSt "" UBYTE RB_RBA_Common_CentralElements_CompuMethods_Identical 1 100 0.0 255.00 FORMAT "%8.2" ECU_ADDRESS 0xfe479363 /end MEASUREMENT
/begin MEASUREMENT Tlib_NvM_WriteReturnSt "" UBYTE RB_RBA_Common_CentralElements_CompuMethods_Identical 1 100 0.0 255.00 FORMAT "%8.2" ECU_ADDRESS 0xfe479364 /end MEASUREMENT
/begin MEASUREMENT Tlib_NvM_ReadReturnSt "" UBYTE RB_RBA_Common_CentralElements_CompuMethods_Identical 1 100 0.0 255.00 FORMAT "%8.2" ECU_ADDRESS 0xfe479365 /end MEASUREMENT
/begin MEASUREMENT Tlib_NvM_InvalidReturnSt "" UBYTE RB_RBA_Common_CentralElements_CompuMethods_Identical 1 100 0.0 255.00 FORMAT "%8.2" ECU_ADDRESS 0xfe479366 /end MEASUREMENT
/begin MEASUREMENT Tst_addr "" ULONG RB_RBA_Common_CentralElements_CompuMethods_Identical 1 100 0.0 4294967295 FORMAT "%8.2" ECU_ADDRESS 0xfe415cec /end MEASUREMENT
/begin MEASUREMENT Tst_Flslen "" ULONG RB_RBA_Common_CentralElements_CompuMethods_Identical 1 100 0.0 4294967295 FORMAT "%8.2" ECU_ADDRESS 0xfe415cf0 /end MEASUREMENT
/begin MEASUREMENT Tlib_mainflg "" UBYTE RB_RBA_Common_CentralElements_CompuMethods_Identical 1 100 0.0 255.00 FORMAT "%8.2" ECU_ADDRESS 0xfe479367 /end MEASUREMENT
/begin MEASUREMENT Tlib_var "" UBYTE RB_RBA_Common_CentralElements_CompuMethods_Identical 1 100 0.0 255.00 FORMAT "%8.2" ECU_ADDRESS 0xfe415cf7 /end MEASUREMENT
/begin MEASUREMENT Tlib_NvMRamBlock_u8 "" UBYTE RB_RBA_Common_CentralElements_CompuMethods_Identical 1 100 0.0 255.00 FORMAT "%8.2" ARRAY_SIZE 4 ECU_ADDRESS 0xfe479340 /end MEASUREMENT
/begin MEASUREMENT Tlib_EEP_ErrCnt "" ULONG RB_RBA_Common_CentralElements_CompuMethods_Identical 1 100 0.0 4294967295 FORMAT "%8.2" ECU_ADDRESS 0xfe479344 /end MEASUREMENT
/begin MEASUREMENT Tlib_flagPowerOnOff "" UBYTE RB_RBA_Common_CentralElements_CompuMethods_Identical 1 100 0.0 255.00 FORMAT "%8.2" ECU_ADDRESS 0xfe479368 /end MEASUREMENT
/begin MEASUREMENT Tlib_EEP_TestCnt "" ULONG RB_RBA_Common_CentralElements_CompuMethods_Identical 1 100 0.0 4294967295 FORMAT "%8.2" ECU_ADDRESS 0xfe479348 /end MEASUREMENT
/begin MEASUREMENT cntr_err "" ULONG RB_RBA_Common_CentralElements_CompuMethods_Identical 1 100 0.0 4294967295 FORMAT "%8.2" ECU_ADDRESS 0xfe47934c /end MEASUREMENT
/begin MEASUREMENT cntr_total "" ULONG RB_RBA_Common_CentralElements_CompuMethods_Identical 1 100 0.0 4294967295 FORMAT "%8.2" ECU_ADDRESS 0xfe479350 /end MEASUREMENT
/begin MEASUREMENT cntr_FlashWrite "" ULONG RB_RBA_Common_CentralElements_CompuMethods_Identical 1 100 0.0 4294967295 FORMAT "%8.2" ARRAY_SIZE 30 ECU_ADDRESS 0xfe478a50 /end MEASUREMENT
/begin MEASUREMENT cntr_FlashRead "" ULONG RB_RBA_Common_CentralElements_CompuMethods_Identical 1 100 0.0 4294967295 FORMAT "%8.2" ARRAY_SIZE 30 ECU_ADDRESS 0xfe478ac8 /end MEASUREMENT
/begin MEASUREMENT Tlib_Eep_Buffer_W_vMemAccM "" UBYTE RB_RBA_Common_CentralElements_CompuMethods_Identical 1 100 0.0 255.00 FORMAT "%8.2" ARRAY_SIZE 1024 ECU_ADDRESS 0xfe478b40 /end MEASUREMENT
/begin MEASUREMENT Tlib_Eep_Buffer_R_vMemAccM "" UBYTE RB_RBA_Common_CentralElements_CompuMethods_Identical 1 100 0.0 255.00 FORMAT "%8.2" ARRAY_SIZE 1024 ECU_ADDRESS 0xfe478f40 /end MEASUREMENT
/begin MEASUREMENT Tlib_EEP_WriteReturnSt_vMemAccM "" UBYTE RB_RBA_Common_CentralElements_CompuMethods_Identical 1 100 0.0 255.00 FORMAT "%8.2" ECU_ADDRESS 0xfe479369 /end MEASUREMENT
/begin MEASUREMENT Tlib_EEP_ReadReturnSt_vMemAccM "" UBYTE RB_RBA_Common_CentralElements_CompuMethods_Identical 1 100 0.0 255.00 FORMAT "%8.2" ECU_ADDRESS 0xfe47936a /end MEASUREMENT
/begin MEASUREMENT flag_switchmode "" UBYTE RB_RBA_Common_CentralElements_CompuMethods_Identical 1 100 0.0 255.00 FORMAT "%8.2" ECU_ADDRESS 0xfe47936b /end MEASUREMENT
/begin MEASUREMENT flag_readall "" UBYTE RB_RBA_Common_CentralElements_CompuMethods_Identical 1 100 0.0 255.00 FORMAT "%8.2" ECU_ADDRESS 0xfe47936c /end MEASUREMENT
/begin MEASUREMENT vMemAccMId "" UBYTE RB_RBA_Common_CentralElements_CompuMethods_Identical 1 100 0.0 255.00 FORMAT "%8.2" ECU_ADDRESS 0xfe415cf8 /end MEASUREMENT
/begin MEASUREMENT TEST_DLT_LOG_NUM "" UBYTE RB_RBA_Common_CentralElements_CompuMethods_Identical 1 100 0.0 255.00 FORMAT "%8.2" ECU_ADDRESS 0xfe415bcc /end MEASUREMENT
/begin MEASUREMENT Tlib_Dlt_Test_ctrl "" UBYTE RB_RBA_Common_CentralElements_CompuMethods_Identical 1 100 0.0 255.00 FORMAT "%8.2" ECU_ADDRESS 0xfe415bcd /end MEASUREMENT
/begin MEASUREMENT Tlib_Dlt_Test_Data_buf "" UBYTE RB_RBA_Common_CentralElements_CompuMethods_Identical 1 100 0.0 255.00 FORMAT "%8.2" ARRAY_SIZE 200 ECU_ADDRESS 0xfe415c24 /end MEASUREMENT
/begin MEASUREMENT Tlib_Dlt_Test_Data_buf_Len "" UBYTE RB_RBA_Common_CentralElements_CompuMethods_Identical 1 100 0.0 255.00 FORMAT "%8.2" ECU_ADDRESS 0xfe415bce /end MEASUREMENT
/begin MEASUREMENT Tlib_Dlt_Test_Data_buf_new "" UBYTE RB_RBA_Common_CentralElements_CompuMethods_Identical 1 100 0.0 255.00 FORMAT "%8.2" ARRAY_SIZE 8 ECU_ADDRESS 0xfe415be0 /end MEASUREMENT
/begin MEASUREMENT Tlib_Dlt_Test_Ap_Id_buf "" UBYTE RB_RBA_Common_CentralElements_CompuMethods_Identical 1 100 0.0 255.00 FORMAT "%8.2" ARRAY_SIZE 8 ECU_ADDRESS 0xfe415be8 /end MEASUREMENT
/begin MEASUREMENT Tlib_Dlt_Test_Ct_Id_buf "" UBYTE RB_RBA_Common_CentralElements_CompuMethods_Identical 1 100 0.0 255.00 FORMAT "%8.2" ARRAY_SIZE 8 ECU_ADDRESS 0xfe415bf0 /end MEASUREMENT
/begin MEASUREMENT Tlib_Dlt_Mode_State "" UBYTE RB_RBA_Common_CentralElements_CompuMethods_Identical 1 100 0.0 255.00 FORMAT "%8.2" ECU_ADDRESS 0xfe415bcf /end MEASUREMENT
/begin MEASUREMENT Tlib_Dlt_Mode_State_get "" UBYTE RB_RBA_Common_CentralElements_CompuMethods_Identical 1 100 0.0 255.00 FORMAT "%8.2" ECU_ADDRESS 0xfe415bd0 /end MEASUREMENT
/begin MEASUREMENT Tlib_Dlt_Trace_State "" UBYTE RB_RBA_Common_CentralElements_CompuMethods_Identical 1 100 0.0 255.00 FORMAT "%8.2" ECU_ADDRESS 0xfe415bd1 /end MEASUREMENT
/begin MEASUREMENT Tlib_Dlt_Log_Ch_Name "" UBYTE RB_RBA_Common_CentralElements_CompuMethods_Identical 1 100 0.0 255.00 FORMAT "%8.2" ARRAY_SIZE 4 ECU_ADDRESS 0xfe415bc0 /end MEASUREMENT
/begin MEASUREMENT Tlib_Dlt_Log_Ch_Log_Level "" UBYTE RB_RBA_Common_CentralElements_CompuMethods_Identical 1 100 0.0 255.00 FORMAT "%8.2" ECU_ADDRESS 0xfe415bd2 /end MEASUREMENT
/begin MEASUREMENT Tlib_Dlt_Log_Ch_Trace_State "" UBYTE RB_RBA_Common_CentralElements_CompuMethods_Identical 1 100 0.0 255.00 FORMAT "%8.2" ECU_ADDRESS 0xfe415bd3 /end MEASUREMENT
/begin MEASUREMENT Tlib_Dlt_Message_Filter_State "" UBYTE RB_RBA_Common_CentralElements_CompuMethods_Identical 1 100 0.0 255.00 FORMAT "%8.2" ECU_ADDRESS 0xfe415bd4 /end MEASUREMENT
/begin MEASUREMENT Tlib_Dlt_Test_Num_Of_CH "" UBYTE RB_RBA_Common_CentralElements_CompuMethods_Identical 1 100 0.0 255.00 FORMAT "%8.2" ECU_ADDRESS 0xfe415bd5 /end MEASUREMENT
/begin MEASUREMENT Tlib_Dlt_CH_Name "" UBYTE RB_RBA_Common_CentralElements_CompuMethods_Identical 1 100 0.0 255.00 FORMAT "%8.2" ARRAY_SIZE 8 ECU_ADDRESS 0xfe415bf8 /end MEASUREMENT
/begin MEASUREMENT Tlib_Dlt_CH_Log_Level "" UBYTE RB_RBA_Common_CentralElements_CompuMethods_Identical 1 100 0.0 255.00 FORMAT "%8.2" ECU_ADDRESS 0xfe415bd6 /end MEASUREMENT
/begin MEASUREMENT Tlib_Dlt_AddRemoveOp_State "" UBYTE RB_RBA_Common_CentralElements_CompuMethods_Identical 1 100 0.0 255.00 FORMAT "%8.2" ECU_ADDRESS 0xfe415bd7 /end MEASUREMENT
/begin MEASUREMENT Tlib_Dlt_Log_Level "" UBYTE RB_RBA_Common_CentralElements_CompuMethods_Identical 1 100 0.0 255.00 FORMAT "%8.2" ECU_ADDRESS 0xfe415bd8 /end MEASUREMENT
/begin MEASUREMENT Tlib_Dlt_Log_Level_get "" UBYTE RB_RBA_Common_CentralElements_CompuMethods_Identical 1 100 0.0 255.00 FORMAT "%8.2" ECU_ADDRESS 0xfe415bd9 /end MEASUREMENT
/begin MEASUREMENT Tlib_Dlt_Log_Level_CTID "" UBYTE RB_RBA_Common_CentralElements_CompuMethods_Identical 1 100 0.0 255.00 FORMAT "%8.2" ARRAY_SIZE 4 ECU_ADDRESS 0xfe415bc4 /end MEASUREMENT
/begin MEASUREMENT Tlib_Dlt_Log_Level_APID "" UBYTE RB_RBA_Common_CentralElements_CompuMethods_Identical 1 100 0.0 255.00 FORMAT "%8.2" ARRAY_SIZE 4 ECU_ADDRESS 0xfe415bc8 /end MEASUREMENT
/begin MEASUREMENT Tlib_Dlt_SoConIdx "" UBYTE RB_RBA_Common_CentralElements_CompuMethods_Identical 1 100 0.0 255.00 FORMAT "%8.2" ECU_ADDRESS 0xfe415bda /end MEASUREMENT
/begin MEASUREMENT Tlib_Dlt_PartitionIdx "" UBYTE RB_RBA_Common_CentralElements_CompuMethods_Identical 1 100 0.0 255.00 FORMAT "%8.2" ECU_ADDRESS 0xfe415bdb /end MEASUREMENT
/begin MEASUREMENT Tlib_Dlt_State_Auto_On "" UBYTE RB_RBA_Common_CentralElements_CompuMethods_Identical 1 100 0.0 255.00 FORMAT "%8.2" ECU_ADDRESS 0xfe415bdd /end MEASUREMENT
/begin MEASUREMENT Tlib_Dlt_SendNewLog "" UBYTE RB_RBA_Common_CentralElements_CompuMethods_Identical 1 100 0.0 255.00 FORMAT "%8.2" ECU_ADDRESS 0xfe415bde /end MEASUREMENT
/begin MEASUREMENT Tlib_Dem_CycleID "" UBYTE RB_RBA_Common_CentralElements_CompuMethods_Identical 1 100 0.0 255.00 FORMAT "%8.2" ECU_ADDRESS 0xfe415bb6 /end MEASUREMENT
/begin MEASUREMENT Tlib_Dem_Set_OperationCycleState "" UBYTE RB_RBA_Common_CentralElements_CompuMethods_Identical 1 100 0.0 255.00 FORMAT "%8.2" ECU_ADDRESS 0xfe415bb7 /end MEASUREMENT
/begin MEASUREMENT Tlib_Dem_Get_OperationCycleState "" UBYTE RB_RBA_Common_CentralElements_CompuMethods_Identical 1 100 0.0 255.00 FORMAT "%8.2" ECU_ADDRESS 0xfe415bb8 /end MEASUREMENT
/begin MEASUREMENT Tlib_Dem_EventStatus "" UBYTE RB_RBA_Common_CentralElements_CompuMethods_Identical 1 100 0.0 255.00 FORMAT "%8.2" ECU_ADDRESS 0xfe415bb9 /end MEASUREMENT
/begin MEASUREMENT Tlib_Dem_EventId "" UWORD RB_RBA_Common_CentralElements_CompuMethods_Identical 1 100 0.0 65535 FORMAT "%8.2" ECU_ADDRESS 0xfe415bb0 /end MEASUREMENT
/begin MEASUREMENT Tlib_Dem_UDSStatusByte "" UBYTE RB_RBA_Common_CentralElements_CompuMethods_Identical 1 100 0.0 255.00 FORMAT "%8.2" ECU_ADDRESS 0xfe467c43 /end MEASUREMENT
/begin MEASUREMENT Tlib_Dem_GetFdc "" SBYTE RB_RBA_Common_CentralElements_CompuMethods_Identical 1 100 -128 127 FORMAT "%8.2" ECU_ADDRESS 0xfe467c44 /end MEASUREMENT
/begin MEASUREMENT Tlib_Dem_ClientID "" UBYTE RB_RBA_Common_CentralElements_CompuMethods_Identical 1 100 0.0 255.00 FORMAT "%8.2" ECU_ADDRESS 0xfe415bba /end MEASUREMENT
/begin MEASUREMENT Tlib_Dem_ClearDTC "" UBYTE RB_RBA_Common_CentralElements_CompuMethods_Identical 1 100 0.0 255.00 FORMAT "%8.2" ECU_ADDRESS 0xfe415bbb /end MEASUREMENT
/begin MEASUREMENT Tlib_Dem_SetOperationCycleNum "" UWORD RB_RBA_Common_CentralElements_CompuMethods_Identical 1 100 0.0 65535 FORMAT "%8.2" ECU_ADDRESS 0xfe415bb2 /end MEASUREMENT
/begin MEASUREMENT Tlib_Dem_Counter "" UWORD RB_RBA_Common_CentralElements_CompuMethods_Identical 1 100 0.0 65535 FORMAT "%8.2" ECU_ADDRESS 0xfe415bb4 /end MEASUREMENT
/begin MEASUREMENT Operation_status "" UBYTE RB_RBA_Common_CentralElements_CompuMethods_Identical 1 100 0.0 255.00 FORMAT "%8.2" ECU_ADDRESS 0xfe415bbc /end MEASUREMENT
/begin MEASUREMENT Tlib_TestCase_Integration_Partload "" ULONG RB_RBA_Common_CentralElements_CompuMethods_Identical 1 100 0.0 4294967295 FORMAT "%8.2" ECU_ADDRESS 0xfe417a7c /end MEASUREMENT
/begin MEASUREMENT Tlib_TestCase_EMS_Partload "" ULONG RB_RBA_Common_CentralElements_CompuMethods_Identical 1 100 0.0 4294967295 FORMAT "%8.2" ECU_ADDRESS 0xfe417a80 /end MEASUREMENT
/begin MEASUREMENT Tlib_TestCase_EMI_Partload "" ULONG RB_RBA_Common_CentralElements_CompuMethods_Identical 1 100 0.0 4294967295 FORMAT "%8.2" ECU_ADDRESS 0xfe417a84 /end MEASUREMENT
/begin MEASUREMENT Tlib_TestCase_TH_Partload "" ULONG RB_RBA_Common_CentralElements_CompuMethods_Identical 1 100 0.0 4294967295 FORMAT "%8.2" ECU_ADDRESS 0xfe417a88 /end MEASUREMENT
/begin MEASUREMENT Tlib_TestCase_ENV_Partload "" ULONG RB_RBA_Common_CentralElements_CompuMethods_Identical 1 100 0.0 4294967295 FORMAT "%8.2" ECU_ADDRESS 0xfe417a8c /end MEASUREMENT
/begin MEASUREMENT Tlib_ADC_L3_Get_RawVal_I_A_TEMP_TOP1 "" UWORD RB_RBA_Common_CentralElements_CompuMethods_Identical 1 100 0.0 65535 FORMAT "%8.2" ECU_ADDRESS 0xfe419474 /end MEASUREMENT
/begin MEASUREMENT Tlib_AdcrFactor_L3_Get_Voltage_I_A_TEMP_TOP1 "" UWORD RB_RBA_Common_CentralElements_CompuMethods_Identical 1 100 0.0 65535 FORMAT "%8.2" ECU_ADDRESS 0xfe419476 /end MEASUREMENT
/begin MEASUREMENT Tlib_ADC_L3_Get_FilterVal_I_A_TEMP_TOP1 "" UBYTE RB_RBA_Common_CentralElements_CompuMethods_Identical 1 100 0.0 255.00 FORMAT "%8.2" ECU_ADDRESS 0xfe4197d4 /end MEASUREMENT
/begin MEASUREMENT Tlib_ADC_L3_Get_ResValue_I_A_TEMP_TOP1 "" ULONG RB_RBA_Common_CentralElements_CompuMethods_Identical 1 100 0.0 4294967295 FORMAT "%8.2" ECU_ADDRESS 0xfe417a90 /end MEASUREMENT
/begin MEASUREMENT Tlib_ADC_L3_DIAG_Get_Value_I_A_TEMP_TOP1 "" UWORD RB_RBA_Common_CentralElements_CompuMethods_Identical 1 100 0.0 65535 FORMAT "%8.2" ECU_ADDRESS 0xfe419478 /end MEASUREMENT
/begin MEASUREMENT Tlib_ADC_L3_Get_RawVal_I_A_TEMP_TOP2 "" UWORD RB_RBA_Common_CentralElements_CompuMethods_Identical 1 100 0.0 65535 FORMAT "%8.2" ECU_ADDRESS 0xfe41947a /end MEASUREMENT
/begin MEASUREMENT Tlib_AdcrFactor_L3_Get_Voltage_I_A_TEMP_TOP2 "" UWORD RB_RBA_Common_CentralElements_CompuMethods_Identical 1 100 0.0 65535 FORMAT "%8.2" ECU_ADDRESS 0xfe41947c /end MEASUREMENT
/begin MEASUREMENT Tlib_ADC_L3_Get_FilterVal_I_A_TEMP_TOP2 "" UBYTE RB_RBA_Common_CentralElements_CompuMethods_Identical 1 100 0.0 255.00 FORMAT "%8.2" ECU_ADDRESS 0xfe4197d5 /end MEASUREMENT
/begin MEASUREMENT Tlib_ADC_L3_Get_ResValue_I_A_TEMP_TOP2 "" ULONG RB_RBA_Common_CentralElements_CompuMethods_Identical 1 100 0.0 4294967295 FORMAT "%8.2" ECU_ADDRESS 0xfe417a94 /end MEASUREMENT
/begin MEASUREMENT Tlib_ADC_L3_DIAG_Get_Value_I_A_TEMP_TOP2 "" UWORD RB_RBA_Common_CentralElements_CompuMethods_Identical 1 100 0.0 65535 FORMAT "%8.2" ECU_ADDRESS 0xfe41947e /end MEASUREMENT
/begin MEASUREMENT Tlib_ADC_L3_Get_RawVal_I_A_TEMP_BOT1 "" UWORD RB_RBA_Common_CentralElements_CompuMethods_Identical 1 100 0.0 65535 FORMAT "%8.2" ECU_ADDRESS 0xfe419480 /end MEASUREMENT
/begin MEASUREMENT Tlib_AdcrFactor_L3_Get_Voltage_I_A_TEMP_BOT1 "" UWORD RB_RBA_Common_CentralElements_CompuMethods_Identical 1 100 0.0 65535 FORMAT "%8.2" ECU_ADDRESS 0xfe419482 /end MEASUREMENT
/begin MEASUREMENT Tlib_ADC_L3_Get_FilterVal_I_A_TEMP_BOT1 "" UBYTE RB_RBA_Common_CentralElements_CompuMethods_Identical 1 100 0.0 255.00 FORMAT "%8.2" ECU_ADDRESS 0xfe4197d6 /end MEASUREMENT
/begin MEASUREMENT Tlib_ADC_L3_Get_ResValue_I_A_TEMP_BOT1 "" ULONG RB_RBA_Common_CentralElements_CompuMethods_Identical 1 100 0.0 4294967295 FORMAT "%8.2" ECU_ADDRESS 0xfe417a98 /end MEASUREMENT
/begin MEASUREMENT Tlib_ADC_L3_DIAG_Get_Value_I_A_TEMP_BOT1 "" UWORD RB_RBA_Common_CentralElements_CompuMethods_Identical 1 100 0.0 65535 FORMAT "%8.2" ECU_ADDRESS 0xfe419484 /end MEASUREMENT
/begin MEASUREMENT Tlib_ADC_L3_Get_RawVal_I_A_TEMP_BOT2 "" UWORD RB_RBA_Common_CentralElements_CompuMethods_Identical 1 100 0.0 65535 FORMAT "%8.2" ECU_ADDRESS 0xfe419486 /end MEASUREMENT
/begin MEASUREMENT Tlib_AdcrFactor_L3_Get_Voltage_I_A_TEMP_BOT2 "" UWORD RB_RBA_Common_CentralElements_CompuMethods_Identical 1 100 0.0 65535 FORMAT "%8.2" ECU_ADDRESS 0xfe419488 /end MEASUREMENT
/begin MEASUREMENT Tlib_ADC_L3_Get_FilterVal_I_A_TEMP_BOT2 "" UBYTE RB_RBA_Common_CentralElements_CompuMethods_Identical 1 100 0.0 255.00 FORMAT "%8.2" ECU_ADDRESS 0xfe4197d7 /end MEASUREMENT
/begin MEASUREMENT Tlib_ADC_L3_Get_ResValue_I_A_TEMP_BOT2 "" ULONG RB_RBA_Common_CentralElements_CompuMethods_Identical 1 100 0.0 4294967295 FORMAT "%8.2" ECU_ADDRESS 0xfe417a9c /end MEASUREMENT
/begin MEASUREMENT Tlib_ADC_L3_DIAG_Get_Value_I_A_TEMP_BOT2 "" UWORD RB_RBA_Common_CentralElements_CompuMethods_Identical 1 100 0.0 65535 FORMAT "%8.2" ECU_ADDRESS 0xfe41948a /end MEASUREMENT
/begin MEASUREMENT Tlib_ADC_L3_Get_RawVal_I_A_IAN45 "" UWORD RB_RBA_Common_CentralElements_CompuMethods_Identical 1 100 0.0 65535 FORMAT "%8.2" ECU_ADDRESS 0xfe41948c /end MEASUREMENT
/begin MEASUREMENT Tlib_AdcrFactor_L3_Get_Voltage_I_A_IAN45 "" UWORD RB_RBA_Common_CentralElements_CompuMethods_Identical 1 100 0.0 65535 FORMAT "%8.2" ECU_ADDRESS 0xfe41948e /end MEASUREMENT
/begin MEASUREMENT Tlib_ADC_L3_Get_FilterVal_I_A_IAN45 "" UBYTE RB_RBA_Common_CentralElements_CompuMethods_Identical 1 100 0.0 255.00 FORMAT "%8.2" ECU_ADDRESS 0xfe4197d8 /end MEASUREMENT
/begin MEASUREMENT Tlib_ADC_L3_Get_ResValue_I_A_IAN45 "" ULONG RB_RBA_Common_CentralElements_CompuMethods_Identical 1 100 0.0 4294967295 FORMAT "%8.2" ECU_ADDRESS 0xfe417aa0 /end MEASUREMENT
/begin MEASUREMENT Tlib_ADC_L3_DIAG_Get_Value_I_A_IAN45 "" UWORD RB_RBA_Common_CentralElements_CompuMethods_Identical 1 100 0.0 65535 FORMAT "%8.2" ECU_ADDRESS 0xfe419490 /end MEASUREMENT
/begin MEASUREMENT Tlib_ADC_L3_Get_RawVal_I_A_IAN27 "" UWORD RB_RBA_Common_CentralElements_CompuMethods_Identical 1 100 0.0 65535 FORMAT "%8.2" ECU_ADDRESS 0xfe419492 /end MEASUREMENT
/begin MEASUREMENT Tlib_AdcrFactor_L3_Get_Voltage_I_A_IAN27 "" UWORD RB_RBA_Common_CentralElements_CompuMethods_Identical 1 100 0.0 65535 FORMAT "%8.2" ECU_ADDRESS 0xfe419494 /end MEASUREMENT
/begin MEASUREMENT Tlib_ADC_L3_Get_FilterVal_I_A_IAN27 "" UBYTE RB_RBA_Common_CentralElements_CompuMethods_Identical 1 100 0.0 255.00 FORMAT "%8.2" ECU_ADDRESS 0xfe4197d9 /end MEASUREMENT
/begin MEASUREMENT Tlib_ADC_L3_Get_ResValue_I_A_IAN27 "" ULONG RB_RBA_Common_CentralElements_CompuMethods_Identical 1 100 0.0 4294967295 FORMAT "%8.2" ECU_ADDRESS 0xfe417aa4 /end MEASUREMENT
/begin MEASUREMENT Tlib_ADC_L3_DIAG_Get_Value_I_A_IAN27 "" UWORD RB_RBA_Common_CentralElements_CompuMethods_Identical 1 100 0.0 65535 FORMAT "%8.2" ECU_ADDRESS 0xfe419496 /end MEASUREMENT
/begin MEASUREMENT Tlib_ADC_L3_Get_RawVal_I_A_IAN29 "" UWORD RB_RBA_Common_CentralElements_CompuMethods_Identical 1 100 0.0 65535 FORMAT "%8.2" ECU_ADDRESS 0xfe419498 /end MEASUREMENT
/begin MEASUREMENT Tlib_AdcrFactor_L3_Get_Voltage_I_A_IAN29 "" UWORD RB_RBA_Common_CentralElements_CompuMethods_Identical 1 100 0.0 65535 FORMAT "%8.2" ECU_ADDRESS 0xfe41949a /end MEASUREMENT
/begin MEASUREMENT Tlib_ADC_L3_Get_FilterVal_I_A_IAN29 "" UBYTE RB_RBA_Common_CentralElements_CompuMethods_Identical 1 100 0.0 255.00 FORMAT "%8.2" ECU_ADDRESS 0xfe4197da /end MEASUREMENT
/begin MEASUREMENT Tlib_ADC_L3_Get_ResValue_I_A_IAN29 "" ULONG RB_RBA_Common_CentralElements_CompuMethods_Identical 1 100 0.0 4294967295 FORMAT "%8.2" ECU_ADDRESS 0xfe417aa8 /end MEASUREMENT
/begin MEASUREMENT Tlib_ADC_L3_DIAG_Get_Value_I_A_IAN29 "" UWORD RB_RBA_Common_CentralElements_CompuMethods_Identical 1 100 0.0 65535 FORMAT "%8.2" ECU_ADDRESS 0xfe41949c /end MEASUREMENT
/begin MEASUREMENT Tlib_ADC_L3_Get_RawVal_I_A_IAN24 "" UWORD RB_RBA_Common_CentralElements_CompuMethods_Identical 1 100 0.0 65535 FORMAT "%8.2" ECU_ADDRESS 0xfe41949e /end MEASUREMENT
/begin MEASUREMENT Tlib_AdcrFactor_L3_Get_Voltage_I_A_IAN24 "" UWORD RB_RBA_Common_CentralElements_CompuMethods_Identical 1 100 0.0 65535 FORMAT "%8.2" ECU_ADDRESS 0xfe4194a0 /end MEASUREMENT
/begin MEASUREMENT Tlib_ADC_L3_Get_FilterVal_I_A_IAN24 "" UBYTE RB_RBA_Common_CentralElements_CompuMethods_Identical 1 100 0.0 255.00 FORMAT "%8.2" ECU_ADDRESS 0xfe4197db /end MEASUREMENT
/begin MEASUREMENT Tlib_ADC_L3_Get_ResValue_I_A_IAN24 "" ULONG RB_RBA_Common_CentralElements_CompuMethods_Identical 1 100 0.0 4294967295 FORMAT "%8.2" ECU_ADDRESS 0xfe417aac /end MEASUREMENT
/begin MEASUREMENT Tlib_ADC_L3_DIAG_Get_Value_I_A_IAN24 "" UWORD RB_RBA_Common_CentralElements_CompuMethods_Identical 1 100 0.0 65535 FORMAT "%8.2" ECU_ADDRESS 0xfe4194a2 /end MEASUREMENT
/begin MEASUREMENT Tlib_ADC_L3_Get_RawVal_I_A_IAN26 "" UWORD RB_RBA_Common_CentralElements_CompuMethods_Identical 1 100 0.0 65535 FORMAT "%8.2" ECU_ADDRESS 0xfe4194a4 /end MEASUREMENT
/begin MEASUREMENT Tlib_AdcrFactor_L3_Get_Voltage_I_A_IAN26 "" UWORD RB_RBA_Common_CentralElements_CompuMethods_Identical 1 100 0.0 65535 FORMAT "%8.2" ECU_ADDRESS 0xfe4194a6 /end MEASUREMENT
/begin MEASUREMENT Tlib_ADC_L3_Get_FilterVal_I_A_IAN26 "" UBYTE RB_RBA_Common_CentralElements_CompuMethods_Identical 1 100 0.0 255.00 FORMAT "%8.2" ECU_ADDRESS 0xfe4197dc /end MEASUREMENT
/begin MEASUREMENT Tlib_ADC_L3_Get_ResValue_I_A_IAN26 "" ULONG RB_RBA_Common_CentralElements_CompuMethods_Identical 1 100 0.0 4294967295 FORMAT "%8.2" ECU_ADDRESS 0xfe417ab0 /end MEASUREMENT
/begin MEASUREMENT Tlib_ADC_L3_DIAG_Get_Value_I_A_IAN26 "" UWORD RB_RBA_Common_CentralElements_CompuMethods_Identical 1 100 0.0 65535 FORMAT "%8.2" ECU_ADDRESS 0xfe4194a8 /end MEASUREMENT
/begin MEASUREMENT Tlib_ADC_L3_Get_RawVal_I_A_IAN32 "" UWORD RB_RBA_Common_CentralElements_CompuMethods_Identical 1 100 0.0 65535 FORMAT "%8.2" ECU_ADDRESS 0xfe4194aa /end MEASUREMENT
/begin MEASUREMENT Tlib_AdcrFactor_L3_Get_Voltage_I_A_IAN32 "" UWORD RB_RBA_Common_CentralElements_CompuMethods_Identical 1 100 0.0 65535 FORMAT "%8.2" ECU_ADDRESS 0xfe4194ac /end MEASUREMENT
/begin MEASUREMENT Tlib_ADC_L3_Get_FilterVal_I_A_IAN32 "" UBYTE RB_RBA_Common_CentralElements_CompuMethods_Identical 1 100 0.0 255.00 FORMAT "%8.2" ECU_ADDRESS 0xfe4197dd /end MEASUREMENT
/begin MEASUREMENT Tlib_ADC_L3_Get_ResValue_I_A_IAN32 "" ULONG RB_RBA_Common_CentralElements_CompuMethods_Identical 1 100 0.0 4294967295 FORMAT "%8.2" ECU_ADDRESS 0xfe417ab4 /end MEASUREMENT
/begin MEASUREMENT Tlib_ADC_L3_DIAG_Get_Value_I_A_IAN32 "" UWORD RB_RBA_Common_CentralElements_CompuMethods_Identical 1 100 0.0 65535 FORMAT "%8.2" ECU_ADDRESS 0xfe4194ae /end MEASUREMENT
/begin MEASUREMENT Tlib_ADC_L3_Get_RawVal_I_A_IAN33 "" UWORD RB_RBA_Common_CentralElements_CompuMethods_Identical 1 100 0.0 65535 FORMAT "%8.2" ECU_ADDRESS 0xfe4194b0 /end MEASUREMENT
/begin MEASUREMENT Tlib_AdcrFactor_L3_Get_Voltage_I_A_IAN33 "" UWORD RB_RBA_Common_CentralElements_CompuMethods_Identical 1 100 0.0 65535 FORMAT "%8.2" ECU_ADDRESS 0xfe4194b2 /end MEASUREMENT
/begin MEASUREMENT Tlib_ADC_L3_Get_FilterVal_I_A_IAN33 "" UBYTE RB_RBA_Common_CentralElements_CompuMethods_Identical 1 100 0.0 255.00 FORMAT "%8.2" ECU_ADDRESS 0xfe4197de /end MEASUREMENT
/begin MEASUREMENT Tlib_ADC_L3_Get_ResValue_I_A_IAN33 "" ULONG RB_RBA_Common_CentralElements_CompuMethods_Identical 1 100 0.0 4294967295 FORMAT "%8.2" ECU_ADDRESS 0xfe417ab8 /end MEASUREMENT
/begin MEASUREMENT Tlib_ADC_L3_DIAG_Get_Value_I_A_IAN33 "" UWORD RB_RBA_Common_CentralElements_CompuMethods_Identical 1 100 0.0 65535 FORMAT "%8.2" ECU_ADDRESS 0xfe4194b4 /end MEASUREMENT
/begin MEASUREMENT Tlib_ADC_L3_Get_RawVal_I_A_IAN34 "" UWORD RB_RBA_Common_CentralElements_CompuMethods_Identical 1 100 0.0 65535 FORMAT "%8.2" ECU_ADDRESS 0xfe4194b6 /end MEASUREMENT
/begin MEASUREMENT Tlib_AdcrFactor_L3_Get_Voltage_I_A_IAN34 "" UWORD RB_RBA_Common_CentralElements_CompuMethods_Identical 1 100 0.0 65535 FORMAT "%8.2" ECU_ADDRESS 0xfe4194b8 /end MEASUREMENT
/begin MEASUREMENT Tlib_ADC_L3_Get_FilterVal_I_A_IAN34 "" UBYTE RB_RBA_Common_CentralElements_CompuMethods_Identical 1 100 0.0 255.00 FORMAT "%8.2" ECU_ADDRESS 0xfe4197df /end MEASUREMENT
/begin MEASUREMENT Tlib_ADC_L3_Get_ResValue_I_A_IAN34 "" ULONG RB_RBA_Common_CentralElements_CompuMethods_Identical 1 100 0.0 4294967295 FORMAT "%8.2" ECU_ADDRESS 0xfe417abc /end MEASUREMENT
/begin MEASUREMENT Tlib_ADC_L3_DIAG_Get_Value_I_A_IAN34 "" UWORD RB_RBA_Common_CentralElements_CompuMethods_Identical 1 100 0.0 65535 FORMAT "%8.2" ECU_ADDRESS 0xfe4194ba /end MEASUREMENT
/begin MEASUREMENT Tlib_ADC_L3_Get_RawVal_I_A_IAN35 "" UWORD RB_RBA_Common_CentralElements_CompuMethods_Identical 1 100 0.0 65535 FORMAT "%8.2" ECU_ADDRESS 0xfe4194bc /end MEASUREMENT
/begin MEASUREMENT Tlib_AdcrFactor_L3_Get_Voltage_I_A_IAN35 "" UWORD RB_RBA_Common_CentralElements_CompuMethods_Identical 1 100 0.0 65535 FORMAT "%8.2" ECU_ADDRESS 0xfe4194be /end MEASUREMENT
/begin MEASUREMENT Tlib_ADC_L3_Get_FilterVal_I_A_IAN35 "" UBYTE RB_RBA_Common_CentralElements_CompuMethods_Identical 1 100 0.0 255.00 FORMAT "%8.2" ECU_ADDRESS 0xfe4197e0 /end MEASUREMENT
/begin MEASUREMENT Tlib_ADC_L3_Get_ResValue_I_A_IAN35 "" ULONG RB_RBA_Common_CentralElements_CompuMethods_Identical 1 100 0.0 4294967295 FORMAT "%8.2" ECU_ADDRESS 0xfe417ac0 /end MEASUREMENT
/begin MEASUREMENT Tlib_ADC_L3_DIAG_Get_Value_I_A_IAN35 "" UWORD RB_RBA_Common_CentralElements_CompuMethods_Identical 1 100 0.0 65535 FORMAT "%8.2" ECU_ADDRESS 0xfe4194c0 /end MEASUREMENT
/begin MEASUREMENT Tlib_ADC_L3_Get_RawVal_I_A_IAN36 "" UWORD RB_RBA_Common_CentralElements_CompuMethods_Identical 1 100 0.0 65535 FORMAT "%8.2" ECU_ADDRESS 0xfe4194c2 /end MEASUREMENT
/begin MEASUREMENT Tlib_AdcrFactor_L3_Get_Voltage_I_A_IAN36 "" UWORD RB_RBA_Common_CentralElements_CompuMethods_Identical 1 100 0.0 65535 FORMAT "%8.2" ECU_ADDRESS 0xfe4194c4 /end MEASUREMENT
/begin MEASUREMENT Tlib_ADC_L3_Get_FilterVal_I_A_IAN36 "" UBYTE RB_RBA_Common_CentralElements_CompuMethods_Identical 1 100 0.0 255.00 FORMAT "%8.2" ECU_ADDRESS 0xfe4197e1 /end MEASUREMENT
/begin MEASUREMENT Tlib_ADC_L3_Get_ResValue_I_A_IAN36 "" ULONG RB_RBA_Common_CentralElements_CompuMethods_Identical 1 100 0.0 4294967295 FORMAT "%8.2" ECU_ADDRESS 0xfe417ac4 /end MEASUREMENT
/begin MEASUREMENT Tlib_ADC_L3_DIAG_Get_Value_I_A_IAN36 "" UWORD RB_RBA_Common_CentralElements_CompuMethods_Identical 1 100 0.0 65535 FORMAT "%8.2" ECU_ADDRESS 0xfe4194c6 /end MEASUREMENT
/begin MEASUREMENT Tlib_ADC_L3_Get_RawVal_I_A_IAN37 "" UWORD RB_RBA_Common_CentralElements_CompuMethods_Identical 1 100 0.0 65535 FORMAT "%8.2" ECU_ADDRESS 0xfe4194c8 /end MEASUREMENT
/begin MEASUREMENT Tlib_AdcrFactor_L3_Get_Voltage_I_A_IAN37 "" UWORD RB_RBA_Common_CentralElements_CompuMethods_Identical 1 100 0.0 65535 FORMAT "%8.2" ECU_ADDRESS 0xfe4194ca /end MEASUREMENT
/begin MEASUREMENT Tlib_ADC_L3_Get_FilterVal_I_A_IAN37 "" UBYTE RB_RBA_Common_CentralElements_CompuMethods_Identical 1 100 0.0 255.00 FORMAT "%8.2" ECU_ADDRESS 0xfe4197e2 /end MEASUREMENT
/begin MEASUREMENT Tlib_ADC_L3_Get_ResValue_I_A_IAN37 "" ULONG RB_RBA_Common_CentralElements_CompuMethods_Identical 1 100 0.0 4294967295 FORMAT "%8.2" ECU_ADDRESS 0xfe417ac8 /end MEASUREMENT
/begin MEASUREMENT Tlib_ADC_L3_DIAG_Get_Value_I_A_IAN37 "" UWORD RB_RBA_Common_CentralElements_CompuMethods_Identical 1 100 0.0 65535 FORMAT "%8.2" ECU_ADDRESS 0xfe4194cc /end MEASUREMENT
/begin MEASUREMENT Tlib_ADC_L3_Get_RawVal_I_A_IAN25 "" UWORD RB_RBA_Common_CentralElements_CompuMethods_Identical 1 100 0.0 65535 FORMAT "%8.2" ECU_ADDRESS 0xfe4194ce /end MEASUREMENT
/begin MEASUREMENT Tlib_AdcrFactor_L3_Get_Voltage_I_A_IAN25 "" UWORD RB_RBA_Common_CentralElements_CompuMethods_Identical 1 100 0.0 65535 FORMAT "%8.2" ECU_ADDRESS 0xfe4194d0 /end MEASUREMENT
/begin MEASUREMENT Tlib_ADC_L3_Get_FilterVal_I_A_IAN25 "" UBYTE RB_RBA_Common_CentralElements_CompuMethods_Identical 1 100 0.0 255.00 FORMAT "%8.2" ECU_ADDRESS 0xfe4197e3 /end MEASUREMENT
/begin MEASUREMENT Tlib_ADC_L3_Get_ResValue_I_A_IAN25 "" ULONG RB_RBA_Common_CentralElements_CompuMethods_Identical 1 100 0.0 4294967295 FORMAT "%8.2" ECU_ADDRESS 0xfe417acc /end MEASUREMENT
/begin MEASUREMENT Tlib_ADC_L3_DIAG_Get_Value_I_A_IAN25 "" UWORD RB_RBA_Common_CentralElements_CompuMethods_Identical 1 100 0.0 65535 FORMAT "%8.2" ECU_ADDRESS 0xfe4194d2 /end MEASUREMENT
/begin MEASUREMENT Tlib_ADC_L3_Get_RawVal_I_A_IAN55 "" UWORD RB_RBA_Common_CentralElements_CompuMethods_Identical 1 100 0.0 65535 FORMAT "%8.2" ECU_ADDRESS 0xfe4194d4 /end MEASUREMENT
/begin MEASUREMENT Tlib_AdcrFactor_L3_Get_Voltage_I_A_IAN55 "" UWORD RB_RBA_Common_CentralElements_CompuMethods_Identical 1 100 0.0 65535 FORMAT "%8.2" ECU_ADDRESS 0xfe4194d6 /end MEASUREMENT
/begin MEASUREMENT Tlib_ADC_L3_Get_FilterVal_I_A_IAN55 "" UBYTE RB_RBA_Common_CentralElements_CompuMethods_Identical 1 100 0.0 255.00 FORMAT "%8.2" ECU_ADDRESS 0xfe4197e4 /end MEASUREMENT
/begin MEASUREMENT Tlib_ADC_L3_Get_ResValue_I_A_IAN55 "" ULONG RB_RBA_Common_CentralElements_CompuMethods_Identical 1 100 0.0 4294967295 FORMAT "%8.2" ECU_ADDRESS 0xfe417ad0 /end MEASUREMENT
/begin MEASUREMENT Tlib_ADC_L3_DIAG_Get_Value_I_A_IAN55 "" UWORD RB_RBA_Common_CentralElements_CompuMethods_Identical 1 100 0.0 65535 FORMAT "%8.2" ECU_ADDRESS 0xfe4194d8 /end MEASUREMENT
/begin MEASUREMENT Tlib_ADC_L3_Get_RawVal_I_A_IAN56 "" UWORD RB_RBA_Common_CentralElements_CompuMethods_Identical 1 100 0.0 65535 FORMAT "%8.2" ECU_ADDRESS 0xfe4194da /end MEASUREMENT
/begin MEASUREMENT Tlib_AdcrFactor_L3_Get_Voltage_I_A_IAN56 "" UWORD RB_RBA_Common_CentralElements_CompuMethods_Identical 1 100 0.0 65535 FORMAT "%8.2" ECU_ADDRESS 0xfe4194dc /end MEASUREMENT
/begin MEASUREMENT Tlib_ADC_L3_Get_FilterVal_I_A_IAN56 "" UBYTE RB_RBA_Common_CentralElements_CompuMethods_Identical 1 100 0.0 255.00 FORMAT "%8.2" ECU_ADDRESS 0xfe4197e5 /end MEASUREMENT
/begin MEASUREMENT Tlib_ADC_L3_Get_ResValue_I_A_IAN56 "" ULONG RB_RBA_Common_CentralElements_CompuMethods_Identical 1 100 0.0 4294967295 FORMAT "%8.2" ECU_ADDRESS 0xfe417ad4 /end MEASUREMENT
/begin MEASUREMENT Tlib_ADC_L3_DIAG_Get_Value_I_A_IAN56 "" UWORD RB_RBA_Common_CentralElements_CompuMethods_Identical 1 100 0.0 65535 FORMAT "%8.2" ECU_ADDRESS 0xfe4194de /end MEASUREMENT
/begin MEASUREMENT Tlib_ADC_L3_Get_RawVal_I_A_IAN57 "" UWORD RB_RBA_Common_CentralElements_CompuMethods_Identical 1 100 0.0 65535 FORMAT "%8.2" ECU_ADDRESS 0xfe4194e0 /end MEASUREMENT
/begin MEASUREMENT Tlib_AdcrFactor_L3_Get_Voltage_I_A_IAN57 "" UWORD RB_RBA_Common_CentralElements_CompuMethods_Identical 1 100 0.0 65535 FORMAT "%8.2" ECU_ADDRESS 0xfe4194e2 /end MEASUREMENT
/begin MEASUREMENT Tlib_ADC_L3_Get_FilterVal_I_A_IAN57 "" UBYTE RB_RBA_Common_CentralElements_CompuMethods_Identical 1 100 0.0 255.00 FORMAT "%8.2" ECU_ADDRESS 0xfe4197e6 /end MEASUREMENT
/begin MEASUREMENT Tlib_ADC_L3_Get_ResValue_I_A_IAN57 "" ULONG RB_RBA_Common_CentralElements_CompuMethods_Identical 1 100 0.0 4294967295 FORMAT "%8.2" ECU_ADDRESS 0xfe417ad8 /end MEASUREMENT
/begin MEASUREMENT Tlib_ADC_L3_DIAG_Get_Value_I_A_IAN57 "" UWORD RB_RBA_Common_CentralElements_CompuMethods_Identical 1 100 0.0 65535 FORMAT "%8.2" ECU_ADDRESS 0xfe4194e4 /end MEASUREMENT
/begin MEASUREMENT Tlib_ADC_L3_Get_RawVal_I_A_IAN58 "" UWORD RB_RBA_Common_CentralElements_CompuMethods_Identical 1 100 0.0 65535 FORMAT "%8.2" ECU_ADDRESS 0xfe4194e6 /end MEASUREMENT
/begin MEASUREMENT Tlib_AdcrFactor_L3_Get_Voltage_I_A_IAN58 "" UWORD RB_RBA_Common_CentralElements_CompuMethods_Identical 1 100 0.0 65535 FORMAT "%8.2" ECU_ADDRESS 0xfe4194e8 /end MEASUREMENT
/begin MEASUREMENT Tlib_ADC_L3_Get_FilterVal_I_A_IAN58 "" UBYTE RB_RBA_Common_CentralElements_CompuMethods_Identical 1 100 0.0 255.00 FORMAT "%8.2" ECU_ADDRESS 0xfe4197e7 /end MEASUREMENT
/begin MEASUREMENT Tlib_ADC_L3_Get_ResValue_I_A_IAN58 "" ULONG RB_RBA_Common_CentralElements_CompuMethods_Identical 1 100 0.0 4294967295 FORMAT "%8.2" ECU_ADDRESS 0xfe417adc /end MEASUREMENT
/begin MEASUREMENT Tlib_ADC_L3_DIAG_Get_Value_I_A_IAN58 "" UWORD RB_RBA_Common_CentralElements_CompuMethods_Identical 1 100 0.0 65535 FORMAT "%8.2" ECU_ADDRESS 0xfe4194ea /end MEASUREMENT
/begin MEASUREMENT Tlib_ADC_L3_Get_RawVal_I_A_IAN60 "" UWORD RB_RBA_Common_CentralElements_CompuMethods_Identical 1 100 0.0 65535 FORMAT "%8.2" ECU_ADDRESS 0xfe4194ec /end MEASUREMENT
/begin MEASUREMENT Tlib_AdcrFactor_L3_Get_Voltage_I_A_IAN60 "" UWORD RB_RBA_Common_CentralElements_CompuMethods_Identical 1 100 0.0 65535 FORMAT "%8.2" ECU_ADDRESS 0xfe4194ee /end MEASUREMENT
/begin MEASUREMENT Tlib_ADC_L3_Get_FilterVal_I_A_IAN60 "" UBYTE RB_RBA_Common_CentralElements_CompuMethods_Identical 1 100 0.0 255.00 FORMAT "%8.2" ECU_ADDRESS 0xfe4197e8 /end MEASUREMENT
/begin MEASUREMENT Tlib_ADC_L3_Get_ResValue_I_A_IAN60 "" ULONG RB_RBA_Common_CentralElements_CompuMethods_Identical 1 100 0.0 4294967295 FORMAT "%8.2" ECU_ADDRESS 0xfe417ae0 /end MEASUREMENT
/begin MEASUREMENT Tlib_ADC_L3_DIAG_Get_Value_I_A_IAN60 "" UWORD RB_RBA_Common_CentralElements_CompuMethods_Identical 1 100 0.0 65535 FORMAT "%8.2" ECU_ADDRESS 0xfe4194f0 /end MEASUREMENT
/begin MEASUREMENT Tlib_ADC_L3_Get_RawVal_I_A_IAN61 "" UWORD RB_RBA_Common_CentralElements_CompuMethods_Identical 1 100 0.0 65535 FORMAT "%8.2" ECU_ADDRESS 0xfe4194f2 /end MEASUREMENT
/begin MEASUREMENT Tlib_AdcrFactor_L3_Get_Voltage_I_A_IAN61 "" UWORD RB_RBA_Common_CentralElements_CompuMethods_Identical 1 100 0.0 65535 FORMAT "%8.2" ECU_ADDRESS 0xfe4194f4 /end MEASUREMENT
/begin MEASUREMENT Tlib_ADC_L3_Get_FilterVal_I_A_IAN61 "" UBYTE RB_RBA_Common_CentralElements_CompuMethods_Identical 1 100 0.0 255.00 FORMAT "%8.2" ECU_ADDRESS 0xfe4197e9 /end MEASUREMENT
/begin MEASUREMENT Tlib_ADC_L3_Get_ResValue_I_A_IAN61 "" ULONG RB_RBA_Common_CentralElements_CompuMethods_Identical 1 100 0.0 4294967295 FORMAT "%8.2" ECU_ADDRESS 0xfe417ae4 /end MEASUREMENT
/begin MEASUREMENT Tlib_ADC_L3_DIAG_Get_Value_I_A_IAN61 "" UWORD RB_RBA_Common_CentralElements_CompuMethods_Identical 1 100 0.0 65535 FORMAT "%8.2" ECU_ADDRESS 0xfe4194f6 /end MEASUREMENT
/begin MEASUREMENT Tlib_ADC_L3_Get_RawVal_I_A_IAN62 "" UWORD RB_RBA_Common_CentralElements_CompuMethods_Identical 1 100 0.0 65535 FORMAT "%8.2" ECU_ADDRESS 0xfe4194f8 /end MEASUREMENT
/begin MEASUREMENT Tlib_AdcrFactor_L3_Get_Voltage_I_A_IAN62 "" UWORD RB_RBA_Common_CentralElements_CompuMethods_Identical 1 100 0.0 65535 FORMAT "%8.2" ECU_ADDRESS 0xfe4194fa /end MEASUREMENT
/begin MEASUREMENT Tlib_ADC_L3_Get_FilterVal_I_A_IAN62 "" UBYTE RB_RBA_Common_CentralElements_CompuMethods_Identical 1 100 0.0 255.00 FORMAT "%8.2" ECU_ADDRESS 0xfe4197ea /end MEASUREMENT
/begin MEASUREMENT Tlib_ADC_L3_Get_ResValue_I_A_IAN62 "" ULONG RB_RBA_Common_CentralElements_CompuMethods_Identical 1 100 0.0 4294967295 FORMAT "%8.2" ECU_ADDRESS 0xfe417ae8 /end MEASUREMENT
/begin MEASUREMENT Tlib_ADC_L3_DIAG_Get_Value_I_A_IAN62 "" UWORD RB_RBA_Common_CentralElements_CompuMethods_Identical 1 100 0.0 65535 FORMAT "%8.2" ECU_ADDRESS 0xfe4194fc /end MEASUREMENT
/begin MEASUREMENT Tlib_ADC_L3_Get_RawVal_I_A_IAN63 "" UWORD RB_RBA_Common_CentralElements_CompuMethods_Identical 1 100 0.0 65535 FORMAT "%8.2" ECU_ADDRESS 0xfe4194fe /end MEASUREMENT
/begin MEASUREMENT Tlib_AdcrFactor_L3_Get_Voltage_I_A_IAN63 "" UWORD RB_RBA_Common_CentralElements_CompuMethods_Identical 1 100 0.0 65535 FORMAT "%8.2" ECU_ADDRESS 0xfe419500 /end MEASUREMENT
/begin MEASUREMENT Tlib_ADC_L3_Get_FilterVal_I_A_IAN63 "" UBYTE RB_RBA_Common_CentralElements_CompuMethods_Identical 1 100 0.0 255.00 FORMAT "%8.2" ECU_ADDRESS 0xfe4197eb /end MEASUREMENT
/begin MEASUREMENT Tlib_ADC_L3_Get_ResValue_I_A_IAN63 "" ULONG RB_RBA_Common_CentralElements_CompuMethods_Identical 1 100 0.0 4294967295 FORMAT "%8.2" ECU_ADDRESS 0xfe417aec /end MEASUREMENT
/begin MEASUREMENT Tlib_ADC_L3_DIAG_Get_Value_I_A_IAN63 "" UWORD RB_RBA_Common_CentralElements_CompuMethods_Identical 1 100 0.0 65535 FORMAT "%8.2" ECU_ADDRESS 0xfe419502 /end MEASUREMENT
/begin MEASUREMENT Tlib_ADC_L3_Get_RawVal_I_A_IAN64 "" UWORD RB_RBA_Common_CentralElements_CompuMethods_Identical 1 100 0.0 65535 FORMAT "%8.2" ECU_ADDRESS 0xfe419504 /end MEASUREMENT
/begin MEASUREMENT Tlib_AdcrFactor_L3_Get_Voltage_I_A_IAN64 "" UWORD RB_RBA_Common_CentralElements_CompuMethods_Identical 1 100 0.0 65535 FORMAT "%8.2" ECU_ADDRESS 0xfe419506 /end MEASUREMENT
/begin MEASUREMENT Tlib_ADC_L3_Get_FilterVal_I_A_IAN64 "" UBYTE RB_RBA_Common_CentralElements_CompuMethods_Identical 1 100 0.0 255.00 FORMAT "%8.2" ECU_ADDRESS 0xfe4197ec /end MEASUREMENT
/begin MEASUREMENT Tlib_ADC_L3_Get_ResValue_I_A_IAN64 "" ULONG RB_RBA_Common_CentralElements_CompuMethods_Identical 1 100 0.0 4294967295 FORMAT "%8.2" ECU_ADDRESS 0xfe417af0 /end MEASUREMENT
/begin MEASUREMENT Tlib_ADC_L3_DIAG_Get_Value_I_A_IAN64 "" UWORD RB_RBA_Common_CentralElements_CompuMethods_Identical 1 100 0.0 65535 FORMAT "%8.2" ECU_ADDRESS 0xfe419508 /end MEASUREMENT
/begin MEASUREMENT Tlib_ADC_L3_Get_RawVal_I_A_IAN65 "" UWORD RB_RBA_Common_CentralElements_CompuMethods_Identical 1 100 0.0 65535 FORMAT "%8.2" ECU_ADDRESS 0xfe41950a /end MEASUREMENT
/begin MEASUREMENT Tlib_AdcrFactor_L3_Get_Voltage_I_A_IAN65 "" UWORD RB_RBA_Common_CentralElements_CompuMethods_Identical 1 100 0.0 65535 FORMAT "%8.2" ECU_ADDRESS 0xfe41950c /end MEASUREMENT
/begin MEASUREMENT Tlib_ADC_L3_Get_FilterVal_I_A_IAN65 "" UBYTE RB_RBA_Common_CentralElements_CompuMethods_Identical 1 100 0.0 255.00 FORMAT "%8.2" ECU_ADDRESS 0xfe4197ed /end MEASUREMENT
/begin MEASUREMENT Tlib_ADC_L3_Get_ResValue_I_A_IAN65 "" ULONG RB_RBA_Common_CentralElements_CompuMethods_Identical 1 100 0.0 4294967295 FORMAT "%8.2" ECU_ADDRESS 0xfe417af4 /end MEASUREMENT
/begin MEASUREMENT Tlib_ADC_L3_DIAG_Get_Value_I_A_IAN65 "" UWORD RB_RBA_Common_CentralElements_CompuMethods_Identical 1 100 0.0 65535 FORMAT "%8.2" ECU_ADDRESS 0xfe41950e /end MEASUREMENT
/begin MEASUREMENT Tlib_ADC_L3_Get_RawVal_I_A_IAN66 "" UWORD RB_RBA_Common_CentralElements_CompuMethods_Identical 1 100 0.0 65535 FORMAT "%8.2" ECU_ADDRESS 0xfe419510 /end MEASUREMENT
/begin MEASUREMENT Tlib_AdcrFactor_L3_Get_Voltage_I_A_IAN66 "" UWORD RB_RBA_Common_CentralElements_CompuMethods_Identical 1 100 0.0 65535 FORMAT "%8.2" ECU_ADDRESS 0xfe419512 /end MEASUREMENT
/begin MEASUREMENT Tlib_ADC_L3_Get_FilterVal_I_A_IAN66 "" UBYTE RB_RBA_Common_CentralElements_CompuMethods_Identical 1 100 0.0 255.00 FORMAT "%8.2" ECU_ADDRESS 0xfe4197ee /end MEASUREMENT
/begin MEASUREMENT Tlib_ADC_L3_Get_ResValue_I_A_IAN66 "" ULONG RB_RBA_Common_CentralElements_CompuMethods_Identical 1 100 0.0 4294967295 FORMAT "%8.2" ECU_ADDRESS 0xfe417af8 /end MEASUREMENT
/begin MEASUREMENT Tlib_ADC_L3_DIAG_Get_Value_I_A_IAN66 "" UWORD RB_RBA_Common_CentralElements_CompuMethods_Identical 1 100 0.0 65535 FORMAT "%8.2" ECU_ADDRESS 0xfe419514 /end MEASUREMENT
/begin MEASUREMENT Tlib_ADC_L3_Get_RawVal_I_A_IAN67 "" UWORD RB_RBA_Common_CentralElements_CompuMethods_Identical 1 100 0.0 65535 FORMAT "%8.2" ECU_ADDRESS 0xfe419516 /end MEASUREMENT
/begin MEASUREMENT Tlib_AdcrFactor_L3_Get_Voltage_I_A_IAN67 "" UWORD RB_RBA_Common_CentralElements_CompuMethods_Identical 1 100 0.0 65535 FORMAT "%8.2" ECU_ADDRESS 0xfe419518 /end MEASUREMENT
/begin MEASUREMENT Tlib_ADC_L3_Get_FilterVal_I_A_IAN67 "" UBYTE RB_RBA_Common_CentralElements_CompuMethods_Identical 1 100 0.0 255.00 FORMAT "%8.2" ECU_ADDRESS 0xfe4197ef /end MEASUREMENT
/begin MEASUREMENT Tlib_ADC_L3_Get_ResValue_I_A_IAN67 "" ULONG RB_RBA_Common_CentralElements_CompuMethods_Identical 1 100 0.0 4294967295 FORMAT "%8.2" ECU_ADDRESS 0xfe417afc /end MEASUREMENT
/begin MEASUREMENT Tlib_ADC_L3_DIAG_Get_Value_I_A_IAN67 "" UWORD RB_RBA_Common_CentralElements_CompuMethods_Identical 1 100 0.0 65535 FORMAT "%8.2" ECU_ADDRESS 0xfe41951a /end MEASUREMENT
/begin MEASUREMENT Tlib_ADC_L3_Get_RawVal_I_A_IAN68 "" UWORD RB_RBA_Common_CentralElements_CompuMethods_Identical 1 100 0.0 65535 FORMAT "%8.2" ECU_ADDRESS 0xfe41951c /end MEASUREMENT
/begin MEASUREMENT Tlib_AdcrFactor_L3_Get_Voltage_I_A_IAN68 "" UWORD RB_RBA_Common_CentralElements_CompuMethods_Identical 1 100 0.0 65535 FORMAT "%8.2" ECU_ADDRESS 0xfe41951e /end MEASUREMENT
/begin MEASUREMENT Tlib_ADC_L3_Get_FilterVal_I_A_IAN68 "" UBYTE RB_RBA_Common_CentralElements_CompuMethods_Identical 1 100 0.0 255.00 FORMAT "%8.2" ECU_ADDRESS 0xfe4197f0 /end MEASUREMENT
/begin MEASUREMENT Tlib_ADC_L3_Get_ResValue_I_A_IAN68 "" ULONG RB_RBA_Common_CentralElements_CompuMethods_Identical 1 100 0.0 4294967295 FORMAT "%8.2" ECU_ADDRESS 0xfe417b00 /end MEASUREMENT
/begin MEASUREMENT Tlib_ADC_L3_DIAG_Get_Value_I_A_IAN68 "" UWORD RB_RBA_Common_CentralElements_CompuMethods_Identical 1 100 0.0 65535 FORMAT "%8.2" ECU_ADDRESS 0xfe419520 /end MEASUREMENT
/begin MEASUREMENT Tlib_ADC_L3_Get_RawVal_I_A_IAN69 "" UWORD RB_RBA_Common_CentralElements_CompuMethods_Identical 1 100 0.0 65535 FORMAT "%8.2" ECU_ADDRESS 0xfe419522 /end MEASUREMENT
/begin MEASUREMENT Tlib_AdcrFactor_L3_Get_Voltage_I_A_IAN69 "" UWORD RB_RBA_Common_CentralElements_CompuMethods_Identical 1 100 0.0 65535 FORMAT "%8.2" ECU_ADDRESS 0xfe419524 /end MEASUREMENT
/begin MEASUREMENT Tlib_ADC_L3_Get_FilterVal_I_A_IAN69 "" UBYTE RB_RBA_Common_CentralElements_CompuMethods_Identical 1 100 0.0 255.00 FORMAT "%8.2" ECU_ADDRESS 0xfe4197f1 /end MEASUREMENT
/begin MEASUREMENT Tlib_ADC_L3_Get_ResValue_I_A_IAN69 "" ULONG RB_RBA_Common_CentralElements_CompuMethods_Identical 1 100 0.0 4294967295 FORMAT "%8.2" ECU_ADDRESS 0xfe417b04 /end MEASUREMENT
/begin MEASUREMENT Tlib_ADC_L3_DIAG_Get_Value_I_A_IAN69 "" UWORD RB_RBA_Common_CentralElements_CompuMethods_Identical 1 100 0.0 65535 FORMAT "%8.2" ECU_ADDRESS 0xfe419526 /end MEASUREMENT
/begin MEASUREMENT Tlib_ADC_L3_Get_RawVal_I_A_IAN70 "" UWORD RB_RBA_Common_CentralElements_CompuMethods_Identical 1 100 0.0 65535 FORMAT "%8.2" ECU_ADDRESS 0xfe419528 /end MEASUREMENT
/begin MEASUREMENT Tlib_AdcrFactor_L3_Get_Voltage_I_A_IAN70 "" UWORD RB_RBA_Common_CentralElements_CompuMethods_Identical 1 100 0.0 65535 FORMAT "%8.2" ECU_ADDRESS 0xfe41952a /end MEASUREMENT
/begin MEASUREMENT Tlib_ADC_L3_Get_FilterVal_I_A_IAN70 "" UBYTE RB_RBA_Common_CentralElements_CompuMethods_Identical 1 100 0.0 255.00 FORMAT "%8.2" ECU_ADDRESS 0xfe4197f2 /end MEASUREMENT
/begin MEASUREMENT Tlib_ADC_L3_Get_ResValue_I_A_IAN70 "" ULONG RB_RBA_Common_CentralElements_CompuMethods_Identical 1 100 0.0 4294967295 FORMAT "%8.2" ECU_ADDRESS 0xfe417b08 /end MEASUREMENT
/begin MEASUREMENT Tlib_ADC_L3_DIAG_Get_Value_I_A_IAN70 "" UWORD RB_RBA_Common_CentralElements_CompuMethods_Identical 1 100 0.0 65535 FORMAT "%8.2" ECU_ADDRESS 0xfe41952c /end MEASUREMENT
/begin MEASUREMENT Tlib_ADC_L3_Get_RawVal_I_A_IAN71 "" UWORD RB_RBA_Common_CentralElements_CompuMethods_Identical 1 100 0.0 65535 FORMAT "%8.2" ECU_ADDRESS 0xfe41952e /end MEASUREMENT
/begin MEASUREMENT Tlib_AdcrFactor_L3_Get_Voltage_I_A_IAN71 "" UWORD RB_RBA_Common_CentralElements_CompuMethods_Identical 1 100 0.0 65535 FORMAT "%8.2" ECU_ADDRESS 0xfe419530 /end MEASUREMENT
/begin MEASUREMENT Tlib_ADC_L3_Get_FilterVal_I_A_IAN71 "" UBYTE RB_RBA_Common_CentralElements_CompuMethods_Identical 1 100 0.0 255.00 FORMAT "%8.2" ECU_ADDRESS 0xfe4197f3 /end MEASUREMENT
/begin MEASUREMENT Tlib_ADC_L3_Get_ResValue_I_A_IAN71 "" ULONG RB_RBA_Common_CentralElements_CompuMethods_Identical 1 100 0.0 4294967295 FORMAT "%8.2" ECU_ADDRESS 0xfe417b0c /end MEASUREMENT
/begin MEASUREMENT Tlib_ADC_L3_DIAG_Get_Value_I_A_IAN71 "" UWORD RB_RBA_Common_CentralElements_CompuMethods_Identical 1 100 0.0 65535 FORMAT "%8.2" ECU_ADDRESS 0xfe419532 /end MEASUREMENT
/begin MEASUREMENT Tlib_ADC_L3_Get_RawVal_I_A_IAN72 "" UWORD RB_RBA_Common_CentralElements_CompuMethods_Identical 1 100 0.0 65535 FORMAT "%8.2" ECU_ADDRESS 0xfe419534 /end MEASUREMENT
/begin MEASUREMENT Tlib_AdcrFactor_L3_Get_Voltage_I_A_IAN72 "" UWORD RB_RBA_Common_CentralElements_CompuMethods_Identical 1 100 0.0 65535 FORMAT "%8.2" ECU_ADDRESS 0xfe419536 /end MEASUREMENT
/begin MEASUREMENT Tlib_ADC_L3_Get_FilterVal_I_A_IAN72 "" UBYTE RB_RBA_Common_CentralElements_CompuMethods_Identical 1 100 0.0 255.00 FORMAT "%8.2" ECU_ADDRESS 0xfe4197f4 /end MEASUREMENT
/begin MEASUREMENT Tlib_ADC_L3_Get_ResValue_I_A_IAN72 "" ULONG RB_RBA_Common_CentralElements_CompuMethods_Identical 1 100 0.0 4294967295 FORMAT "%8.2" ECU_ADDRESS 0xfe417b10 /end MEASUREMENT
/begin MEASUREMENT Tlib_ADC_L3_DIAG_Get_Value_I_A_IAN72 "" UWORD RB_RBA_Common_CentralElements_CompuMethods_Identical 1 100 0.0 65535 FORMAT "%8.2" ECU_ADDRESS 0xfe419538 /end MEASUREMENT
/begin MEASUREMENT Tlib_ADC_L3_Get_RawVal_I_A_IAN73 "" UWORD RB_RBA_Common_CentralElements_CompuMethods_Identical 1 100 0.0 65535 FORMAT "%8.2" ECU_ADDRESS 0xfe41953a /end MEASUREMENT
/begin MEASUREMENT Tlib_AdcrFactor_L3_Get_Voltage_I_A_IAN73 "" UWORD RB_RBA_Common_CentralElements_CompuMethods_Identical 1 100 0.0 65535 FORMAT "%8.2" ECU_ADDRESS 0xfe41953c /end MEASUREMENT
/begin MEASUREMENT Tlib_ADC_L3_Get_FilterVal_I_A_IAN73 "" UBYTE RB_RBA_Common_CentralElements_CompuMethods_Identical 1 100 0.0 255.00 FORMAT "%8.2" ECU_ADDRESS 0xfe4197f5 /end MEASUREMENT
/begin MEASUREMENT Tlib_ADC_L3_Get_ResValue_I_A_IAN73 "" ULONG RB_RBA_Common_CentralElements_CompuMethods_Identical 1 100 0.0 4294967295 FORMAT "%8.2" ECU_ADDRESS 0xfe417b14 /end MEASUREMENT
/begin MEASUREMENT Tlib_ADC_L3_DIAG_Get_Value_I_A_IAN73 "" UWORD RB_RBA_Common_CentralElements_CompuMethods_Identical 1 100 0.0 65535 FORMAT "%8.2" ECU_ADDRESS 0xfe41953e /end MEASUREMENT
/begin MEASUREMENT Tlib_ADC_L3_Get_RawVal_I_A_IAN76 "" UWORD RB_RBA_Common_CentralElements_CompuMethods_Identical 1 100 0.0 65535 FORMAT "%8.2" ECU_ADDRESS 0xfe419540 /end MEASUREMENT
/begin MEASUREMENT Tlib_AdcrFactor_L3_Get_Voltage_I_A_IAN76 "" UWORD RB_RBA_Common_CentralElements_CompuMethods_Identical 1 100 0.0 65535 FORMAT "%8.2" ECU_ADDRESS 0xfe419542 /end MEASUREMENT
/begin MEASUREMENT Tlib_ADC_L3_Get_FilterVal_I_A_IAN76 "" UBYTE RB_RBA_Common_CentralElements_CompuMethods_Identical 1 100 0.0 255.00 FORMAT "%8.2" ECU_ADDRESS 0xfe4197f6 /end MEASUREMENT
/begin MEASUREMENT Tlib_ADC_L3_Get_ResValue_I_A_IAN76 "" ULONG RB_RBA_Common_CentralElements_CompuMethods_Identical 1 100 0.0 4294967295 FORMAT "%8.2" ECU_ADDRESS 0xfe417b18 /end MEASUREMENT
/begin MEASUREMENT Tlib_ADC_L3_DIAG_Get_Value_I_A_IAN76 "" UWORD RB_RBA_Common_CentralElements_CompuMethods_Identical 1 100 0.0 65535 FORMAT "%8.2" ECU_ADDRESS 0xfe419544 /end MEASUREMENT
/begin MEASUREMENT Tlib_ADC_L3_Get_RawVal_I_A_IAN13 "" UWORD RB_RBA_Common_CentralElements_CompuMethods_Identical 1 100 0.0 65535 FORMAT "%8.2" ECU_ADDRESS 0xfe419546 /end MEASUREMENT
/begin MEASUREMENT Tlib_AdcrFactor_L3_Get_Voltage_I_A_IAN13 "" UWORD RB_RBA_Common_CentralElements_CompuMethods_Identical 1 100 0.0 65535 FORMAT "%8.2" ECU_ADDRESS 0xfe419548 /end MEASUREMENT
/begin MEASUREMENT Tlib_ADC_L3_Get_FilterVal_I_A_IAN13 "" UBYTE RB_RBA_Common_CentralElements_CompuMethods_Identical 1 100 0.0 255.00 FORMAT "%8.2" ECU_ADDRESS 0xfe4197f7 /end MEASUREMENT
/begin MEASUREMENT Tlib_ADC_L3_Get_ResValue_I_A_IAN13 "" ULONG RB_RBA_Common_CentralElements_CompuMethods_Identical 1 100 0.0 4294967295 FORMAT "%8.2" ECU_ADDRESS 0xfe417b1c /end MEASUREMENT
/begin MEASUREMENT Tlib_ADC_L3_DIAG_Get_Value_I_A_IAN13 "" UWORD RB_RBA_Common_CentralElements_CompuMethods_Identical 1 100 0.0 65535 FORMAT "%8.2" ECU_ADDRESS 0xfe41954a /end MEASUREMENT
/begin MEASUREMENT Tlib_ADC_L3_Get_RawVal_I_A_IAN14 "" UWORD RB_RBA_Common_CentralElements_CompuMethods_Identical 1 100 0.0 65535 FORMAT "%8.2" ECU_ADDRESS 0xfe41954c /end MEASUREMENT
/begin MEASUREMENT Tlib_AdcrFactor_L3_Get_Voltage_I_A_IAN14 "" UWORD RB_RBA_Common_CentralElements_CompuMethods_Identical 1 100 0.0 65535 FORMAT "%8.2" ECU_ADDRESS 0xfe41954e /end MEASUREMENT
/begin MEASUREMENT Tlib_ADC_L3_Get_FilterVal_I_A_IAN14 "" UBYTE RB_RBA_Common_CentralElements_CompuMethods_Identical 1 100 0.0 255.00 FORMAT "%8.2" ECU_ADDRESS 0xfe4197f8 /end MEASUREMENT
/begin MEASUREMENT Tlib_ADC_L3_Get_ResValue_I_A_IAN14 "" ULONG RB_RBA_Common_CentralElements_CompuMethods_Identical 1 100 0.0 4294967295 FORMAT "%8.2" ECU_ADDRESS 0xfe417b20 /end MEASUREMENT
/begin MEASUREMENT Tlib_ADC_L3_DIAG_Get_Value_I_A_IAN14 "" UWORD RB_RBA_Common_CentralElements_CompuMethods_Identical 1 100 0.0 65535 FORMAT "%8.2" ECU_ADDRESS 0xfe419550 /end MEASUREMENT
/begin MEASUREMENT Tlib_ADC_L3_Get_RawVal_I_A_IAN16 "" UWORD RB_RBA_Common_CentralElements_CompuMethods_Identical 1 100 0.0 65535 FORMAT "%8.2" ECU_ADDRESS 0xfe419552 /end MEASUREMENT
/begin MEASUREMENT Tlib_AdcrFactor_L3_Get_Voltage_I_A_IAN16 "" UWORD RB_RBA_Common_CentralElements_CompuMethods_Identical 1 100 0.0 65535 FORMAT "%8.2" ECU_ADDRESS 0xfe419554 /end MEASUREMENT
/begin MEASUREMENT Tlib_ADC_L3_Get_FilterVal_I_A_IAN16 "" UBYTE RB_RBA_Common_CentralElements_CompuMethods_Identical 1 100 0.0 255.00 FORMAT "%8.2" ECU_ADDRESS 0xfe4197f9 /end MEASUREMENT
/begin MEASUREMENT Tlib_ADC_L3_Get_ResValue_I_A_IAN16 "" ULONG RB_RBA_Common_CentralElements_CompuMethods_Identical 1 100 0.0 4294967295 FORMAT "%8.2" ECU_ADDRESS 0xfe417b24 /end MEASUREMENT
/begin MEASUREMENT Tlib_ADC_L3_DIAG_Get_Value_I_A_IAN16 "" UWORD RB_RBA_Common_CentralElements_CompuMethods_Identical 1 100 0.0 65535 FORMAT "%8.2" ECU_ADDRESS 0xfe419556 /end MEASUREMENT
/begin MEASUREMENT Tlib_ADC_L3_Get_RawVal_I_A_IAN01 "" UWORD RB_RBA_Common_CentralElements_CompuMethods_Identical 1 100 0.0 65535 FORMAT "%8.2" ECU_ADDRESS 0xfe419558 /end MEASUREMENT
/begin MEASUREMENT Tlib_AdcrFactor_L3_Get_Voltage_I_A_IAN01 "" UWORD RB_RBA_Common_CentralElements_CompuMethods_Identical 1 100 0.0 65535 FORMAT "%8.2" ECU_ADDRESS 0xfe41955a /end MEASUREMENT
/begin MEASUREMENT Tlib_ADC_L3_Get_FilterVal_I_A_IAN01 "" UBYTE RB_RBA_Common_CentralElements_CompuMethods_Identical 1 100 0.0 255.00 FORMAT "%8.2" ECU_ADDRESS 0xfe4197fa /end MEASUREMENT
/begin MEASUREMENT Tlib_ADC_L3_Get_ResValue_I_A_IAN01 "" ULONG RB_RBA_Common_CentralElements_CompuMethods_Identical 1 100 0.0 4294967295 FORMAT "%8.2" ECU_ADDRESS 0xfe417b28 /end MEASUREMENT
/begin MEASUREMENT Tlib_ADC_L3_DIAG_Get_Value_I_A_IAN01 "" UWORD RB_RBA_Common_CentralElements_CompuMethods_Identical 1 100 0.0 65535 FORMAT "%8.2" ECU_ADDRESS 0xfe41955c /end MEASUREMENT
/begin MEASUREMENT Tlib_ADC_L3_Get_RawVal_I_A_IAN02 "" UWORD RB_RBA_Common_CentralElements_CompuMethods_Identical 1 100 0.0 65535 FORMAT "%8.2" ECU_ADDRESS 0xfe41955e /end MEASUREMENT
/begin MEASUREMENT Tlib_AdcrFactor_L3_Get_Voltage_I_A_IAN02 "" UWORD RB_RBA_Common_CentralElements_CompuMethods_Identical 1 100 0.0 65535 FORMAT "%8.2" ECU_ADDRESS 0xfe419560 /end MEASUREMENT
/begin MEASUREMENT Tlib_ADC_L3_Get_FilterVal_I_A_IAN02 "" UBYTE RB_RBA_Common_CentralElements_CompuMethods_Identical 1 100 0.0 255.00 FORMAT "%8.2" ECU_ADDRESS 0xfe4197fb /end MEASUREMENT
/begin MEASUREMENT Tlib_ADC_L3_Get_ResValue_I_A_IAN02 "" ULONG RB_RBA_Common_CentralElements_CompuMethods_Identical 1 100 0.0 4294967295 FORMAT "%8.2" ECU_ADDRESS 0xfe417b2c /end MEASUREMENT
/begin MEASUREMENT Tlib_ADC_L3_DIAG_Get_Value_I_A_IAN02 "" UWORD RB_RBA_Common_CentralElements_CompuMethods_Identical 1 100 0.0 65535 FORMAT "%8.2" ECU_ADDRESS 0xfe419562 /end MEASUREMENT
/begin MEASUREMENT Tlib_ADC_L3_Get_RawVal_I_A_IAN03 "" UWORD RB_RBA_Common_CentralElements_CompuMethods_Identical 1 100 0.0 65535 FORMAT "%8.2" ECU_ADDRESS 0xfe419564 /end MEASUREMENT
/begin MEASUREMENT Tlib_AdcrFactor_L3_Get_Voltage_I_A_IAN03 "" UWORD RB_RBA_Common_CentralElements_CompuMethods_Identical 1 100 0.0 65535 FORMAT "%8.2" ECU_ADDRESS 0xfe419566 /end MEASUREMENT
/begin MEASUREMENT Tlib_ADC_L3_Get_FilterVal_I_A_IAN03 "" UBYTE RB_RBA_Common_CentralElements_CompuMethods_Identical 1 100 0.0 255.00 FORMAT "%8.2" ECU_ADDRESS 0xfe4197fc /end MEASUREMENT
/begin MEASUREMENT Tlib_ADC_L3_Get_ResValue_I_A_IAN03 "" ULONG RB_RBA_Common_CentralElements_CompuMethods_Identical 1 100 0.0 4294967295 FORMAT "%8.2" ECU_ADDRESS 0xfe417b30 /end MEASUREMENT
/begin MEASUREMENT Tlib_ADC_L3_DIAG_Get_Value_I_A_IAN03 "" UWORD RB_RBA_Common_CentralElements_CompuMethods_Identical 1 100 0.0 65535 FORMAT "%8.2" ECU_ADDRESS 0xfe419568 /end MEASUREMENT
/begin MEASUREMENT Tlib_ADC_L3_Get_RawVal_I_A_IAN04 "" UWORD RB_RBA_Common_CentralElements_CompuMethods_Identical 1 100 0.0 65535 FORMAT "%8.2" ECU_ADDRESS 0xfe41956a /end MEASUREMENT
/begin MEASUREMENT Tlib_AdcrFactor_L3_Get_Voltage_I_A_IAN04 "" UWORD RB_RBA_Common_CentralElements_CompuMethods_Identical 1 100 0.0 65535 FORMAT "%8.2" ECU_ADDRESS 0xfe41956c /end MEASUREMENT
/begin MEASUREMENT Tlib_ADC_L3_Get_FilterVal_I_A_IAN04 "" UBYTE RB_RBA_Common_CentralElements_CompuMethods_Identical 1 100 0.0 255.00 FORMAT "%8.2" ECU_ADDRESS 0xfe4197fd /end MEASUREMENT
/begin MEASUREMENT Tlib_ADC_L3_Get_ResValue_I_A_IAN04 "" ULONG RB_RBA_Common_CentralElements_CompuMethods_Identical 1 100 0.0 4294967295 FORMAT "%8.2" ECU_ADDRESS 0xfe417b34 /end MEASUREMENT
/begin MEASUREMENT Tlib_ADC_L3_DIAG_Get_Value_I_A_IAN04 "" UWORD RB_RBA_Common_CentralElements_CompuMethods_Identical 1 100 0.0 65535 FORMAT "%8.2" ECU_ADDRESS 0xfe41956e /end MEASUREMENT
/begin MEASUREMENT Tlib_ADC_L3_Get_RawVal_I_A_IAN05 "" UWORD RB_RBA_Common_CentralElements_CompuMethods_Identical 1 100 0.0 65535 FORMAT "%8.2" ECU_ADDRESS 0xfe419570 /end MEASUREMENT
/begin MEASUREMENT Tlib_AdcrFactor_L3_Get_Voltage_I_A_IAN05 "" UWORD RB_RBA_Common_CentralElements_CompuMethods_Identical 1 100 0.0 65535 FORMAT "%8.2" ECU_ADDRESS 0xfe419572 /end MEASUREMENT
/begin MEASUREMENT Tlib_ADC_L3_Get_FilterVal_I_A_IAN05 "" UBYTE RB_RBA_Common_CentralElements_CompuMethods_Identical 1 100 0.0 255.00 FORMAT "%8.2" ECU_ADDRESS 0xfe4197fe /end MEASUREMENT
/begin MEASUREMENT Tlib_ADC_L3_Get_ResValue_I_A_IAN05 "" ULONG RB_RBA_Common_CentralElements_CompuMethods_Identical 1 100 0.0 4294967295 FORMAT "%8.2" ECU_ADDRESS 0xfe417b38 /end MEASUREMENT
/begin MEASUREMENT Tlib_ADC_L3_DIAG_Get_Value_I_A_IAN05 "" UWORD RB_RBA_Common_CentralElements_CompuMethods_Identical 1 100 0.0 65535 FORMAT "%8.2" ECU_ADDRESS 0xfe419574 /end MEASUREMENT
/begin MEASUREMENT Tlib_ADC_L3_Get_RawVal_I_A_IAN08 "" UWORD RB_RBA_Common_CentralElements_CompuMethods_Identical 1 100 0.0 65535 FORMAT "%8.2" ECU_ADDRESS 0xfe419576 /end MEASUREMENT
/begin MEASUREMENT Tlib_AdcrFactor_L3_Get_Voltage_I_A_IAN08 "" UWORD RB_RBA_Common_CentralElements_CompuMethods_Identical 1 100 0.0 65535 FORMAT "%8.2" ECU_ADDRESS 0xfe419578 /end MEASUREMENT
/begin MEASUREMENT Tlib_ADC_L3_Get_FilterVal_I_A_IAN08 "" UBYTE RB_RBA_Common_CentralElements_CompuMethods_Identical 1 100 0.0 255.00 FORMAT "%8.2" ECU_ADDRESS 0xfe4197ff /end MEASUREMENT
/begin MEASUREMENT Tlib_ADC_L3_Get_ResValue_I_A_IAN08 "" ULONG RB_RBA_Common_CentralElements_CompuMethods_Identical 1 100 0.0 4294967295 FORMAT "%8.2" ECU_ADDRESS 0xfe417b3c /end MEASUREMENT
/begin MEASUREMENT Tlib_ADC_L3_DIAG_Get_Value_I_A_IAN08 "" UWORD RB_RBA_Common_CentralElements_CompuMethods_Identical 1 100 0.0 65535 FORMAT "%8.2" ECU_ADDRESS 0xfe41957a /end MEASUREMENT
/begin MEASUREMENT Tlib_ADC_L3_Get_RawVal_I_A_IAN09 "" UWORD RB_RBA_Common_CentralElements_CompuMethods_Identical 1 100 0.0 65535 FORMAT "%8.2" ECU_ADDRESS 0xfe41957c /end MEASUREMENT
/begin MEASUREMENT Tlib_AdcrFactor_L3_Get_Voltage_I_A_IAN09 "" UWORD RB_RBA_Common_CentralElements_CompuMethods_Identical 1 100 0.0 65535 FORMAT "%8.2" ECU_ADDRESS 0xfe41957e /end MEASUREMENT
/begin MEASUREMENT Tlib_ADC_L3_Get_FilterVal_I_A_IAN09 "" UBYTE RB_RBA_Common_CentralElements_CompuMethods_Identical 1 100 0.0 255.00 FORMAT "%8.2" ECU_ADDRESS 0xfe419800 /end MEASUREMENT
/begin MEASUREMENT Tlib_ADC_L3_Get_ResValue_I_A_IAN09 "" ULONG RB_RBA_Common_CentralElements_CompuMethods_Identical 1 100 0.0 4294967295 FORMAT "%8.2" ECU_ADDRESS 0xfe417b40 /end MEASUREMENT
/begin MEASUREMENT Tlib_ADC_L3_DIAG_Get_Value_I_A_IAN09 "" UWORD RB_RBA_Common_CentralElements_CompuMethods_Identical 1 100 0.0 65535 FORMAT "%8.2" ECU_ADDRESS 0xfe419580 /end MEASUREMENT
/begin MEASUREMENT Tlib_ADC_L3_Get_RawVal_I_A_IAN17 "" UWORD RB_RBA_Common_CentralElements_CompuMethods_Identical 1 100 0.0 65535 FORMAT "%8.2" ECU_ADDRESS 0xfe419582 /end MEASUREMENT
/begin MEASUREMENT Tlib_AdcrFactor_L3_Get_Voltage_I_A_IAN17 "" UWORD RB_RBA_Common_CentralElements_CompuMethods_Identical 1 100 0.0 65535 FORMAT "%8.2" ECU_ADDRESS 0xfe419584 /end MEASUREMENT
/begin MEASUREMENT Tlib_ADC_L3_Get_FilterVal_I_A_IAN17 "" UBYTE RB_RBA_Common_CentralElements_CompuMethods_Identical 1 100 0.0 255.00 FORMAT "%8.2" ECU_ADDRESS 0xfe419801 /end MEASUREMENT
/begin MEASUREMENT Tlib_ADC_L3_Get_ResValue_I_A_IAN17 "" ULONG RB_RBA_Common_CentralElements_CompuMethods_Identical 1 100 0.0 4294967295 FORMAT "%8.2" ECU_ADDRESS 0xfe417b44 /end MEASUREMENT
/begin MEASUREMENT Tlib_ADC_L3_DIAG_Get_Value_I_A_IAN17 "" UWORD RB_RBA_Common_CentralElements_CompuMethods_Identical 1 100 0.0 65535 FORMAT "%8.2" ECU_ADDRESS 0xfe419586 /end MEASUREMENT
/begin MEASUREMENT Tlib_ADC_L3_Get_RawVal_I_A_IAN18 "" UWORD RB_RBA_Common_CentralElements_CompuMethods_Identical 1 100 0.0 65535 FORMAT "%8.2" ECU_ADDRESS 0xfe419588 /end MEASUREMENT
/begin MEASUREMENT Tlib_AdcrFactor_L3_Get_Voltage_I_A_IAN18 "" UWORD RB_RBA_Common_CentralElements_CompuMethods_Identical 1 100 0.0 65535 FORMAT "%8.2" ECU_ADDRESS 0xfe41958a /end MEASUREMENT
/begin MEASUREMENT Tlib_ADC_L3_Get_FilterVal_I_A_IAN18 "" UBYTE RB_RBA_Common_CentralElements_CompuMethods_Identical 1 100 0.0 255.00 FORMAT "%8.2" ECU_ADDRESS 0xfe419802 /end MEASUREMENT
/begin MEASUREMENT Tlib_ADC_L3_Get_ResValue_I_A_IAN18 "" ULONG RB_RBA_Common_CentralElements_CompuMethods_Identical 1 100 0.0 4294967295 FORMAT "%8.2" ECU_ADDRESS 0xfe417b48 /end MEASUREMENT
/begin MEASUREMENT Tlib_ADC_L3_DIAG_Get_Value_I_A_IAN18 "" UWORD RB_RBA_Common_CentralElements_CompuMethods_Identical 1 100 0.0 65535 FORMAT "%8.2" ECU_ADDRESS 0xfe41958c /end MEASUREMENT
/begin MEASUREMENT Tlib_ADC_L3_Get_RawVal_I_A_IAN19 "" UWORD RB_RBA_Common_CentralElements_CompuMethods_Identical 1 100 0.0 65535 FORMAT "%8.2" ECU_ADDRESS 0xfe41958e /end MEASUREMENT
/begin MEASUREMENT Tlib_AdcrFactor_L3_Get_Voltage_I_A_IAN19 "" UWORD RB_RBA_Common_CentralElements_CompuMethods_Identical 1 100 0.0 65535 FORMAT "%8.2" ECU_ADDRESS 0xfe419590 /end MEASUREMENT
/begin MEASUREMENT Tlib_ADC_L3_Get_FilterVal_I_A_IAN19 "" UBYTE RB_RBA_Common_CentralElements_CompuMethods_Identical 1 100 0.0 255.00 FORMAT "%8.2" ECU_ADDRESS 0xfe419803 /end MEASUREMENT
/begin MEASUREMENT Tlib_ADC_L3_Get_ResValue_I_A_IAN19 "" ULONG RB_RBA_Common_CentralElements_CompuMethods_Identical 1 100 0.0 4294967295 FORMAT "%8.2" ECU_ADDRESS 0xfe417b4c /end MEASUREMENT
/begin MEASUREMENT Tlib_ADC_L3_DIAG_Get_Value_I_A_IAN19 "" UWORD RB_RBA_Common_CentralElements_CompuMethods_Identical 1 100 0.0 65535 FORMAT "%8.2" ECU_ADDRESS 0xfe419592 /end MEASUREMENT
/begin MEASUREMENT Tlib_ADC_L3_Get_RawVal_I_A_IAN12 "" UWORD RB_RBA_Common_CentralElements_CompuMethods_Identical 1 100 0.0 65535 FORMAT "%8.2" ECU_ADDRESS 0xfe419594 /end MEASUREMENT
/begin MEASUREMENT Tlib_AdcrFactor_L3_Get_Voltage_I_A_IAN12 "" UWORD RB_RBA_Common_CentralElements_CompuMethods_Identical 1 100 0.0 65535 FORMAT "%8.2" ECU_ADDRESS 0xfe419596 /end MEASUREMENT
/begin MEASUREMENT Tlib_ADC_L3_Get_FilterVal_I_A_IAN12 "" UBYTE RB_RBA_Common_CentralElements_CompuMethods_Identical 1 100 0.0 255.00 FORMAT "%8.2" ECU_ADDRESS 0xfe419804 /end MEASUREMENT
/begin MEASUREMENT Tlib_ADC_L3_Get_ResValue_I_A_IAN12 "" ULONG RB_RBA_Common_CentralElements_CompuMethods_Identical 1 100 0.0 4294967295 FORMAT "%8.2" ECU_ADDRESS 0xfe417b50 /end MEASUREMENT
/begin MEASUREMENT Tlib_ADC_L3_DIAG_Get_Value_I_A_IAN12 "" UWORD RB_RBA_Common_CentralElements_CompuMethods_Identical 1 100 0.0 65535 FORMAT "%8.2" ECU_ADDRESS 0xfe419598 /end MEASUREMENT
/begin MEASUREMENT Tlib_ADC_L3_Get_RawVal_I_A_IAN20 "" UWORD RB_RBA_Common_CentralElements_CompuMethods_Identical 1 100 0.0 65535 FORMAT "%8.2" ECU_ADDRESS 0xfe41959a /end MEASUREMENT
/begin MEASUREMENT Tlib_AdcrFactor_L3_Get_Voltage_I_A_IAN20 "" UWORD RB_RBA_Common_CentralElements_CompuMethods_Identical 1 100 0.0 65535 FORMAT "%8.2" ECU_ADDRESS 0xfe41959c /end MEASUREMENT
/begin MEASUREMENT Tlib_ADC_L3_Get_FilterVal_I_A_IAN20 "" UBYTE RB_RBA_Common_CentralElements_CompuMethods_Identical 1 100 0.0 255.00 FORMAT "%8.2" ECU_ADDRESS 0xfe419805 /end MEASUREMENT
/begin MEASUREMENT Tlib_ADC_L3_Get_ResValue_I_A_IAN20 "" ULONG RB_RBA_Common_CentralElements_CompuMethods_Identical 1 100 0.0 4294967295 FORMAT "%8.2" ECU_ADDRESS 0xfe417b54 /end MEASUREMENT
/begin MEASUREMENT Tlib_ADC_L3_DIAG_Get_Value_I_A_IAN20 "" UWORD RB_RBA_Common_CentralElements_CompuMethods_Identical 1 100 0.0 65535 FORMAT "%8.2" ECU_ADDRESS 0xfe41959e /end MEASUREMENT
/begin MEASUREMENT Tlib_ADC_L3_Get_RawVal_I_A_IAN15 "" UWORD RB_RBA_Common_CentralElements_CompuMethods_Identical 1 100 0.0 65535 FORMAT "%8.2" ECU_ADDRESS 0xfe4195a0 /end MEASUREMENT
/begin MEASUREMENT Tlib_AdcrFactor_L3_Get_Voltage_I_A_IAN15 "" UWORD RB_RBA_Common_CentralElements_CompuMethods_Identical 1 100 0.0 65535 FORMAT "%8.2" ECU_ADDRESS 0xfe4195a2 /end MEASUREMENT
/begin MEASUREMENT Tlib_ADC_L3_Get_FilterVal_I_A_IAN15 "" UBYTE RB_RBA_Common_CentralElements_CompuMethods_Identical 1 100 0.0 255.00 FORMAT "%8.2" ECU_ADDRESS 0xfe419806 /end MEASUREMENT
/begin MEASUREMENT Tlib_ADC_L3_Get_ResValue_I_A_IAN15 "" ULONG RB_RBA_Common_CentralElements_CompuMethods_Identical 1 100 0.0 4294967295 FORMAT "%8.2" ECU_ADDRESS 0xfe417b58 /end MEASUREMENT
/begin MEASUREMENT Tlib_ADC_L3_DIAG_Get_Value_I_A_IAN15 "" UWORD RB_RBA_Common_CentralElements_CompuMethods_Identical 1 100 0.0 65535 FORMAT "%8.2" ECU_ADDRESS 0xfe4195a4 /end MEASUREMENT
/begin MEASUREMENT Tlib_ADC_L3_Get_RawVal_I_A_IAN52 "" UWORD RB_RBA_Common_CentralElements_CompuMethods_Identical 1 100 0.0 65535 FORMAT "%8.2" ECU_ADDRESS 0xfe4195a6 /end MEASUREMENT
/begin MEASUREMENT Tlib_AdcrFactor_L3_Get_Voltage_I_A_IAN52 "" UWORD RB_RBA_Common_CentralElements_CompuMethods_Identical 1 100 0.0 65535 FORMAT "%8.2" ECU_ADDRESS 0xfe4195a8 /end MEASUREMENT
/begin MEASUREMENT Tlib_ADC_L3_Get_FilterVal_I_A_IAN52 "" UBYTE RB_RBA_Common_CentralElements_CompuMethods_Identical 1 100 0.0 255.00 FORMAT "%8.2" ECU_ADDRESS 0xfe419807 /end MEASUREMENT
/begin MEASUREMENT Tlib_ADC_L3_Get_ResValue_I_A_IAN52 "" ULONG RB_RBA_Common_CentralElements_CompuMethods_Identical 1 100 0.0 4294967295 FORMAT "%8.2" ECU_ADDRESS 0xfe417b5c /end MEASUREMENT
/begin MEASUREMENT Tlib_ADC_L3_DIAG_Get_Value_I_A_IAN52 "" UWORD RB_RBA_Common_CentralElements_CompuMethods_Identical 1 100 0.0 65535 FORMAT "%8.2" ECU_ADDRESS 0xfe4195aa /end MEASUREMENT
/begin MEASUREMENT Tlib_ADC_L3_Get_RawVal_I_A_IAN53 "" UWORD RB_RBA_Common_CentralElements_CompuMethods_Identical 1 100 0.0 65535 FORMAT "%8.2" ECU_ADDRESS 0xfe4195ac /end MEASUREMENT
/begin MEASUREMENT Tlib_AdcrFactor_L3_Get_Voltage_I_A_IAN53 "" UWORD RB_RBA_Common_CentralElements_CompuMethods_Identical 1 100 0.0 65535 FORMAT "%8.2" ECU_ADDRESS 0xfe4195ae /end MEASUREMENT
/begin MEASUREMENT Tlib_ADC_L3_Get_FilterVal_I_A_IAN53 "" UBYTE RB_RBA_Common_CentralElements_CompuMethods_Identical 1 100 0.0 255.00 FORMAT "%8.2" ECU_ADDRESS 0xfe419808 /end MEASUREMENT
/begin MEASUREMENT Tlib_ADC_L3_Get_ResValue_I_A_IAN53 "" ULONG RB_RBA_Common_CentralElements_CompuMethods_Identical 1 100 0.0 4294967295 FORMAT "%8.2" ECU_ADDRESS 0xfe417b60 /end MEASUREMENT
/begin MEASUREMENT Tlib_ADC_L3_DIAG_Get_Value_I_A_IAN53 "" UWORD RB_RBA_Common_CentralElements_CompuMethods_Identical 1 100 0.0 65535 FORMAT "%8.2" ECU_ADDRESS 0xfe4195b0 /end MEASUREMENT
/begin MEASUREMENT Tlib_ADC_L3_Get_RawVal_I_A_IAN54 "" UWORD RB_RBA_Common_CentralElements_CompuMethods_Identical 1 100 0.0 65535 FORMAT "%8.2" ECU_ADDRESS 0xfe4195b2 /end MEASUREMENT
/begin MEASUREMENT Tlib_AdcrFactor_L3_Get_Voltage_I_A_IAN54 "" UWORD RB_RBA_Common_CentralElements_CompuMethods_Identical 1 100 0.0 65535 FORMAT "%8.2" ECU_ADDRESS 0xfe4195b4 /end MEASUREMENT
/begin MEASUREMENT Tlib_ADC_L3_Get_FilterVal_I_A_IAN54 "" UBYTE RB_RBA_Common_CentralElements_CompuMethods_Identical 1 100 0.0 255.00 FORMAT "%8.2" ECU_ADDRESS 0xfe419809 /end MEASUREMENT
/begin MEASUREMENT Tlib_ADC_L3_Get_ResValue_I_A_IAN54 "" ULONG RB_RBA_Common_CentralElements_CompuMethods_Identical 1 100 0.0 4294967295 FORMAT "%8.2" ECU_ADDRESS 0xfe417b64 /end MEASUREMENT
/begin MEASUREMENT Tlib_ADC_L3_DIAG_Get_Value_I_A_IAN54 "" UWORD RB_RBA_Common_CentralElements_CompuMethods_Identical 1 100 0.0 65535 FORMAT "%8.2" ECU_ADDRESS 0xfe4195b6 /end MEASUREMENT
/begin MEASUREMENT Tlib_ADC_L3_Get_RawVal_I_A_IAN83 "" UWORD RB_RBA_Common_CentralElements_CompuMethods_Identical 1 100 0.0 65535 FORMAT "%8.2" ECU_ADDRESS 0xfe4195b8 /end MEASUREMENT
/begin MEASUREMENT Tlib_AdcrFactor_L3_Get_Voltage_I_A_IAN83 "" UWORD RB_RBA_Common_CentralElements_CompuMethods_Identical 1 100 0.0 65535 FORMAT "%8.2" ECU_ADDRESS 0xfe4195ba /end MEASUREMENT
/begin MEASUREMENT Tlib_ADC_L3_Get_FilterVal_I_A_IAN83 "" UBYTE RB_RBA_Common_CentralElements_CompuMethods_Identical 1 100 0.0 255.00 FORMAT "%8.2" ECU_ADDRESS 0xfe41980a /end MEASUREMENT
/begin MEASUREMENT Tlib_ADC_L3_Get_ResValue_I_A_IAN83 "" ULONG RB_RBA_Common_CentralElements_CompuMethods_Identical 1 100 0.0 4294967295 FORMAT "%8.2" ECU_ADDRESS 0xfe417b68 /end MEASUREMENT
/begin MEASUREMENT Tlib_ADC_L3_DIAG_Get_Value_I_A_IAN83 "" UWORD RB_RBA_Common_CentralElements_CompuMethods_Identical 1 100 0.0 65535 FORMAT "%8.2" ECU_ADDRESS 0xfe4195bc /end MEASUREMENT
/begin MEASUREMENT Tlib_ADC_L3_Get_RawVal_I_A_KL30C "" UWORD RB_RBA_Common_CentralElements_CompuMethods_Identical 1 100 0.0 65535 FORMAT "%8.2" ECU_ADDRESS 0xfe4195be /end MEASUREMENT
/begin MEASUREMENT Tlib_AdcrFactor_L3_Get_Voltage_I_A_KL30C "" UWORD RB_RBA_Common_CentralElements_CompuMethods_Identical 1 100 0.0 65535 FORMAT "%8.2" ECU_ADDRESS 0xfe4195c0 /end MEASUREMENT
/begin MEASUREMENT Tlib_ADC_L3_Get_FilterVal_I_A_KL30C "" UBYTE RB_RBA_Common_CentralElements_CompuMethods_Identical 1 100 0.0 255.00 FORMAT "%8.2" ECU_ADDRESS 0xfe41980b /end MEASUREMENT
/begin MEASUREMENT Tlib_ADC_L3_Get_ResValue_I_A_KL30C "" ULONG RB_RBA_Common_CentralElements_CompuMethods_Identical 1 100 0.0 4294967295 FORMAT "%8.2" ECU_ADDRESS 0xfe417b6c /end MEASUREMENT
/begin MEASUREMENT Tlib_ADC_L3_DIAG_Get_Value_I_A_KL30C "" UWORD RB_RBA_Common_CentralElements_CompuMethods_Identical 1 100 0.0 65535 FORMAT "%8.2" ECU_ADDRESS 0xfe4195c2 /end MEASUREMENT
/begin MEASUREMENT Tlib_ADC_L3_Get_RawVal_I_A_KL30D "" UWORD RB_RBA_Common_CentralElements_CompuMethods_Identical 1 100 0.0 65535 FORMAT "%8.2" ECU_ADDRESS 0xfe4195c4 /end MEASUREMENT
/begin MEASUREMENT Tlib_AdcrFactor_L3_Get_Voltage_I_A_KL30D "" UWORD RB_RBA_Common_CentralElements_CompuMethods_Identical 1 100 0.0 65535 FORMAT "%8.2" ECU_ADDRESS 0xfe4195c6 /end MEASUREMENT
/begin MEASUREMENT Tlib_ADC_L3_Get_FilterVal_I_A_KL30D "" UBYTE RB_RBA_Common_CentralElements_CompuMethods_Identical 1 100 0.0 255.00 FORMAT "%8.2" ECU_ADDRESS 0xfe41980c /end MEASUREMENT
/begin MEASUREMENT Tlib_ADC_L3_Get_ResValue_I_A_KL30D "" ULONG RB_RBA_Common_CentralElements_CompuMethods_Identical 1 100 0.0 4294967295 FORMAT "%8.2" ECU_ADDRESS 0xfe417b70 /end MEASUREMENT
/begin MEASUREMENT Tlib_ADC_L3_DIAG_Get_Value_I_A_KL30D "" UWORD RB_RBA_Common_CentralElements_CompuMethods_Identical 1 100 0.0 65535 FORMAT "%8.2" ECU_ADDRESS 0xfe4195c8 /end MEASUREMENT
/begin MEASUREMENT Tlib_ADC_L3_Get_RawVal_I_A_VPUP1 "" UWORD RB_RBA_Common_CentralElements_CompuMethods_Identical 1 100 0.0 65535 FORMAT "%8.2" ECU_ADDRESS 0xfe4195ca /end MEASUREMENT
/begin MEASUREMENT Tlib_AdcrFactor_L3_Get_Voltage_I_A_VPUP1 "" UWORD RB_RBA_Common_CentralElements_CompuMethods_Identical 1 100 0.0 65535 FORMAT "%8.2" ECU_ADDRESS 0xfe4195cc /end MEASUREMENT
/begin MEASUREMENT Tlib_ADC_L3_Get_FilterVal_I_A_VPUP1 "" UBYTE RB_RBA_Common_CentralElements_CompuMethods_Identical 1 100 0.0 255.00 FORMAT "%8.2" ECU_ADDRESS 0xfe41980d /end MEASUREMENT
/begin MEASUREMENT Tlib_ADC_L3_Get_ResValue_I_A_VPUP1 "" ULONG RB_RBA_Common_CentralElements_CompuMethods_Identical 1 100 0.0 4294967295 FORMAT "%8.2" ECU_ADDRESS 0xfe417b74 /end MEASUREMENT
/begin MEASUREMENT Tlib_ADC_L3_DIAG_Get_Value_I_A_VPUP1 "" UWORD RB_RBA_Common_CentralElements_CompuMethods_Identical 1 100 0.0 65535 FORMAT "%8.2" ECU_ADDRESS 0xfe4195ce /end MEASUREMENT
/begin MEASUREMENT Tlib_ADC_L3_Get_RawVal_I_A_VPUP2 "" UWORD RB_RBA_Common_CentralElements_CompuMethods_Identical 1 100 0.0 65535 FORMAT "%8.2" ECU_ADDRESS 0xfe4195d0 /end MEASUREMENT
/begin MEASUREMENT Tlib_AdcrFactor_L3_Get_Voltage_I_A_VPUP2 "" UWORD RB_RBA_Common_CentralElements_CompuMethods_Identical 1 100 0.0 65535 FORMAT "%8.2" ECU_ADDRESS 0xfe4195d2 /end MEASUREMENT
/begin MEASUREMENT Tlib_ADC_L3_Get_FilterVal_I_A_VPUP2 "" UBYTE RB_RBA_Common_CentralElements_CompuMethods_Identical 1 100 0.0 255.00 FORMAT "%8.2" ECU_ADDRESS 0xfe41980e /end MEASUREMENT
/begin MEASUREMENT Tlib_ADC_L3_Get_ResValue_I_A_VPUP2 "" ULONG RB_RBA_Common_CentralElements_CompuMethods_Identical 1 100 0.0 4294967295 FORMAT "%8.2" ECU_ADDRESS 0xfe417b78 /end MEASUREMENT
/begin MEASUREMENT Tlib_ADC_L3_DIAG_Get_Value_I_A_VPUP2 "" UWORD RB_RBA_Common_CentralElements_CompuMethods_Identical 1 100 0.0 65535 FORMAT "%8.2" ECU_ADDRESS 0xfe4195d4 /end MEASUREMENT
/begin MEASUREMENT Tlib_ADC_L3_Get_RawVal_I_A_VPUP3 "" UWORD RB_RBA_Common_CentralElements_CompuMethods_Identical 1 100 0.0 65535 FORMAT "%8.2" ECU_ADDRESS 0xfe4195d6 /end MEASUREMENT
/begin MEASUREMENT Tlib_AdcrFactor_L3_Get_Voltage_I_A_VPUP3 "" UWORD RB_RBA_Common_CentralElements_CompuMethods_Identical 1 100 0.0 65535 FORMAT "%8.2" ECU_ADDRESS 0xfe4195d8 /end MEASUREMENT
/begin MEASUREMENT Tlib_ADC_L3_Get_FilterVal_I_A_VPUP3 "" UBYTE RB_RBA_Common_CentralElements_CompuMethods_Identical 1 100 0.0 255.00 FORMAT "%8.2" ECU_ADDRESS 0xfe41980f /end MEASUREMENT
/begin MEASUREMENT Tlib_ADC_L3_Get_ResValue_I_A_VPUP3 "" ULONG RB_RBA_Common_CentralElements_CompuMethods_Identical 1 100 0.0 4294967295 FORMAT "%8.2" ECU_ADDRESS 0xfe417b7c /end MEASUREMENT
/begin MEASUREMENT Tlib_ADC_L3_DIAG_Get_Value_I_A_VPUP3 "" UWORD RB_RBA_Common_CentralElements_CompuMethods_Identical 1 100 0.0 65535 FORMAT "%8.2" ECU_ADDRESS 0xfe4195da /end MEASUREMENT
/begin MEASUREMENT Tlib_ADC_L3_Get_RawVal_I_A_QVR_5V_SW "" UWORD RB_RBA_Common_CentralElements_CompuMethods_Identical 1 100 0.0 65535 FORMAT "%8.2" ECU_ADDRESS 0xfe4195dc /end MEASUREMENT
/begin MEASUREMENT Tlib_AdcrFactor_L3_Get_Voltage_I_A_QVR_5V_SW "" UWORD RB_RBA_Common_CentralElements_CompuMethods_Identical 1 100 0.0 65535 FORMAT "%8.2" ECU_ADDRESS 0xfe4195de /end MEASUREMENT
/begin MEASUREMENT Tlib_ADC_L3_Get_FilterVal_I_A_QVR_5V_SW "" UBYTE RB_RBA_Common_CentralElements_CompuMethods_Identical 1 100 0.0 255.00 FORMAT "%8.2" ECU_ADDRESS 0xfe419810 /end MEASUREMENT
/begin MEASUREMENT Tlib_ADC_L3_Get_ResValue_I_A_QVR_5V_SW "" ULONG RB_RBA_Common_CentralElements_CompuMethods_Identical 1 100 0.0 4294967295 FORMAT "%8.2" ECU_ADDRESS 0xfe417b80 /end MEASUREMENT
/begin MEASUREMENT Tlib_ADC_L3_DIAG_Get_Value_I_A_QVR_5V_SW "" UWORD RB_RBA_Common_CentralElements_CompuMethods_Identical 1 100 0.0 65535 FORMAT "%8.2" ECU_ADDRESS 0xfe4195e0 /end MEASUREMENT
/begin MEASUREMENT Tlib_ADC_L3_Get_RawVal_I_A_5V_SW "" UWORD RB_RBA_Common_CentralElements_CompuMethods_Identical 1 100 0.0 65535 FORMAT "%8.2" ECU_ADDRESS 0xfe4195e2 /end MEASUREMENT
/begin MEASUREMENT Tlib_AdcrFactor_L3_Get_Voltage_I_A_5V_SW "" UWORD RB_RBA_Common_CentralElements_CompuMethods_Identical 1 100 0.0 65535 FORMAT "%8.2" ECU_ADDRESS 0xfe4195e4 /end MEASUREMENT
/begin MEASUREMENT Tlib_ADC_L3_Get_FilterVal_I_A_5V_SW "" UBYTE RB_RBA_Common_CentralElements_CompuMethods_Identical 1 100 0.0 255.00 FORMAT "%8.2" ECU_ADDRESS 0xfe419811 /end MEASUREMENT
/begin MEASUREMENT Tlib_ADC_L3_Get_ResValue_I_A_5V_SW "" ULONG RB_RBA_Common_CentralElements_CompuMethods_Identical 1 100 0.0 4294967295 FORMAT "%8.2" ECU_ADDRESS 0xfe417b84 /end MEASUREMENT
/begin MEASUREMENT Tlib_ADC_L3_DIAG_Get_Value_I_A_5V_SW "" UWORD RB_RBA_Common_CentralElements_CompuMethods_Identical 1 100 0.0 65535 FORMAT "%8.2" ECU_ADDRESS 0xfe4195e6 /end MEASUREMENT
/begin MEASUREMENT Tlib_DIO_L3_Get_Val_I_S_IDL06 "" UBYTE RB_RBA_Common_CentralElements_CompuMethods_Identical 1 100 0.0 255.00 FORMAT "%8.2" ECU_ADDRESS 0xfe419812 /end MEASUREMENT
/begin MEASUREMENT Tlib_DI_L3_Get_FilterVal_I_S_IDL06 "" UBYTE RB_RBA_Common_CentralElements_CompuMethods_Identical 1 100 0.0 255.00 FORMAT "%8.2" ECU_ADDRESS 0xfe419813 /end MEASUREMENT
/begin MEASUREMENT Tlib_DI_L3_DIAG_Get_Val_I_S_IDL06 "" UWORD RB_RBA_Common_CentralElements_CompuMethods_Identical 1 100 0.0 65535 FORMAT "%8.2" ECU_ADDRESS 0xfe4195e8 /end MEASUREMENT
/begin MEASUREMENT Tlib_DIO_L3_Get_Val_I_S_IDL01 "" UBYTE RB_RBA_Common_CentralElements_CompuMethods_Identical 1 100 0.0 255.00 FORMAT "%8.2" ECU_ADDRESS 0xfe419814 /end MEASUREMENT
/begin MEASUREMENT Tlib_DI_L3_Get_FilterVal_I_S_IDL01 "" UBYTE RB_RBA_Common_CentralElements_CompuMethods_Identical 1 100 0.0 255.00 FORMAT "%8.2" ECU_ADDRESS 0xfe419815 /end MEASUREMENT
/begin MEASUREMENT Tlib_DI_L3_DIAG_Get_Val_I_S_IDL01 "" UWORD RB_RBA_Common_CentralElements_CompuMethods_Identical 1 100 0.0 65535 FORMAT "%8.2" ECU_ADDRESS 0xfe4195ea /end MEASUREMENT
/begin MEASUREMENT Tlib_DIO_L3_Get_Val_I_S_IDL12 "" UBYTE RB_RBA_Common_CentralElements_CompuMethods_Identical 1 100 0.0 255.00 FORMAT "%8.2" ECU_ADDRESS 0xfe419816 /end MEASUREMENT
/begin MEASUREMENT Tlib_DI_L3_Get_FilterVal_I_S_IDL12 "" UBYTE RB_RBA_Common_CentralElements_CompuMethods_Identical 1 100 0.0 255.00 FORMAT "%8.2" ECU_ADDRESS 0xfe419817 /end MEASUREMENT
/begin MEASUREMENT Tlib_DI_L3_DIAG_Get_Val_I_S_IDL12 "" UWORD RB_RBA_Common_CentralElements_CompuMethods_Identical 1 100 0.0 65535 FORMAT "%8.2" ECU_ADDRESS 0xfe4195ec /end MEASUREMENT
/begin MEASUREMENT Tlib_DIO_L3_Get_Val_I_S_IDL18 "" UBYTE RB_RBA_Common_CentralElements_CompuMethods_Identical 1 100 0.0 255.00 FORMAT "%8.2" ECU_ADDRESS 0xfe419818 /end MEASUREMENT
/begin MEASUREMENT Tlib_DI_L3_Get_FilterVal_I_S_IDL18 "" UBYTE RB_RBA_Common_CentralElements_CompuMethods_Identical 1 100 0.0 255.00 FORMAT "%8.2" ECU_ADDRESS 0xfe419819 /end MEASUREMENT
/begin MEASUREMENT Tlib_DI_L3_DIAG_Get_Val_I_S_IDL18 "" UWORD RB_RBA_Common_CentralElements_CompuMethods_Identical 1 100 0.0 65535 FORMAT "%8.2" ECU_ADDRESS 0xfe4195ee /end MEASUREMENT
/begin MEASUREMENT Tlib_DIO_L3_Get_Val_I_S_IDL33 "" UBYTE RB_RBA_Common_CentralElements_CompuMethods_Identical 1 100 0.0 255.00 FORMAT "%8.2" ECU_ADDRESS 0xfe41981a /end MEASUREMENT
/begin MEASUREMENT Tlib_DI_L3_Get_FilterVal_I_S_IDL33 "" UBYTE RB_RBA_Common_CentralElements_CompuMethods_Identical 1 100 0.0 255.00 FORMAT "%8.2" ECU_ADDRESS 0xfe41981b /end MEASUREMENT
/begin MEASUREMENT Tlib_DI_L3_DIAG_Get_Val_I_S_IDL33 "" UWORD RB_RBA_Common_CentralElements_CompuMethods_Identical 1 100 0.0 65535 FORMAT "%8.2" ECU_ADDRESS 0xfe4195f0 /end MEASUREMENT
/begin MEASUREMENT Tlib_DIO_L3_Get_Val_I_S_IDL24 "" UBYTE RB_RBA_Common_CentralElements_CompuMethods_Identical 1 100 0.0 255.00 FORMAT "%8.2" ECU_ADDRESS 0xfe41981c /end MEASUREMENT
/begin MEASUREMENT Tlib_DI_L3_Get_FilterVal_I_S_IDL24 "" UBYTE RB_RBA_Common_CentralElements_CompuMethods_Identical 1 100 0.0 255.00 FORMAT "%8.2" ECU_ADDRESS 0xfe41981d /end MEASUREMENT
/begin MEASUREMENT Tlib_DI_L3_DIAG_Get_Val_I_S_IDL24 "" UWORD RB_RBA_Common_CentralElements_CompuMethods_Identical 1 100 0.0 65535 FORMAT "%8.2" ECU_ADDRESS 0xfe4195f2 /end MEASUREMENT
/begin MEASUREMENT Tlib_DIO_L3_Get_Val_I_S_IDL20 "" UBYTE RB_RBA_Common_CentralElements_CompuMethods_Identical 1 100 0.0 255.00 FORMAT "%8.2" ECU_ADDRESS 0xfe41981e /end MEASUREMENT
/begin MEASUREMENT Tlib_DI_L3_Get_FilterVal_I_S_IDL20 "" UBYTE RB_RBA_Common_CentralElements_CompuMethods_Identical 1 100 0.0 255.00 FORMAT "%8.2" ECU_ADDRESS 0xfe41981f /end MEASUREMENT
/begin MEASUREMENT Tlib_DI_L3_DIAG_Get_Val_I_S_IDL20 "" UWORD RB_RBA_Common_CentralElements_CompuMethods_Identical 1 100 0.0 65535 FORMAT "%8.2" ECU_ADDRESS 0xfe4195f4 /end MEASUREMENT
/begin MEASUREMENT Tlib_DIO_L3_Get_Val_I_S_IDL21 "" UBYTE RB_RBA_Common_CentralElements_CompuMethods_Identical 1 100 0.0 255.00 FORMAT "%8.2" ECU_ADDRESS 0xfe419820 /end MEASUREMENT
/begin MEASUREMENT Tlib_DI_L3_Get_FilterVal_I_S_IDL21 "" UBYTE RB_RBA_Common_CentralElements_CompuMethods_Identical 1 100 0.0 255.00 FORMAT "%8.2" ECU_ADDRESS 0xfe419821 /end MEASUREMENT
/begin MEASUREMENT Tlib_DI_L3_DIAG_Get_Val_I_S_IDL21 "" UWORD RB_RBA_Common_CentralElements_CompuMethods_Identical 1 100 0.0 65535 FORMAT "%8.2" ECU_ADDRESS 0xfe4195f6 /end MEASUREMENT
/begin MEASUREMENT Tlib_DIO_L3_Get_Val_I_S_IDL25 "" UBYTE RB_RBA_Common_CentralElements_CompuMethods_Identical 1 100 0.0 255.00 FORMAT "%8.2" ECU_ADDRESS 0xfe419822 /end MEASUREMENT
/begin MEASUREMENT Tlib_DI_L3_Get_FilterVal_I_S_IDL25 "" UBYTE RB_RBA_Common_CentralElements_CompuMethods_Identical 1 100 0.0 255.00 FORMAT "%8.2" ECU_ADDRESS 0xfe419823 /end MEASUREMENT
/begin MEASUREMENT Tlib_DI_L3_DIAG_Get_Val_I_S_IDL25 "" UWORD RB_RBA_Common_CentralElements_CompuMethods_Identical 1 100 0.0 65535 FORMAT "%8.2" ECU_ADDRESS 0xfe4195f8 /end MEASUREMENT
/begin MEASUREMENT Tlib_DIO_L3_Get_Val_I_S_IDL32 "" UBYTE RB_RBA_Common_CentralElements_CompuMethods_Identical 1 100 0.0 255.00 FORMAT "%8.2" ECU_ADDRESS 0xfe419824 /end MEASUREMENT
/begin MEASUREMENT Tlib_DI_L3_Get_FilterVal_I_S_IDL32 "" UBYTE RB_RBA_Common_CentralElements_CompuMethods_Identical 1 100 0.0 255.00 FORMAT "%8.2" ECU_ADDRESS 0xfe419825 /end MEASUREMENT
/begin MEASUREMENT Tlib_DI_L3_DIAG_Get_Val_I_S_IDL32 "" UWORD RB_RBA_Common_CentralElements_CompuMethods_Identical 1 100 0.0 65535 FORMAT "%8.2" ECU_ADDRESS 0xfe4195fa /end MEASUREMENT
/begin MEASUREMENT Tlib_DIO_L3_Get_Val_I_S_IDL26 "" UBYTE RB_RBA_Common_CentralElements_CompuMethods_Identical 1 100 0.0 255.00 FORMAT "%8.2" ECU_ADDRESS 0xfe419826 /end MEASUREMENT
/begin MEASUREMENT Tlib_DI_L3_Get_FilterVal_I_S_IDL26 "" UBYTE RB_RBA_Common_CentralElements_CompuMethods_Identical 1 100 0.0 255.00 FORMAT "%8.2" ECU_ADDRESS 0xfe419827 /end MEASUREMENT
/begin MEASUREMENT Tlib_DI_L3_DIAG_Get_Val_I_S_IDL26 "" UWORD RB_RBA_Common_CentralElements_CompuMethods_Identical 1 100 0.0 65535 FORMAT "%8.2" ECU_ADDRESS 0xfe4195fc /end MEASUREMENT
/begin MEASUREMENT Tlib_DIO_L3_Get_Val_I_S_IDL27 "" UBYTE RB_RBA_Common_CentralElements_CompuMethods_Identical 1 100 0.0 255.00 FORMAT "%8.2" ECU_ADDRESS 0xfe419828 /end MEASUREMENT
/begin MEASUREMENT Tlib_DI_L3_Get_FilterVal_I_S_IDL27 "" UBYTE RB_RBA_Common_CentralElements_CompuMethods_Identical 1 100 0.0 255.00 FORMAT "%8.2" ECU_ADDRESS 0xfe419829 /end MEASUREMENT
/begin MEASUREMENT Tlib_DI_L3_DIAG_Get_Val_I_S_IDL27 "" UWORD RB_RBA_Common_CentralElements_CompuMethods_Identical 1 100 0.0 65535 FORMAT "%8.2" ECU_ADDRESS 0xfe4195fe /end MEASUREMENT
/begin MEASUREMENT Tlib_DIO_L3_Get_Val_I_S_IDL28 "" UBYTE RB_RBA_Common_CentralElements_CompuMethods_Identical 1 100 0.0 255.00 FORMAT "%8.2" ECU_ADDRESS 0xfe41982a /end MEASUREMENT
/begin MEASUREMENT Tlib_DI_L3_Get_FilterVal_I_S_IDL28 "" UBYTE RB_RBA_Common_CentralElements_CompuMethods_Identical 1 100 0.0 255.00 FORMAT "%8.2" ECU_ADDRESS 0xfe41982b /end MEASUREMENT
/begin MEASUREMENT Tlib_DI_L3_DIAG_Get_Val_I_S_IDL28 "" UWORD RB_RBA_Common_CentralElements_CompuMethods_Identical 1 100 0.0 65535 FORMAT "%8.2" ECU_ADDRESS 0xfe419600 /end MEASUREMENT
/begin MEASUREMENT Tlib_DIO_L3_Get_Val_I_S_IDL29 "" UBYTE RB_RBA_Common_CentralElements_CompuMethods_Identical 1 100 0.0 255.00 FORMAT "%8.2" ECU_ADDRESS 0xfe41982c /end MEASUREMENT
/begin MEASUREMENT Tlib_DI_L3_Get_FilterVal_I_S_IDL29 "" UBYTE RB_RBA_Common_CentralElements_CompuMethods_Identical 1 100 0.0 255.00 FORMAT "%8.2" ECU_ADDRESS 0xfe41982d /end MEASUREMENT
/begin MEASUREMENT Tlib_DI_L3_DIAG_Get_Val_I_S_IDL29 "" UWORD RB_RBA_Common_CentralElements_CompuMethods_Identical 1 100 0.0 65535 FORMAT "%8.2" ECU_ADDRESS 0xfe419602 /end MEASUREMENT
/begin MEASUREMENT Tlib_DIO_L3_Get_Val_I_S_IDL30 "" UBYTE RB_RBA_Common_CentralElements_CompuMethods_Identical 1 100 0.0 255.00 FORMAT "%8.2" ECU_ADDRESS 0xfe41982e /end MEASUREMENT
/begin MEASUREMENT Tlib_DI_L3_Get_FilterVal_I_S_IDL30 "" UBYTE RB_RBA_Common_CentralElements_CompuMethods_Identical 1 100 0.0 255.00 FORMAT "%8.2" ECU_ADDRESS 0xfe41982f /end MEASUREMENT
/begin MEASUREMENT Tlib_DI_L3_DIAG_Get_Val_I_S_IDL30 "" UWORD RB_RBA_Common_CentralElements_CompuMethods_Identical 1 100 0.0 65535 FORMAT "%8.2" ECU_ADDRESS 0xfe419604 /end MEASUREMENT
/begin MEASUREMENT Tlib_DIO_L3_Get_Val_I_S_IDL34 "" UBYTE RB_RBA_Common_CentralElements_CompuMethods_Identical 1 100 0.0 255.00 FORMAT "%8.2" ECU_ADDRESS 0xfe419830 /end MEASUREMENT
/begin MEASUREMENT Tlib_DI_L3_Get_FilterVal_I_S_IDL34 "" UBYTE RB_RBA_Common_CentralElements_CompuMethods_Identical 1 100 0.0 255.00 FORMAT "%8.2" ECU_ADDRESS 0xfe419831 /end MEASUREMENT
/begin MEASUREMENT Tlib_DI_L3_DIAG_Get_Val_I_S_IDL34 "" UWORD RB_RBA_Common_CentralElements_CompuMethods_Identical 1 100 0.0 65535 FORMAT "%8.2" ECU_ADDRESS 0xfe419606 /end MEASUREMENT
/begin MEASUREMENT Tlib_DIO_L3_Get_Val_I_S_IDL36 "" UBYTE RB_RBA_Common_CentralElements_CompuMethods_Identical 1 100 0.0 255.00 FORMAT "%8.2" ECU_ADDRESS 0xfe419832 /end MEASUREMENT
/begin MEASUREMENT Tlib_DI_L3_Get_FilterVal_I_S_IDL36 "" UBYTE RB_RBA_Common_CentralElements_CompuMethods_Identical 1 100 0.0 255.00 FORMAT "%8.2" ECU_ADDRESS 0xfe419833 /end MEASUREMENT
/begin MEASUREMENT Tlib_DI_L3_DIAG_Get_Val_I_S_IDL36 "" UWORD RB_RBA_Common_CentralElements_CompuMethods_Identical 1 100 0.0 65535 FORMAT "%8.2" ECU_ADDRESS 0xfe419608 /end MEASUREMENT
/begin MEASUREMENT Tlib_DIO_L3_Get_Val_I_S_IDL03 "" UBYTE RB_RBA_Common_CentralElements_CompuMethods_Identical 1 100 0.0 255.00 FORMAT "%8.2" ECU_ADDRESS 0xfe419834 /end MEASUREMENT
/begin MEASUREMENT Tlib_DI_L3_Get_FilterVal_I_S_IDL03 "" UBYTE RB_RBA_Common_CentralElements_CompuMethods_Identical 1 100 0.0 255.00 FORMAT "%8.2" ECU_ADDRESS 0xfe419835 /end MEASUREMENT
/begin MEASUREMENT Tlib_DI_L3_DIAG_Get_Val_I_S_IDL03 "" UWORD RB_RBA_Common_CentralElements_CompuMethods_Identical 1 100 0.0 65535 FORMAT "%8.2" ECU_ADDRESS 0xfe41960a /end MEASUREMENT
/begin MEASUREMENT Tlib_DIO_L3_Get_Val_I_S_IAN83 "" UBYTE RB_RBA_Common_CentralElements_CompuMethods_Identical 1 100 0.0 255.00 FORMAT "%8.2" ECU_ADDRESS 0xfe419836 /end MEASUREMENT
/begin MEASUREMENT Tlib_DI_L3_Get_FilterVal_I_S_IAN83 "" UBYTE RB_RBA_Common_CentralElements_CompuMethods_Identical 1 100 0.0 255.00 FORMAT "%8.2" ECU_ADDRESS 0xfe419837 /end MEASUREMENT
/begin MEASUREMENT Tlib_DI_L3_DIAG_Get_Val_I_S_IAN83 "" UWORD RB_RBA_Common_CentralElements_CompuMethods_Identical 1 100 0.0 65535 FORMAT "%8.2" ECU_ADDRESS 0xfe41960c /end MEASUREMENT
/begin MEASUREMENT Tlib_DIO_L3_Get_Val_I_S_IPL02 "" UBYTE RB_RBA_Common_CentralElements_CompuMethods_Identical 1 100 0.0 255.00 FORMAT "%8.2" ECU_ADDRESS 0xfe419838 /end MEASUREMENT
/begin MEASUREMENT Tlib_DI_L3_Get_FilterVal_I_S_IPL02 "" UBYTE RB_RBA_Common_CentralElements_CompuMethods_Identical 1 100 0.0 255.00 FORMAT "%8.2" ECU_ADDRESS 0xfe419839 /end MEASUREMENT
/begin MEASUREMENT Tlib_DI_L3_DIAG_Get_Val_I_S_IPL02 "" UWORD RB_RBA_Common_CentralElements_CompuMethods_Identical 1 100 0.0 65535 FORMAT "%8.2" ECU_ADDRESS 0xfe41960e /end MEASUREMENT
/begin MEASUREMENT Tlib_DIO_L3_Get_Val_I_S_IDL35 "" UBYTE RB_RBA_Common_CentralElements_CompuMethods_Identical 1 100 0.0 255.00 FORMAT "%8.2" ECU_ADDRESS 0xfe41983a /end MEASUREMENT
/begin MEASUREMENT Tlib_DI_L3_Get_FilterVal_I_S_IDL35 "" UBYTE RB_RBA_Common_CentralElements_CompuMethods_Identical 1 100 0.0 255.00 FORMAT "%8.2" ECU_ADDRESS 0xfe41983b /end MEASUREMENT
/begin MEASUREMENT Tlib_DI_L3_DIAG_Get_Val_I_S_IDL35 "" UWORD RB_RBA_Common_CentralElements_CompuMethods_Identical 1 100 0.0 65535 FORMAT "%8.2" ECU_ADDRESS 0xfe419610 /end MEASUREMENT
/begin MEASUREMENT Tlib_DIO_L3_GetStatus_Val_O_S_5V05 "" UBYTE RB_RBA_Common_CentralElements_CompuMethods_Identical 1 100 0.0 255.00 FORMAT "%8.2" ECU_ADDRESS 0xfe41983c /end MEASUREMENT
/begin MEASUREMENT Tlib_Efuse_L3_GetCurrent_Val_I_C_5V05 "" ULONG RB_RBA_Common_CentralElements_CompuMethods_Identical 1 100 0.0 4294967295 FORMAT "%8.2" ECU_ADDRESS 0xfe417b88 /end MEASUREMENT
/begin MEASUREMENT Tlib_Efuse_L3_GetVoltage_Val_O_S_5V05 "" UWORD RB_RBA_Common_CentralElements_CompuMethods_Identical 1 100 0.0 65535 FORMAT "%8.2" ECU_ADDRESS 0xfe419612 /end MEASUREMENT
/begin MEASUREMENT Tlib_DoVoltage_L3_Get_FilterVal_O_S_5V05 "" UBYTE RB_RBA_Common_CentralElements_CompuMethods_Identical 1 100 0.0 255.00 FORMAT "%8.2" ECU_ADDRESS 0xfe41983d /end MEASUREMENT
/begin MEASUREMENT Tlib_DO_L3_DIAG_Get_Val_O_S_5V05 "" UWORD RB_RBA_Common_CentralElements_CompuMethods_Identical 1 100 0.0 65535 FORMAT "%8.2" ECU_ADDRESS 0xfe419614 /end MEASUREMENT
/begin MEASUREMENT Tlib_DIO_L3_GetStatus_Val_O_S_5V02 "" UBYTE RB_RBA_Common_CentralElements_CompuMethods_Identical 1 100 0.0 255.00 FORMAT "%8.2" ECU_ADDRESS 0xfe41983e /end MEASUREMENT
/begin MEASUREMENT Tlib_Efuse_L3_GetCurrent_Val_I_C_5V02 "" ULONG RB_RBA_Common_CentralElements_CompuMethods_Identical 1 100 0.0 4294967295 FORMAT "%8.2" ECU_ADDRESS 0xfe417b8c /end MEASUREMENT
/begin MEASUREMENT Tlib_Efuse_L3_GetVoltage_Val_O_S_5V02 "" UWORD RB_RBA_Common_CentralElements_CompuMethods_Identical 1 100 0.0 65535 FORMAT "%8.2" ECU_ADDRESS 0xfe419616 /end MEASUREMENT
/begin MEASUREMENT Tlib_DoVoltage_L3_Get_FilterVal_O_S_5V02 "" UBYTE RB_RBA_Common_CentralElements_CompuMethods_Identical 1 100 0.0 255.00 FORMAT "%8.2" ECU_ADDRESS 0xfe41983f /end MEASUREMENT
/begin MEASUREMENT Tlib_DO_L3_DIAG_Get_Val_O_S_5V02 "" UWORD RB_RBA_Common_CentralElements_CompuMethods_Identical 1 100 0.0 65535 FORMAT "%8.2" ECU_ADDRESS 0xfe419618 /end MEASUREMENT
/begin MEASUREMENT Tlib_DIO_L3_GetStatus_Val_O_S_5V06 "" UBYTE RB_RBA_Common_CentralElements_CompuMethods_Identical 1 100 0.0 255.00 FORMAT "%8.2" ECU_ADDRESS 0xfe419840 /end MEASUREMENT
/begin MEASUREMENT Tlib_Efuse_L3_GetCurrent_Val_I_C_5V06 "" ULONG RB_RBA_Common_CentralElements_CompuMethods_Identical 1 100 0.0 4294967295 FORMAT "%8.2" ECU_ADDRESS 0xfe417b90 /end MEASUREMENT
/begin MEASUREMENT Tlib_Efuse_L3_GetVoltage_Val_O_S_5V06 "" UWORD RB_RBA_Common_CentralElements_CompuMethods_Identical 1 100 0.0 65535 FORMAT "%8.2" ECU_ADDRESS 0xfe41961a /end MEASUREMENT
/begin MEASUREMENT Tlib_DoVoltage_L3_Get_FilterVal_O_S_5V06 "" UBYTE RB_RBA_Common_CentralElements_CompuMethods_Identical 1 100 0.0 255.00 FORMAT "%8.2" ECU_ADDRESS 0xfe419841 /end MEASUREMENT
/begin MEASUREMENT Tlib_DO_L3_DIAG_Get_Val_O_S_5V06 "" UWORD RB_RBA_Common_CentralElements_CompuMethods_Identical 1 100 0.0 65535 FORMAT "%8.2" ECU_ADDRESS 0xfe41961c /end MEASUREMENT
/begin MEASUREMENT Tlib_DIO_L3_GetStatus_Val_O_S_5V07 "" UBYTE RB_RBA_Common_CentralElements_CompuMethods_Identical 1 100 0.0 255.00 FORMAT "%8.2" ECU_ADDRESS 0xfe419842 /end MEASUREMENT
/begin MEASUREMENT Tlib_Efuse_L3_GetCurrent_Val_I_C_5V07 "" ULONG RB_RBA_Common_CentralElements_CompuMethods_Identical 1 100 0.0 4294967295 FORMAT "%8.2" ECU_ADDRESS 0xfe417b94 /end MEASUREMENT
/begin MEASUREMENT Tlib_Efuse_L3_GetVoltage_Val_O_S_5V07 "" UWORD RB_RBA_Common_CentralElements_CompuMethods_Identical 1 100 0.0 65535 FORMAT "%8.2" ECU_ADDRESS 0xfe41961e /end MEASUREMENT
/begin MEASUREMENT Tlib_DoVoltage_L3_Get_FilterVal_O_S_5V07 "" UBYTE RB_RBA_Common_CentralElements_CompuMethods_Identical 1 100 0.0 255.00 FORMAT "%8.2" ECU_ADDRESS 0xfe419843 /end MEASUREMENT
/begin MEASUREMENT Tlib_DO_L3_DIAG_Get_Val_O_S_5V07 "" UWORD RB_RBA_Common_CentralElements_CompuMethods_Identical 1 100 0.0 65535 FORMAT "%8.2" ECU_ADDRESS 0xfe419620 /end MEASUREMENT
/begin MEASUREMENT Tlib_DIO_L3_GetStatus_Val_O_S_5V10 "" UBYTE RB_RBA_Common_CentralElements_CompuMethods_Identical 1 100 0.0 255.00 FORMAT "%8.2" ECU_ADDRESS 0xfe419844 /end MEASUREMENT
/begin MEASUREMENT Tlib_Efuse_L3_GetCurrent_Val_I_C_5V10 "" ULONG RB_RBA_Common_CentralElements_CompuMethods_Identical 1 100 0.0 4294967295 FORMAT "%8.2" ECU_ADDRESS 0xfe417b98 /end MEASUREMENT
/begin MEASUREMENT Tlib_Efuse_L3_GetVoltage_Val_O_S_5V10 "" UWORD RB_RBA_Common_CentralElements_CompuMethods_Identical 1 100 0.0 65535 FORMAT "%8.2" ECU_ADDRESS 0xfe419622 /end MEASUREMENT
/begin MEASUREMENT Tlib_DoVoltage_L3_Get_FilterVal_O_S_5V10 "" UBYTE RB_RBA_Common_CentralElements_CompuMethods_Identical 1 100 0.0 255.00 FORMAT "%8.2" ECU_ADDRESS 0xfe419845 /end MEASUREMENT
/begin MEASUREMENT Tlib_DO_L3_DIAG_Get_Val_O_S_5V10 "" UWORD RB_RBA_Common_CentralElements_CompuMethods_Identical 1 100 0.0 65535 FORMAT "%8.2" ECU_ADDRESS 0xfe419624 /end MEASUREMENT
/begin MEASUREMENT Tlib_DIO_L3_GetStatus_Val_O_S_ODH110 "" UBYTE RB_RBA_Common_CentralElements_CompuMethods_Identical 1 100 0.0 255.00 FORMAT "%8.2" ECU_ADDRESS 0xfe419846 /end MEASUREMENT
/begin MEASUREMENT Tlib_Efuse_L3_GetCurrent_Val_I_C_ODH110 "" ULONG RB_RBA_Common_CentralElements_CompuMethods_Identical 1 100 0.0 4294967295 FORMAT "%8.2" ECU_ADDRESS 0xfe417b9c /end MEASUREMENT
/begin MEASUREMENT Tlib_Efuse_L3_GetVoltage_Val_O_S_ODH110 "" UWORD RB_RBA_Common_CentralElements_CompuMethods_Identical 1 100 0.0 65535 FORMAT "%8.2" ECU_ADDRESS 0xfe419626 /end MEASUREMENT
/begin MEASUREMENT Tlib_DoVoltage_L3_Get_FilterVal_O_S_ODH110 "" UBYTE RB_RBA_Common_CentralElements_CompuMethods_Identical 1 100 0.0 255.00 FORMAT "%8.2" ECU_ADDRESS 0xfe419847 /end MEASUREMENT
/begin MEASUREMENT Tlib_DO_L3_DIAG_Get_Val_O_S_ODH110 "" UWORD RB_RBA_Common_CentralElements_CompuMethods_Identical 1 100 0.0 65535 FORMAT "%8.2" ECU_ADDRESS 0xfe419628 /end MEASUREMENT
/begin MEASUREMENT Tlib_DIO_L3_GetStatus_Val_O_S_ODH111 "" UBYTE RB_RBA_Common_CentralElements_CompuMethods_Identical 1 100 0.0 255.00 FORMAT "%8.2" ECU_ADDRESS 0xfe419848 /end MEASUREMENT
/begin MEASUREMENT Tlib_Efuse_L3_GetCurrent_Val_I_C_ODH111 "" ULONG RB_RBA_Common_CentralElements_CompuMethods_Identical 1 100 0.0 4294967295 FORMAT "%8.2" ECU_ADDRESS 0xfe417ba0 /end MEASUREMENT
/begin MEASUREMENT Tlib_Efuse_L3_GetVoltage_Val_O_S_ODH111 "" UWORD RB_RBA_Common_CentralElements_CompuMethods_Identical 1 100 0.0 65535 FORMAT "%8.2" ECU_ADDRESS 0xfe41962a /end MEASUREMENT
/begin MEASUREMENT Tlib_DoVoltage_L3_Get_FilterVal_O_S_ODH111 "" UBYTE RB_RBA_Common_CentralElements_CompuMethods_Identical 1 100 0.0 255.00 FORMAT "%8.2" ECU_ADDRESS 0xfe419849 /end MEASUREMENT
/begin MEASUREMENT Tlib_DO_L3_DIAG_Get_Val_O_S_ODH111 "" UWORD RB_RBA_Common_CentralElements_CompuMethods_Identical 1 100 0.0 65535 FORMAT "%8.2" ECU_ADDRESS 0xfe41962c /end MEASUREMENT
/begin MEASUREMENT Tlib_DIO_L3_GetStatus_Val_O_S_ODH112 "" UBYTE RB_RBA_Common_CentralElements_CompuMethods_Identical 1 100 0.0 255.00 FORMAT "%8.2" ECU_ADDRESS 0xfe41984a /end MEASUREMENT
/begin MEASUREMENT Tlib_Efuse_L3_GetCurrent_Val_I_C_ODH112 "" ULONG RB_RBA_Common_CentralElements_CompuMethods_Identical 1 100 0.0 4294967295 FORMAT "%8.2" ECU_ADDRESS 0xfe417ba4 /end MEASUREMENT
/begin MEASUREMENT Tlib_Efuse_L3_GetVoltage_Val_O_S_ODH112 "" UWORD RB_RBA_Common_CentralElements_CompuMethods_Identical 1 100 0.0 65535 FORMAT "%8.2" ECU_ADDRESS 0xfe41962e /end MEASUREMENT
/begin MEASUREMENT Tlib_DoVoltage_L3_Get_FilterVal_O_S_ODH112 "" UBYTE RB_RBA_Common_CentralElements_CompuMethods_Identical 1 100 0.0 255.00 FORMAT "%8.2" ECU_ADDRESS 0xfe41984b /end MEASUREMENT
/begin MEASUREMENT Tlib_DO_L3_DIAG_Get_Val_O_S_ODH112 "" UWORD RB_RBA_Common_CentralElements_CompuMethods_Identical 1 100 0.0 65535 FORMAT "%8.2" ECU_ADDRESS 0xfe419630 /end MEASUREMENT
/begin MEASUREMENT Tlib_DIO_L3_GetStatus_Val_O_S_ODH113 "" UBYTE RB_RBA_Common_CentralElements_CompuMethods_Identical 1 100 0.0 255.00 FORMAT "%8.2" ECU_ADDRESS 0xfe41984c /end MEASUREMENT
/begin MEASUREMENT Tlib_Efuse_L3_GetCurrent_Val_I_C_ODH113 "" ULONG RB_RBA_Common_CentralElements_CompuMethods_Identical 1 100 0.0 4294967295 FORMAT "%8.2" ECU_ADDRESS 0xfe417ba8 /end MEASUREMENT
/begin MEASUREMENT Tlib_Efuse_L3_GetVoltage_Val_O_S_ODH113 "" UWORD RB_RBA_Common_CentralElements_CompuMethods_Identical 1 100 0.0 65535 FORMAT "%8.2" ECU_ADDRESS 0xfe419632 /end MEASUREMENT
/begin MEASUREMENT Tlib_DoVoltage_L3_Get_FilterVal_O_S_ODH113 "" UBYTE RB_RBA_Common_CentralElements_CompuMethods_Identical 1 100 0.0 255.00 FORMAT "%8.2" ECU_ADDRESS 0xfe41984d /end MEASUREMENT
/begin MEASUREMENT Tlib_DO_L3_DIAG_Get_Val_O_S_ODH113 "" UWORD RB_RBA_Common_CentralElements_CompuMethods_Identical 1 100 0.0 65535 FORMAT "%8.2" ECU_ADDRESS 0xfe419634 /end MEASUREMENT
/begin MEASUREMENT Tlib_DIO_L3_GetStatus_Val_O_S_EFUSE08 "" UBYTE RB_RBA_Common_CentralElements_CompuMethods_Identical 1 100 0.0 255.00 FORMAT "%8.2" ECU_ADDRESS 0xfe41984e /end MEASUREMENT
/begin MEASUREMENT Tlib_Efuse_L3_GetCurrent_Val_I_C_EFUSE08 "" ULONG RB_RBA_Common_CentralElements_CompuMethods_Identical 1 100 0.0 4294967295 FORMAT "%8.2" ECU_ADDRESS 0xfe417bac /end MEASUREMENT
/begin MEASUREMENT Tlib_Efuse_L3_GetVoltage_Val_O_S_EFUSE08 "" UWORD RB_RBA_Common_CentralElements_CompuMethods_Identical 1 100 0.0 65535 FORMAT "%8.2" ECU_ADDRESS 0xfe419636 /end MEASUREMENT
/begin MEASUREMENT Tlib_DoVoltage_L3_Get_FilterVal_O_S_EFUSE08 "" UBYTE RB_RBA_Common_CentralElements_CompuMethods_Identical 1 100 0.0 255.00 FORMAT "%8.2" ECU_ADDRESS 0xfe41984f /end MEASUREMENT
/begin MEASUREMENT Tlib_DO_L3_DIAG_Get_Val_O_S_EFUSE08 "" UWORD RB_RBA_Common_CentralElements_CompuMethods_Identical 1 100 0.0 65535 FORMAT "%8.2" ECU_ADDRESS 0xfe419638 /end MEASUREMENT
/begin MEASUREMENT Tlib_DIO_L3_GetStatus_Val_O_S_ODH02 "" UBYTE RB_RBA_Common_CentralElements_CompuMethods_Identical 1 100 0.0 255.00 FORMAT "%8.2" ECU_ADDRESS 0xfe419850 /end MEASUREMENT
/begin MEASUREMENT Tlib_Efuse_L3_GetCurrent_Val_I_C_ODH02 "" ULONG RB_RBA_Common_CentralElements_CompuMethods_Identical 1 100 0.0 4294967295 FORMAT "%8.2" ECU_ADDRESS 0xfe417bb0 /end MEASUREMENT
/begin MEASUREMENT Tlib_Efuse_L3_GetVoltage_Val_O_S_ODH02 "" UWORD RB_RBA_Common_CentralElements_CompuMethods_Identical 1 100 0.0 65535 FORMAT "%8.2" ECU_ADDRESS 0xfe41963a /end MEASUREMENT
/begin MEASUREMENT Tlib_DoVoltage_L3_Get_FilterVal_O_S_ODH02 "" UBYTE RB_RBA_Common_CentralElements_CompuMethods_Identical 1 100 0.0 255.00 FORMAT "%8.2" ECU_ADDRESS 0xfe419851 /end MEASUREMENT
/begin MEASUREMENT Tlib_DO_L3_DIAG_Get_Val_O_S_ODH02 "" UWORD RB_RBA_Common_CentralElements_CompuMethods_Identical 1 100 0.0 65535 FORMAT "%8.2" ECU_ADDRESS 0xfe41963c /end MEASUREMENT
/begin MEASUREMENT Tlib_DIO_L3_GetStatus_Val_O_S_ODH24 "" UBYTE RB_RBA_Common_CentralElements_CompuMethods_Identical 1 100 0.0 255.00 FORMAT "%8.2" ECU_ADDRESS 0xfe419852 /end MEASUREMENT
/begin MEASUREMENT Tlib_Efuse_L3_GetCurrent_Val_I_C_ODH24 "" ULONG RB_RBA_Common_CentralElements_CompuMethods_Identical 1 100 0.0 4294967295 FORMAT "%8.2" ECU_ADDRESS 0xfe417bb4 /end MEASUREMENT
/begin MEASUREMENT Tlib_Efuse_L3_GetVoltage_Val_O_S_ODH24 "" UWORD RB_RBA_Common_CentralElements_CompuMethods_Identical 1 100 0.0 65535 FORMAT "%8.2" ECU_ADDRESS 0xfe41963e /end MEASUREMENT
/begin MEASUREMENT Tlib_DoVoltage_L3_Get_FilterVal_O_S_ODH24 "" UBYTE RB_RBA_Common_CentralElements_CompuMethods_Identical 1 100 0.0 255.00 FORMAT "%8.2" ECU_ADDRESS 0xfe419853 /end MEASUREMENT
/begin MEASUREMENT Tlib_DO_L3_DIAG_Get_Val_O_S_ODH24 "" UWORD RB_RBA_Common_CentralElements_CompuMethods_Identical 1 100 0.0 65535 FORMAT "%8.2" ECU_ADDRESS 0xfe419640 /end MEASUREMENT
/begin MEASUREMENT Tlib_DIO_L3_GetStatus_Val_O_S_ODH04 "" UBYTE RB_RBA_Common_CentralElements_CompuMethods_Identical 1 100 0.0 255.00 FORMAT "%8.2" ECU_ADDRESS 0xfe419854 /end MEASUREMENT
/begin MEASUREMENT Tlib_Efuse_L3_GetCurrent_Val_I_C_ODH04 "" ULONG RB_RBA_Common_CentralElements_CompuMethods_Identical 1 100 0.0 4294967295 FORMAT "%8.2" ECU_ADDRESS 0xfe417bb8 /end MEASUREMENT
/begin MEASUREMENT Tlib_Efuse_L3_GetVoltage_Val_O_S_ODH04 "" UWORD RB_RBA_Common_CentralElements_CompuMethods_Identical 1 100 0.0 65535 FORMAT "%8.2" ECU_ADDRESS 0xfe419642 /end MEASUREMENT
/begin MEASUREMENT Tlib_DoVoltage_L3_Get_FilterVal_O_S_ODH04 "" UBYTE RB_RBA_Common_CentralElements_CompuMethods_Identical 1 100 0.0 255.00 FORMAT "%8.2" ECU_ADDRESS 0xfe419855 /end MEASUREMENT
/begin MEASUREMENT Tlib_DO_L3_DIAG_Get_Val_O_S_ODH04 "" UWORD RB_RBA_Common_CentralElements_CompuMethods_Identical 1 100 0.0 65535 FORMAT "%8.2" ECU_ADDRESS 0xfe419644 /end MEASUREMENT
/begin MEASUREMENT Tlib_DIO_L3_GetStatus_Val_O_S_ODH29 "" UBYTE RB_RBA_Common_CentralElements_CompuMethods_Identical 1 100 0.0 255.00 FORMAT "%8.2" ECU_ADDRESS 0xfe419856 /end MEASUREMENT
/begin MEASUREMENT Tlib_Efuse_L3_GetCurrent_Val_I_C_ODH29 "" ULONG RB_RBA_Common_CentralElements_CompuMethods_Identical 1 100 0.0 4294967295 FORMAT "%8.2" ECU_ADDRESS 0xfe417bbc /end MEASUREMENT
/begin MEASUREMENT Tlib_Efuse_L3_GetVoltage_Val_O_S_ODH29 "" UWORD RB_RBA_Common_CentralElements_CompuMethods_Identical 1 100 0.0 65535 FORMAT "%8.2" ECU_ADDRESS 0xfe419646 /end MEASUREMENT
/begin MEASUREMENT Tlib_DoVoltage_L3_Get_FilterVal_O_S_ODH29 "" UBYTE RB_RBA_Common_CentralElements_CompuMethods_Identical 1 100 0.0 255.00 FORMAT "%8.2" ECU_ADDRESS 0xfe419857 /end MEASUREMENT
/begin MEASUREMENT Tlib_DO_L3_DIAG_Get_Val_O_S_ODH29 "" UWORD RB_RBA_Common_CentralElements_CompuMethods_Identical 1 100 0.0 65535 FORMAT "%8.2" ECU_ADDRESS 0xfe419648 /end MEASUREMENT
/begin MEASUREMENT Tlib_DIO_L3_GetStatus_Val_O_S_ODH22 "" UBYTE RB_RBA_Common_CentralElements_CompuMethods_Identical 1 100 0.0 255.00 FORMAT "%8.2" ECU_ADDRESS 0xfe419858 /end MEASUREMENT
/begin MEASUREMENT Tlib_Efuse_L3_GetCurrent_Val_I_C_ODH22 "" ULONG RB_RBA_Common_CentralElements_CompuMethods_Identical 1 100 0.0 4294967295 FORMAT "%8.2" ECU_ADDRESS 0xfe417bc0 /end MEASUREMENT
/begin MEASUREMENT Tlib_Efuse_L3_GetVoltage_Val_O_S_ODH22 "" UWORD RB_RBA_Common_CentralElements_CompuMethods_Identical 1 100 0.0 65535 FORMAT "%8.2" ECU_ADDRESS 0xfe41964a /end MEASUREMENT
/begin MEASUREMENT Tlib_DoVoltage_L3_Get_FilterVal_O_S_ODH22 "" UBYTE RB_RBA_Common_CentralElements_CompuMethods_Identical 1 100 0.0 255.00 FORMAT "%8.2" ECU_ADDRESS 0xfe419859 /end MEASUREMENT
/begin MEASUREMENT Tlib_DO_L3_DIAG_Get_Val_O_S_ODH22 "" UWORD RB_RBA_Common_CentralElements_CompuMethods_Identical 1 100 0.0 65535 FORMAT "%8.2" ECU_ADDRESS 0xfe41964c /end MEASUREMENT
/begin MEASUREMENT Tlib_DIO_L3_GetStatus_Val_O_S_ODH25 "" UBYTE RB_RBA_Common_CentralElements_CompuMethods_Identical 1 100 0.0 255.00 FORMAT "%8.2" ECU_ADDRESS 0xfe41985a /end MEASUREMENT
/begin MEASUREMENT Tlib_Efuse_L3_GetCurrent_Val_I_C_ODH25 "" ULONG RB_RBA_Common_CentralElements_CompuMethods_Identical 1 100 0.0 4294967295 FORMAT "%8.2" ECU_ADDRESS 0xfe417bc4 /end MEASUREMENT
/begin MEASUREMENT Tlib_Efuse_L3_GetVoltage_Val_O_S_ODH25 "" UWORD RB_RBA_Common_CentralElements_CompuMethods_Identical 1 100 0.0 65535 FORMAT "%8.2" ECU_ADDRESS 0xfe41964e /end MEASUREMENT
/begin MEASUREMENT Tlib_DoVoltage_L3_Get_FilterVal_O_S_ODH25 "" UBYTE RB_RBA_Common_CentralElements_CompuMethods_Identical 1 100 0.0 255.00 FORMAT "%8.2" ECU_ADDRESS 0xfe41985b /end MEASUREMENT
/begin MEASUREMENT Tlib_DO_L3_DIAG_Get_Val_O_S_ODH25 "" UWORD RB_RBA_Common_CentralElements_CompuMethods_Identical 1 100 0.0 65535 FORMAT "%8.2" ECU_ADDRESS 0xfe419650 /end MEASUREMENT
/begin MEASUREMENT Tlib_DIO_L3_GetStatus_Val_O_S_ODH21 "" UBYTE RB_RBA_Common_CentralElements_CompuMethods_Identical 1 100 0.0 255.00 FORMAT "%8.2" ECU_ADDRESS 0xfe41985c /end MEASUREMENT
/begin MEASUREMENT Tlib_Efuse_L3_GetCurrent_Val_I_C_ODH21 "" ULONG RB_RBA_Common_CentralElements_CompuMethods_Identical 1 100 0.0 4294967295 FORMAT "%8.2" ECU_ADDRESS 0xfe417bc8 /end MEASUREMENT
/begin MEASUREMENT Tlib_Efuse_L3_GetVoltage_Val_O_S_ODH21 "" UWORD RB_RBA_Common_CentralElements_CompuMethods_Identical 1 100 0.0 65535 FORMAT "%8.2" ECU_ADDRESS 0xfe419652 /end MEASUREMENT
/begin MEASUREMENT Tlib_DoVoltage_L3_Get_FilterVal_O_S_ODH21 "" UBYTE RB_RBA_Common_CentralElements_CompuMethods_Identical 1 100 0.0 255.00 FORMAT "%8.2" ECU_ADDRESS 0xfe41985d /end MEASUREMENT
/begin MEASUREMENT Tlib_DO_L3_DIAG_Get_Val_O_S_ODH21 "" UWORD RB_RBA_Common_CentralElements_CompuMethods_Identical 1 100 0.0 65535 FORMAT "%8.2" ECU_ADDRESS 0xfe419654 /end MEASUREMENT
/begin MEASUREMENT Tlib_DIO_L3_GetStatus_Val_O_S_EFUSE22 "" UBYTE RB_RBA_Common_CentralElements_CompuMethods_Identical 1 100 0.0 255.00 FORMAT "%8.2" ECU_ADDRESS 0xfe41985e /end MEASUREMENT
/begin MEASUREMENT Tlib_Efuse_L3_GetCurrent_Val_I_C_EFUSE22 "" ULONG RB_RBA_Common_CentralElements_CompuMethods_Identical 1 100 0.0 4294967295 FORMAT "%8.2" ECU_ADDRESS 0xfe417bcc /end MEASUREMENT
/begin MEASUREMENT Tlib_Efuse_L3_GetVoltage_Val_O_S_EFUSE22 "" UWORD RB_RBA_Common_CentralElements_CompuMethods_Identical 1 100 0.0 65535 FORMAT "%8.2" ECU_ADDRESS 0xfe419656 /end MEASUREMENT
/begin MEASUREMENT Tlib_DoVoltage_L3_Get_FilterVal_O_S_EFUSE22 "" UBYTE RB_RBA_Common_CentralElements_CompuMethods_Identical 1 100 0.0 255.00 FORMAT "%8.2" ECU_ADDRESS 0xfe41985f /end MEASUREMENT
/begin MEASUREMENT Tlib_DO_L3_DIAG_Get_Val_O_S_EFUSE22 "" UWORD RB_RBA_Common_CentralElements_CompuMethods_Identical 1 100 0.0 65535 FORMAT "%8.2" ECU_ADDRESS 0xfe419658 /end MEASUREMENT
/begin MEASUREMENT Tlib_DIO_L3_GetStatus_Val_O_S_ODH39 "" UBYTE RB_RBA_Common_CentralElements_CompuMethods_Identical 1 100 0.0 255.00 FORMAT "%8.2" ECU_ADDRESS 0xfe419860 /end MEASUREMENT
/begin MEASUREMENT Tlib_Efuse_L3_GetCurrent_Val_I_C_ODH39 "" ULONG RB_RBA_Common_CentralElements_CompuMethods_Identical 1 100 0.0 4294967295 FORMAT "%8.2" ECU_ADDRESS 0xfe417bd0 /end MEASUREMENT
/begin MEASUREMENT Tlib_Efuse_L3_GetVoltage_Val_O_S_ODH39 "" UWORD RB_RBA_Common_CentralElements_CompuMethods_Identical 1 100 0.0 65535 FORMAT "%8.2" ECU_ADDRESS 0xfe41965a /end MEASUREMENT
/begin MEASUREMENT Tlib_DoVoltage_L3_Get_FilterVal_O_S_ODH39 "" UBYTE RB_RBA_Common_CentralElements_CompuMethods_Identical 1 100 0.0 255.00 FORMAT "%8.2" ECU_ADDRESS 0xfe419861 /end MEASUREMENT
/begin MEASUREMENT Tlib_DO_L3_DIAG_Get_Val_O_S_ODH39 "" UWORD RB_RBA_Common_CentralElements_CompuMethods_Identical 1 100 0.0 65535 FORMAT "%8.2" ECU_ADDRESS 0xfe41965c /end MEASUREMENT
/begin MEASUREMENT Tlib_DIO_L3_GetStatus_Val_O_S_ODH37 "" UBYTE RB_RBA_Common_CentralElements_CompuMethods_Identical 1 100 0.0 255.00 FORMAT "%8.2" ECU_ADDRESS 0xfe419862 /end MEASUREMENT
/begin MEASUREMENT Tlib_Efuse_L3_GetCurrent_Val_I_C_ODH37 "" ULONG RB_RBA_Common_CentralElements_CompuMethods_Identical 1 100 0.0 4294967295 FORMAT "%8.2" ECU_ADDRESS 0xfe417bd4 /end MEASUREMENT
/begin MEASUREMENT Tlib_Efuse_L3_GetVoltage_Val_O_S_ODH37 "" UWORD RB_RBA_Common_CentralElements_CompuMethods_Identical 1 100 0.0 65535 FORMAT "%8.2" ECU_ADDRESS 0xfe41965e /end MEASUREMENT
/begin MEASUREMENT Tlib_DoVoltage_L3_Get_FilterVal_O_S_ODH37 "" UBYTE RB_RBA_Common_CentralElements_CompuMethods_Identical 1 100 0.0 255.00 FORMAT "%8.2" ECU_ADDRESS 0xfe419863 /end MEASUREMENT
/begin MEASUREMENT Tlib_DO_L3_DIAG_Get_Val_O_S_ODH37 "" UWORD RB_RBA_Common_CentralElements_CompuMethods_Identical 1 100 0.0 65535 FORMAT "%8.2" ECU_ADDRESS 0xfe419660 /end MEASUREMENT
/begin MEASUREMENT Tlib_DIO_L3_GetStatus_Val_O_S_ODH75 "" UBYTE RB_RBA_Common_CentralElements_CompuMethods_Identical 1 100 0.0 255.00 FORMAT "%8.2" ECU_ADDRESS 0xfe419864 /end MEASUREMENT
/begin MEASUREMENT Tlib_Efuse_L3_GetCurrent_Val_I_C_ODH75 "" ULONG RB_RBA_Common_CentralElements_CompuMethods_Identical 1 100 0.0 4294967295 FORMAT "%8.2" ECU_ADDRESS 0xfe417bd8 /end MEASUREMENT
/begin MEASUREMENT Tlib_Efuse_L3_GetVoltage_Val_O_S_ODH75 "" UWORD RB_RBA_Common_CentralElements_CompuMethods_Identical 1 100 0.0 65535 FORMAT "%8.2" ECU_ADDRESS 0xfe419662 /end MEASUREMENT
/begin MEASUREMENT Tlib_DoVoltage_L3_Get_FilterVal_O_S_ODH75 "" UBYTE RB_RBA_Common_CentralElements_CompuMethods_Identical 1 100 0.0 255.00 FORMAT "%8.2" ECU_ADDRESS 0xfe419865 /end MEASUREMENT
/begin MEASUREMENT Tlib_DO_L3_DIAG_Get_Val_O_S_ODH75 "" UWORD RB_RBA_Common_CentralElements_CompuMethods_Identical 1 100 0.0 65535 FORMAT "%8.2" ECU_ADDRESS 0xfe419664 /end MEASUREMENT
/begin MEASUREMENT Tlib_DIO_L3_GetStatus_Val_O_S_EFUSE17 "" UBYTE RB_RBA_Common_CentralElements_CompuMethods_Identical 1 100 0.0 255.00 FORMAT "%8.2" ECU_ADDRESS 0xfe419866 /end MEASUREMENT
/begin MEASUREMENT Tlib_Efuse_L3_GetCurrent_Val_I_C_EFUSE17 "" ULONG RB_RBA_Common_CentralElements_CompuMethods_Identical 1 100 0.0 4294967295 FORMAT "%8.2" ECU_ADDRESS 0xfe417bdc /end MEASUREMENT
/begin MEASUREMENT Tlib_Efuse_L3_GetVoltage_Val_O_S_EFUSE17 "" UWORD RB_RBA_Common_CentralElements_CompuMethods_Identical 1 100 0.0 65535 FORMAT "%8.2" ECU_ADDRESS 0xfe419666 /end MEASUREMENT
/begin MEASUREMENT Tlib_DoVoltage_L3_Get_FilterVal_O_S_EFUSE17 "" UBYTE RB_RBA_Common_CentralElements_CompuMethods_Identical 1 100 0.0 255.00 FORMAT "%8.2" ECU_ADDRESS 0xfe419867 /end MEASUREMENT
/begin MEASUREMENT Tlib_DO_L3_DIAG_Get_Val_O_S_EFUSE17 "" UWORD RB_RBA_Common_CentralElements_CompuMethods_Identical 1 100 0.0 65535 FORMAT "%8.2" ECU_ADDRESS 0xfe419668 /end MEASUREMENT
/begin MEASUREMENT Tlib_DIO_L3_GetStatus_Val_O_S_ODH66 "" UBYTE RB_RBA_Common_CentralElements_CompuMethods_Identical 1 100 0.0 255.00 FORMAT "%8.2" ECU_ADDRESS 0xfe419868 /end MEASUREMENT
/begin MEASUREMENT Tlib_Efuse_L3_GetCurrent_Val_I_C_ODH66 "" ULONG RB_RBA_Common_CentralElements_CompuMethods_Identical 1 100 0.0 4294967295 FORMAT "%8.2" ECU_ADDRESS 0xfe417be0 /end MEASUREMENT
/begin MEASUREMENT Tlib_Efuse_L3_GetVoltage_Val_O_S_ODH66 "" UWORD RB_RBA_Common_CentralElements_CompuMethods_Identical 1 100 0.0 65535 FORMAT "%8.2" ECU_ADDRESS 0xfe41966a /end MEASUREMENT
/begin MEASUREMENT Tlib_DoVoltage_L3_Get_FilterVal_O_S_ODH66 "" UBYTE RB_RBA_Common_CentralElements_CompuMethods_Identical 1 100 0.0 255.00 FORMAT "%8.2" ECU_ADDRESS 0xfe419869 /end MEASUREMENT
/begin MEASUREMENT Tlib_DO_L3_DIAG_Get_Val_O_S_ODH66 "" UWORD RB_RBA_Common_CentralElements_CompuMethods_Identical 1 100 0.0 65535 FORMAT "%8.2" ECU_ADDRESS 0xfe41966c /end MEASUREMENT
/begin MEASUREMENT Tlib_DIO_L3_GetStatus_Val_O_S_ODH34 "" UBYTE RB_RBA_Common_CentralElements_CompuMethods_Identical 1 100 0.0 255.00 FORMAT "%8.2" ECU_ADDRESS 0xfe41986a /end MEASUREMENT
/begin MEASUREMENT Tlib_Efuse_L3_GetCurrent_Val_I_C_ODH34 "" ULONG RB_RBA_Common_CentralElements_CompuMethods_Identical 1 100 0.0 4294967295 FORMAT "%8.2" ECU_ADDRESS 0xfe417be4 /end MEASUREMENT
/begin MEASUREMENT Tlib_Efuse_L3_GetVoltage_Val_O_S_ODH34 "" UWORD RB_RBA_Common_CentralElements_CompuMethods_Identical 1 100 0.0 65535 FORMAT "%8.2" ECU_ADDRESS 0xfe41966e /end MEASUREMENT
/begin MEASUREMENT Tlib_DoVoltage_L3_Get_FilterVal_O_S_ODH34 "" UBYTE RB_RBA_Common_CentralElements_CompuMethods_Identical 1 100 0.0 255.00 FORMAT "%8.2" ECU_ADDRESS 0xfe41986b /end MEASUREMENT
/begin MEASUREMENT Tlib_DO_L3_DIAG_Get_Val_O_S_ODH34 "" UWORD RB_RBA_Common_CentralElements_CompuMethods_Identical 1 100 0.0 65535 FORMAT "%8.2" ECU_ADDRESS 0xfe419670 /end MEASUREMENT
/begin MEASUREMENT Tlib_DIO_L3_GetStatus_Val_O_S_EFUSE31 "" UBYTE RB_RBA_Common_CentralElements_CompuMethods_Identical 1 100 0.0 255.00 FORMAT "%8.2" ECU_ADDRESS 0xfe41986c /end MEASUREMENT
/begin MEASUREMENT Tlib_Efuse_L3_GetCurrent_Val_I_C_EFUSE31 "" ULONG RB_RBA_Common_CentralElements_CompuMethods_Identical 1 100 0.0 4294967295 FORMAT "%8.2" ECU_ADDRESS 0xfe417be8 /end MEASUREMENT
/begin MEASUREMENT Tlib_Efuse_L3_GetVoltage_Val_O_S_EFUSE31 "" UWORD RB_RBA_Common_CentralElements_CompuMethods_Identical 1 100 0.0 65535 FORMAT "%8.2" ECU_ADDRESS 0xfe419672 /end MEASUREMENT
/begin MEASUREMENT Tlib_DoVoltage_L3_Get_FilterVal_O_S_EFUSE31 "" UBYTE RB_RBA_Common_CentralElements_CompuMethods_Identical 1 100 0.0 255.00 FORMAT "%8.2" ECU_ADDRESS 0xfe41986d /end MEASUREMENT
/begin MEASUREMENT Tlib_DO_L3_DIAG_Get_Val_O_S_EFUSE31 "" UWORD RB_RBA_Common_CentralElements_CompuMethods_Identical 1 100 0.0 65535 FORMAT "%8.2" ECU_ADDRESS 0xfe419674 /end MEASUREMENT
/begin MEASUREMENT Tlib_DIO_L3_GetStatus_Val_O_S_ODH30 "" UBYTE RB_RBA_Common_CentralElements_CompuMethods_Identical 1 100 0.0 255.00 FORMAT "%8.2" ECU_ADDRESS 0xfe41986e /end MEASUREMENT
/begin MEASUREMENT Tlib_Efuse_L3_GetCurrent_Val_I_C_ODH30 "" ULONG RB_RBA_Common_CentralElements_CompuMethods_Identical 1 100 0.0 4294967295 FORMAT "%8.2" ECU_ADDRESS 0xfe417bec /end MEASUREMENT
/begin MEASUREMENT Tlib_Efuse_L3_GetVoltage_Val_O_S_ODH30 "" UWORD RB_RBA_Common_CentralElements_CompuMethods_Identical 1 100 0.0 65535 FORMAT "%8.2" ECU_ADDRESS 0xfe419676 /end MEASUREMENT
/begin MEASUREMENT Tlib_DoVoltage_L3_Get_FilterVal_O_S_ODH30 "" UBYTE RB_RBA_Common_CentralElements_CompuMethods_Identical 1 100 0.0 255.00 FORMAT "%8.2" ECU_ADDRESS 0xfe41986f /end MEASUREMENT
/begin MEASUREMENT Tlib_DO_L3_DIAG_Get_Val_O_S_ODH30 "" UWORD RB_RBA_Common_CentralElements_CompuMethods_Identical 1 100 0.0 65535 FORMAT "%8.2" ECU_ADDRESS 0xfe419678 /end MEASUREMENT
/begin MEASUREMENT Tlib_DIO_L3_GetStatus_Val_O_S_EFUSE29 "" UBYTE RB_RBA_Common_CentralElements_CompuMethods_Identical 1 100 0.0 255.00 FORMAT "%8.2" ECU_ADDRESS 0xfe419870 /end MEASUREMENT
/begin MEASUREMENT Tlib_Efuse_L3_GetCurrent_Val_I_C_EFUSE29 "" ULONG RB_RBA_Common_CentralElements_CompuMethods_Identical 1 100 0.0 4294967295 FORMAT "%8.2" ECU_ADDRESS 0xfe417bf0 /end MEASUREMENT
/begin MEASUREMENT Tlib_Efuse_L3_GetVoltage_Val_O_S_EFUSE29 "" UWORD RB_RBA_Common_CentralElements_CompuMethods_Identical 1 100 0.0 65535 FORMAT "%8.2" ECU_ADDRESS 0xfe41967a /end MEASUREMENT
/begin MEASUREMENT Tlib_DoVoltage_L3_Get_FilterVal_O_S_EFUSE29 "" UBYTE RB_RBA_Common_CentralElements_CompuMethods_Identical 1 100 0.0 255.00 FORMAT "%8.2" ECU_ADDRESS 0xfe419871 /end MEASUREMENT
/begin MEASUREMENT Tlib_DO_L3_DIAG_Get_Val_O_S_EFUSE29 "" UWORD RB_RBA_Common_CentralElements_CompuMethods_Identical 1 100 0.0 65535 FORMAT "%8.2" ECU_ADDRESS 0xfe41967c /end MEASUREMENT
/begin MEASUREMENT Tlib_DIO_L3_GetStatus_Val_O_S_ODH100 "" UBYTE RB_RBA_Common_CentralElements_CompuMethods_Identical 1 100 0.0 255.00 FORMAT "%8.2" ECU_ADDRESS 0xfe419872 /end MEASUREMENT
/begin MEASUREMENT Tlib_Efuse_L3_GetCurrent_Val_I_C_ODH100 "" ULONG RB_RBA_Common_CentralElements_CompuMethods_Identical 1 100 0.0 4294967295 FORMAT "%8.2" ECU_ADDRESS 0xfe417bf4 /end MEASUREMENT
/begin MEASUREMENT Tlib_Efuse_L3_GetVoltage_Val_O_S_ODH100 "" UWORD RB_RBA_Common_CentralElements_CompuMethods_Identical 1 100 0.0 65535 FORMAT "%8.2" ECU_ADDRESS 0xfe41967e /end MEASUREMENT
/begin MEASUREMENT Tlib_DoVoltage_L3_Get_FilterVal_O_S_ODH100 "" UBYTE RB_RBA_Common_CentralElements_CompuMethods_Identical 1 100 0.0 255.00 FORMAT "%8.2" ECU_ADDRESS 0xfe419873 /end MEASUREMENT
/begin MEASUREMENT Tlib_DO_L3_DIAG_Get_Val_O_S_ODH100 "" UWORD RB_RBA_Common_CentralElements_CompuMethods_Identical 1 100 0.0 65535 FORMAT "%8.2" ECU_ADDRESS 0xfe419680 /end MEASUREMENT
/begin MEASUREMENT Tlib_DIO_L3_GetStatus_Val_O_S_ODH86 "" UBYTE RB_RBA_Common_CentralElements_CompuMethods_Identical 1 100 0.0 255.00 FORMAT "%8.2" ECU_ADDRESS 0xfe419874 /end MEASUREMENT
/begin MEASUREMENT Tlib_Efuse_L3_GetCurrent_Val_I_C_ODH86 "" ULONG RB_RBA_Common_CentralElements_CompuMethods_Identical 1 100 0.0 4294967295 FORMAT "%8.2" ECU_ADDRESS 0xfe417bf8 /end MEASUREMENT
/begin MEASUREMENT Tlib_Efuse_L3_GetVoltage_Val_O_S_ODH86 "" UWORD RB_RBA_Common_CentralElements_CompuMethods_Identical 1 100 0.0 65535 FORMAT "%8.2" ECU_ADDRESS 0xfe419682 /end MEASUREMENT
/begin MEASUREMENT Tlib_DoVoltage_L3_Get_FilterVal_O_S_ODH86 "" UBYTE RB_RBA_Common_CentralElements_CompuMethods_Identical 1 100 0.0 255.00 FORMAT "%8.2" ECU_ADDRESS 0xfe419875 /end MEASUREMENT
/begin MEASUREMENT Tlib_DO_L3_DIAG_Get_Val_O_S_ODH86 "" UWORD RB_RBA_Common_CentralElements_CompuMethods_Identical 1 100 0.0 65535 FORMAT "%8.2" ECU_ADDRESS 0xfe419684 /end MEASUREMENT
/begin MEASUREMENT Tlib_DIO_L3_GetStatus_Val_O_S_ODH13 "" UBYTE RB_RBA_Common_CentralElements_CompuMethods_Identical 1 100 0.0 255.00 FORMAT "%8.2" ECU_ADDRESS 0xfe419876 /end MEASUREMENT
/begin MEASUREMENT Tlib_Efuse_L3_GetCurrent_Val_I_C_ODH13 "" ULONG RB_RBA_Common_CentralElements_CompuMethods_Identical 1 100 0.0 4294967295 FORMAT "%8.2" ECU_ADDRESS 0xfe417bfc /end MEASUREMENT
/begin MEASUREMENT Tlib_Efuse_L3_GetVoltage_Val_O_S_ODH13 "" UWORD RB_RBA_Common_CentralElements_CompuMethods_Identical 1 100 0.0 65535 FORMAT "%8.2" ECU_ADDRESS 0xfe419686 /end MEASUREMENT
/begin MEASUREMENT Tlib_DoVoltage_L3_Get_FilterVal_O_S_ODH13 "" UBYTE RB_RBA_Common_CentralElements_CompuMethods_Identical 1 100 0.0 255.00 FORMAT "%8.2" ECU_ADDRESS 0xfe419877 /end MEASUREMENT
/begin MEASUREMENT Tlib_DO_L3_DIAG_Get_Val_O_S_ODH13 "" UWORD RB_RBA_Common_CentralElements_CompuMethods_Identical 1 100 0.0 65535 FORMAT "%8.2" ECU_ADDRESS 0xfe419688 /end MEASUREMENT
/begin MEASUREMENT Tlib_DIO_L3_GetStatus_Val_O_S_5V09 "" UBYTE RB_RBA_Common_CentralElements_CompuMethods_Identical 1 100 0.0 255.00 FORMAT "%8.2" ECU_ADDRESS 0xfe419878 /end MEASUREMENT
/begin MEASUREMENT Tlib_Efuse_L3_GetCurrent_Val_I_C_5V09 "" ULONG RB_RBA_Common_CentralElements_CompuMethods_Identical 1 100 0.0 4294967295 FORMAT "%8.2" ECU_ADDRESS 0xfe417c00 /end MEASUREMENT
/begin MEASUREMENT Tlib_Efuse_L3_GetVoltage_Val_O_S_5V09 "" UWORD RB_RBA_Common_CentralElements_CompuMethods_Identical 1 100 0.0 65535 FORMAT "%8.2" ECU_ADDRESS 0xfe41968a /end MEASUREMENT
/begin MEASUREMENT Tlib_DoVoltage_L3_Get_FilterVal_O_S_5V09 "" UBYTE RB_RBA_Common_CentralElements_CompuMethods_Identical 1 100 0.0 255.00 FORMAT "%8.2" ECU_ADDRESS 0xfe419879 /end MEASUREMENT
/begin MEASUREMENT Tlib_DO_L3_DIAG_Get_Val_O_S_5V09 "" UWORD RB_RBA_Common_CentralElements_CompuMethods_Identical 1 100 0.0 65535 FORMAT "%8.2" ECU_ADDRESS 0xfe41968c /end MEASUREMENT
/begin MEASUREMENT Tlib_DIO_L3_GetStatus_Val_O_S_ODH23 "" UBYTE RB_RBA_Common_CentralElements_CompuMethods_Identical 1 100 0.0 255.00 FORMAT "%8.2" ECU_ADDRESS 0xfe41987a /end MEASUREMENT
/begin MEASUREMENT Tlib_Efuse_L3_GetCurrent_Val_I_C_ODH23 "" ULONG RB_RBA_Common_CentralElements_CompuMethods_Identical 1 100 0.0 4294967295 FORMAT "%8.2" ECU_ADDRESS 0xfe417c04 /end MEASUREMENT
/begin MEASUREMENT Tlib_Efuse_L3_GetVoltage_Val_O_S_ODH23 "" UWORD RB_RBA_Common_CentralElements_CompuMethods_Identical 1 100 0.0 65535 FORMAT "%8.2" ECU_ADDRESS 0xfe41968e /end MEASUREMENT
/begin MEASUREMENT Tlib_DoVoltage_L3_Get_FilterVal_O_S_ODH23 "" UBYTE RB_RBA_Common_CentralElements_CompuMethods_Identical 1 100 0.0 255.00 FORMAT "%8.2" ECU_ADDRESS 0xfe41987b /end MEASUREMENT
/begin MEASUREMENT Tlib_DO_L3_DIAG_Get_Val_O_S_ODH23 "" UWORD RB_RBA_Common_CentralElements_CompuMethods_Identical 1 100 0.0 65535 FORMAT "%8.2" ECU_ADDRESS 0xfe419690 /end MEASUREMENT
/begin MEASUREMENT Tlib_DIO_L3_GetStatus_Val_O_S_EFUSE10 "" UBYTE RB_RBA_Common_CentralElements_CompuMethods_Identical 1 100 0.0 255.00 FORMAT "%8.2" ECU_ADDRESS 0xfe41987c /end MEASUREMENT
/begin MEASUREMENT Tlib_Efuse_L3_GetCurrent_Val_I_C_EFUSE10 "" ULONG RB_RBA_Common_CentralElements_CompuMethods_Identical 1 100 0.0 4294967295 FORMAT "%8.2" ECU_ADDRESS 0xfe417c08 /end MEASUREMENT
/begin MEASUREMENT Tlib_Efuse_L3_GetVoltage_Val_O_S_EFUSE10 "" UWORD RB_RBA_Common_CentralElements_CompuMethods_Identical 1 100 0.0 65535 FORMAT "%8.2" ECU_ADDRESS 0xfe419692 /end MEASUREMENT
/begin MEASUREMENT Tlib_DoVoltage_L3_Get_FilterVal_O_S_EFUSE10 "" UBYTE RB_RBA_Common_CentralElements_CompuMethods_Identical 1 100 0.0 255.00 FORMAT "%8.2" ECU_ADDRESS 0xfe41987d /end MEASUREMENT
/begin MEASUREMENT Tlib_DO_L3_DIAG_Get_Val_O_S_EFUSE10 "" UWORD RB_RBA_Common_CentralElements_CompuMethods_Identical 1 100 0.0 65535 FORMAT "%8.2" ECU_ADDRESS 0xfe419694 /end MEASUREMENT
/begin MEASUREMENT Tlib_DIO_L3_GetStatus_Val_O_S_EFUSE18 "" UBYTE RB_RBA_Common_CentralElements_CompuMethods_Identical 1 100 0.0 255.00 FORMAT "%8.2" ECU_ADDRESS 0xfe41987e /end MEASUREMENT
/begin MEASUREMENT Tlib_Efuse_L3_GetCurrent_Val_I_C_EFUSE18 "" ULONG RB_RBA_Common_CentralElements_CompuMethods_Identical 1 100 0.0 4294967295 FORMAT "%8.2" ECU_ADDRESS 0xfe417c0c /end MEASUREMENT
/begin MEASUREMENT Tlib_Efuse_L3_GetVoltage_Val_O_S_EFUSE18 "" UWORD RB_RBA_Common_CentralElements_CompuMethods_Identical 1 100 0.0 65535 FORMAT "%8.2" ECU_ADDRESS 0xfe419696 /end MEASUREMENT
/begin MEASUREMENT Tlib_DoVoltage_L3_Get_FilterVal_O_S_EFUSE18 "" UBYTE RB_RBA_Common_CentralElements_CompuMethods_Identical 1 100 0.0 255.00 FORMAT "%8.2" ECU_ADDRESS 0xfe41987f /end MEASUREMENT
/begin MEASUREMENT Tlib_DO_L3_DIAG_Get_Val_O_S_EFUSE18 "" UWORD RB_RBA_Common_CentralElements_CompuMethods_Identical 1 100 0.0 65535 FORMAT "%8.2" ECU_ADDRESS 0xfe419698 /end MEASUREMENT
/begin MEASUREMENT Tlib_DIO_L3_GetStatus_Val_O_S_ODH27 "" UBYTE RB_RBA_Common_CentralElements_CompuMethods_Identical 1 100 0.0 255.00 FORMAT "%8.2" ECU_ADDRESS 0xfe419880 /end MEASUREMENT
/begin MEASUREMENT Tlib_Efuse_L3_GetCurrent_Val_I_C_ODH27 "" ULONG RB_RBA_Common_CentralElements_CompuMethods_Identical 1 100 0.0 4294967295 FORMAT "%8.2" ECU_ADDRESS 0xfe417c10 /end MEASUREMENT
/begin MEASUREMENT Tlib_Efuse_L3_GetVoltage_Val_O_S_ODH27 "" UWORD RB_RBA_Common_CentralElements_CompuMethods_Identical 1 100 0.0 65535 FORMAT "%8.2" ECU_ADDRESS 0xfe41969a /end MEASUREMENT
/begin MEASUREMENT Tlib_DoVoltage_L3_Get_FilterVal_O_S_ODH27 "" UBYTE RB_RBA_Common_CentralElements_CompuMethods_Identical 1 100 0.0 255.00 FORMAT "%8.2" ECU_ADDRESS 0xfe419881 /end MEASUREMENT
/begin MEASUREMENT Tlib_DO_L3_DIAG_Get_Val_O_S_ODH27 "" UWORD RB_RBA_Common_CentralElements_CompuMethods_Identical 1 100 0.0 65535 FORMAT "%8.2" ECU_ADDRESS 0xfe41969c /end MEASUREMENT
/begin MEASUREMENT Tlib_DIO_L3_GetStatus_Val_O_S_ODH20 "" UBYTE RB_RBA_Common_CentralElements_CompuMethods_Identical 1 100 0.0 255.00 FORMAT "%8.2" ECU_ADDRESS 0xfe419882 /end MEASUREMENT
/begin MEASUREMENT Tlib_Efuse_L3_GetCurrent_Val_I_C_ODH20 "" ULONG RB_RBA_Common_CentralElements_CompuMethods_Identical 1 100 0.0 4294967295 FORMAT "%8.2" ECU_ADDRESS 0xfe417c14 /end MEASUREMENT
/begin MEASUREMENT Tlib_Efuse_L3_GetVoltage_Val_O_S_ODH20 "" UWORD RB_RBA_Common_CentralElements_CompuMethods_Identical 1 100 0.0 65535 FORMAT "%8.2" ECU_ADDRESS 0xfe41969e /end MEASUREMENT
/begin MEASUREMENT Tlib_DoVoltage_L3_Get_FilterVal_O_S_ODH20 "" UBYTE RB_RBA_Common_CentralElements_CompuMethods_Identical 1 100 0.0 255.00 FORMAT "%8.2" ECU_ADDRESS 0xfe419883 /end MEASUREMENT
/begin MEASUREMENT Tlib_DO_L3_DIAG_Get_Val_O_S_ODH20 "" UWORD RB_RBA_Common_CentralElements_CompuMethods_Identical 1 100 0.0 65535 FORMAT "%8.2" ECU_ADDRESS 0xfe4196a0 /end MEASUREMENT
/begin MEASUREMENT Tlib_DIO_L3_GetStatus_Val_O_S_ODH56 "" UBYTE RB_RBA_Common_CentralElements_CompuMethods_Identical 1 100 0.0 255.00 FORMAT "%8.2" ECU_ADDRESS 0xfe419884 /end MEASUREMENT
/begin MEASUREMENT Tlib_Efuse_L3_GetCurrent_Val_I_C_ODH56 "" ULONG RB_RBA_Common_CentralElements_CompuMethods_Identical 1 100 0.0 4294967295 FORMAT "%8.2" ECU_ADDRESS 0xfe417c18 /end MEASUREMENT
/begin MEASUREMENT Tlib_Efuse_L3_GetVoltage_Val_O_S_ODH56 "" UWORD RB_RBA_Common_CentralElements_CompuMethods_Identical 1 100 0.0 65535 FORMAT "%8.2" ECU_ADDRESS 0xfe4196a2 /end MEASUREMENT
/begin MEASUREMENT Tlib_DoVoltage_L3_Get_FilterVal_O_S_ODH56 "" UBYTE RB_RBA_Common_CentralElements_CompuMethods_Identical 1 100 0.0 255.00 FORMAT "%8.2" ECU_ADDRESS 0xfe419885 /end MEASUREMENT
/begin MEASUREMENT Tlib_DO_L3_DIAG_Get_Val_O_S_ODH56 "" UWORD RB_RBA_Common_CentralElements_CompuMethods_Identical 1 100 0.0 65535 FORMAT "%8.2" ECU_ADDRESS 0xfe4196a4 /end MEASUREMENT
/begin MEASUREMENT Tlib_DIO_L3_GetStatus_Val_O_S_ODH98 "" UBYTE RB_RBA_Common_CentralElements_CompuMethods_Identical 1 100 0.0 255.00 FORMAT "%8.2" ECU_ADDRESS 0xfe419886 /end MEASUREMENT
/begin MEASUREMENT Tlib_Efuse_L3_GetCurrent_Val_I_C_ODH98 "" ULONG RB_RBA_Common_CentralElements_CompuMethods_Identical 1 100 0.0 4294967295 FORMAT "%8.2" ECU_ADDRESS 0xfe417c1c /end MEASUREMENT
/begin MEASUREMENT Tlib_Efuse_L3_GetVoltage_Val_O_S_ODH98 "" UWORD RB_RBA_Common_CentralElements_CompuMethods_Identical 1 100 0.0 65535 FORMAT "%8.2" ECU_ADDRESS 0xfe4196a6 /end MEASUREMENT
/begin MEASUREMENT Tlib_DoVoltage_L3_Get_FilterVal_O_S_ODH98 "" UBYTE RB_RBA_Common_CentralElements_CompuMethods_Identical 1 100 0.0 255.00 FORMAT "%8.2" ECU_ADDRESS 0xfe419887 /end MEASUREMENT
/begin MEASUREMENT Tlib_DO_L3_DIAG_Get_Val_O_S_ODH98 "" UWORD RB_RBA_Common_CentralElements_CompuMethods_Identical 1 100 0.0 65535 FORMAT "%8.2" ECU_ADDRESS 0xfe4196a8 /end MEASUREMENT
/begin MEASUREMENT Tlib_DIO_L3_GetStatus_Val_O_S_ODH82 "" UBYTE RB_RBA_Common_CentralElements_CompuMethods_Identical 1 100 0.0 255.00 FORMAT "%8.2" ECU_ADDRESS 0xfe419888 /end MEASUREMENT
/begin MEASUREMENT Tlib_Efuse_L3_GetCurrent_Val_I_C_ODH82 "" ULONG RB_RBA_Common_CentralElements_CompuMethods_Identical 1 100 0.0 4294967295 FORMAT "%8.2" ECU_ADDRESS 0xfe417c20 /end MEASUREMENT
/begin MEASUREMENT Tlib_Efuse_L3_GetVoltage_Val_O_S_ODH82 "" UWORD RB_RBA_Common_CentralElements_CompuMethods_Identical 1 100 0.0 65535 FORMAT "%8.2" ECU_ADDRESS 0xfe4196aa /end MEASUREMENT
/begin MEASUREMENT Tlib_DoVoltage_L3_Get_FilterVal_O_S_ODH82 "" UBYTE RB_RBA_Common_CentralElements_CompuMethods_Identical 1 100 0.0 255.00 FORMAT "%8.2" ECU_ADDRESS 0xfe419889 /end MEASUREMENT
/begin MEASUREMENT Tlib_DO_L3_DIAG_Get_Val_O_S_ODH82 "" UWORD RB_RBA_Common_CentralElements_CompuMethods_Identical 1 100 0.0 65535 FORMAT "%8.2" ECU_ADDRESS 0xfe4196ac /end MEASUREMENT
/begin MEASUREMENT Tlib_DIO_L3_GetStatus_Val_O_S_EFUSE23 "" UBYTE RB_RBA_Common_CentralElements_CompuMethods_Identical 1 100 0.0 255.00 FORMAT "%8.2" ECU_ADDRESS 0xfe41988a /end MEASUREMENT
/begin MEASUREMENT Tlib_Efuse_L3_GetCurrent_Val_I_C_EFUSE23 "" ULONG RB_RBA_Common_CentralElements_CompuMethods_Identical 1 100 0.0 4294967295 FORMAT "%8.2" ECU_ADDRESS 0xfe417c24 /end MEASUREMENT
/begin MEASUREMENT Tlib_Efuse_L3_GetVoltage_Val_O_S_EFUSE23 "" UWORD RB_RBA_Common_CentralElements_CompuMethods_Identical 1 100 0.0 65535 FORMAT "%8.2" ECU_ADDRESS 0xfe4196ae /end MEASUREMENT
/begin MEASUREMENT Tlib_DoVoltage_L3_Get_FilterVal_O_S_EFUSE23 "" UBYTE RB_RBA_Common_CentralElements_CompuMethods_Identical 1 100 0.0 255.00 FORMAT "%8.2" ECU_ADDRESS 0xfe41988b /end MEASUREMENT
/begin MEASUREMENT Tlib_DO_L3_DIAG_Get_Val_O_S_EFUSE23 "" UWORD RB_RBA_Common_CentralElements_CompuMethods_Identical 1 100 0.0 65535 FORMAT "%8.2" ECU_ADDRESS 0xfe4196b0 /end MEASUREMENT
/begin MEASUREMENT Tlib_DIO_L3_GetStatus_Val_O_S_EFUSE24 "" UBYTE RB_RBA_Common_CentralElements_CompuMethods_Identical 1 100 0.0 255.00 FORMAT "%8.2" ECU_ADDRESS 0xfe41988c /end MEASUREMENT
/begin MEASUREMENT Tlib_Efuse_L3_GetCurrent_Val_I_C_EFUSE24 "" ULONG RB_RBA_Common_CentralElements_CompuMethods_Identical 1 100 0.0 4294967295 FORMAT "%8.2" ECU_ADDRESS 0xfe417c28 /end MEASUREMENT
/begin MEASUREMENT Tlib_Efuse_L3_GetVoltage_Val_O_S_EFUSE24 "" UWORD RB_RBA_Common_CentralElements_CompuMethods_Identical 1 100 0.0 65535 FORMAT "%8.2" ECU_ADDRESS 0xfe4196b2 /end MEASUREMENT
/begin MEASUREMENT Tlib_DoVoltage_L3_Get_FilterVal_O_S_EFUSE24 "" UBYTE RB_RBA_Common_CentralElements_CompuMethods_Identical 1 100 0.0 255.00 FORMAT "%8.2" ECU_ADDRESS 0xfe41988d /end MEASUREMENT
/begin MEASUREMENT Tlib_DO_L3_DIAG_Get_Val_O_S_EFUSE24 "" UWORD RB_RBA_Common_CentralElements_CompuMethods_Identical 1 100 0.0 65535 FORMAT "%8.2" ECU_ADDRESS 0xfe4196b4 /end MEASUREMENT
/begin MEASUREMENT Tlib_DIO_L3_GetStatus_Val_O_S_ODH53 "" UBYTE RB_RBA_Common_CentralElements_CompuMethods_Identical 1 100 0.0 255.00 FORMAT "%8.2" ECU_ADDRESS 0xfe41988e /end MEASUREMENT
/begin MEASUREMENT Tlib_Efuse_L3_GetCurrent_Val_I_C_ODH53 "" ULONG RB_RBA_Common_CentralElements_CompuMethods_Identical 1 100 0.0 4294967295 FORMAT "%8.2" ECU_ADDRESS 0xfe417c2c /end MEASUREMENT
/begin MEASUREMENT Tlib_Efuse_L3_GetVoltage_Val_O_S_ODH53 "" UWORD RB_RBA_Common_CentralElements_CompuMethods_Identical 1 100 0.0 65535 FORMAT "%8.2" ECU_ADDRESS 0xfe4196b6 /end MEASUREMENT
/begin MEASUREMENT Tlib_DoVoltage_L3_Get_FilterVal_O_S_ODH53 "" UBYTE RB_RBA_Common_CentralElements_CompuMethods_Identical 1 100 0.0 255.00 FORMAT "%8.2" ECU_ADDRESS 0xfe41988f /end MEASUREMENT
/begin MEASUREMENT Tlib_DO_L3_DIAG_Get_Val_O_S_ODH53 "" UWORD RB_RBA_Common_CentralElements_CompuMethods_Identical 1 100 0.0 65535 FORMAT "%8.2" ECU_ADDRESS 0xfe4196b8 /end MEASUREMENT
/begin MEASUREMENT Tlib_DIO_L3_GetStatus_Val_O_S_ODH76 "" UBYTE RB_RBA_Common_CentralElements_CompuMethods_Identical 1 100 0.0 255.00 FORMAT "%8.2" ECU_ADDRESS 0xfe419890 /end MEASUREMENT
/begin MEASUREMENT Tlib_Efuse_L3_GetCurrent_Val_I_C_ODH76 "" ULONG RB_RBA_Common_CentralElements_CompuMethods_Identical 1 100 0.0 4294967295 FORMAT "%8.2" ECU_ADDRESS 0xfe417c30 /end MEASUREMENT
/begin MEASUREMENT Tlib_Efuse_L3_GetVoltage_Val_O_S_ODH76 "" UWORD RB_RBA_Common_CentralElements_CompuMethods_Identical 1 100 0.0 65535 FORMAT "%8.2" ECU_ADDRESS 0xfe4196ba /end MEASUREMENT
/begin MEASUREMENT Tlib_DoVoltage_L3_Get_FilterVal_O_S_ODH76 "" UBYTE RB_RBA_Common_CentralElements_CompuMethods_Identical 1 100 0.0 255.00 FORMAT "%8.2" ECU_ADDRESS 0xfe419891 /end MEASUREMENT
/begin MEASUREMENT Tlib_DO_L3_DIAG_Get_Val_O_S_ODH76 "" UWORD RB_RBA_Common_CentralElements_CompuMethods_Identical 1 100 0.0 65535 FORMAT "%8.2" ECU_ADDRESS 0xfe4196bc /end MEASUREMENT
/begin MEASUREMENT Tlib_DIO_L3_GetStatus_Val_O_S_ODH65 "" UBYTE RB_RBA_Common_CentralElements_CompuMethods_Identical 1 100 0.0 255.00 FORMAT "%8.2" ECU_ADDRESS 0xfe419892 /end MEASUREMENT
/begin MEASUREMENT Tlib_Efuse_L3_GetCurrent_Val_I_C_ODH65 "" ULONG RB_RBA_Common_CentralElements_CompuMethods_Identical 1 100 0.0 4294967295 FORMAT "%8.2" ECU_ADDRESS 0xfe417c34 /end MEASUREMENT
/begin MEASUREMENT Tlib_Efuse_L3_GetVoltage_Val_O_S_ODH65 "" UWORD RB_RBA_Common_CentralElements_CompuMethods_Identical 1 100 0.0 65535 FORMAT "%8.2" ECU_ADDRESS 0xfe4196be /end MEASUREMENT
/begin MEASUREMENT Tlib_DoVoltage_L3_Get_FilterVal_O_S_ODH65 "" UBYTE RB_RBA_Common_CentralElements_CompuMethods_Identical 1 100 0.0 255.00 FORMAT "%8.2" ECU_ADDRESS 0xfe419893 /end MEASUREMENT
/begin MEASUREMENT Tlib_DO_L3_DIAG_Get_Val_O_S_ODH65 "" UWORD RB_RBA_Common_CentralElements_CompuMethods_Identical 1 100 0.0 65535 FORMAT "%8.2" ECU_ADDRESS 0xfe4196c0 /end MEASUREMENT
/begin MEASUREMENT Tlib_DIO_L3_GetStatus_Val_O_S_ODH83 "" UBYTE RB_RBA_Common_CentralElements_CompuMethods_Identical 1 100 0.0 255.00 FORMAT "%8.2" ECU_ADDRESS 0xfe419894 /end MEASUREMENT
/begin MEASUREMENT Tlib_Efuse_L3_GetCurrent_Val_I_C_ODH83 "" ULONG RB_RBA_Common_CentralElements_CompuMethods_Identical 1 100 0.0 4294967295 FORMAT "%8.2" ECU_ADDRESS 0xfe417c38 /end MEASUREMENT
/begin MEASUREMENT Tlib_Efuse_L3_GetVoltage_Val_O_S_ODH83 "" UWORD RB_RBA_Common_CentralElements_CompuMethods_Identical 1 100 0.0 65535 FORMAT "%8.2" ECU_ADDRESS 0xfe4196c2 /end MEASUREMENT
/begin MEASUREMENT Tlib_DoVoltage_L3_Get_FilterVal_O_S_ODH83 "" UBYTE RB_RBA_Common_CentralElements_CompuMethods_Identical 1 100 0.0 255.00 FORMAT "%8.2" ECU_ADDRESS 0xfe419895 /end MEASUREMENT
/begin MEASUREMENT Tlib_DO_L3_DIAG_Get_Val_O_S_ODH83 "" UWORD RB_RBA_Common_CentralElements_CompuMethods_Identical 1 100 0.0 65535 FORMAT "%8.2" ECU_ADDRESS 0xfe4196c4 /end MEASUREMENT
/begin MEASUREMENT Tlib_DIO_L3_GetStatus_Val_O_S_ODH54 "" UBYTE RB_RBA_Common_CentralElements_CompuMethods_Identical 1 100 0.0 255.00 FORMAT "%8.2" ECU_ADDRESS 0xfe419896 /end MEASUREMENT
/begin MEASUREMENT Tlib_Efuse_L3_GetCurrent_Val_I_C_ODH54 "" ULONG RB_RBA_Common_CentralElements_CompuMethods_Identical 1 100 0.0 4294967295 FORMAT "%8.2" ECU_ADDRESS 0xfe417c3c /end MEASUREMENT
/begin MEASUREMENT Tlib_Efuse_L3_GetVoltage_Val_O_S_ODH54 "" UWORD RB_RBA_Common_CentralElements_CompuMethods_Identical 1 100 0.0 65535 FORMAT "%8.2" ECU_ADDRESS 0xfe4196c6 /end MEASUREMENT
/begin MEASUREMENT Tlib_DoVoltage_L3_Get_FilterVal_O_S_ODH54 "" UBYTE RB_RBA_Common_CentralElements_CompuMethods_Identical 1 100 0.0 255.00 FORMAT "%8.2" ECU_ADDRESS 0xfe419897 /end MEASUREMENT
/begin MEASUREMENT Tlib_DO_L3_DIAG_Get_Val_O_S_ODH54 "" UWORD RB_RBA_Common_CentralElements_CompuMethods_Identical 1 100 0.0 65535 FORMAT "%8.2" ECU_ADDRESS 0xfe4196c8 /end MEASUREMENT
/begin MEASUREMENT Tlib_DIO_L3_GetStatus_Val_O_S_ODH42 "" UBYTE RB_RBA_Common_CentralElements_CompuMethods_Identical 1 100 0.0 255.00 FORMAT "%8.2" ECU_ADDRESS 0xfe419898 /end MEASUREMENT
/begin MEASUREMENT Tlib_Efuse_L3_GetCurrent_Val_I_C_ODH42 "" ULONG RB_RBA_Common_CentralElements_CompuMethods_Identical 1 100 0.0 4294967295 FORMAT "%8.2" ECU_ADDRESS 0xfe417c40 /end MEASUREMENT
/begin MEASUREMENT Tlib_Efuse_L3_GetVoltage_Val_O_S_ODH42 "" UWORD RB_RBA_Common_CentralElements_CompuMethods_Identical 1 100 0.0 65535 FORMAT "%8.2" ECU_ADDRESS 0xfe4196ca /end MEASUREMENT
/begin MEASUREMENT Tlib_DoVoltage_L3_Get_FilterVal_O_S_ODH42 "" UBYTE RB_RBA_Common_CentralElements_CompuMethods_Identical 1 100 0.0 255.00 FORMAT "%8.2" ECU_ADDRESS 0xfe419899 /end MEASUREMENT
/begin MEASUREMENT Tlib_DO_L3_DIAG_Get_Val_O_S_ODH42 "" UWORD RB_RBA_Common_CentralElements_CompuMethods_Identical 1 100 0.0 65535 FORMAT "%8.2" ECU_ADDRESS 0xfe4196cc /end MEASUREMENT
/begin MEASUREMENT Tlib_DIO_L3_GetStatus_Val_O_S_ODH80 "" UBYTE RB_RBA_Common_CentralElements_CompuMethods_Identical 1 100 0.0 255.00 FORMAT "%8.2" ECU_ADDRESS 0xfe41989a /end MEASUREMENT
/begin MEASUREMENT Tlib_Efuse_L3_GetCurrent_Val_I_C_ODH80 "" ULONG RB_RBA_Common_CentralElements_CompuMethods_Identical 1 100 0.0 4294967295 FORMAT "%8.2" ECU_ADDRESS 0xfe417c44 /end MEASUREMENT
/begin MEASUREMENT Tlib_Efuse_L3_GetVoltage_Val_O_S_ODH80 "" UWORD RB_RBA_Common_CentralElements_CompuMethods_Identical 1 100 0.0 65535 FORMAT "%8.2" ECU_ADDRESS 0xfe4196ce /end MEASUREMENT
/begin MEASUREMENT Tlib_DoVoltage_L3_Get_FilterVal_O_S_ODH80 "" UBYTE RB_RBA_Common_CentralElements_CompuMethods_Identical 1 100 0.0 255.00 FORMAT "%8.2" ECU_ADDRESS 0xfe41989b /end MEASUREMENT
/begin MEASUREMENT Tlib_DO_L3_DIAG_Get_Val_O_S_ODH80 "" UWORD RB_RBA_Common_CentralElements_CompuMethods_Identical 1 100 0.0 65535 FORMAT "%8.2" ECU_ADDRESS 0xfe4196d0 /end MEASUREMENT
/begin MEASUREMENT Tlib_DIO_L3_GetStatus_Val_O_S_ODH81 "" UBYTE RB_RBA_Common_CentralElements_CompuMethods_Identical 1 100 0.0 255.00 FORMAT "%8.2" ECU_ADDRESS 0xfe41989c /end MEASUREMENT
/begin MEASUREMENT Tlib_Efuse_L3_GetCurrent_Val_I_C_ODH81 "" ULONG RB_RBA_Common_CentralElements_CompuMethods_Identical 1 100 0.0 4294967295 FORMAT "%8.2" ECU_ADDRESS 0xfe417c48 /end MEASUREMENT
/begin MEASUREMENT Tlib_Efuse_L3_GetVoltage_Val_O_S_ODH81 "" UWORD RB_RBA_Common_CentralElements_CompuMethods_Identical 1 100 0.0 65535 FORMAT "%8.2" ECU_ADDRESS 0xfe4196d2 /end MEASUREMENT
/begin MEASUREMENT Tlib_DoVoltage_L3_Get_FilterVal_O_S_ODH81 "" UBYTE RB_RBA_Common_CentralElements_CompuMethods_Identical 1 100 0.0 255.00 FORMAT "%8.2" ECU_ADDRESS 0xfe41989d /end MEASUREMENT
/begin MEASUREMENT Tlib_DO_L3_DIAG_Get_Val_O_S_ODH81 "" UWORD RB_RBA_Common_CentralElements_CompuMethods_Identical 1 100 0.0 65535 FORMAT "%8.2" ECU_ADDRESS 0xfe4196d4 /end MEASUREMENT
/begin MEASUREMENT Tlib_DIO_L3_GetStatus_Val_O_S_EFUSE25 "" UBYTE RB_RBA_Common_CentralElements_CompuMethods_Identical 1 100 0.0 255.00 FORMAT "%8.2" ECU_ADDRESS 0xfe41989e /end MEASUREMENT
/begin MEASUREMENT Tlib_Efuse_L3_GetCurrent_Val_I_C_EFUSE25 "" ULONG RB_RBA_Common_CentralElements_CompuMethods_Identical 1 100 0.0 4294967295 FORMAT "%8.2" ECU_ADDRESS 0xfe417c4c /end MEASUREMENT
/begin MEASUREMENT Tlib_Efuse_L3_GetVoltage_Val_O_S_EFUSE25 "" UWORD RB_RBA_Common_CentralElements_CompuMethods_Identical 1 100 0.0 65535 FORMAT "%8.2" ECU_ADDRESS 0xfe4196d6 /end MEASUREMENT
/begin MEASUREMENT Tlib_DoVoltage_L3_Get_FilterVal_O_S_EFUSE25 "" UBYTE RB_RBA_Common_CentralElements_CompuMethods_Identical 1 100 0.0 255.00 FORMAT "%8.2" ECU_ADDRESS 0xfe41989f /end MEASUREMENT
/begin MEASUREMENT Tlib_DO_L3_DIAG_Get_Val_O_S_EFUSE25 "" UWORD RB_RBA_Common_CentralElements_CompuMethods_Identical 1 100 0.0 65535 FORMAT "%8.2" ECU_ADDRESS 0xfe4196d8 /end MEASUREMENT
/begin MEASUREMENT Tlib_DIO_L3_GetStatus_Val_O_S_ODH79 "" UBYTE RB_RBA_Common_CentralElements_CompuMethods_Identical 1 100 0.0 255.00 FORMAT "%8.2" ECU_ADDRESS 0xfe4198a0 /end MEASUREMENT
/begin MEASUREMENT Tlib_Efuse_L3_GetCurrent_Val_I_C_ODH79 "" ULONG RB_RBA_Common_CentralElements_CompuMethods_Identical 1 100 0.0 4294967295 FORMAT "%8.2" ECU_ADDRESS 0xfe417c50 /end MEASUREMENT
/begin MEASUREMENT Tlib_Efuse_L3_GetVoltage_Val_O_S_ODH79 "" UWORD RB_RBA_Common_CentralElements_CompuMethods_Identical 1 100 0.0 65535 FORMAT "%8.2" ECU_ADDRESS 0xfe4196da /end MEASUREMENT
/begin MEASUREMENT Tlib_DoVoltage_L3_Get_FilterVal_O_S_ODH79 "" UBYTE RB_RBA_Common_CentralElements_CompuMethods_Identical 1 100 0.0 255.00 FORMAT "%8.2" ECU_ADDRESS 0xfe4198a1 /end MEASUREMENT
/begin MEASUREMENT Tlib_DO_L3_DIAG_Get_Val_O_S_ODH79 "" UWORD RB_RBA_Common_CentralElements_CompuMethods_Identical 1 100 0.0 65535 FORMAT "%8.2" ECU_ADDRESS 0xfe4196dc /end MEASUREMENT
/begin MEASUREMENT Tlib_DIO_L3_GetStatus_Val_O_S_ODH78 "" UBYTE RB_RBA_Common_CentralElements_CompuMethods_Identical 1 100 0.0 255.00 FORMAT "%8.2" ECU_ADDRESS 0xfe4198a2 /end MEASUREMENT
/begin MEASUREMENT Tlib_Efuse_L3_GetCurrent_Val_I_C_ODH78 "" ULONG RB_RBA_Common_CentralElements_CompuMethods_Identical 1 100 0.0 4294967295 FORMAT "%8.2" ECU_ADDRESS 0xfe417c54 /end MEASUREMENT
/begin MEASUREMENT Tlib_Efuse_L3_GetVoltage_Val_O_S_ODH78 "" UWORD RB_RBA_Common_CentralElements_CompuMethods_Identical 1 100 0.0 65535 FORMAT "%8.2" ECU_ADDRESS 0xfe4196de /end MEASUREMENT
/begin MEASUREMENT Tlib_DoVoltage_L3_Get_FilterVal_O_S_ODH78 "" UBYTE RB_RBA_Common_CentralElements_CompuMethods_Identical 1 100 0.0 255.00 FORMAT "%8.2" ECU_ADDRESS 0xfe4198a3 /end MEASUREMENT
/begin MEASUREMENT Tlib_DO_L3_DIAG_Get_Val_O_S_ODH78 "" UWORD RB_RBA_Common_CentralElements_CompuMethods_Identical 1 100 0.0 65535 FORMAT "%8.2" ECU_ADDRESS 0xfe4196e0 /end MEASUREMENT
/begin MEASUREMENT Tlib_DIO_L3_GetStatus_Val_O_S_ODH74 "" UBYTE RB_RBA_Common_CentralElements_CompuMethods_Identical 1 100 0.0 255.00 FORMAT "%8.2" ECU_ADDRESS 0xfe4198a4 /end MEASUREMENT
/begin MEASUREMENT Tlib_Efuse_L3_GetCurrent_Val_I_C_ODH74 "" ULONG RB_RBA_Common_CentralElements_CompuMethods_Identical 1 100 0.0 4294967295 FORMAT "%8.2" ECU_ADDRESS 0xfe417c58 /end MEASUREMENT
/begin MEASUREMENT Tlib_Efuse_L3_GetVoltage_Val_O_S_ODH74 "" UWORD RB_RBA_Common_CentralElements_CompuMethods_Identical 1 100 0.0 65535 FORMAT "%8.2" ECU_ADDRESS 0xfe4196e2 /end MEASUREMENT
/begin MEASUREMENT Tlib_DoVoltage_L3_Get_FilterVal_O_S_ODH74 "" UBYTE RB_RBA_Common_CentralElements_CompuMethods_Identical 1 100 0.0 255.00 FORMAT "%8.2" ECU_ADDRESS 0xfe4198a5 /end MEASUREMENT
/begin MEASUREMENT Tlib_DO_L3_DIAG_Get_Val_O_S_ODH74 "" UWORD RB_RBA_Common_CentralElements_CompuMethods_Identical 1 100 0.0 65535 FORMAT "%8.2" ECU_ADDRESS 0xfe4196e4 /end MEASUREMENT
/begin MEASUREMENT Tlib_DIO_L3_GetStatus_Val_O_S_EFUSE26 "" UBYTE RB_RBA_Common_CentralElements_CompuMethods_Identical 1 100 0.0 255.00 FORMAT "%8.2" ECU_ADDRESS 0xfe4198a6 /end MEASUREMENT
/begin MEASUREMENT Tlib_Efuse_L3_GetCurrent_Val_I_C_EFUSE26 "" ULONG RB_RBA_Common_CentralElements_CompuMethods_Identical 1 100 0.0 4294967295 FORMAT "%8.2" ECU_ADDRESS 0xfe417c5c /end MEASUREMENT
/begin MEASUREMENT Tlib_Efuse_L3_GetVoltage_Val_O_S_EFUSE26 "" UWORD RB_RBA_Common_CentralElements_CompuMethods_Identical 1 100 0.0 65535 FORMAT "%8.2" ECU_ADDRESS 0xfe4196e6 /end MEASUREMENT
/begin MEASUREMENT Tlib_DoVoltage_L3_Get_FilterVal_O_S_EFUSE26 "" UBYTE RB_RBA_Common_CentralElements_CompuMethods_Identical 1 100 0.0 255.00 FORMAT "%8.2" ECU_ADDRESS 0xfe4198a7 /end MEASUREMENT
/begin MEASUREMENT Tlib_DO_L3_DIAG_Get_Val_O_S_EFUSE26 "" UWORD RB_RBA_Common_CentralElements_CompuMethods_Identical 1 100 0.0 65535 FORMAT "%8.2" ECU_ADDRESS 0xfe4196e8 /end MEASUREMENT
/begin MEASUREMENT Tlib_DIO_L3_GetStatus_Val_O_S_EFUSE28 "" UBYTE RB_RBA_Common_CentralElements_CompuMethods_Identical 1 100 0.0 255.00 FORMAT "%8.2" ECU_ADDRESS 0xfe4198a8 /end MEASUREMENT
/begin MEASUREMENT Tlib_Efuse_L3_GetCurrent_Val_I_C_EFUSE28 "" ULONG RB_RBA_Common_CentralElements_CompuMethods_Identical 1 100 0.0 4294967295 FORMAT "%8.2" ECU_ADDRESS 0xfe417c60 /end MEASUREMENT
/begin MEASUREMENT Tlib_Efuse_L3_GetVoltage_Val_O_S_EFUSE28 "" UWORD RB_RBA_Common_CentralElements_CompuMethods_Identical 1 100 0.0 65535 FORMAT "%8.2" ECU_ADDRESS 0xfe4196ea /end MEASUREMENT
/begin MEASUREMENT Tlib_DoVoltage_L3_Get_FilterVal_O_S_EFUSE28 "" UBYTE RB_RBA_Common_CentralElements_CompuMethods_Identical 1 100 0.0 255.00 FORMAT "%8.2" ECU_ADDRESS 0xfe4198a9 /end MEASUREMENT
/begin MEASUREMENT Tlib_DO_L3_DIAG_Get_Val_O_S_EFUSE28 "" UWORD RB_RBA_Common_CentralElements_CompuMethods_Identical 1 100 0.0 65535 FORMAT "%8.2" ECU_ADDRESS 0xfe4196ec /end MEASUREMENT
/begin MEASUREMENT Tlib_DIO_L3_GetStatus_Val_O_S_ODH33 "" UBYTE RB_RBA_Common_CentralElements_CompuMethods_Identical 1 100 0.0 255.00 FORMAT "%8.2" ECU_ADDRESS 0xfe4198aa /end MEASUREMENT
/begin MEASUREMENT Tlib_Efuse_L3_GetCurrent_Val_I_C_ODH33 "" ULONG RB_RBA_Common_CentralElements_CompuMethods_Identical 1 100 0.0 4294967295 FORMAT "%8.2" ECU_ADDRESS 0xfe417c64 /end MEASUREMENT
/begin MEASUREMENT Tlib_Efuse_L3_GetVoltage_Val_O_S_ODH33 "" UWORD RB_RBA_Common_CentralElements_CompuMethods_Identical 1 100 0.0 65535 FORMAT "%8.2" ECU_ADDRESS 0xfe4196ee /end MEASUREMENT
/begin MEASUREMENT Tlib_DoVoltage_L3_Get_FilterVal_O_S_ODH33 "" UBYTE RB_RBA_Common_CentralElements_CompuMethods_Identical 1 100 0.0 255.00 FORMAT "%8.2" ECU_ADDRESS 0xfe4198ab /end MEASUREMENT
/begin MEASUREMENT Tlib_DO_L3_DIAG_Get_Val_O_S_ODH33 "" UWORD RB_RBA_Common_CentralElements_CompuMethods_Identical 1 100 0.0 65535 FORMAT "%8.2" ECU_ADDRESS 0xfe4196f0 /end MEASUREMENT
/begin MEASUREMENT Tlib_DIO_L3_GetStatus_Val_O_S_ODH73 "" UBYTE RB_RBA_Common_CentralElements_CompuMethods_Identical 1 100 0.0 255.00 FORMAT "%8.2" ECU_ADDRESS 0xfe4198ac /end MEASUREMENT
/begin MEASUREMENT Tlib_Efuse_L3_GetCurrent_Val_I_C_ODH73 "" ULONG RB_RBA_Common_CentralElements_CompuMethods_Identical 1 100 0.0 4294967295 FORMAT "%8.2" ECU_ADDRESS 0xfe417c68 /end MEASUREMENT
/begin MEASUREMENT Tlib_Efuse_L3_GetVoltage_Val_O_S_ODH73 "" UWORD RB_RBA_Common_CentralElements_CompuMethods_Identical 1 100 0.0 65535 FORMAT "%8.2" ECU_ADDRESS 0xfe4196f2 /end MEASUREMENT
/begin MEASUREMENT Tlib_DoVoltage_L3_Get_FilterVal_O_S_ODH73 "" UBYTE RB_RBA_Common_CentralElements_CompuMethods_Identical 1 100 0.0 255.00 FORMAT "%8.2" ECU_ADDRESS 0xfe4198ad /end MEASUREMENT
/begin MEASUREMENT Tlib_DO_L3_DIAG_Get_Val_O_S_ODH73 "" UWORD RB_RBA_Common_CentralElements_CompuMethods_Identical 1 100 0.0 65535 FORMAT "%8.2" ECU_ADDRESS 0xfe4196f4 /end MEASUREMENT
/begin MEASUREMENT Tlib_DIO_L3_GetStatus_Val_O_S_ODH18 "" UBYTE RB_RBA_Common_CentralElements_CompuMethods_Identical 1 100 0.0 255.00 FORMAT "%8.2" ECU_ADDRESS 0xfe4198ae /end MEASUREMENT
/begin MEASUREMENT Tlib_Efuse_L3_GetCurrent_Val_I_C_ODH18 "" ULONG RB_RBA_Common_CentralElements_CompuMethods_Identical 1 100 0.0 4294967295 FORMAT "%8.2" ECU_ADDRESS 0xfe417c6c /end MEASUREMENT
/begin MEASUREMENT Tlib_Efuse_L3_GetVoltage_Val_O_S_ODH18 "" UWORD RB_RBA_Common_CentralElements_CompuMethods_Identical 1 100 0.0 65535 FORMAT "%8.2" ECU_ADDRESS 0xfe4196f6 /end MEASUREMENT
/begin MEASUREMENT Tlib_DoVoltage_L3_Get_FilterVal_O_S_ODH18 "" UBYTE RB_RBA_Common_CentralElements_CompuMethods_Identical 1 100 0.0 255.00 FORMAT "%8.2" ECU_ADDRESS 0xfe4198af /end MEASUREMENT
/begin MEASUREMENT Tlib_DO_L3_DIAG_Get_Val_O_S_ODH18 "" UWORD RB_RBA_Common_CentralElements_CompuMethods_Identical 1 100 0.0 65535 FORMAT "%8.2" ECU_ADDRESS 0xfe4196f8 /end MEASUREMENT
/begin MEASUREMENT Tlib_DIO_L3_GetStatus_Val_O_S_ODH77 "" UBYTE RB_RBA_Common_CentralElements_CompuMethods_Identical 1 100 0.0 255.00 FORMAT "%8.2" ECU_ADDRESS 0xfe4198b0 /end MEASUREMENT
/begin MEASUREMENT Tlib_Efuse_L3_GetCurrent_Val_I_C_ODH77 "" ULONG RB_RBA_Common_CentralElements_CompuMethods_Identical 1 100 0.0 4294967295 FORMAT "%8.2" ECU_ADDRESS 0xfe417c70 /end MEASUREMENT
/begin MEASUREMENT Tlib_Efuse_L3_GetVoltage_Val_O_S_ODH77 "" UWORD RB_RBA_Common_CentralElements_CompuMethods_Identical 1 100 0.0 65535 FORMAT "%8.2" ECU_ADDRESS 0xfe4196fa /end MEASUREMENT
/begin MEASUREMENT Tlib_DoVoltage_L3_Get_FilterVal_O_S_ODH77 "" UBYTE RB_RBA_Common_CentralElements_CompuMethods_Identical 1 100 0.0 255.00 FORMAT "%8.2" ECU_ADDRESS 0xfe4198b1 /end MEASUREMENT
/begin MEASUREMENT Tlib_DO_L3_DIAG_Get_Val_O_S_ODH77 "" UWORD RB_RBA_Common_CentralElements_CompuMethods_Identical 1 100 0.0 65535 FORMAT "%8.2" ECU_ADDRESS 0xfe4196fc /end MEASUREMENT
/begin MEASUREMENT Tlib_DIO_L3_GetStatus_Val_O_S_ODH61 "" UBYTE RB_RBA_Common_CentralElements_CompuMethods_Identical 1 100 0.0 255.00 FORMAT "%8.2" ECU_ADDRESS 0xfe4198b2 /end MEASUREMENT
/begin MEASUREMENT Tlib_Efuse_L3_GetCurrent_Val_I_C_ODH61 "" ULONG RB_RBA_Common_CentralElements_CompuMethods_Identical 1 100 0.0 4294967295 FORMAT "%8.2" ECU_ADDRESS 0xfe417c74 /end MEASUREMENT
/begin MEASUREMENT Tlib_Efuse_L3_GetVoltage_Val_O_S_ODH61 "" UWORD RB_RBA_Common_CentralElements_CompuMethods_Identical 1 100 0.0 65535 FORMAT "%8.2" ECU_ADDRESS 0xfe4196fe /end MEASUREMENT
/begin MEASUREMENT Tlib_DoVoltage_L3_Get_FilterVal_O_S_ODH61 "" UBYTE RB_RBA_Common_CentralElements_CompuMethods_Identical 1 100 0.0 255.00 FORMAT "%8.2" ECU_ADDRESS 0xfe4198b3 /end MEASUREMENT
/begin MEASUREMENT Tlib_DO_L3_DIAG_Get_Val_O_S_ODH61 "" UWORD RB_RBA_Common_CentralElements_CompuMethods_Identical 1 100 0.0 65535 FORMAT "%8.2" ECU_ADDRESS 0xfe419700 /end MEASUREMENT
/begin MEASUREMENT Tlib_DIO_L3_GetStatus_Val_O_S_ODH62 "" UBYTE RB_RBA_Common_CentralElements_CompuMethods_Identical 1 100 0.0 255.00 FORMAT "%8.2" ECU_ADDRESS 0xfe4198b4 /end MEASUREMENT
/begin MEASUREMENT Tlib_Efuse_L3_GetCurrent_Val_I_C_ODH62 "" ULONG RB_RBA_Common_CentralElements_CompuMethods_Identical 1 100 0.0 4294967295 FORMAT "%8.2" ECU_ADDRESS 0xfe417c78 /end MEASUREMENT
/begin MEASUREMENT Tlib_Efuse_L3_GetVoltage_Val_O_S_ODH62 "" UWORD RB_RBA_Common_CentralElements_CompuMethods_Identical 1 100 0.0 65535 FORMAT "%8.2" ECU_ADDRESS 0xfe419702 /end MEASUREMENT
/begin MEASUREMENT Tlib_DoVoltage_L3_Get_FilterVal_O_S_ODH62 "" UBYTE RB_RBA_Common_CentralElements_CompuMethods_Identical 1 100 0.0 255.00 FORMAT "%8.2" ECU_ADDRESS 0xfe4198b5 /end MEASUREMENT
/begin MEASUREMENT Tlib_DO_L3_DIAG_Get_Val_O_S_ODH62 "" UWORD RB_RBA_Common_CentralElements_CompuMethods_Identical 1 100 0.0 65535 FORMAT "%8.2" ECU_ADDRESS 0xfe419704 /end MEASUREMENT
/begin MEASUREMENT Tlib_DIO_L3_GetStatus_Val_O_S_ODH63 "" UBYTE RB_RBA_Common_CentralElements_CompuMethods_Identical 1 100 0.0 255.00 FORMAT "%8.2" ECU_ADDRESS 0xfe4198b6 /end MEASUREMENT
/*********** End of merged FUNCTION blocks ***********/ /*********** Start of merged COMPU_METHOD blocks ***********/
/begin COMPU_METHOD RB_RBA_Common_CentralElements_CompuMethods_Identical "The internal value and the physical one are identical. No physical unit available" RAT_FUNC "%10.5" "noUnit" COEFFS 0.0 1.0 0.0 0.0 0.0 1.0 REF_UNIT RB_RBA_Common_CentralElements_Units_NoUnit /end COMPU_METHOD
/*********** Start of merged UNIT blocks ***********/
/begin UNIT RB_RBA_Common_CentralElements_Units_NoUnit "No Unit" "noUnit" EXTENDED_SI SI_EXPONENTS 0 0 0 0 0 0 0 /end UNIT
/begin UNIT RB_RBA_rba_Etks_Units_NoUnit "No Unit" "noUnit" EXTENDED_SI SI_EXPONENTS 0 0 0 0 0 0 0 /end UNIT
/begin UNIT RB_RBA_rba_IoExtLib_Units_NoUnit "No Unit" "noUnit" EXTENDED_SI SI_EXPONENTS 0 0 0 0 0 0 0 /end UNIT
/begin UNIT RB_RBA_rba_IoSigRtc_Units_NoUnit "No Unit" "noUnit" EXTENDED_SI SI_EXPONENTS 0 0 0 0 0 0 0 /end UNIT
/begin UNIT RB_RBA_rba_LtcySpy_Units_MilliSec "Milli Second" "ms" EXTENDED_SI /end UNIT
/begin UNIT RB_RBA_rba_LtcySpy_Units_NoUnit "No Unit" "noUnit" EXTENDED_SI SI_EXPONENTS 0 0 0 0 0 0 0 /end UNIT
/begin UNIT RB_RBA_rba_LtcySpy_Units_MicroSec "Micro Second" "us" EXTENDED_SI /end UNIT
/end MODULE
/end PROJECT
