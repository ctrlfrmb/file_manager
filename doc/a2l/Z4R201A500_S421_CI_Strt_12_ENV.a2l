ASAP2_VERSION 1 61
/begin PROJECT ZCU "ZCU"
/begin HEADER "" VERSION "ZCU" PROJECT_NO ZCU /end HEADER
/begin MODULE DIM ""
/begin MOD_COMMON "" BYTE_ORDER MSB_LAST ALIGNMENT_BYTE 1 ALIGNMENT_WORD 2 ALIGNMENT_LONG 4 ALIGNMENT_INT64 4 ALIGNMENT_FLOAT32_IEEE 4 ALIGNMENT_FLOAT64_IEEE 4 DATA_SIZE 32 /end MOD_COMMON
/begin MEASUREMENT Tlib_EfuseRegRead_GetSR1_O_S_ODH78 "" ULONG RB_RBA_Common_CentralElements_CompuMethods_Identical 1 100 0.0 4294967295 FORMAT "%8.2" ECU_ADDRESS 0xfe4189a0 /end MEASUREMENT
/begin MEASUREMENT Tlib_EfuseRegRead_GetCurrent_O_S_ODH78 "" ULONG RB_RBA_Common_CentralElements_CompuMethods_Identical 1 100 0.0 4294967295 FORMAT "%8.2" ECU_ADDRESS 0xfe4189a4 /end MEASUREMENT
/begin MEASUREMENT Tlib_EfuseRegRead_GetTJ_O_S_ODH78 "" ULONG RB_RBA_Common_CentralElements_CompuMethods_Identical 1 100 0.0 4294967295 FORMAT "%8.2" ECU_ADDRESS 0xfe4189a8 /end MEASUREMENT
/begin MEASUREMENT Tlib_EfuseRegRead_GetTMOS_O_S_ODH78 "" ULONG RB_RBA_Common_CentralElements_CompuMethods_Identical 1 100 0.0 4294967295 FORMAT "%8.2" ECU_ADDRESS 0xfe4189ac /end MEASUREMENT
/begin MEASUREMENT Tlib_EfuseRegRead_GetVDS_O_S_ODH78 "" ULONG RB_RBA_Common_CentralElements_CompuMethods_Identical 1 100 0.0 4294967295 FORMAT "%8.2" ECU_ADDRESS 0xfe4189b0 /end MEASUREMENT
/begin MEASUREMENT Tlib_EfuseRegRead_GetVOUT_O_S_ODH78 "" ULONG RB_RBA_Common_CentralElements_CompuMethods_Identical 1 100 0.0 4294967295 FORMAT "%8.2" ECU_ADDRESS 0xfe4189b4 /end MEASUREMENT
/begin MEASUREMENT Tlib_EfuseRegRead_GetT_NOM_O_S_ODH78 "" ULONG RB_RBA_Common_CentralElements_CompuMethods_Identical 1 100 0.0 4294967295 FORMAT "%8.2" ECU_ADDRESS 0xfe4189b8 /end MEASUREMENT
/begin MEASUREMENT Tlib_EfuseRegRead_GetOVC_THR_O_S_ODH78 "" ULONG RB_RBA_Common_CentralElements_CompuMethods_Identical 1 100 0.0 4294967295 FORMAT "%8.2" ECU_ADDRESS 0xfe4189bc /end MEASUREMENT
/begin MEASUREMENT Tlib_EfuseRegRead_GetHSHT_THR_O_S_ODH78 "" ULONG RB_RBA_Common_CentralElements_CompuMethods_Identical 1 100 0.0 4294967295 FORMAT "%8.2" ECU_ADDRESS 0xfe4189c0 /end MEASUREMENT
/begin MEASUREMENT Tlib_EfuseRegRead_GetVDS_THR_O_S_ODH78 "" ULONG RB_RBA_Common_CentralElements_CompuMethods_Identical 1 100 0.0 4294967295 FORMAT "%8.2" ECU_ADDRESS 0xfe4189c4 /end MEASUREMENT
/begin MEASUREMENT Tlib_EfuseRegRead_GetNTC_THR_O_S_ODH78 "" ULONG RB_RBA_Common_CentralElements_CompuMethods_Identical 1 100 0.0 4294967295 FORMAT "%8.2" ECU_ADDRESS 0xfe4189c8 /end MEASUREMENT
/begin MEASUREMENT Tlib_EfuseRegRead_R_Shunt_O_S_ODH78 "" ULONG RB_RBA_Common_CentralElements_CompuMethods_Identical 1 100 0.0 4294967295 FORMAT "%8.2" ECU_ADDRESS 0xfe4189cc /end MEASUREMENT
/begin MEASUREMENT Tlib_EfuseRegRead_GetCr1_O_S_ODH74 "" ULONG RB_RBA_Common_CentralElements_CompuMethods_Identical 1 100 0.0 4294967295 FORMAT "%8.2" ECU_ADDRESS 0xfe4189d0 /end MEASUREMENT
/begin MEASUREMENT Tlib_EfuseRegRead_GetCR3_O_S_ODH74 "" ULONG RB_RBA_Common_CentralElements_CompuMethods_Identical 1 100 0.0 4294967295 FORMAT "%8.2" ECU_ADDRESS 0xfe4189d4 /end MEASUREMENT
/begin MEASUREMENT Tlib_EfuseRegRead_GetSR1_O_S_ODH74 "" ULONG RB_RBA_Common_CentralElements_CompuMethods_Identical 1 100 0.0 4294967295 FORMAT "%8.2" ECU_ADDRESS 0xfe4189d8 /end MEASUREMENT
/begin MEASUREMENT Tlib_EfuseRegRead_GetCurrent_O_S_ODH74 "" ULONG RB_RBA_Common_CentralElements_CompuMethods_Identical 1 100 0.0 4294967295 FORMAT "%8.2" ECU_ADDRESS 0xfe4189dc /end MEASUREMENT
/begin MEASUREMENT Tlib_EfuseRegRead_GetTJ_O_S_ODH74 "" ULONG RB_RBA_Common_CentralElements_CompuMethods_Identical 1 100 0.0 4294967295 FORMAT "%8.2" ECU_ADDRESS 0xfe4189e0 /end MEASUREMENT
/begin MEASUREMENT Tlib_EfuseRegRead_GetTMOS_O_S_ODH74 "" ULONG RB_RBA_Common_CentralElements_CompuMethods_Identical 1 100 0.0 4294967295 FORMAT "%8.2" ECU_ADDRESS 0xfe4189e4 /end MEASUREMENT
/begin MEASUREMENT Tlib_EfuseRegRead_GetVDS_O_S_ODH74 "" ULONG RB_RBA_Common_CentralElements_CompuMethods_Identical 1 100 0.0 4294967295 FORMAT "%8.2" ECU_ADDRESS 0xfe4189e8 /end MEASUREMENT
/begin MEASUREMENT Tlib_EfuseRegRead_GetVOUT_O_S_ODH74 "" ULONG RB_RBA_Common_CentralElements_CompuMethods_Identical 1 100 0.0 4294967295 FORMAT "%8.2" ECU_ADDRESS 0xfe4189ec /end MEASUREMENT
/begin MEASUREMENT Tlib_EfuseRegRead_GetT_NOM_O_S_ODH74 "" ULONG RB_RBA_Common_CentralElements_CompuMethods_Identical 1 100 0.0 4294967295 FORMAT "%8.2" ECU_ADDRESS 0xfe4189f0 /end MEASUREMENT
/begin MEASUREMENT Tlib_EfuseRegRead_GetOVC_THR_O_S_ODH74 "" ULONG RB_RBA_Common_CentralElements_CompuMethods_Identical 1 100 0.0 4294967295 FORMAT "%8.2" ECU_ADDRESS 0xfe4189f4 /end MEASUREMENT
/begin MEASUREMENT Tlib_EfuseRegRead_GetHSHT_THR_O_S_ODH74 "" ULONG RB_RBA_Common_CentralElements_CompuMethods_Identical 1 100 0.0 4294967295 FORMAT "%8.2" ECU_ADDRESS 0xfe4189f8 /end MEASUREMENT
/begin MEASUREMENT Tlib_EfuseRegRead_GetVDS_THR_O_S_ODH74 "" ULONG RB_RBA_Common_CentralElements_CompuMethods_Identical 1 100 0.0 4294967295 FORMAT "%8.2" ECU_ADDRESS 0xfe4189fc /end MEASUREMENT
/begin MEASUREMENT Tlib_EfuseRegRead_GetNTC_THR_O_S_ODH74 "" ULONG RB_RBA_Common_CentralElements_CompuMethods_Identical 1 100 0.0 4294967295 FORMAT "%8.2" ECU_ADDRESS 0xfe418a00 /end MEASUREMENT
/begin MEASUREMENT Tlib_EfuseRegRead_R_Shunt_O_S_ODH74 "" ULONG RB_RBA_Common_CentralElements_CompuMethods_Identical 1 100 0.0 4294967295 FORMAT "%8.2" ECU_ADDRESS 0xfe418a04 /end MEASUREMENT
/begin MEASUREMENT Tlib_EfuseRegRead_GetCr1_O_S_EFUSE26 "" ULONG RB_RBA_Common_CentralElements_CompuMethods_Identical 1 100 0.0 4294967295 FORMAT "%8.2" ECU_ADDRESS 0xfe418a08 /end MEASUREMENT
/begin MEASUREMENT Tlib_EfuseRegRead_GetCR3_O_S_EFUSE26 "" ULONG RB_RBA_Common_CentralElements_CompuMethods_Identical 1 100 0.0 4294967295 FORMAT "%8.2" ECU_ADDRESS 0xfe418a0c /end MEASUREMENT
/begin MEASUREMENT Tlib_EfuseRegRead_GetSR1_O_S_EFUSE26 "" ULONG RB_RBA_Common_CentralElements_CompuMethods_Identical 1 100 0.0 4294967295 FORMAT "%8.2" ECU_ADDRESS 0xfe418a10 /end MEASUREMENT
/begin MEASUREMENT Tlib_EfuseRegRead_GetCurrent_O_S_EFUSE26 "" ULONG RB_RBA_Common_CentralElements_CompuMethods_Identical 1 100 0.0 4294967295 FORMAT "%8.2" ECU_ADDRESS 0xfe418a14 /end MEASUREMENT
/begin MEASUREMENT Tlib_EfuseRegRead_GetTJ_O_S_EFUSE26 "" ULONG RB_RBA_Common_CentralElements_CompuMethods_Identical 1 100 0.0 4294967295 FORMAT "%8.2" ECU_ADDRESS 0xfe418a18 /end MEASUREMENT
/begin MEASUREMENT Tlib_EfuseRegRead_GetTMOS_O_S_EFUSE26 "" ULONG RB_RBA_Common_CentralElements_CompuMethods_Identical 1 100 0.0 4294967295 FORMAT "%8.2" ECU_ADDRESS 0xfe418a1c /end MEASUREMENT
/begin MEASUREMENT Tlib_EfuseRegRead_GetVDS_O_S_EFUSE26 "" ULONG RB_RBA_Common_CentralElements_CompuMethods_Identical 1 100 0.0 4294967295 FORMAT "%8.2" ECU_ADDRESS 0xfe418a20 /end MEASUREMENT
/begin MEASUREMENT Tlib_EfuseRegRead_GetVOUT_O_S_EFUSE26 "" ULONG RB_RBA_Common_CentralElements_CompuMethods_Identical 1 100 0.0 4294967295 FORMAT "%8.2" ECU_ADDRESS 0xfe418a24 /end MEASUREMENT
/begin MEASUREMENT Tlib_EfuseRegRead_GetT_NOM_O_S_EFUSE26 "" ULONG RB_RBA_Common_CentralElements_CompuMethods_Identical 1 100 0.0 4294967295 FORMAT "%8.2" ECU_ADDRESS 0xfe418a28 /end MEASUREMENT
/begin MEASUREMENT Tlib_EfuseRegRead_GetOVC_THR_O_S_EFUSE26 "" ULONG RB_RBA_Common_CentralElements_CompuMethods_Identical 1 100 0.0 4294967295 FORMAT "%8.2" ECU_ADDRESS 0xfe418a2c /end MEASUREMENT
/begin MEASUREMENT Tlib_EfuseRegRead_GetHSHT_THR_O_S_EFUSE26 "" ULONG RB_RBA_Common_CentralElements_CompuMethods_Identical 1 100 0.0 4294967295 FORMAT "%8.2" ECU_ADDRESS 0xfe418a30 /end MEASUREMENT
/begin MEASUREMENT Tlib_EfuseRegRead_GetVDS_THR_O_S_EFUSE26 "" ULONG RB_RBA_Common_CentralElements_CompuMethods_Identical 1 100 0.0 4294967295 FORMAT "%8.2" ECU_ADDRESS 0xfe418a34 /end MEASUREMENT
/begin MEASUREMENT Tlib_EfuseRegRead_GetNTC_THR_O_S_EFUSE26 "" ULONG RB_RBA_Common_CentralElements_CompuMethods_Identical 1 100 0.0 4294967295 FORMAT "%8.2" ECU_ADDRESS 0xfe418a38 /end MEASUREMENT
/begin MEASUREMENT Tlib_EfuseRegRead_R_Shunt_O_S_EFUSE26 "" ULONG RB_RBA_Common_CentralElements_CompuMethods_Identical 1 100 0.0 4294967295 FORMAT "%8.2" ECU_ADDRESS 0xfe418a3c /end MEASUREMENT
/begin MEASUREMENT Tlib_EfuseRegRead_GetCr1_O_S_EFUSE28 "" ULONG RB_RBA_Common_CentralElements_CompuMethods_Identical 1 100 0.0 4294967295 FORMAT "%8.2" ECU_ADDRESS 0xfe418a40 /end MEASUREMENT
/begin MEASUREMENT Tlib_EfuseRegRead_GetCR3_O_S_EFUSE28 "" ULONG RB_RBA_Common_CentralElements_CompuMethods_Identical 1 100 0.0 4294967295 FORMAT "%8.2" ECU_ADDRESS 0xfe418a44 /end MEASUREMENT
/begin MEASUREMENT Tlib_EfuseRegRead_GetSR1_O_S_EFUSE28 "" ULONG RB_RBA_Common_CentralElements_CompuMethods_Identical 1 100 0.0 4294967295 FORMAT "%8.2" ECU_ADDRESS 0xfe418a48 /end MEASUREMENT
/begin MEASUREMENT Tlib_EfuseRegRead_GetCurrent_O_S_EFUSE28 "" ULONG RB_RBA_Common_CentralElements_CompuMethods_Identical 1 100 0.0 4294967295 FORMAT "%8.2" ECU_ADDRESS 0xfe418a4c /end MEASUREMENT
/begin MEASUREMENT Tlib_EfuseRegRead_GetTJ_O_S_EFUSE28 "" ULONG RB_RBA_Common_CentralElements_CompuMethods_Identical 1 100 0.0 4294967295 FORMAT "%8.2" ECU_ADDRESS 0xfe418a50 /end MEASUREMENT
/begin MEASUREMENT Tlib_EfuseRegRead_GetTMOS_O_S_EFUSE28 "" ULONG RB_RBA_Common_CentralElements_CompuMethods_Identical 1 100 0.0 4294967295 FORMAT "%8.2" ECU_ADDRESS 0xfe418a54 /end MEASUREMENT
/begin MEASUREMENT Tlib_EfuseRegRead_GetVDS_O_S_EFUSE28 "" ULONG RB_RBA_Common_CentralElements_CompuMethods_Identical 1 100 0.0 4294967295 FORMAT "%8.2" ECU_ADDRESS 0xfe418a58 /end MEASUREMENT
/begin MEASUREMENT Tlib_EfuseRegRead_GetVOUT_O_S_EFUSE28 "" ULONG RB_RBA_Common_CentralElements_CompuMethods_Identical 1 100 0.0 4294967295 FORMAT "%8.2" ECU_ADDRESS 0xfe418a5c /end MEASUREMENT
/begin MEASUREMENT Tlib_EfuseRegRead_GetT_NOM_O_S_EFUSE28 "" ULONG RB_RBA_Common_CentralElements_CompuMethods_Identical 1 100 0.0 4294967295 FORMAT "%8.2" ECU_ADDRESS 0xfe418a60 /end MEASUREMENT
/begin MEASUREMENT Tlib_EfuseRegRead_GetOVC_THR_O_S_EFUSE28 "" ULONG RB_RBA_Common_CentralElements_CompuMethods_Identical 1 100 0.0 4294967295 FORMAT "%8.2" ECU_ADDRESS 0xfe418a64 /end MEASUREMENT
/begin MEASUREMENT Tlib_EfuseRegRead_GetHSHT_THR_O_S_EFUSE28 "" ULONG RB_RBA_Common_CentralElements_CompuMethods_Identical 1 100 0.0 4294967295 FORMAT "%8.2" ECU_ADDRESS 0xfe418a68 /end MEASUREMENT
/begin MEASUREMENT Tlib_EfuseRegRead_GetVDS_THR_O_S_EFUSE28 "" ULONG RB_RBA_Common_CentralElements_CompuMethods_Identical 1 100 0.0 4294967295 FORMAT "%8.2" ECU_ADDRESS 0xfe418a6c /end MEASUREMENT
/begin MEASUREMENT Tlib_EfuseRegRead_GetNTC_THR_O_S_EFUSE28 "" ULONG RB_RBA_Common_CentralElements_CompuMethods_Identical 1 100 0.0 4294967295 FORMAT "%8.2" ECU_ADDRESS 0xfe418a70 /end MEASUREMENT
/begin MEASUREMENT Tlib_EfuseRegRead_R_Shunt_O_S_EFUSE28 "" ULONG RB_RBA_Common_CentralElements_CompuMethods_Identical 1 100 0.0 4294967295 FORMAT "%8.2" ECU_ADDRESS 0xfe418a74 /end MEASUREMENT
/begin MEASUREMENT Tlib_EfuseRegRead_GetCr1_O_S_ODH33 "" ULONG RB_RBA_Common_CentralElements_CompuMethods_Identical 1 100 0.0 4294967295 FORMAT "%8.2" ECU_ADDRESS 0xfe418a78 /end MEASUREMENT
/begin MEASUREMENT Tlib_EfuseRegRead_GetCR3_O_S_ODH33 "" ULONG RB_RBA_Common_CentralElements_CompuMethods_Identical 1 100 0.0 4294967295 FORMAT "%8.2" ECU_ADDRESS 0xfe418a7c /end MEASUREMENT
/begin MEASUREMENT Tlib_EfuseRegRead_GetSR1_O_S_ODH33 "" ULONG RB_RBA_Common_CentralElements_CompuMethods_Identical 1 100 0.0 4294967295 FORMAT "%8.2" ECU_ADDRESS 0xfe418a80 /end MEASUREMENT
/begin MEASUREMENT Tlib_EfuseRegRead_GetCurrent_O_S_ODH33 "" ULONG RB_RBA_Common_CentralElements_CompuMethods_Identical 1 100 0.0 4294967295 FORMAT "%8.2" ECU_ADDRESS 0xfe418a84 /end MEASUREMENT
/begin MEASUREMENT Tlib_EfuseRegRead_GetTJ_O_S_ODH33 "" ULONG RB_RBA_Common_CentralElements_CompuMethods_Identical 1 100 0.0 4294967295 FORMAT "%8.2" ECU_ADDRESS 0xfe418a88 /end MEASUREMENT
/begin MEASUREMENT Tlib_EfuseRegRead_GetTMOS_O_S_ODH33 "" ULONG RB_RBA_Common_CentralElements_CompuMethods_Identical 1 100 0.0 4294967295 FORMAT "%8.2" ECU_ADDRESS 0xfe418a8c /end MEASUREMENT
/begin MEASUREMENT Tlib_EfuseRegRead_GetVDS_O_S_ODH33 "" ULONG RB_RBA_Common_CentralElements_CompuMethods_Identical 1 100 0.0 4294967295 FORMAT "%8.2" ECU_ADDRESS 0xfe418a90 /end MEASUREMENT
/begin MEASUREMENT Tlib_EfuseRegRead_GetVOUT_O_S_ODH33 "" ULONG RB_RBA_Common_CentralElements_CompuMethods_Identical 1 100 0.0 4294967295 FORMAT "%8.2" ECU_ADDRESS 0xfe418a94 /end MEASUREMENT
/begin MEASUREMENT Tlib_EfuseRegRead_GetT_NOM_O_S_ODH33 "" ULONG RB_RBA_Common_CentralElements_CompuMethods_Identical 1 100 0.0 4294967295 FORMAT "%8.2" ECU_ADDRESS 0xfe418a98 /end MEASUREMENT
/begin MEASUREMENT Tlib_EfuseRegRead_GetOVC_THR_O_S_ODH33 "" ULONG RB_RBA_Common_CentralElements_CompuMethods_Identical 1 100 0.0 4294967295 FORMAT "%8.2" ECU_ADDRESS 0xfe418a9c /end MEASUREMENT
/begin MEASUREMENT Tlib_EfuseRegRead_GetHSHT_THR_O_S_ODH33 "" ULONG RB_RBA_Common_CentralElements_CompuMethods_Identical 1 100 0.0 4294967295 FORMAT "%8.2" ECU_ADDRESS 0xfe418aa0 /end MEASUREMENT
/begin MEASUREMENT Tlib_EfuseRegRead_GetVDS_THR_O_S_ODH33 "" ULONG RB_RBA_Common_CentralElements_CompuMethods_Identical 1 100 0.0 4294967295 FORMAT "%8.2" ECU_ADDRESS 0xfe418aa4 /end MEASUREMENT
/begin MEASUREMENT Tlib_EfuseRegRead_GetNTC_THR_O_S_ODH33 "" ULONG RB_RBA_Common_CentralElements_CompuMethods_Identical 1 100 0.0 4294967295 FORMAT "%8.2" ECU_ADDRESS 0xfe418aa8 /end MEASUREMENT
/begin MEASUREMENT Tlib_EfuseRegRead_R_Shunt_O_S_ODH33 "" ULONG RB_RBA_Common_CentralElements_CompuMethods_Identical 1 100 0.0 4294967295 FORMAT "%8.2" ECU_ADDRESS 0xfe418aac /end MEASUREMENT
/begin MEASUREMENT Tlib_EfuseRegRead_GetCr1_O_S_ODH73 "" ULONG RB_RBA_Common_CentralElements_CompuMethods_Identical 1 100 0.0 4294967295 FORMAT "%8.2" ECU_ADDRESS 0xfe418ab0 /end MEASUREMENT
/begin MEASUREMENT Tlib_EfuseRegRead_GetCR3_O_S_ODH73 "" ULONG RB_RBA_Common_CentralElements_CompuMethods_Identical 1 100 0.0 4294967295 FORMAT "%8.2" ECU_ADDRESS 0xfe418ab4 /end MEASUREMENT
/begin MEASUREMENT Tlib_EfuseRegRead_GetSR1_O_S_ODH73 "" ULONG RB_RBA_Common_CentralElements_CompuMethods_Identical 1 100 0.0 4294967295 FORMAT "%8.2" ECU_ADDRESS 0xfe418ab8 /end MEASUREMENT
/begin MEASUREMENT Tlib_EfuseRegRead_GetCurrent_O_S_ODH73 "" ULONG RB_RBA_Common_CentralElements_CompuMethods_Identical 1 100 0.0 4294967295 FORMAT "%8.2" ECU_ADDRESS 0xfe418abc /end MEASUREMENT
/begin MEASUREMENT Tlib_EfuseRegRead_GetTJ_O_S_ODH73 "" ULONG RB_RBA_Common_CentralElements_CompuMethods_Identical 1 100 0.0 4294967295 FORMAT "%8.2" ECU_ADDRESS 0xfe418ac0 /end MEASUREMENT
/begin MEASUREMENT Tlib_EfuseRegRead_GetTMOS_O_S_ODH73 "" ULONG RB_RBA_Common_CentralElements_CompuMethods_Identical 1 100 0.0 4294967295 FORMAT "%8.2" ECU_ADDRESS 0xfe418ac4 /end MEASUREMENT
/begin MEASUREMENT Tlib_EfuseRegRead_GetVDS_O_S_ODH73 "" ULONG RB_RBA_Common_CentralElements_CompuMethods_Identical 1 100 0.0 4294967295 FORMAT "%8.2" ECU_ADDRESS 0xfe418ac8 /end MEASUREMENT
/begin MEASUREMENT Tlib_EfuseRegRead_GetVOUT_O_S_ODH73 "" ULONG RB_RBA_Common_CentralElements_CompuMethods_Identical 1 100 0.0 4294967295 FORMAT "%8.2" ECU_ADDRESS 0xfe418acc /end MEASUREMENT
/begin MEASUREMENT Tlib_EfuseRegRead_GetT_NOM_O_S_ODH73 "" ULONG RB_RBA_Common_CentralElements_CompuMethods_Identical 1 100 0.0 4294967295 FORMAT "%8.2" ECU_ADDRESS 0xfe418ad0 /end MEASUREMENT
/begin MEASUREMENT Tlib_EfuseRegRead_GetOVC_THR_O_S_ODH73 "" ULONG RB_RBA_Common_CentralElements_CompuMethods_Identical 1 100 0.0 4294967295 FORMAT "%8.2" ECU_ADDRESS 0xfe418ad4 /end MEASUREMENT
/begin MEASUREMENT Tlib_EfuseRegRead_GetHSHT_THR_O_S_ODH73 "" ULONG RB_RBA_Common_CentralElements_CompuMethods_Identical 1 100 0.0 4294967295 FORMAT "%8.2" ECU_ADDRESS 0xfe418ad8 /end MEASUREMENT
/begin MEASUREMENT Tlib_EfuseRegRead_GetVDS_THR_O_S_ODH73 "" ULONG RB_RBA_Common_CentralElements_CompuMethods_Identical 1 100 0.0 4294967295 FORMAT "%8.2" ECU_ADDRESS 0xfe418adc /end MEASUREMENT
/begin MEASUREMENT Tlib_EfuseRegRead_GetNTC_THR_O_S_ODH73 "" ULONG RB_RBA_Common_CentralElements_CompuMethods_Identical 1 100 0.0 4294967295 FORMAT "%8.2" ECU_ADDRESS 0xfe418ae0 /end MEASUREMENT
/begin MEASUREMENT Tlib_EfuseRegRead_R_Shunt_O_S_ODH73 "" ULONG RB_RBA_Common_CentralElements_CompuMethods_Identical 1 100 0.0 4294967295 FORMAT "%8.2" ECU_ADDRESS 0xfe418ae4 /end MEASUREMENT
/begin MEASUREMENT Tlib_EfuseRegRead_GetCr1_O_S_ODH18 "" ULONG RB_RBA_Common_CentralElements_CompuMethods_Identical 1 100 0.0 4294967295 FORMAT "%8.2" ECU_ADDRESS 0xfe418ae8 /end MEASUREMENT
/begin MEASUREMENT Tlib_EfuseRegRead_GetCR3_O_S_ODH18 "" ULONG RB_RBA_Common_CentralElements_CompuMethods_Identical 1 100 0.0 4294967295 FORMAT "%8.2" ECU_ADDRESS 0xfe418aec /end MEASUREMENT
/begin MEASUREMENT Tlib_EfuseRegRead_GetSR1_O_S_ODH18 "" ULONG RB_RBA_Common_CentralElements_CompuMethods_Identical 1 100 0.0 4294967295 FORMAT "%8.2" ECU_ADDRESS 0xfe418af0 /end MEASUREMENT
/begin MEASUREMENT Tlib_EfuseRegRead_GetCurrent_O_S_ODH18 "" ULONG RB_RBA_Common_CentralElements_CompuMethods_Identical 1 100 0.0 4294967295 FORMAT "%8.2" ECU_ADDRESS 0xfe418af4 /end MEASUREMENT
/begin MEASUREMENT Tlib_EfuseRegRead_GetTJ_O_S_ODH18 "" ULONG RB_RBA_Common_CentralElements_CompuMethods_Identical 1 100 0.0 4294967295 FORMAT "%8.2" ECU_ADDRESS 0xfe418af8 /end MEASUREMENT
/begin MEASUREMENT Tlib_EfuseRegRead_GetTMOS_O_S_ODH18 "" ULONG RB_RBA_Common_CentralElements_CompuMethods_Identical 1 100 0.0 4294967295 FORMAT "%8.2" ECU_ADDRESS 0xfe418afc /end MEASUREMENT
/begin MEASUREMENT Tlib_EfuseRegRead_GetVDS_O_S_ODH18 "" ULONG RB_RBA_Common_CentralElements_CompuMethods_Identical 1 100 0.0 4294967295 FORMAT "%8.2" ECU_ADDRESS 0xfe418b00 /end MEASUREMENT
/begin MEASUREMENT Tlib_EfuseRegRead_GetVOUT_O_S_ODH18 "" ULONG RB_RBA_Common_CentralElements_CompuMethods_Identical 1 100 0.0 4294967295 FORMAT "%8.2" ECU_ADDRESS 0xfe418b04 /end MEASUREMENT
/begin MEASUREMENT Tlib_EfuseRegRead_GetT_NOM_O_S_ODH18 "" ULONG RB_RBA_Common_CentralElements_CompuMethods_Identical 1 100 0.0 4294967295 FORMAT "%8.2" ECU_ADDRESS 0xfe418b08 /end MEASUREMENT
/begin MEASUREMENT Tlib_EfuseRegRead_GetOVC_THR_O_S_ODH18 "" ULONG RB_RBA_Common_CentralElements_CompuMethods_Identical 1 100 0.0 4294967295 FORMAT "%8.2" ECU_ADDRESS 0xfe418b0c /end MEASUREMENT
/begin MEASUREMENT Tlib_EfuseRegRead_GetHSHT_THR_O_S_ODH18 "" ULONG RB_RBA_Common_CentralElements_CompuMethods_Identical 1 100 0.0 4294967295 FORMAT "%8.2" ECU_ADDRESS 0xfe418b10 /end MEASUREMENT
/begin MEASUREMENT Tlib_EfuseRegRead_GetVDS_THR_O_S_ODH18 "" ULONG RB_RBA_Common_CentralElements_CompuMethods_Identical 1 100 0.0 4294967295 FORMAT "%8.2" ECU_ADDRESS 0xfe418b14 /end MEASUREMENT
/begin MEASUREMENT Tlib_EfuseRegRead_GetNTC_THR_O_S_ODH18 "" ULONG RB_RBA_Common_CentralElements_CompuMethods_Identical 1 100 0.0 4294967295 FORMAT "%8.2" ECU_ADDRESS 0xfe418b18 /end MEASUREMENT
/begin MEASUREMENT Tlib_EfuseRegRead_R_Shunt_O_S_ODH18 "" ULONG RB_RBA_Common_CentralElements_CompuMethods_Identical 1 100 0.0 4294967295 FORMAT "%8.2" ECU_ADDRESS 0xfe418b1c /end MEASUREMENT
/begin MEASUREMENT Tlib_EfuseRegRead_GetCr1_O_S_ODH77 "" ULONG RB_RBA_Common_CentralElements_CompuMethods_Identical 1 100 0.0 4294967295 FORMAT "%8.2" ECU_ADDRESS 0xfe418b20 /end MEASUREMENT
/begin MEASUREMENT Tlib_EfuseRegRead_GetCR3_O_S_ODH77 "" ULONG RB_RBA_Common_CentralElements_CompuMethods_Identical 1 100 0.0 4294967295 FORMAT "%8.2" ECU_ADDRESS 0xfe418b24 /end MEASUREMENT
/begin MEASUREMENT Tlib_EfuseRegRead_GetSR1_O_S_ODH77 "" ULONG RB_RBA_Common_CentralElements_CompuMethods_Identical 1 100 0.0 4294967295 FORMAT "%8.2" ECU_ADDRESS 0xfe418b28 /end MEASUREMENT
/begin MEASUREMENT Tlib_EfuseRegRead_GetCurrent_O_S_ODH77 "" ULONG RB_RBA_Common_CentralElements_CompuMethods_Identical 1 100 0.0 4294967295 FORMAT "%8.2" ECU_ADDRESS 0xfe418b2c /end MEASUREMENT
/begin MEASUREMENT Tlib_EfuseRegRead_GetTJ_O_S_ODH77 "" ULONG RB_RBA_Common_CentralElements_CompuMethods_Identical 1 100 0.0 4294967295 FORMAT "%8.2" ECU_ADDRESS 0xfe418b30 /end MEASUREMENT
/begin MEASUREMENT Tlib_EfuseRegRead_GetTMOS_O_S_ODH77 "" ULONG RB_RBA_Common_CentralElements_CompuMethods_Identical 1 100 0.0 4294967295 FORMAT "%8.2" ECU_ADDRESS 0xfe418b34 /end MEASUREMENT
/begin MEASUREMENT Tlib_EfuseRegRead_GetVDS_O_S_ODH77 "" ULONG RB_RBA_Common_CentralElements_CompuMethods_Identical 1 100 0.0 4294967295 FORMAT "%8.2" ECU_ADDRESS 0xfe418b38 /end MEASUREMENT
/begin MEASUREMENT Tlib_EfuseRegRead_GetVOUT_O_S_ODH77 "" ULONG RB_RBA_Common_CentralElements_CompuMethods_Identical 1 100 0.0 4294967295 FORMAT "%8.2" ECU_ADDRESS 0xfe418b3c /end MEASUREMENT
/begin MEASUREMENT Tlib_EfuseRegRead_GetT_NOM_O_S_ODH77 "" ULONG RB_RBA_Common_CentralElements_CompuMethods_Identical 1 100 0.0 4294967295 FORMAT "%8.2" ECU_ADDRESS 0xfe418b40 /end MEASUREMENT
/begin MEASUREMENT Tlib_EfuseRegRead_GetOVC_THR_O_S_ODH77 "" ULONG RB_RBA_Common_CentralElements_CompuMethods_Identical 1 100 0.0 4294967295 FORMAT "%8.2" ECU_ADDRESS 0xfe418b44 /end MEASUREMENT
/begin MEASUREMENT Tlib_EfuseRegRead_GetHSHT_THR_O_S_ODH77 "" ULONG RB_RBA_Common_CentralElements_CompuMethods_Identical 1 100 0.0 4294967295 FORMAT "%8.2" ECU_ADDRESS 0xfe418b48 /end MEASUREMENT
/begin MEASUREMENT Tlib_EfuseRegRead_GetVDS_THR_O_S_ODH77 "" ULONG RB_RBA_Common_CentralElements_CompuMethods_Identical 1 100 0.0 4294967295 FORMAT "%8.2" ECU_ADDRESS 0xfe418b4c /end MEASUREMENT
/begin MEASUREMENT Tlib_EfuseRegRead_GetNTC_THR_O_S_ODH77 "" ULONG RB_RBA_Common_CentralElements_CompuMethods_Identical 1 100 0.0 4294967295 FORMAT "%8.2" ECU_ADDRESS 0xfe418b50 /end MEASUREMENT
/begin MEASUREMENT Tlib_EfuseRegRead_R_Shunt_O_S_ODH77 "" ULONG RB_RBA_Common_CentralElements_CompuMethods_Identical 1 100 0.0 4294967295 FORMAT "%8.2" ECU_ADDRESS 0xfe418b54 /end MEASUREMENT
/begin MEASUREMENT Tlib_EfuseRegRead_GetCr1_O_S_ODH61 "" ULONG RB_RBA_Common_CentralElements_CompuMethods_Identical 1 100 0.0 4294967295 FORMAT "%8.2" ECU_ADDRESS 0xfe418b58 /end MEASUREMENT
/begin MEASUREMENT Tlib_EfuseRegRead_GetCR3_O_S_ODH61 "" ULONG RB_RBA_Common_CentralElements_CompuMethods_Identical 1 100 0.0 4294967295 FORMAT "%8.2" ECU_ADDRESS 0xfe418b5c /end MEASUREMENT
/begin MEASUREMENT Tlib_EfuseRegRead_GetSR1_O_S_ODH61 "" ULONG RB_RBA_Common_CentralElements_CompuMethods_Identical 1 100 0.0 4294967295 FORMAT "%8.2" ECU_ADDRESS 0xfe418b60 /end MEASUREMENT
/begin MEASUREMENT Tlib_EfuseRegRead_GetCurrent_O_S_ODH61 "" ULONG RB_RBA_Common_CentralElements_CompuMethods_Identical 1 100 0.0 4294967295 FORMAT "%8.2" ECU_ADDRESS 0xfe418b64 /end MEASUREMENT
/begin MEASUREMENT Tlib_EfuseRegRead_GetTJ_O_S_ODH61 "" ULONG RB_RBA_Common_CentralElements_CompuMethods_Identical 1 100 0.0 4294967295 FORMAT "%8.2" ECU_ADDRESS 0xfe418b68 /end MEASUREMENT
/begin MEASUREMENT Tlib_EfuseRegRead_GetTMOS_O_S_ODH61 "" ULONG RB_RBA_Common_CentralElements_CompuMethods_Identical 1 100 0.0 4294967295 FORMAT "%8.2" ECU_ADDRESS 0xfe418b6c /end MEASUREMENT
/begin MEASUREMENT Tlib_EfuseRegRead_GetVDS_O_S_ODH61 "" ULONG RB_RBA_Common_CentralElements_CompuMethods_Identical 1 100 0.0 4294967295 FORMAT "%8.2" ECU_ADDRESS 0xfe418b70 /end MEASUREMENT
/begin MEASUREMENT Tlib_EfuseRegRead_GetVOUT_O_S_ODH61 "" ULONG RB_RBA_Common_CentralElements_CompuMethods_Identical 1 100 0.0 4294967295 FORMAT "%8.2" ECU_ADDRESS 0xfe418b74 /end MEASUREMENT
/begin MEASUREMENT Tlib_EfuseRegRead_GetT_NOM_O_S_ODH61 "" ULONG RB_RBA_Common_CentralElements_CompuMethods_Identical 1 100 0.0 4294967295 FORMAT "%8.2" ECU_ADDRESS 0xfe418b78 /end MEASUREMENT
/begin MEASUREMENT Tlib_EfuseRegRead_GetOVC_THR_O_S_ODH61 "" ULONG RB_RBA_Common_CentralElements_CompuMethods_Identical 1 100 0.0 4294967295 FORMAT "%8.2" ECU_ADDRESS 0xfe418b7c /end MEASUREMENT
/begin MEASUREMENT Tlib_EfuseRegRead_GetHSHT_THR_O_S_ODH61 "" ULONG RB_RBA_Common_CentralElements_CompuMethods_Identical 1 100 0.0 4294967295 FORMAT "%8.2" ECU_ADDRESS 0xfe418b80 /end MEASUREMENT
/begin MEASUREMENT Tlib_EfuseRegRead_GetVDS_THR_O_S_ODH61 "" ULONG RB_RBA_Common_CentralElements_CompuMethods_Identical 1 100 0.0 4294967295 FORMAT "%8.2" ECU_ADDRESS 0xfe418b84 /end MEASUREMENT
/begin MEASUREMENT Tlib_EfuseRegRead_GetNTC_THR_O_S_ODH61 "" ULONG RB_RBA_Common_CentralElements_CompuMethods_Identical 1 100 0.0 4294967295 FORMAT "%8.2" ECU_ADDRESS 0xfe418b88 /end MEASUREMENT
/begin MEASUREMENT Tlib_EfuseRegRead_R_Shunt_O_S_ODH61 "" ULONG RB_RBA_Common_CentralElements_CompuMethods_Identical 1 100 0.0 4294967295 FORMAT "%8.2" ECU_ADDRESS 0xfe418b8c /end MEASUREMENT
/begin MEASUREMENT Tlib_EfuseRegRead_GetCr1_O_S_ODH62 "" ULONG RB_RBA_Common_CentralElements_CompuMethods_Identical 1 100 0.0 4294967295 FORMAT "%8.2" ECU_ADDRESS 0xfe418b90 /end MEASUREMENT
/begin MEASUREMENT Tlib_EfuseRegRead_GetCR3_O_S_ODH62 "" ULONG RB_RBA_Common_CentralElements_CompuMethods_Identical 1 100 0.0 4294967295 FORMAT "%8.2" ECU_ADDRESS 0xfe418b94 /end MEASUREMENT
/begin MEASUREMENT Tlib_EfuseRegRead_GetSR1_O_S_ODH62 "" ULONG RB_RBA_Common_CentralElements_CompuMethods_Identical 1 100 0.0 4294967295 FORMAT "%8.2" ECU_ADDRESS 0xfe418b98 /end MEASUREMENT
/begin MEASUREMENT Tlib_EfuseRegRead_GetCurrent_O_S_ODH62 "" ULONG RB_RBA_Common_CentralElements_CompuMethods_Identical 1 100 0.0 4294967295 FORMAT "%8.2" ECU_ADDRESS 0xfe418b9c /end MEASUREMENT
/begin MEASUREMENT Tlib_EfuseRegRead_GetTJ_O_S_ODH62 "" ULONG RB_RBA_Common_CentralElements_CompuMethods_Identical 1 100 0.0 4294967295 FORMAT "%8.2" ECU_ADDRESS 0xfe418ba0 /end MEASUREMENT
/begin MEASUREMENT Tlib_EfuseRegRead_GetTMOS_O_S_ODH62 "" ULONG RB_RBA_Common_CentralElements_CompuMethods_Identical 1 100 0.0 4294967295 FORMAT "%8.2" ECU_ADDRESS 0xfe418ba4 /end MEASUREMENT
/begin MEASUREMENT Tlib_EfuseRegRead_GetVDS_O_S_ODH62 "" ULONG RB_RBA_Common_CentralElements_CompuMethods_Identical 1 100 0.0 4294967295 FORMAT "%8.2" ECU_ADDRESS 0xfe418ba8 /end MEASUREMENT
/begin MEASUREMENT Tlib_EfuseRegRead_GetVOUT_O_S_ODH62 "" ULONG RB_RBA_Common_CentralElements_CompuMethods_Identical 1 100 0.0 4294967295 FORMAT "%8.2" ECU_ADDRESS 0xfe418bac /end MEASUREMENT
/begin MEASUREMENT Tlib_EfuseRegRead_GetT_NOM_O_S_ODH62 "" ULONG RB_RBA_Common_CentralElements_CompuMethods_Identical 1 100 0.0 4294967295 FORMAT "%8.2" ECU_ADDRESS 0xfe418bb0 /end MEASUREMENT
/begin MEASUREMENT Tlib_EfuseRegRead_GetOVC_THR_O_S_ODH62 "" ULONG RB_RBA_Common_CentralElements_CompuMethods_Identical 1 100 0.0 4294967295 FORMAT "%8.2" ECU_ADDRESS 0xfe418bb4 /end MEASUREMENT
/begin MEASUREMENT Tlib_EfuseRegRead_GetHSHT_THR_O_S_ODH62 "" ULONG RB_RBA_Common_CentralElements_CompuMethods_Identical 1 100 0.0 4294967295 FORMAT "%8.2" ECU_ADDRESS 0xfe418bb8 /end MEASUREMENT
/begin MEASUREMENT Tlib_EfuseRegRead_GetVDS_THR_O_S_ODH62 "" ULONG RB_RBA_Common_CentralElements_CompuMethods_Identical 1 100 0.0 4294967295 FORMAT "%8.2" ECU_ADDRESS 0xfe418bbc /end MEASUREMENT
/begin MEASUREMENT Tlib_EfuseRegRead_GetNTC_THR_O_S_ODH62 "" ULONG RB_RBA_Common_CentralElements_CompuMethods_Identical 1 100 0.0 4294967295 FORMAT "%8.2" ECU_ADDRESS 0xfe418bc0 /end MEASUREMENT
/begin MEASUREMENT Tlib_EfuseRegRead_R_Shunt_O_S_ODH62 "" ULONG RB_RBA_Common_CentralElements_CompuMethods_Identical 1 100 0.0 4294967295 FORMAT "%8.2" ECU_ADDRESS 0xfe418bc4 /end MEASUREMENT
/begin MEASUREMENT Tlib_EfuseRegRead_GetCr1_O_S_ODH63 "" ULONG RB_RBA_Common_CentralElements_CompuMethods_Identical 1 100 0.0 4294967295 FORMAT "%8.2" ECU_ADDRESS 0xfe418bc8 /end MEASUREMENT
/begin MEASUREMENT Tlib_EfuseRegRead_GetCR3_O_S_ODH63 "" ULONG RB_RBA_Common_CentralElements_CompuMethods_Identical 1 100 0.0 4294967295 FORMAT "%8.2" ECU_ADDRESS 0xfe418bcc /end MEASUREMENT
/begin MEASUREMENT Tlib_EfuseRegRead_GetSR1_O_S_ODH63 "" ULONG RB_RBA_Common_CentralElements_CompuMethods_Identical 1 100 0.0 4294967295 FORMAT "%8.2" ECU_ADDRESS 0xfe418bd0 /end MEASUREMENT
/begin MEASUREMENT Tlib_EfuseRegRead_GetCurrent_O_S_ODH63 "" ULONG RB_RBA_Common_CentralElements_CompuMethods_Identical 1 100 0.0 4294967295 FORMAT "%8.2" ECU_ADDRESS 0xfe418bd4 /end MEASUREMENT
/begin MEASUREMENT Tlib_EfuseRegRead_GetTJ_O_S_ODH63 "" ULONG RB_RBA_Common_CentralElements_CompuMethods_Identical 1 100 0.0 4294967295 FORMAT "%8.2" ECU_ADDRESS 0xfe418bd8 /end MEASUREMENT
/begin MEASUREMENT Tlib_EfuseRegRead_GetTMOS_O_S_ODH63 "" ULONG RB_RBA_Common_CentralElements_CompuMethods_Identical 1 100 0.0 4294967295 FORMAT "%8.2" ECU_ADDRESS 0xfe418bdc /end MEASUREMENT
/begin MEASUREMENT Tlib_EfuseRegRead_GetVDS_O_S_ODH63 "" ULONG RB_RBA_Common_CentralElements_CompuMethods_Identical 1 100 0.0 4294967295 FORMAT "%8.2" ECU_ADDRESS 0xfe418be0 /end MEASUREMENT
/begin MEASUREMENT Tlib_EfuseRegRead_GetVOUT_O_S_ODH63 "" ULONG RB_RBA_Common_CentralElements_CompuMethods_Identical 1 100 0.0 4294967295 FORMAT "%8.2" ECU_ADDRESS 0xfe418be4 /end MEASUREMENT
/begin MEASUREMENT Tlib_EfuseRegRead_GetT_NOM_O_S_ODH63 "" ULONG RB_RBA_Common_CentralElements_CompuMethods_Identical 1 100 0.0 4294967295 FORMAT "%8.2" ECU_ADDRESS 0xfe418be8 /end MEASUREMENT
/begin MEASUREMENT Tlib_EfuseRegRead_GetOVC_THR_O_S_ODH63 "" ULONG RB_RBA_Common_CentralElements_CompuMethods_Identical 1 100 0.0 4294967295 FORMAT "%8.2" ECU_ADDRESS 0xfe418bec /end MEASUREMENT
/begin MEASUREMENT Tlib_EfuseRegRead_GetHSHT_THR_O_S_ODH63 "" ULONG RB_RBA_Common_CentralElements_CompuMethods_Identical 1 100 0.0 4294967295 FORMAT "%8.2" ECU_ADDRESS 0xfe418bf0 /end MEASUREMENT
/begin MEASUREMENT Tlib_EfuseRegRead_GetVDS_THR_O_S_ODH63 "" ULONG RB_RBA_Common_CentralElements_CompuMethods_Identical 1 100 0.0 4294967295 FORMAT "%8.2" ECU_ADDRESS 0xfe418bf4 /end MEASUREMENT
/begin MEASUREMENT Tlib_EfuseRegRead_GetNTC_THR_O_S_ODH63 "" ULONG RB_RBA_Common_CentralElements_CompuMethods_Identical 1 100 0.0 4294967295 FORMAT "%8.2" ECU_ADDRESS 0xfe418bf8 /end MEASUREMENT
/begin MEASUREMENT Tlib_EfuseRegRead_R_Shunt_O_S_ODH63 "" ULONG RB_RBA_Common_CentralElements_CompuMethods_Identical 1 100 0.0 4294967295 FORMAT "%8.2" ECU_ADDRESS 0xfe418bfc /end MEASUREMENT
/begin MEASUREMENT Tlib_EfuseRegRead_GetCr1_O_S_ODH64 "" ULONG RB_RBA_Common_CentralElements_CompuMethods_Identical 1 100 0.0 4294967295 FORMAT "%8.2" ECU_ADDRESS 0xfe418c00 /end MEASUREMENT
/begin MEASUREMENT Tlib_EfuseRegRead_GetCR3_O_S_ODH64 "" ULONG RB_RBA_Common_CentralElements_CompuMethods_Identical 1 100 0.0 4294967295 FORMAT "%8.2" ECU_ADDRESS 0xfe418c04 /end MEASUREMENT
/begin MEASUREMENT Tlib_EfuseRegRead_GetSR1_O_S_ODH64 "" ULONG RB_RBA_Common_CentralElements_CompuMethods_Identical 1 100 0.0 4294967295 FORMAT "%8.2" ECU_ADDRESS 0xfe418c08 /end MEASUREMENT
/begin MEASUREMENT Tlib_EfuseRegRead_GetCurrent_O_S_ODH64 "" ULONG RB_RBA_Common_CentralElements_CompuMethods_Identical 1 100 0.0 4294967295 FORMAT "%8.2" ECU_ADDRESS 0xfe418c0c /end MEASUREMENT
/begin MEASUREMENT Tlib_EfuseRegRead_GetTJ_O_S_ODH64 "" ULONG RB_RBA_Common_CentralElements_CompuMethods_Identical 1 100 0.0 4294967295 FORMAT "%8.2" ECU_ADDRESS 0xfe418c10 /end MEASUREMENT
/begin MEASUREMENT Tlib_EfuseRegRead_GetTMOS_O_S_ODH64 "" ULONG RB_RBA_Common_CentralElements_CompuMethods_Identical 1 100 0.0 4294967295 FORMAT "%8.2" ECU_ADDRESS 0xfe418c14 /end MEASUREMENT
/begin MEASUREMENT Tlib_EfuseRegRead_GetVDS_O_S_ODH64 "" ULONG RB_RBA_Common_CentralElements_CompuMethods_Identical 1 100 0.0 4294967295 FORMAT "%8.2" ECU_ADDRESS 0xfe418c18 /end MEASUREMENT
/begin MEASUREMENT Tlib_EfuseRegRead_GetVOUT_O_S_ODH64 "" ULONG RB_RBA_Common_CentralElements_CompuMethods_Identical 1 100 0.0 4294967295 FORMAT "%8.2" ECU_ADDRESS 0xfe418c1c /end MEASUREMENT
/begin MEASUREMENT Tlib_EfuseRegRead_GetT_NOM_O_S_ODH64 "" ULONG RB_RBA_Common_CentralElements_CompuMethods_Identical 1 100 0.0 4294967295 FORMAT "%8.2" ECU_ADDRESS 0xfe418c20 /end MEASUREMENT
/begin MEASUREMENT Tlib_EfuseRegRead_GetOVC_THR_O_S_ODH64 "" ULONG RB_RBA_Common_CentralElements_CompuMethods_Identical 1 100 0.0 4294967295 FORMAT "%8.2" ECU_ADDRESS 0xfe418c24 /end MEASUREMENT
/begin MEASUREMENT Tlib_EfuseRegRead_GetHSHT_THR_O_S_ODH64 "" ULONG RB_RBA_Common_CentralElements_CompuMethods_Identical 1 100 0.0 4294967295 FORMAT "%8.2" ECU_ADDRESS 0xfe418c28 /end MEASUREMENT
/begin MEASUREMENT Tlib_EfuseRegRead_GetVDS_THR_O_S_ODH64 "" ULONG RB_RBA_Common_CentralElements_CompuMethods_Identical 1 100 0.0 4294967295 FORMAT "%8.2" ECU_ADDRESS 0xfe418c2c /end MEASUREMENT
/begin MEASUREMENT Tlib_EfuseRegRead_GetNTC_THR_O_S_ODH64 "" ULONG RB_RBA_Common_CentralElements_CompuMethods_Identical 1 100 0.0 4294967295 FORMAT "%8.2" ECU_ADDRESS 0xfe418c30 /end MEASUREMENT
/begin MEASUREMENT Tlib_EfuseRegRead_R_Shunt_O_S_ODH64 "" ULONG RB_RBA_Common_CentralElements_CompuMethods_Identical 1 100 0.0 4294967295 FORMAT "%8.2" ECU_ADDRESS 0xfe418c34 /end MEASUREMENT
/begin MEASUREMENT Tlib_EfuseRegRead_GetCr1_O_S_ODH106 "" ULONG RB_RBA_Common_CentralElements_CompuMethods_Identical 1 100 0.0 4294967295 FORMAT "%8.2" ECU_ADDRESS 0xfe418c38 /end MEASUREMENT
/begin MEASUREMENT Tlib_EfuseRegRead_GetCR3_O_S_ODH106 "" ULONG RB_RBA_Common_CentralElements_CompuMethods_Identical 1 100 0.0 4294967295 FORMAT "%8.2" ECU_ADDRESS 0xfe418c3c /end MEASUREMENT
/begin MEASUREMENT Tlib_EfuseRegRead_GetSR1_O_S_ODH106 "" ULONG RB_RBA_Common_CentralElements_CompuMethods_Identical 1 100 0.0 4294967295 FORMAT "%8.2" ECU_ADDRESS 0xfe418c40 /end MEASUREMENT
/begin MEASUREMENT Tlib_EfuseRegRead_GetCurrent_O_S_ODH106 "" ULONG RB_RBA_Common_CentralElements_CompuMethods_Identical 1 100 0.0 4294967295 FORMAT "%8.2" ECU_ADDRESS 0xfe418c44 /end MEASUREMENT
/begin MEASUREMENT Tlib_EfuseRegRead_GetTJ_O_S_ODH106 "" ULONG RB_RBA_Common_CentralElements_CompuMethods_Identical 1 100 0.0 4294967295 FORMAT "%8.2" ECU_ADDRESS 0xfe418c48 /end MEASUREMENT
/begin MEASUREMENT Tlib_EfuseRegRead_GetTMOS_O_S_ODH106 "" ULONG RB_RBA_Common_CentralElements_CompuMethods_Identical 1 100 0.0 4294967295 FORMAT "%8.2" ECU_ADDRESS 0xfe418c4c /end MEASUREMENT
/begin MEASUREMENT Tlib_EfuseRegRead_GetVDS_O_S_ODH106 "" ULONG RB_RBA_Common_CentralElements_CompuMethods_Identical 1 100 0.0 4294967295 FORMAT "%8.2" ECU_ADDRESS 0xfe418c50 /end MEASUREMENT
/begin MEASUREMENT Tlib_EfuseRegRead_GetVOUT_O_S_ODH106 "" ULONG RB_RBA_Common_CentralElements_CompuMethods_Identical 1 100 0.0 4294967295 FORMAT "%8.2" ECU_ADDRESS 0xfe418c54 /end MEASUREMENT
/begin MEASUREMENT Tlib_EfuseRegRead_GetT_NOM_O_S_ODH106 "" ULONG RB_RBA_Common_CentralElements_CompuMethods_Identical 1 100 0.0 4294967295 FORMAT "%8.2" ECU_ADDRESS 0xfe418c58 /end MEASUREMENT
/begin MEASUREMENT Tlib_EfuseRegRead_GetOVC_THR_O_S_ODH106 "" ULONG RB_RBA_Common_CentralElements_CompuMethods_Identical 1 100 0.0 4294967295 FORMAT "%8.2" ECU_ADDRESS 0xfe418c5c /end MEASUREMENT
/begin MEASUREMENT Tlib_EfuseRegRead_GetHSHT_THR_O_S_ODH106 "" ULONG RB_RBA_Common_CentralElements_CompuMethods_Identical 1 100 0.0 4294967295 FORMAT "%8.2" ECU_ADDRESS 0xfe418c60 /end MEASUREMENT
/begin MEASUREMENT Tlib_EfuseRegRead_GetVDS_THR_O_S_ODH106 "" ULONG RB_RBA_Common_CentralElements_CompuMethods_Identical 1 100 0.0 4294967295 FORMAT "%8.2" ECU_ADDRESS 0xfe418c64 /end MEASUREMENT
/begin MEASUREMENT Tlib_EfuseRegRead_GetNTC_THR_O_S_ODH106 "" ULONG RB_RBA_Common_CentralElements_CompuMethods_Identical 1 100 0.0 4294967295 FORMAT "%8.2" ECU_ADDRESS 0xfe418c68 /end MEASUREMENT
/begin MEASUREMENT Tlib_EfuseRegRead_R_Shunt_O_S_ODH106 "" ULONG RB_RBA_Common_CentralElements_CompuMethods_Identical 1 100 0.0 4294967295 FORMAT "%8.2" ECU_ADDRESS 0xfe418c6c /end MEASUREMENT
/begin MEASUREMENT Tlib_EfuseRegRead_GetCr1_O_S_ODH40 "" ULONG RB_RBA_Common_CentralElements_CompuMethods_Identical 1 100 0.0 4294967295 FORMAT "%8.2" ECU_ADDRESS 0xfe418c70 /end MEASUREMENT
/begin MEASUREMENT Tlib_EfuseRegRead_GetCR3_O_S_ODH40 "" ULONG RB_RBA_Common_CentralElements_CompuMethods_Identical 1 100 0.0 4294967295 FORMAT "%8.2" ECU_ADDRESS 0xfe418c74 /end MEASUREMENT
/begin MEASUREMENT Tlib_EfuseRegRead_GetSR1_O_S_ODH40 "" ULONG RB_RBA_Common_CentralElements_CompuMethods_Identical 1 100 0.0 4294967295 FORMAT "%8.2" ECU_ADDRESS 0xfe418c78 /end MEASUREMENT
/begin MEASUREMENT Tlib_EfuseRegRead_GetCurrent_O_S_ODH40 "" ULONG RB_RBA_Common_CentralElements_CompuMethods_Identical 1 100 0.0 4294967295 FORMAT "%8.2" ECU_ADDRESS 0xfe418c7c /end MEASUREMENT
/begin MEASUREMENT Tlib_EfuseRegRead_GetTJ_O_S_ODH40 "" ULONG RB_RBA_Common_CentralElements_CompuMethods_Identical 1 100 0.0 4294967295 FORMAT "%8.2" ECU_ADDRESS 0xfe418c80 /end MEASUREMENT
/begin MEASUREMENT Tlib_EfuseRegRead_GetTMOS_O_S_ODH40 "" ULONG RB_RBA_Common_CentralElements_CompuMethods_Identical 1 100 0.0 4294967295 FORMAT "%8.2" ECU_ADDRESS 0xfe418c84 /end MEASUREMENT
/begin MEASUREMENT Tlib_EfuseRegRead_GetVDS_O_S_ODH40 "" ULONG RB_RBA_Common_CentralElements_CompuMethods_Identical 1 100 0.0 4294967295 FORMAT "%8.2" ECU_ADDRESS 0xfe418c88 /end MEASUREMENT
/begin MEASUREMENT Tlib_EfuseRegRead_GetVOUT_O_S_ODH40 "" ULONG RB_RBA_Common_CentralElements_CompuMethods_Identical 1 100 0.0 4294967295 FORMAT "%8.2" ECU_ADDRESS 0xfe418c8c /end MEASUREMENT
/begin MEASUREMENT Tlib_EfuseRegRead_GetT_NOM_O_S_ODH40 "" ULONG RB_RBA_Common_CentralElements_CompuMethods_Identical 1 100 0.0 4294967295 FORMAT "%8.2" ECU_ADDRESS 0xfe418c90 /end MEASUREMENT
/begin MEASUREMENT Tlib_EfuseRegRead_GetOVC_THR_O_S_ODH40 "" ULONG RB_RBA_Common_CentralElements_CompuMethods_Identical 1 100 0.0 4294967295 FORMAT "%8.2" ECU_ADDRESS 0xfe418c94 /end MEASUREMENT
/begin MEASUREMENT Tlib_EfuseRegRead_GetHSHT_THR_O_S_ODH40 "" ULONG RB_RBA_Common_CentralElements_CompuMethods_Identical 1 100 0.0 4294967295 FORMAT "%8.2" ECU_ADDRESS 0xfe418c98 /end MEASUREMENT
/begin MEASUREMENT Tlib_EfuseRegRead_GetVDS_THR_O_S_ODH40 "" ULONG RB_RBA_Common_CentralElements_CompuMethods_Identical 1 100 0.0 4294967295 FORMAT "%8.2" ECU_ADDRESS 0xfe418c9c /end MEASUREMENT
/begin MEASUREMENT Tlib_EfuseRegRead_GetNTC_THR_O_S_ODH40 "" ULONG RB_RBA_Common_CentralElements_CompuMethods_Identical 1 100 0.0 4294967295 FORMAT "%8.2" ECU_ADDRESS 0xfe418ca0 /end MEASUREMENT
/begin MEASUREMENT Tlib_EfuseRegRead_R_Shunt_O_S_ODH40 "" ULONG RB_RBA_Common_CentralElements_CompuMethods_Identical 1 100 0.0 4294967295 FORMAT "%8.2" ECU_ADDRESS 0xfe418ca4 /end MEASUREMENT
/begin MEASUREMENT Tlib_EfuseRegRead_GetCr1_O_S_EFUSE27 "" ULONG RB_RBA_Common_CentralElements_CompuMethods_Identical 1 100 0.0 4294967295 FORMAT "%8.2" ECU_ADDRESS 0xfe418ca8 /end MEASUREMENT
/begin MEASUREMENT Tlib_EfuseRegRead_GetCR3_O_S_EFUSE27 "" ULONG RB_RBA_Common_CentralElements_CompuMethods_Identical 1 100 0.0 4294967295 FORMAT "%8.2" ECU_ADDRESS 0xfe418cac /end MEASUREMENT
/begin MEASUREMENT Tlib_EfuseRegRead_GetSR1_O_S_EFUSE27 "" ULONG RB_RBA_Common_CentralElements_CompuMethods_Identical 1 100 0.0 4294967295 FORMAT "%8.2" ECU_ADDRESS 0xfe418cb0 /end MEASUREMENT
/begin MEASUREMENT Tlib_EfuseRegRead_GetCurrent_O_S_EFUSE27 "" ULONG RB_RBA_Common_CentralElements_CompuMethods_Identical 1 100 0.0 4294967295 FORMAT "%8.2" ECU_ADDRESS 0xfe418cb4 /end MEASUREMENT
/begin MEASUREMENT Tlib_EfuseRegRead_GetTJ_O_S_EFUSE27 "" ULONG RB_RBA_Common_CentralElements_CompuMethods_Identical 1 100 0.0 4294967295 FORMAT "%8.2" ECU_ADDRESS 0xfe418cb8 /end MEASUREMENT
/begin MEASUREMENT Tlib_EfuseRegRead_GetTMOS_O_S_EFUSE27 "" ULONG RB_RBA_Common_CentralElements_CompuMethods_Identical 1 100 0.0 4294967295 FORMAT "%8.2" ECU_ADDRESS 0xfe418cbc /end MEASUREMENT
/begin MEASUREMENT Tlib_EfuseRegRead_GetVDS_O_S_EFUSE27 "" ULONG RB_RBA_Common_CentralElements_CompuMethods_Identical 1 100 0.0 4294967295 FORMAT "%8.2" ECU_ADDRESS 0xfe418cc0 /end MEASUREMENT
/begin MEASUREMENT Tlib_EfuseRegRead_GetVOUT_O_S_EFUSE27 "" ULONG RB_RBA_Common_CentralElements_CompuMethods_Identical 1 100 0.0 4294967295 FORMAT "%8.2" ECU_ADDRESS 0xfe418cc4 /end MEASUREMENT
/begin MEASUREMENT Tlib_EfuseRegRead_GetT_NOM_O_S_EFUSE27 "" ULONG RB_RBA_Common_CentralElements_CompuMethods_Identical 1 100 0.0 4294967295 FORMAT "%8.2" ECU_ADDRESS 0xfe418cc8 /end MEASUREMENT
/begin MEASUREMENT Tlib_EfuseRegRead_GetOVC_THR_O_S_EFUSE27 "" ULONG RB_RBA_Common_CentralElements_CompuMethods_Identical 1 100 0.0 4294967295 FORMAT "%8.2" ECU_ADDRESS 0xfe418ccc /end MEASUREMENT
/begin MEASUREMENT Tlib_EfuseRegRead_GetHSHT_THR_O_S_EFUSE27 "" ULONG RB_RBA_Common_CentralElements_CompuMethods_Identical 1 100 0.0 4294967295 FORMAT "%8.2" ECU_ADDRESS 0xfe418cd0 /end MEASUREMENT
/begin MEASUREMENT Tlib_EfuseRegRead_GetVDS_THR_O_S_EFUSE27 "" ULONG RB_RBA_Common_CentralElements_CompuMethods_Identical 1 100 0.0 4294967295 FORMAT "%8.2" ECU_ADDRESS 0xfe418cd4 /end MEASUREMENT
/begin MEASUREMENT Tlib_EfuseRegRead_GetNTC_THR_O_S_EFUSE27 "" ULONG RB_RBA_Common_CentralElements_CompuMethods_Identical 1 100 0.0 4294967295 FORMAT "%8.2" ECU_ADDRESS 0xfe418cd8 /end MEASUREMENT
/begin MEASUREMENT Tlib_EfuseRegRead_R_Shunt_O_S_EFUSE27 "" ULONG RB_RBA_Common_CentralElements_CompuMethods_Identical 1 100 0.0 4294967295 FORMAT "%8.2" ECU_ADDRESS 0xfe418cdc /end MEASUREMENT
/begin MEASUREMENT Tlib_EfuseRegRead_GetCr1_O_S_ODH88 "" ULONG RB_RBA_Common_CentralElements_CompuMethods_Identical 1 100 0.0 4294967295 FORMAT "%8.2" ECU_ADDRESS 0xfe418ce0 /end MEASUREMENT
/begin MEASUREMENT Tlib_EfuseRegRead_GetCR3_O_S_ODH88 "" ULONG RB_RBA_Common_CentralElements_CompuMethods_Identical 1 100 0.0 4294967295 FORMAT "%8.2" ECU_ADDRESS 0xfe418ce4 /end MEASUREMENT
/begin MEASUREMENT Tlib_EfuseRegRead_GetSR1_O_S_ODH88 "" ULONG RB_RBA_Common_CentralElements_CompuMethods_Identical 1 100 0.0 4294967295 FORMAT "%8.2" ECU_ADDRESS 0xfe418ce8 /end MEASUREMENT
/begin MEASUREMENT Tlib_EfuseRegRead_GetCurrent_O_S_ODH88 "" ULONG RB_RBA_Common_CentralElements_CompuMethods_Identical 1 100 0.0 4294967295 FORMAT "%8.2" ECU_ADDRESS 0xfe418cec /end MEASUREMENT
/begin MEASUREMENT Tlib_EfuseRegRead_GetTJ_O_S_ODH88 "" ULONG RB_RBA_Common_CentralElements_CompuMethods_Identical 1 100 0.0 4294967295 FORMAT "%8.2" ECU_ADDRESS 0xfe418cf0 /end MEASUREMENT
/begin MEASUREMENT Tlib_EfuseRegRead_GetTMOS_O_S_ODH88 "" ULONG RB_RBA_Common_CentralElements_CompuMethods_Identical 1 100 0.0 4294967295 FORMAT "%8.2" ECU_ADDRESS 0xfe418cf4 /end MEASUREMENT
/begin MEASUREMENT Tlib_EfuseRegRead_GetVDS_O_S_ODH88 "" ULONG RB_RBA_Common_CentralElements_CompuMethods_Identical 1 100 0.0 4294967295 FORMAT "%8.2" ECU_ADDRESS 0xfe418cf8 /end MEASUREMENT
/begin MEASUREMENT Tlib_EfuseRegRead_GetVOUT_O_S_ODH88 "" ULONG RB_RBA_Common_CentralElements_CompuMethods_Identical 1 100 0.0 4294967295 FORMAT "%8.2" ECU_ADDRESS 0xfe418cfc /end MEASUREMENT
/begin MEASUREMENT Tlib_EfuseRegRead_GetT_NOM_O_S_ODH88 "" ULONG RB_RBA_Common_CentralElements_CompuMethods_Identical 1 100 0.0 4294967295 FORMAT "%8.2" ECU_ADDRESS 0xfe418d00 /end MEASUREMENT
/begin MEASUREMENT Tlib_EfuseRegRead_GetOVC_THR_O_S_ODH88 "" ULONG RB_RBA_Common_CentralElements_CompuMethods_Identical 1 100 0.0 4294967295 FORMAT "%8.2" ECU_ADDRESS 0xfe418d04 /end MEASUREMENT
/begin MEASUREMENT Tlib_EfuseRegRead_GetHSHT_THR_O_S_ODH88 "" ULONG RB_RBA_Common_CentralElements_CompuMethods_Identical 1 100 0.0 4294967295 FORMAT "%8.2" ECU_ADDRESS 0xfe418d08 /end MEASUREMENT
/begin MEASUREMENT Tlib_EfuseRegRead_GetVDS_THR_O_S_ODH88 "" ULONG RB_RBA_Common_CentralElements_CompuMethods_Identical 1 100 0.0 4294967295 FORMAT "%8.2" ECU_ADDRESS 0xfe418d0c /end MEASUREMENT
/begin MEASUREMENT Tlib_EfuseRegRead_GetNTC_THR_O_S_ODH88 "" ULONG RB_RBA_Common_CentralElements_CompuMethods_Identical 1 100 0.0 4294967295 FORMAT "%8.2" ECU_ADDRESS 0xfe418d10 /end MEASUREMENT
/begin MEASUREMENT Tlib_EfuseRegRead_R_Shunt_O_S_ODH88 "" ULONG RB_RBA_Common_CentralElements_CompuMethods_Identical 1 100 0.0 4294967295 FORMAT "%8.2" ECU_ADDRESS 0xfe418d14 /end MEASUREMENT
/begin MEASUREMENT Tlib_EfuseRegRead_GetCr1_O_S_ODH89 "" ULONG RB_RBA_Common_CentralElements_CompuMethods_Identical 1 100 0.0 4294967295 FORMAT "%8.2" ECU_ADDRESS 0xfe418d18 /end MEASUREMENT
/begin MEASUREMENT Tlib_EfuseRegRead_GetCR3_O_S_ODH89 "" ULONG RB_RBA_Common_CentralElements_CompuMethods_Identical 1 100 0.0 4294967295 FORMAT "%8.2" ECU_ADDRESS 0xfe418d1c /end MEASUREMENT
/begin MEASUREMENT Tlib_EfuseRegRead_GetSR1_O_S_ODH89 "" ULONG RB_RBA_Common_CentralElements_CompuMethods_Identical 1 100 0.0 4294967295 FORMAT "%8.2" ECU_ADDRESS 0xfe418d20 /end MEASUREMENT
/begin MEASUREMENT Tlib_EfuseRegRead_GetCurrent_O_S_ODH89 "" ULONG RB_RBA_Common_CentralElements_CompuMethods_Identical 1 100 0.0 4294967295 FORMAT "%8.2" ECU_ADDRESS 0xfe418d24 /end MEASUREMENT
/begin MEASUREMENT Tlib_EfuseRegRead_GetTJ_O_S_ODH89 "" ULONG RB_RBA_Common_CentralElements_CompuMethods_Identical 1 100 0.0 4294967295 FORMAT "%8.2" ECU_ADDRESS 0xfe418d28 /end MEASUREMENT
/begin MEASUREMENT Tlib_EfuseRegRead_GetTMOS_O_S_ODH89 "" ULONG RB_RBA_Common_CentralElements_CompuMethods_Identical 1 100 0.0 4294967295 FORMAT "%8.2" ECU_ADDRESS 0xfe418d2c /end MEASUREMENT
/begin MEASUREMENT Tlib_EfuseRegRead_GetVDS_O_S_ODH89 "" ULONG RB_RBA_Common_CentralElements_CompuMethods_Identical 1 100 0.0 4294967295 FORMAT "%8.2" ECU_ADDRESS 0xfe418d30 /end MEASUREMENT
/begin MEASUREMENT Tlib_EfuseRegRead_GetVOUT_O_S_ODH89 "" ULONG RB_RBA_Common_CentralElements_CompuMethods_Identical 1 100 0.0 4294967295 FORMAT "%8.2" ECU_ADDRESS 0xfe418d34 /end MEASUREMENT
/begin MEASUREMENT Tlib_EfuseRegRead_GetT_NOM_O_S_ODH89 "" ULONG RB_RBA_Common_CentralElements_CompuMethods_Identical 1 100 0.0 4294967295 FORMAT "%8.2" ECU_ADDRESS 0xfe418d38 /end MEASUREMENT
/begin MEASUREMENT Tlib_EfuseRegRead_GetOVC_THR_O_S_ODH89 "" ULONG RB_RBA_Common_CentralElements_CompuMethods_Identical 1 100 0.0 4294967295 FORMAT "%8.2" ECU_ADDRESS 0xfe418d3c /end MEASUREMENT
/begin MEASUREMENT Tlib_EfuseRegRead_GetHSHT_THR_O_S_ODH89 "" ULONG RB_RBA_Common_CentralElements_CompuMethods_Identical 1 100 0.0 4294967295 FORMAT "%8.2" ECU_ADDRESS 0xfe418d40 /end MEASUREMENT
/begin MEASUREMENT Tlib_EfuseRegRead_GetVDS_THR_O_S_ODH89 "" ULONG RB_RBA_Common_CentralElements_CompuMethods_Identical 1 100 0.0 4294967295 FORMAT "%8.2" ECU_ADDRESS 0xfe418d44 /end MEASUREMENT
/begin MEASUREMENT Tlib_EfuseRegRead_GetNTC_THR_O_S_ODH89 "" ULONG RB_RBA_Common_CentralElements_CompuMethods_Identical 1 100 0.0 4294967295 FORMAT "%8.2" ECU_ADDRESS 0xfe418d48 /end MEASUREMENT
/begin MEASUREMENT Tlib_EfuseRegRead_R_Shunt_O_S_ODH89 "" ULONG RB_RBA_Common_CentralElements_CompuMethods_Identical 1 100 0.0 4294967295 FORMAT "%8.2" ECU_ADDRESS 0xfe418d4c /end MEASUREMENT
/begin MEASUREMENT Tlib_EfuseRegRead_GetCr1_O_S_ODH90 "" ULONG RB_RBA_Common_CentralElements_CompuMethods_Identical 1 100 0.0 4294967295 FORMAT "%8.2" ECU_ADDRESS 0xfe418d50 /end MEASUREMENT
/begin MEASUREMENT Tlib_EfuseRegRead_GetCR3_O_S_ODH90 "" ULONG RB_RBA_Common_CentralElements_CompuMethods_Identical 1 100 0.0 4294967295 FORMAT "%8.2" ECU_ADDRESS 0xfe418d54 /end MEASUREMENT
/begin MEASUREMENT Tlib_EfuseRegRead_GetSR1_O_S_ODH90 "" ULONG RB_RBA_Common_CentralElements_CompuMethods_Identical 1 100 0.0 4294967295 FORMAT "%8.2" ECU_ADDRESS 0xfe418d58 /end MEASUREMENT
/begin MEASUREMENT Tlib_EfuseRegRead_GetCurrent_O_S_ODH90 "" ULONG RB_RBA_Common_CentralElements_CompuMethods_Identical 1 100 0.0 4294967295 FORMAT "%8.2" ECU_ADDRESS 0xfe418d5c /end MEASUREMENT
/begin MEASUREMENT Tlib_EfuseRegRead_GetTJ_O_S_ODH90 "" ULONG RB_RBA_Common_CentralElements_CompuMethods_Identical 1 100 0.0 4294967295 FORMAT "%8.2" ECU_ADDRESS 0xfe418d60 /end MEASUREMENT
/begin MEASUREMENT Tlib_EfuseRegRead_GetTMOS_O_S_ODH90 "" ULONG RB_RBA_Common_CentralElements_CompuMethods_Identical 1 100 0.0 4294967295 FORMAT "%8.2" ECU_ADDRESS 0xfe418d64 /end MEASUREMENT
/begin MEASUREMENT Tlib_EfuseRegRead_GetVDS_O_S_ODH90 "" ULONG RB_RBA_Common_CentralElements_CompuMethods_Identical 1 100 0.0 4294967295 FORMAT "%8.2" ECU_ADDRESS 0xfe418d68 /end MEASUREMENT
/begin MEASUREMENT Tlib_EfuseRegRead_GetVOUT_O_S_ODH90 "" ULONG RB_RBA_Common_CentralElements_CompuMethods_Identical 1 100 0.0 4294967295 FORMAT "%8.2" ECU_ADDRESS 0xfe418d6c /end MEASUREMENT
/begin MEASUREMENT Tlib_EfuseRegRead_GetT_NOM_O_S_ODH90 "" ULONG RB_RBA_Common_CentralElements_CompuMethods_Identical 1 100 0.0 4294967295 FORMAT "%8.2" ECU_ADDRESS 0xfe418d70 /end MEASUREMENT
/begin MEASUREMENT Tlib_EfuseRegRead_GetOVC_THR_O_S_ODH90 "" ULONG RB_RBA_Common_CentralElements_CompuMethods_Identical 1 100 0.0 4294967295 FORMAT "%8.2" ECU_ADDRESS 0xfe418d74 /end MEASUREMENT
/begin MEASUREMENT Tlib_EfuseRegRead_GetHSHT_THR_O_S_ODH90 "" ULONG RB_RBA_Common_CentralElements_CompuMethods_Identical 1 100 0.0 4294967295 FORMAT "%8.2" ECU_ADDRESS 0xfe418d78 /end MEASUREMENT
/begin MEASUREMENT Tlib_EfuseRegRead_GetVDS_THR_O_S_ODH90 "" ULONG RB_RBA_Common_CentralElements_CompuMethods_Identical 1 100 0.0 4294967295 FORMAT "%8.2" ECU_ADDRESS 0xfe418d7c /end MEASUREMENT
/begin MEASUREMENT Tlib_EfuseRegRead_GetNTC_THR_O_S_ODH90 "" ULONG RB_RBA_Common_CentralElements_CompuMethods_Identical 1 100 0.0 4294967295 FORMAT "%8.2" ECU_ADDRESS 0xfe418d80 /end MEASUREMENT
/begin MEASUREMENT Tlib_EfuseRegRead_R_Shunt_O_S_ODH90 "" ULONG RB_RBA_Common_CentralElements_CompuMethods_Identical 1 100 0.0 4294967295 FORMAT "%8.2" ECU_ADDRESS 0xfe418d84 /end MEASUREMENT
/begin MEASUREMENT Tlib_EfuseRegRead_GetCr1_O_S_ODH114 "" ULONG RB_RBA_Common_CentralElements_CompuMethods_Identical 1 100 0.0 4294967295 FORMAT "%8.2" ECU_ADDRESS 0xfe418d88 /end MEASUREMENT
/begin MEASUREMENT Tlib_EfuseRegRead_GetCR3_O_S_ODH114 "" ULONG RB_RBA_Common_CentralElements_CompuMethods_Identical 1 100 0.0 4294967295 FORMAT "%8.2" ECU_ADDRESS 0xfe418d8c /end MEASUREMENT
/begin MEASUREMENT Tlib_EfuseRegRead_GetSR1_O_S_ODH114 "" ULONG RB_RBA_Common_CentralElements_CompuMethods_Identical 1 100 0.0 4294967295 FORMAT "%8.2" ECU_ADDRESS 0xfe418d90 /end MEASUREMENT
/begin MEASUREMENT Tlib_EfuseRegRead_GetCurrent_O_S_ODH114 "" ULONG RB_RBA_Common_CentralElements_CompuMethods_Identical 1 100 0.0 4294967295 FORMAT "%8.2" ECU_ADDRESS 0xfe418d94 /end MEASUREMENT
/begin MEASUREMENT Tlib_EfuseRegRead_GetTJ_O_S_ODH114 "" ULONG RB_RBA_Common_CentralElements_CompuMethods_Identical 1 100 0.0 4294967295 FORMAT "%8.2" ECU_ADDRESS 0xfe418d98 /end MEASUREMENT
/begin MEASUREMENT Tlib_EfuseRegRead_GetTMOS_O_S_ODH114 "" ULONG RB_RBA_Common_CentralElements_CompuMethods_Identical 1 100 0.0 4294967295 FORMAT "%8.2" ECU_ADDRESS 0xfe418d9c /end MEASUREMENT
/begin MEASUREMENT Tlib_EfuseRegRead_GetVDS_O_S_ODH114 "" ULONG RB_RBA_Common_CentralElements_CompuMethods_Identical 1 100 0.0 4294967295 FORMAT "%8.2" ECU_ADDRESS 0xfe418da0 /end MEASUREMENT
/begin MEASUREMENT Tlib_EfuseRegRead_GetVOUT_O_S_ODH114 "" ULONG RB_RBA_Common_CentralElements_CompuMethods_Identical 1 100 0.0 4294967295 FORMAT "%8.2" ECU_ADDRESS 0xfe418da4 /end MEASUREMENT
/begin MEASUREMENT Tlib_EfuseRegRead_GetT_NOM_O_S_ODH114 "" ULONG RB_RBA_Common_CentralElements_CompuMethods_Identical 1 100 0.0 4294967295 FORMAT "%8.2" ECU_ADDRESS 0xfe418da8 /end MEASUREMENT
/begin MEASUREMENT Tlib_EfuseRegRead_GetOVC_THR_O_S_ODH114 "" ULONG RB_RBA_Common_CentralElements_CompuMethods_Identical 1 100 0.0 4294967295 FORMAT "%8.2" ECU_ADDRESS 0xfe418dac /end MEASUREMENT
/begin MEASUREMENT Tlib_EfuseRegRead_GetHSHT_THR_O_S_ODH114 "" ULONG RB_RBA_Common_CentralElements_CompuMethods_Identical 1 100 0.0 4294967295 FORMAT "%8.2" ECU_ADDRESS 0xfe418db0 /end MEASUREMENT
/begin MEASUREMENT Tlib_EfuseRegRead_GetVDS_THR_O_S_ODH114 "" ULONG RB_RBA_Common_CentralElements_CompuMethods_Identical 1 100 0.0 4294967295 FORMAT "%8.2" ECU_ADDRESS 0xfe418db4 /end MEASUREMENT
/begin MEASUREMENT Tlib_EfuseRegRead_GetNTC_THR_O_S_ODH114 "" ULONG RB_RBA_Common_CentralElements_CompuMethods_Identical 1 100 0.0 4294967295 FORMAT "%8.2" ECU_ADDRESS 0xfe418db8 /end MEASUREMENT
/begin MEASUREMENT Tlib_EfuseRegRead_R_Shunt_O_S_ODH114 "" ULONG RB_RBA_Common_CentralElements_CompuMethods_Identical 1 100 0.0 4294967295 FORMAT "%8.2" ECU_ADDRESS 0xfe418dbc /end MEASUREMENT
/begin MEASUREMENT Tlib_EfuseRegRead_GetCr1_O_S_ODH92 "" ULONG RB_RBA_Common_CentralElements_CompuMethods_Identical 1 100 0.0 4294967295 FORMAT "%8.2" ECU_ADDRESS 0xfe418dc0 /end MEASUREMENT
/begin MEASUREMENT Tlib_EfuseRegRead_GetCR3_O_S_ODH92 "" ULONG RB_RBA_Common_CentralElements_CompuMethods_Identical 1 100 0.0 4294967295 FORMAT "%8.2" ECU_ADDRESS 0xfe418dc4 /end MEASUREMENT
/begin MEASUREMENT Tlib_EfuseRegRead_GetSR1_O_S_ODH92 "" ULONG RB_RBA_Common_CentralElements_CompuMethods_Identical 1 100 0.0 4294967295 FORMAT "%8.2" ECU_ADDRESS 0xfe418dc8 /end MEASUREMENT
/begin MEASUREMENT Tlib_EfuseRegRead_GetCurrent_O_S_ODH92 "" ULONG RB_RBA_Common_CentralElements_CompuMethods_Identical 1 100 0.0 4294967295 FORMAT "%8.2" ECU_ADDRESS 0xfe418dcc /end MEASUREMENT
/begin MEASUREMENT Tlib_EfuseRegRead_GetTJ_O_S_ODH92 "" ULONG RB_RBA_Common_CentralElements_CompuMethods_Identical 1 100 0.0 4294967295 FORMAT "%8.2" ECU_ADDRESS 0xfe418dd0 /end MEASUREMENT
/begin MEASUREMENT Tlib_EfuseRegRead_GetTMOS_O_S_ODH92 "" ULONG RB_RBA_Common_CentralElements_CompuMethods_Identical 1 100 0.0 4294967295 FORMAT "%8.2" ECU_ADDRESS 0xfe418dd4 /end MEASUREMENT
/begin MEASUREMENT Tlib_EfuseRegRead_GetVDS_O_S_ODH92 "" ULONG RB_RBA_Common_CentralElements_CompuMethods_Identical 1 100 0.0 4294967295 FORMAT "%8.2" ECU_ADDRESS 0xfe418dd8 /end MEASUREMENT
/begin MEASUREMENT Tlib_EfuseRegRead_GetVOUT_O_S_ODH92 "" ULONG RB_RBA_Common_CentralElements_CompuMethods_Identical 1 100 0.0 4294967295 FORMAT "%8.2" ECU_ADDRESS 0xfe418ddc /end MEASUREMENT
/begin MEASUREMENT Tlib_EfuseRegRead_GetT_NOM_O_S_ODH92 "" ULONG RB_RBA_Common_CentralElements_CompuMethods_Identical 1 100 0.0 4294967295 FORMAT "%8.2" ECU_ADDRESS 0xfe418de0 /end MEASUREMENT
/begin MEASUREMENT Tlib_EfuseRegRead_GetOVC_THR_O_S_ODH92 "" ULONG RB_RBA_Common_CentralElements_CompuMethods_Identical 1 100 0.0 4294967295 FORMAT "%8.2" ECU_ADDRESS 0xfe418de4 /end MEASUREMENT
/begin MEASUREMENT Tlib_EfuseRegRead_GetHSHT_THR_O_S_ODH92 "" ULONG RB_RBA_Common_CentralElements_CompuMethods_Identical 1 100 0.0 4294967295 FORMAT "%8.2" ECU_ADDRESS 0xfe418de8 /end MEASUREMENT
/begin MEASUREMENT Tlib_EfuseRegRead_GetVDS_THR_O_S_ODH92 "" ULONG RB_RBA_Common_CentralElements_CompuMethods_Identical 1 100 0.0 4294967295 FORMAT "%8.2" ECU_ADDRESS 0xfe418dec /end MEASUREMENT
/begin MEASUREMENT Tlib_EfuseRegRead_GetNTC_THR_O_S_ODH92 "" ULONG RB_RBA_Common_CentralElements_CompuMethods_Identical 1 100 0.0 4294967295 FORMAT "%8.2" ECU_ADDRESS 0xfe418df0 /end MEASUREMENT
/begin MEASUREMENT Tlib_EfuseRegRead_R_Shunt_O_S_ODH92 "" ULONG RB_RBA_Common_CentralElements_CompuMethods_Identical 1 100 0.0 4294967295 FORMAT "%8.2" ECU_ADDRESS 0xfe418df4 /end MEASUREMENT
/begin MEASUREMENT Tlib_EfuseRegRead_GetCr1_O_S_ODH93 "" ULONG RB_RBA_Common_CentralElements_CompuMethods_Identical 1 100 0.0 4294967295 FORMAT "%8.2" ECU_ADDRESS 0xfe418df8 /end MEASUREMENT
/begin MEASUREMENT Tlib_EfuseRegRead_GetCR3_O_S_ODH93 "" ULONG RB_RBA_Common_CentralElements_CompuMethods_Identical 1 100 0.0 4294967295 FORMAT "%8.2" ECU_ADDRESS 0xfe418dfc /end MEASUREMENT
/begin MEASUREMENT Tlib_EfuseRegRead_GetSR1_O_S_ODH93 "" ULONG RB_RBA_Common_CentralElements_CompuMethods_Identical 1 100 0.0 4294967295 FORMAT "%8.2" ECU_ADDRESS 0xfe418e00 /end MEASUREMENT
/begin MEASUREMENT Tlib_EfuseRegRead_GetCurrent_O_S_ODH93 "" ULONG RB_RBA_Common_CentralElements_CompuMethods_Identical 1 100 0.0 4294967295 FORMAT "%8.2" ECU_ADDRESS 0xfe418e04 /end MEASUREMENT
/begin MEASUREMENT Tlib_EfuseRegRead_GetTJ_O_S_ODH93 "" ULONG RB_RBA_Common_CentralElements_CompuMethods_Identical 1 100 0.0 4294967295 FORMAT "%8.2" ECU_ADDRESS 0xfe418e08 /end MEASUREMENT
/begin MEASUREMENT Tlib_EfuseRegRead_GetTMOS_O_S_ODH93 "" ULONG RB_RBA_Common_CentralElements_CompuMethods_Identical 1 100 0.0 4294967295 FORMAT "%8.2" ECU_ADDRESS 0xfe418e0c /end MEASUREMENT
/begin MEASUREMENT Tlib_EfuseRegRead_GetVDS_O_S_ODH93 "" ULONG RB_RBA_Common_CentralElements_CompuMethods_Identical 1 100 0.0 4294967295 FORMAT "%8.2" ECU_ADDRESS 0xfe418e10 /end MEASUREMENT
/begin MEASUREMENT Tlib_EfuseRegRead_GetVOUT_O_S_ODH93 "" ULONG RB_RBA_Common_CentralElements_CompuMethods_Identical 1 100 0.0 4294967295 FORMAT "%8.2" ECU_ADDRESS 0xfe418e14 /end MEASUREMENT
/begin MEASUREMENT Tlib_EfuseRegRead_GetT_NOM_O_S_ODH93 "" ULONG RB_RBA_Common_CentralElements_CompuMethods_Identical 1 100 0.0 4294967295 FORMAT "%8.2" ECU_ADDRESS 0xfe418e18 /end MEASUREMENT
/begin MEASUREMENT Tlib_EfuseRegRead_GetOVC_THR_O_S_ODH93 "" ULONG RB_RBA_Common_CentralElements_CompuMethods_Identical 1 100 0.0 4294967295 FORMAT "%8.2" ECU_ADDRESS 0xfe418e1c /end MEASUREMENT
/begin MEASUREMENT Tlib_EfuseRegRead_GetHSHT_THR_O_S_ODH93 "" ULONG RB_RBA_Common_CentralElements_CompuMethods_Identical 1 100 0.0 4294967295 FORMAT "%8.2" ECU_ADDRESS 0xfe418e20 /end MEASUREMENT
/begin MEASUREMENT Tlib_EfuseRegRead_GetVDS_THR_O_S_ODH93 "" ULONG RB_RBA_Common_CentralElements_CompuMethods_Identical 1 100 0.0 4294967295 FORMAT "%8.2" ECU_ADDRESS 0xfe418e24 /end MEASUREMENT
/begin MEASUREMENT Tlib_EfuseRegRead_GetNTC_THR_O_S_ODH93 "" ULONG RB_RBA_Common_CentralElements_CompuMethods_Identical 1 100 0.0 4294967295 FORMAT "%8.2" ECU_ADDRESS 0xfe418e28 /end MEASUREMENT
/begin MEASUREMENT Tlib_EfuseRegRead_R_Shunt_O_S_ODH93 "" ULONG RB_RBA_Common_CentralElements_CompuMethods_Identical 1 100 0.0 4294967295 FORMAT "%8.2" ECU_ADDRESS 0xfe418e2c /end MEASUREMENT
/begin MEASUREMENT Tlib_EfuseRegRead_GetCr1_O_S_ODH95 "" ULONG RB_RBA_Common_CentralElements_CompuMethods_Identical 1 100 0.0 4294967295 FORMAT "%8.2" ECU_ADDRESS 0xfe418e30 /end MEASUREMENT
/begin MEASUREMENT Tlib_EfuseRegRead_GetCR3_O_S_ODH95 "" ULONG RB_RBA_Common_CentralElements_CompuMethods_Identical 1 100 0.0 4294967295 FORMAT "%8.2" ECU_ADDRESS 0xfe418e34 /end MEASUREMENT
/begin MEASUREMENT Tlib_EfuseRegRead_GetSR1_O_S_ODH95 "" ULONG RB_RBA_Common_CentralElements_CompuMethods_Identical 1 100 0.0 4294967295 FORMAT "%8.2" ECU_ADDRESS 0xfe418e38 /end MEASUREMENT
/begin MEASUREMENT Tlib_EfuseRegRead_GetCurrent_O_S_ODH95 "" ULONG RB_RBA_Common_CentralElements_CompuMethods_Identical 1 100 0.0 4294967295 FORMAT "%8.2" ECU_ADDRESS 0xfe418e3c /end MEASUREMENT
/begin MEASUREMENT Tlib_EfuseRegRead_GetTJ_O_S_ODH95 "" ULONG RB_RBA_Common_CentralElements_CompuMethods_Identical 1 100 0.0 4294967295 FORMAT "%8.2" ECU_ADDRESS 0xfe418e40 /end MEASUREMENT
/begin MEASUREMENT Tlib_EfuseRegRead_GetTMOS_O_S_ODH95 "" ULONG RB_RBA_Common_CentralElements_CompuMethods_Identical 1 100 0.0 4294967295 FORMAT "%8.2" ECU_ADDRESS 0xfe418e44 /end MEASUREMENT
/begin MEASUREMENT Tlib_EfuseRegRead_GetVDS_O_S_ODH95 "" ULONG RB_RBA_Common_CentralElements_CompuMethods_Identical 1 100 0.0 4294967295 FORMAT "%8.2" ECU_ADDRESS 0xfe418e48 /end MEASUREMENT
/begin MEASUREMENT Tlib_EfuseRegRead_GetVOUT_O_S_ODH95 "" ULONG RB_RBA_Common_CentralElements_CompuMethods_Identical 1 100 0.0 4294967295 FORMAT "%8.2" ECU_ADDRESS 0xfe418e4c /end MEASUREMENT
/begin MEASUREMENT Tlib_EfuseRegRead_GetT_NOM_O_S_ODH95 "" ULONG RB_RBA_Common_CentralElements_CompuMethods_Identical 1 100 0.0 4294967295 FORMAT "%8.2" ECU_ADDRESS 0xfe418e50 /end MEASUREMENT
/begin MEASUREMENT Tlib_EfuseRegRead_GetOVC_THR_O_S_ODH95 "" ULONG RB_RBA_Common_CentralElements_CompuMethods_Identical 1 100 0.0 4294967295 FORMAT "%8.2" ECU_ADDRESS 0xfe418e54 /end MEASUREMENT
/begin MEASUREMENT Tlib_EfuseRegRead_GetHSHT_THR_O_S_ODH95 "" ULONG RB_RBA_Common_CentralElements_CompuMethods_Identical 1 100 0.0 4294967295 FORMAT "%8.2" ECU_ADDRESS 0xfe418e58 /end MEASUREMENT
/begin MEASUREMENT Tlib_EfuseRegRead_GetVDS_THR_O_S_ODH95 "" ULONG RB_RBA_Common_CentralElements_CompuMethods_Identical 1 100 0.0 4294967295 FORMAT "%8.2" ECU_ADDRESS 0xfe418e5c /end MEASUREMENT
/begin MEASUREMENT Tlib_EfuseRegRead_GetNTC_THR_O_S_ODH95 "" ULONG RB_RBA_Common_CentralElements_CompuMethods_Identical 1 100 0.0 4294967295 FORMAT "%8.2" ECU_ADDRESS 0xfe418e60 /end MEASUREMENT
/begin MEASUREMENT Tlib_EfuseRegRead_R_Shunt_O_S_ODH95 "" ULONG RB_RBA_Common_CentralElements_CompuMethods_Identical 1 100 0.0 4294967295 FORMAT "%8.2" ECU_ADDRESS 0xfe418e64 /end MEASUREMENT
/begin MEASUREMENT Tlib_EfuseRegRead_GetCr1_O_S_ODH51 "" ULONG RB_RBA_Common_CentralElements_CompuMethods_Identical 1 100 0.0 4294967295 FORMAT "%8.2" ECU_ADDRESS 0xfe418e68 /end MEASUREMENT
/begin MEASUREMENT Tlib_EfuseRegRead_GetCR3_O_S_ODH51 "" ULONG RB_RBA_Common_CentralElements_CompuMethods_Identical 1 100 0.0 4294967295 FORMAT "%8.2" ECU_ADDRESS 0xfe418e6c /end MEASUREMENT
/begin MEASUREMENT Tlib_EfuseRegRead_GetSR1_O_S_ODH51 "" ULONG RB_RBA_Common_CentralElements_CompuMethods_Identical 1 100 0.0 4294967295 FORMAT "%8.2" ECU_ADDRESS 0xfe418e70 /end MEASUREMENT
/begin MEASUREMENT Tlib_EfuseRegRead_GetCurrent_O_S_ODH51 "" ULONG RB_RBA_Common_CentralElements_CompuMethods_Identical 1 100 0.0 4294967295 FORMAT "%8.2" ECU_ADDRESS 0xfe418e74 /end MEASUREMENT
/begin MEASUREMENT Tlib_EfuseRegRead_GetTJ_O_S_ODH51 "" ULONG RB_RBA_Common_CentralElements_CompuMethods_Identical 1 100 0.0 4294967295 FORMAT "%8.2" ECU_ADDRESS 0xfe418e78 /end MEASUREMENT
/begin MEASUREMENT Tlib_EfuseRegRead_GetTMOS_O_S_ODH51 "" ULONG RB_RBA_Common_CentralElements_CompuMethods_Identical 1 100 0.0 4294967295 FORMAT "%8.2" ECU_ADDRESS 0xfe418e7c /end MEASUREMENT
/begin MEASUREMENT Tlib_EfuseRegRead_GetVDS_O_S_ODH51 "" ULONG RB_RBA_Common_CentralElements_CompuMethods_Identical 1 100 0.0 4294967295 FORMAT "%8.2" ECU_ADDRESS 0xfe418e80 /end MEASUREMENT
/begin MEASUREMENT Tlib_EfuseRegRead_GetVOUT_O_S_ODH51 "" ULONG RB_RBA_Common_CentralElements_CompuMethods_Identical 1 100 0.0 4294967295 FORMAT "%8.2" ECU_ADDRESS 0xfe418e84 /end MEASUREMENT
/begin MEASUREMENT Tlib_EfuseRegRead_GetT_NOM_O_S_ODH51 "" ULONG RB_RBA_Common_CentralElements_CompuMethods_Identical 1 100 0.0 4294967295 FORMAT "%8.2" ECU_ADDRESS 0xfe418e88 /end MEASUREMENT
/begin MEASUREMENT Tlib_EfuseRegRead_GetOVC_THR_O_S_ODH51 "" ULONG RB_RBA_Common_CentralElements_CompuMethods_Identical 1 100 0.0 4294967295 FORMAT "%8.2" ECU_ADDRESS 0xfe418e8c /end MEASUREMENT
/begin MEASUREMENT Tlib_EfuseRegRead_GetHSHT_THR_O_S_ODH51 "" ULONG RB_RBA_Common_CentralElements_CompuMethods_Identical 1 100 0.0 4294967295 FORMAT "%8.2" ECU_ADDRESS 0xfe418e90 /end MEASUREMENT
/begin MEASUREMENT Tlib_EfuseRegRead_GetVDS_THR_O_S_ODH51 "" ULONG RB_RBA_Common_CentralElements_CompuMethods_Identical 1 100 0.0 4294967295 FORMAT "%8.2" ECU_ADDRESS 0xfe418e94 /end MEASUREMENT
/begin MEASUREMENT Tlib_EfuseRegRead_GetNTC_THR_O_S_ODH51 "" ULONG RB_RBA_Common_CentralElements_CompuMethods_Identical 1 100 0.0 4294967295 FORMAT "%8.2" ECU_ADDRESS 0xfe418e98 /end MEASUREMENT
/begin MEASUREMENT Tlib_EfuseRegRead_R_Shunt_O_S_ODH51 "" ULONG RB_RBA_Common_CentralElements_CompuMethods_Identical 1 100 0.0 4294967295 FORMAT "%8.2" ECU_ADDRESS 0xfe418e9c /end MEASUREMENT
/begin MEASUREMENT Tlib_EfuseRegRead_GetCr1_O_S_ODH99 "" ULONG RB_RBA_Common_CentralElements_CompuMethods_Identical 1 100 0.0 4294967295 FORMAT "%8.2" ECU_ADDRESS 0xfe418ea0 /end MEASUREMENT
/begin MEASUREMENT Tlib_EfuseRegRead_GetCR3_O_S_ODH99 "" ULONG RB_RBA_Common_CentralElements_CompuMethods_Identical 1 100 0.0 4294967295 FORMAT "%8.2" ECU_ADDRESS 0xfe418ea4 /end MEASUREMENT
/begin MEASUREMENT Tlib_EfuseRegRead_GetSR1_O_S_ODH99 "" ULONG RB_RBA_Common_CentralElements_CompuMethods_Identical 1 100 0.0 4294967295 FORMAT "%8.2" ECU_ADDRESS 0xfe418ea8 /end MEASUREMENT
/begin MEASUREMENT Tlib_EfuseRegRead_GetCurrent_O_S_ODH99 "" ULONG RB_RBA_Common_CentralElements_CompuMethods_Identical 1 100 0.0 4294967295 FORMAT "%8.2" ECU_ADDRESS 0xfe418eac /end MEASUREMENT
/begin MEASUREMENT Tlib_EfuseRegRead_GetTJ_O_S_ODH99 "" ULONG RB_RBA_Common_CentralElements_CompuMethods_Identical 1 100 0.0 4294967295 FORMAT "%8.2" ECU_ADDRESS 0xfe418eb0 /end MEASUREMENT
/begin MEASUREMENT Tlib_EfuseRegRead_GetTMOS_O_S_ODH99 "" ULONG RB_RBA_Common_CentralElements_CompuMethods_Identical 1 100 0.0 4294967295 FORMAT "%8.2" ECU_ADDRESS 0xfe418eb4 /end MEASUREMENT
/begin MEASUREMENT Tlib_EfuseRegRead_GetVDS_O_S_ODH99 "" ULONG RB_RBA_Common_CentralElements_CompuMethods_Identical 1 100 0.0 4294967295 FORMAT "%8.2" ECU_ADDRESS 0xfe418eb8 /end MEASUREMENT
/begin MEASUREMENT Tlib_EfuseRegRead_GetVOUT_O_S_ODH99 "" ULONG RB_RBA_Common_CentralElements_CompuMethods_Identical 1 100 0.0 4294967295 FORMAT "%8.2" ECU_ADDRESS 0xfe418ebc /end MEASUREMENT
/begin MEASUREMENT Tlib_EfuseRegRead_GetT_NOM_O_S_ODH99 "" ULONG RB_RBA_Common_CentralElements_CompuMethods_Identical 1 100 0.0 4294967295 FORMAT "%8.2" ECU_ADDRESS 0xfe418ec0 /end MEASUREMENT
/begin MEASUREMENT Tlib_EfuseRegRead_GetOVC_THR_O_S_ODH99 "" ULONG RB_RBA_Common_CentralElements_CompuMethods_Identical 1 100 0.0 4294967295 FORMAT "%8.2" ECU_ADDRESS 0xfe418ec4 /end MEASUREMENT
/begin MEASUREMENT Tlib_EfuseRegRead_GetHSHT_THR_O_S_ODH99 "" ULONG RB_RBA_Common_CentralElements_CompuMethods_Identical 1 100 0.0 4294967295 FORMAT "%8.2" ECU_ADDRESS 0xfe418ec8 /end MEASUREMENT
/begin MEASUREMENT Tlib_EfuseRegRead_GetVDS_THR_O_S_ODH99 "" ULONG RB_RBA_Common_CentralElements_CompuMethods_Identical 1 100 0.0 4294967295 FORMAT "%8.2" ECU_ADDRESS 0xfe418ecc /end MEASUREMENT
/begin MEASUREMENT Tlib_EfuseRegRead_GetNTC_THR_O_S_ODH99 "" ULONG RB_RBA_Common_CentralElements_CompuMethods_Identical 1 100 0.0 4294967295 FORMAT "%8.2" ECU_ADDRESS 0xfe418ed0 /end MEASUREMENT
/begin MEASUREMENT Tlib_EfuseRegRead_R_Shunt_O_S_ODH99 "" ULONG RB_RBA_Common_CentralElements_CompuMethods_Identical 1 100 0.0 4294967295 FORMAT "%8.2" ECU_ADDRESS 0xfe418ed4 /end MEASUREMENT
/begin MEASUREMENT Tlib_EfuseRegRead_GetCr1_O_S_ODH71 "" ULONG RB_RBA_Common_CentralElements_CompuMethods_Identical 1 100 0.0 4294967295 FORMAT "%8.2" ECU_ADDRESS 0xfe418ed8 /end MEASUREMENT
/begin MEASUREMENT Tlib_EfuseRegRead_GetCR3_O_S_ODH71 "" ULONG RB_RBA_Common_CentralElements_CompuMethods_Identical 1 100 0.0 4294967295 FORMAT "%8.2" ECU_ADDRESS 0xfe418edc /end MEASUREMENT
/begin MEASUREMENT Tlib_EfuseRegRead_GetSR1_O_S_ODH71 "" ULONG RB_RBA_Common_CentralElements_CompuMethods_Identical 1 100 0.0 4294967295 FORMAT "%8.2" ECU_ADDRESS 0xfe418ee0 /end MEASUREMENT
/begin MEASUREMENT Tlib_EfuseRegRead_GetCurrent_O_S_ODH71 "" ULONG RB_RBA_Common_CentralElements_CompuMethods_Identical 1 100 0.0 4294967295 FORMAT "%8.2" ECU_ADDRESS 0xfe418ee4 /end MEASUREMENT
/begin MEASUREMENT Tlib_EfuseRegRead_GetTJ_O_S_ODH71 "" ULONG RB_RBA_Common_CentralElements_CompuMethods_Identical 1 100 0.0 4294967295 FORMAT "%8.2" ECU_ADDRESS 0xfe418ee8 /end MEASUREMENT
/begin MEASUREMENT Tlib_EfuseRegRead_GetTMOS_O_S_ODH71 "" ULONG RB_RBA_Common_CentralElements_CompuMethods_Identical 1 100 0.0 4294967295 FORMAT "%8.2" ECU_ADDRESS 0xfe418eec /end MEASUREMENT
/begin MEASUREMENT Tlib_EfuseRegRead_GetVDS_O_S_ODH71 "" ULONG RB_RBA_Common_CentralElements_CompuMethods_Identical 1 100 0.0 4294967295 FORMAT "%8.2" ECU_ADDRESS 0xfe418ef0 /end MEASUREMENT
/begin MEASUREMENT Tlib_EfuseRegRead_GetVOUT_O_S_ODH71 "" ULONG RB_RBA_Common_CentralElements_CompuMethods_Identical 1 100 0.0 4294967295 FORMAT "%8.2" ECU_ADDRESS 0xfe418ef4 /end MEASUREMENT
/begin MEASUREMENT Tlib_EfuseRegRead_GetT_NOM_O_S_ODH71 "" ULONG RB_RBA_Common_CentralElements_CompuMethods_Identical 1 100 0.0 4294967295 FORMAT "%8.2" ECU_ADDRESS 0xfe418ef8 /end MEASUREMENT
/begin MEASUREMENT Tlib_EfuseRegRead_GetOVC_THR_O_S_ODH71 "" ULONG RB_RBA_Common_CentralElements_CompuMethods_Identical 1 100 0.0 4294967295 FORMAT "%8.2" ECU_ADDRESS 0xfe418efc /end MEASUREMENT
/begin MEASUREMENT Tlib_EfuseRegRead_GetHSHT_THR_O_S_ODH71 "" ULONG RB_RBA_Common_CentralElements_CompuMethods_Identical 1 100 0.0 4294967295 FORMAT "%8.2" ECU_ADDRESS 0xfe418f00 /end MEASUREMENT
/begin MEASUREMENT Tlib_EfuseRegRead_GetVDS_THR_O_S_ODH71 "" ULONG RB_RBA_Common_CentralElements_CompuMethods_Identical 1 100 0.0 4294967295 FORMAT "%8.2" ECU_ADDRESS 0xfe418f04 /end MEASUREMENT
/begin MEASUREMENT Tlib_EfuseRegRead_GetNTC_THR_O_S_ODH71 "" ULONG RB_RBA_Common_CentralElements_CompuMethods_Identical 1 100 0.0 4294967295 FORMAT "%8.2" ECU_ADDRESS 0xfe418f08 /end MEASUREMENT
/begin MEASUREMENT Tlib_EfuseRegRead_R_Shunt_O_S_ODH71 "" ULONG RB_RBA_Common_CentralElements_CompuMethods_Identical 1 100 0.0 4294967295 FORMAT "%8.2" ECU_ADDRESS 0xfe418f0c /end MEASUREMENT
/begin MEASUREMENT Tlib_EfuseRegRead_GetCr1_O_S_ODH87 "" ULONG RB_RBA_Common_CentralElements_CompuMethods_Identical 1 100 0.0 4294967295 FORMAT "%8.2" ECU_ADDRESS 0xfe418f10 /end MEASUREMENT
/begin MEASUREMENT Tlib_EfuseRegRead_GetCR3_O_S_ODH87 "" ULONG RB_RBA_Common_CentralElements_CompuMethods_Identical 1 100 0.0 4294967295 FORMAT "%8.2" ECU_ADDRESS 0xfe418f14 /end MEASUREMENT
/begin MEASUREMENT Tlib_EfuseRegRead_GetSR1_O_S_ODH87 "" ULONG RB_RBA_Common_CentralElements_CompuMethods_Identical 1 100 0.0 4294967295 FORMAT "%8.2" ECU_ADDRESS 0xfe418f18 /end MEASUREMENT
/begin MEASUREMENT Tlib_EfuseRegRead_GetCurrent_O_S_ODH87 "" ULONG RB_RBA_Common_CentralElements_CompuMethods_Identical 1 100 0.0 4294967295 FORMAT "%8.2" ECU_ADDRESS 0xfe418f1c /end MEASUREMENT
/begin MEASUREMENT Tlib_EfuseRegRead_GetTJ_O_S_ODH87 "" ULONG RB_RBA_Common_CentralElements_CompuMethods_Identical 1 100 0.0 4294967295 FORMAT "%8.2" ECU_ADDRESS 0xfe418f20 /end MEASUREMENT
/begin MEASUREMENT Tlib_EfuseRegRead_GetTMOS_O_S_ODH87 "" ULONG RB_RBA_Common_CentralElements_CompuMethods_Identical 1 100 0.0 4294967295 FORMAT "%8.2" ECU_ADDRESS 0xfe418f24 /end MEASUREMENT
/begin MEASUREMENT Tlib_EfuseRegRead_GetVDS_O_S_ODH87 "" ULONG RB_RBA_Common_CentralElements_CompuMethods_Identical 1 100 0.0 4294967295 FORMAT "%8.2" ECU_ADDRESS 0xfe418f28 /end MEASUREMENT
/begin MEASUREMENT Tlib_EfuseRegRead_GetVOUT_O_S_ODH87 "" ULONG RB_RBA_Common_CentralElements_CompuMethods_Identical 1 100 0.0 4294967295 FORMAT "%8.2" ECU_ADDRESS 0xfe418f2c /end MEASUREMENT
/begin MEASUREMENT Tlib_EfuseRegRead_GetT_NOM_O_S_ODH87 "" ULONG RB_RBA_Common_CentralElements_CompuMethods_Identical 1 100 0.0 4294967295 FORMAT "%8.2" ECU_ADDRESS 0xfe418f30 /end MEASUREMENT
/begin MEASUREMENT Tlib_EfuseRegRead_GetOVC_THR_O_S_ODH87 "" ULONG RB_RBA_Common_CentralElements_CompuMethods_Identical 1 100 0.0 4294967295 FORMAT "%8.2" ECU_ADDRESS 0xfe418f34 /end MEASUREMENT
/begin MEASUREMENT Tlib_EfuseRegRead_GetHSHT_THR_O_S_ODH87 "" ULONG RB_RBA_Common_CentralElements_CompuMethods_Identical 1 100 0.0 4294967295 FORMAT "%8.2" ECU_ADDRESS 0xfe418f38 /end MEASUREMENT
/begin MEASUREMENT Tlib_EfuseRegRead_GetVDS_THR_O_S_ODH87 "" ULONG RB_RBA_Common_CentralElements_CompuMethods_Identical 1 100 0.0 4294967295 FORMAT "%8.2" ECU_ADDRESS 0xfe418f3c /end MEASUREMENT
/begin MEASUREMENT Tlib_EfuseRegRead_GetNTC_THR_O_S_ODH87 "" ULONG RB_RBA_Common_CentralElements_CompuMethods_Identical 1 100 0.0 4294967295 FORMAT "%8.2" ECU_ADDRESS 0xfe418f40 /end MEASUREMENT
/begin MEASUREMENT Tlib_EfuseRegRead_R_Shunt_O_S_ODH87 "" ULONG RB_RBA_Common_CentralElements_CompuMethods_Identical 1 100 0.0 4294967295 FORMAT "%8.2" ECU_ADDRESS 0xfe418f44 /end MEASUREMENT
/begin MEASUREMENT Tlib_EfuseRegRead_GetCr1_O_S_ODH28 "" ULONG RB_RBA_Common_CentralElements_CompuMethods_Identical 1 100 0.0 4294967295 FORMAT "%8.2" ECU_ADDRESS 0xfe418f48 /end MEASUREMENT
/begin MEASUREMENT Tlib_EfuseRegRead_GetCR3_O_S_ODH28 "" ULONG RB_RBA_Common_CentralElements_CompuMethods_Identical 1 100 0.0 4294967295 FORMAT "%8.2" ECU_ADDRESS 0xfe418f4c /end MEASUREMENT
/begin MEASUREMENT Tlib_EfuseRegRead_GetSR1_O_S_ODH28 "" ULONG RB_RBA_Common_CentralElements_CompuMethods_Identical 1 100 0.0 4294967295 FORMAT "%8.2" ECU_ADDRESS 0xfe418f50 /end MEASUREMENT
/begin MEASUREMENT Tlib_EfuseRegRead_GetCurrent_O_S_ODH28 "" ULONG RB_RBA_Common_CentralElements_CompuMethods_Identical 1 100 0.0 4294967295 FORMAT "%8.2" ECU_ADDRESS 0xfe418f54 /end MEASUREMENT
/begin MEASUREMENT Tlib_EfuseRegRead_GetTJ_O_S_ODH28 "" ULONG RB_RBA_Common_CentralElements_CompuMethods_Identical 1 100 0.0 4294967295 FORMAT "%8.2" ECU_ADDRESS 0xfe418f58 /end MEASUREMENT
/begin MEASUREMENT Tlib_EfuseRegRead_GetTMOS_O_S_ODH28 "" ULONG RB_RBA_Common_CentralElements_CompuMethods_Identical 1 100 0.0 4294967295 FORMAT "%8.2" ECU_ADDRESS 0xfe418f5c /end MEASUREMENT
/begin MEASUREMENT Tlib_EfuseRegRead_GetVDS_O_S_ODH28 "" ULONG RB_RBA_Common_CentralElements_CompuMethods_Identical 1 100 0.0 4294967295 FORMAT "%8.2" ECU_ADDRESS 0xfe418f60 /end MEASUREMENT
/begin MEASUREMENT Tlib_EfuseRegRead_GetVOUT_O_S_ODH28 "" ULONG RB_RBA_Common_CentralElements_CompuMethods_Identical 1 100 0.0 4294967295 FORMAT "%8.2" ECU_ADDRESS 0xfe418f64 /end MEASUREMENT
/begin MEASUREMENT Tlib_EfuseRegRead_GetT_NOM_O_S_ODH28 "" ULONG RB_RBA_Common_CentralElements_CompuMethods_Identical 1 100 0.0 4294967295 FORMAT "%8.2" ECU_ADDRESS 0xfe418f68 /end MEASUREMENT
/begin MEASUREMENT Tlib_EfuseRegRead_GetOVC_THR_O_S_ODH28 "" ULONG RB_RBA_Common_CentralElements_CompuMethods_Identical 1 100 0.0 4294967295 FORMAT "%8.2" ECU_ADDRESS 0xfe418f6c /end MEASUREMENT
/begin MEASUREMENT Tlib_EfuseRegRead_GetHSHT_THR_O_S_ODH28 "" ULONG RB_RBA_Common_CentralElements_CompuMethods_Identical 1 100 0.0 4294967295 FORMAT "%8.2" ECU_ADDRESS 0xfe418f70 /end MEASUREMENT
/begin MEASUREMENT Tlib_EfuseRegRead_GetVDS_THR_O_S_ODH28 "" ULONG RB_RBA_Common_CentralElements_CompuMethods_Identical 1 100 0.0 4294967295 FORMAT "%8.2" ECU_ADDRESS 0xfe418f74 /end MEASUREMENT
/begin MEASUREMENT Tlib_EfuseRegRead_GetNTC_THR_O_S_ODH28 "" ULONG RB_RBA_Common_CentralElements_CompuMethods_Identical 1 100 0.0 4294967295 FORMAT "%8.2" ECU_ADDRESS 0xfe418f78 /end MEASUREMENT
/begin MEASUREMENT Tlib_EfuseRegRead_R_Shunt_O_S_ODH28 "" ULONG RB_RBA_Common_CentralElements_CompuMethods_Identical 1 100 0.0 4294967295 FORMAT "%8.2" ECU_ADDRESS 0xfe418f7c /end MEASUREMENT
/begin MEASUREMENT Tlib_BTGRegRead_GetI2tSetting_O_S_5V05 "" ULONG RB_RBA_Common_CentralElements_CompuMethods_Identical 1 100 0.0 4294967295 FORMAT "%8.2" ECU_ADDRESS 0xfe418f80 /end MEASUREMENT
/begin MEASUREMENT Tlib_BTGRegRead_GetI2tStatus_O_S_5V05 "" ULONG RB_RBA_Common_CentralElements_CompuMethods_Identical 1 100 0.0 4294967295 FORMAT "%8.2" ECU_ADDRESS 0xfe418f84 /end MEASUREMENT
/begin MEASUREMENT Tlib_BTGRegRead_GetOctSetting_O_S_5V05 "" ULONG RB_RBA_Common_CentralElements_CompuMethods_Identical 1 100 0.0 4294967295 FORMAT "%8.2" ECU_ADDRESS 0xfe418f88 /end MEASUREMENT
/begin MEASUREMENT Tlib_BTGRegRead_GetCurrent_O_S_5V05 "" ULONG RB_RBA_Common_CentralElements_CompuMethods_Identical 1 100 0.0 4294967295 FORMAT "%8.2" ECU_ADDRESS 0xfe418f8c /end MEASUREMENT
/begin MEASUREMENT Tlib_BTGRegRead_GetI2tSetting_O_S_5V02 "" ULONG RB_RBA_Common_CentralElements_CompuMethods_Identical 1 100 0.0 4294967295 FORMAT "%8.2" ECU_ADDRESS 0xfe418f90 /end MEASUREMENT
/begin MEASUREMENT Tlib_BTGRegRead_GetI2tStatus_O_S_5V02 "" ULONG RB_RBA_Common_CentralElements_CompuMethods_Identical 1 100 0.0 4294967295 FORMAT "%8.2" ECU_ADDRESS 0xfe418f94 /end MEASUREMENT
/begin MEASUREMENT Tlib_BTGRegRead_GetOctSetting_O_S_5V02 "" ULONG RB_RBA_Common_CentralElements_CompuMethods_Identical 1 100 0.0 4294967295 FORMAT "%8.2" ECU_ADDRESS 0xfe418f98 /end MEASUREMENT
/begin MEASUREMENT Tlib_BTGRegRead_GetCurrent_O_S_5V02 "" ULONG RB_RBA_Common_CentralElements_CompuMethods_Identical 1 100 0.0 4294967295 FORMAT "%8.2" ECU_ADDRESS 0xfe418f9c /end MEASUREMENT
/begin MEASUREMENT Tlib_BTGRegRead_GetI2tSetting_O_S_5V06 "" ULONG RB_RBA_Common_CentralElements_CompuMethods_Identical 1 100 0.0 4294967295 FORMAT "%8.2" ECU_ADDRESS 0xfe418fa0 /end MEASUREMENT
/begin MEASUREMENT Tlib_BTGRegRead_GetI2tStatus_O_S_5V06 "" ULONG RB_RBA_Common_CentralElements_CompuMethods_Identical 1 100 0.0 4294967295 FORMAT "%8.2" ECU_ADDRESS 0xfe418fa4 /end MEASUREMENT
/begin MEASUREMENT Tlib_BTGRegRead_GetOctSetting_O_S_5V06 "" ULONG RB_RBA_Common_CentralElements_CompuMethods_Identical 1 100 0.0 4294967295 FORMAT "%8.2" ECU_ADDRESS 0xfe418fa8 /end MEASUREMENT
/begin MEASUREMENT Tlib_BTGRegRead_GetCurrent_O_S_5V06 "" ULONG RB_RBA_Common_CentralElements_CompuMethods_Identical 1 100 0.0 4294967295 FORMAT "%8.2" ECU_ADDRESS 0xfe418fac /end MEASUREMENT
/begin MEASUREMENT Tlib_BTGRegRead_GetI2tSetting_O_S_5V07 "" ULONG RB_RBA_Common_CentralElements_CompuMethods_Identical 1 100 0.0 4294967295 FORMAT "%8.2" ECU_ADDRESS 0xfe418fb0 /end MEASUREMENT
/begin MEASUREMENT Tlib_BTGRegRead_GetI2tStatus_O_S_5V07 "" ULONG RB_RBA_Common_CentralElements_CompuMethods_Identical 1 100 0.0 4294967295 FORMAT "%8.2" ECU_ADDRESS 0xfe418fb4 /end MEASUREMENT
/begin MEASUREMENT Tlib_BTGRegRead_GetOctSetting_O_S_5V07 "" ULONG RB_RBA_Common_CentralElements_CompuMethods_Identical 1 100 0.0 4294967295 FORMAT "%8.2" ECU_ADDRESS 0xfe418fb8 /end MEASUREMENT
/begin MEASUREMENT Tlib_BTGRegRead_GetCurrent_O_S_5V07 "" ULONG RB_RBA_Common_CentralElements_CompuMethods_Identical 1 100 0.0 4294967295 FORMAT "%8.2" ECU_ADDRESS 0xfe418fbc /end MEASUREMENT
/begin MEASUREMENT Tlib_BTGRegRead_GetI2tSetting_O_S_5V10 "" ULONG RB_RBA_Common_CentralElements_CompuMethods_Identical 1 100 0.0 4294967295 FORMAT "%8.2" ECU_ADDRESS 0xfe418fc0 /end MEASUREMENT
/begin MEASUREMENT Tlib_BTGRegRead_GetI2tStatus_O_S_5V10 "" ULONG RB_RBA_Common_CentralElements_CompuMethods_Identical 1 100 0.0 4294967295 FORMAT "%8.2" ECU_ADDRESS 0xfe418fc4 /end MEASUREMENT
/begin MEASUREMENT Tlib_BTGRegRead_GetOctSetting_O_S_5V10 "" ULONG RB_RBA_Common_CentralElements_CompuMethods_Identical 1 100 0.0 4294967295 FORMAT "%8.2" ECU_ADDRESS 0xfe418fc8 /end MEASUREMENT
/begin MEASUREMENT Tlib_BTGRegRead_GetCurrent_O_S_5V10 "" ULONG RB_RBA_Common_CentralElements_CompuMethods_Identical 1 100 0.0 4294967295 FORMAT "%8.2" ECU_ADDRESS 0xfe418fcc /end MEASUREMENT
/begin MEASUREMENT Tlib_BTGRegRead_GetI2tSetting_O_S_ODH110 "" ULONG RB_RBA_Common_CentralElements_CompuMethods_Identical 1 100 0.0 4294967295 FORMAT "%8.2" ECU_ADDRESS 0xfe418fd0 /end MEASUREMENT
/begin MEASUREMENT Tlib_BTGRegRead_GetI2tStatus_O_S_ODH110 "" ULONG RB_RBA_Common_CentralElements_CompuMethods_Identical 1 100 0.0 4294967295 FORMAT "%8.2" ECU_ADDRESS 0xfe418fd4 /end MEASUREMENT
/begin MEASUREMENT Tlib_BTGRegRead_GetOctSetting_O_S_ODH110 "" ULONG RB_RBA_Common_CentralElements_CompuMethods_Identical 1 100 0.0 4294967295 FORMAT "%8.2" ECU_ADDRESS 0xfe418fd8 /end MEASUREMENT
/begin MEASUREMENT Tlib_BTGRegRead_GetCurrent_O_S_ODH110 "" ULONG RB_RBA_Common_CentralElements_CompuMethods_Identical 1 100 0.0 4294967295 FORMAT "%8.2" ECU_ADDRESS 0xfe418fdc /end MEASUREMENT
/begin MEASUREMENT Tlib_BTGRegRead_GetI2tSetting_O_S_ODH111 "" ULONG RB_RBA_Common_CentralElements_CompuMethods_Identical 1 100 0.0 4294967295 FORMAT "%8.2" ECU_ADDRESS 0xfe418fe0 /end MEASUREMENT
/begin MEASUREMENT Tlib_BTGRegRead_GetI2tStatus_O_S_ODH111 "" ULONG RB_RBA_Common_CentralElements_CompuMethods_Identical 1 100 0.0 4294967295 FORMAT "%8.2" ECU_ADDRESS 0xfe418fe4 /end MEASUREMENT
/begin MEASUREMENT Tlib_BTGRegRead_GetOctSetting_O_S_ODH111 "" ULONG RB_RBA_Common_CentralElements_CompuMethods_Identical 1 100 0.0 4294967295 FORMAT "%8.2" ECU_ADDRESS 0xfe418fe8 /end MEASUREMENT
/begin MEASUREMENT Tlib_BTGRegRead_GetCurrent_O_S_ODH111 "" ULONG RB_RBA_Common_CentralElements_CompuMethods_Identical 1 100 0.0 4294967295 FORMAT "%8.2" ECU_ADDRESS 0xfe418fec /end MEASUREMENT
/begin MEASUREMENT Tlib_BTGRegRead_GetI2tSetting_O_S_ODH112 "" ULONG RB_RBA_Common_CentralElements_CompuMethods_Identical 1 100 0.0 4294967295 FORMAT "%8.2" ECU_ADDRESS 0xfe418ff0 /end MEASUREMENT
/begin MEASUREMENT Tlib_BTGRegRead_GetI2tStatus_O_S_ODH112 "" ULONG RB_RBA_Common_CentralElements_CompuMethods_Identical 1 100 0.0 4294967295 FORMAT "%8.2" ECU_ADDRESS 0xfe418ff4 /end MEASUREMENT
/begin MEASUREMENT Tlib_BTGRegRead_GetOctSetting_O_S_ODH112 "" ULONG RB_RBA_Common_CentralElements_CompuMethods_Identical 1 100 0.0 4294967295 FORMAT "%8.2" ECU_ADDRESS 0xfe418ff8 /end MEASUREMENT
/begin MEASUREMENT Tlib_BTGRegRead_GetCurrent_O_S_ODH112 "" ULONG RB_RBA_Common_CentralElements_CompuMethods_Identical 1 100 0.0 4294967295 FORMAT "%8.2" ECU_ADDRESS 0xfe418ffc /end MEASUREMENT
/begin MEASUREMENT Tlib_BTGRegRead_GetI2tSetting_O_S_ODH113 "" ULONG RB_RBA_Common_CentralElements_CompuMethods_Identical 1 100 0.0 4294967295 FORMAT "%8.2" ECU_ADDRESS 0xfe419000 /end MEASUREMENT
/begin MEASUREMENT Tlib_BTGRegRead_GetI2tStatus_O_S_ODH113 "" ULONG RB_RBA_Common_CentralElements_CompuMethods_Identical 1 100 0.0 4294967295 FORMAT "%8.2" ECU_ADDRESS 0xfe419004 /end MEASUREMENT
/begin MEASUREMENT Tlib_BTGRegRead_GetOctSetting_O_S_ODH113 "" ULONG RB_RBA_Common_CentralElements_CompuMethods_Identical 1 100 0.0 4294967295 FORMAT "%8.2" ECU_ADDRESS 0xfe419008 /end MEASUREMENT
/begin MEASUREMENT Tlib_BTGRegRead_GetCurrent_O_S_ODH113 "" ULONG RB_RBA_Common_CentralElements_CompuMethods_Identical 1 100 0.0 4294967295 FORMAT "%8.2" ECU_ADDRESS 0xfe41900c /end MEASUREMENT
/begin MEASUREMENT Tlib_BTGRegRead_GetI2tSetting_O_S_EFUSE08 "" ULONG RB_RBA_Common_CentralElements_CompuMethods_Identical 1 100 0.0 4294967295 FORMAT "%8.2" ECU_ADDRESS 0xfe419010 /end MEASUREMENT
/begin MEASUREMENT Tlib_BTGRegRead_GetI2tStatus_O_S_EFUSE08 "" ULONG RB_RBA_Common_CentralElements_CompuMethods_Identical 1 100 0.0 4294967295 FORMAT "%8.2" ECU_ADDRESS 0xfe419014 /end MEASUREMENT
/begin MEASUREMENT Tlib_BTGRegRead_GetOctSetting_O_S_EFUSE08 "" ULONG RB_RBA_Common_CentralElements_CompuMethods_Identical 1 100 0.0 4294967295 FORMAT "%8.2" ECU_ADDRESS 0xfe419018 /end MEASUREMENT
/begin MEASUREMENT Tlib_BTGRegRead_GetCurrent_O_S_EFUSE08 "" ULONG RB_RBA_Common_CentralElements_CompuMethods_Identical 1 100 0.0 4294967295 FORMAT "%8.2" ECU_ADDRESS 0xfe41901c /end MEASUREMENT
/begin MEASUREMENT Tlib_BTGRegRead_GetI2tSetting_O_S_ODH02 "" ULONG RB_RBA_Common_CentralElements_CompuMethods_Identical 1 100 0.0 4294967295 FORMAT "%8.2" ECU_ADDRESS 0xfe419020 /end MEASUREMENT
/begin MEASUREMENT Tlib_BTGRegRead_GetI2tStatus_O_S_ODH02 "" ULONG RB_RBA_Common_CentralElements_CompuMethods_Identical 1 100 0.0 4294967295 FORMAT "%8.2" ECU_ADDRESS 0xfe419024 /end MEASUREMENT
/begin MEASUREMENT Tlib_BTGRegRead_GetOctSetting_O_S_ODH02 "" ULONG RB_RBA_Common_CentralElements_CompuMethods_Identical 1 100 0.0 4294967295 FORMAT "%8.2" ECU_ADDRESS 0xfe419028 /end MEASUREMENT
/begin MEASUREMENT Tlib_BTGRegRead_GetCurrent_O_S_ODH02 "" ULONG RB_RBA_Common_CentralElements_CompuMethods_Identical 1 100 0.0 4294967295 FORMAT "%8.2" ECU_ADDRESS 0xfe41902c /end MEASUREMENT
/begin MEASUREMENT Tlib_BTGRegRead_GetI2tSetting_O_S_ODH24 "" ULONG RB_RBA_Common_CentralElements_CompuMethods_Identical 1 100 0.0 4294967295 FORMAT "%8.2" ECU_ADDRESS 0xfe419030 /end MEASUREMENT
/begin MEASUREMENT Tlib_BTGRegRead_GetI2tStatus_O_S_ODH24 "" ULONG RB_RBA_Common_CentralElements_CompuMethods_Identical 1 100 0.0 4294967295 FORMAT "%8.2" ECU_ADDRESS 0xfe419034 /end MEASUREMENT
/begin MEASUREMENT Tlib_BTGRegRead_GetOctSetting_O_S_ODH24 "" ULONG RB_RBA_Common_CentralElements_CompuMethods_Identical 1 100 0.0 4294967295 FORMAT "%8.2" ECU_ADDRESS 0xfe419038 /end MEASUREMENT
/begin MEASUREMENT Tlib_BTGRegRead_GetCurrent_O_S_ODH24 "" ULONG RB_RBA_Common_CentralElements_CompuMethods_Identical 1 100 0.0 4294967295 FORMAT "%8.2" ECU_ADDRESS 0xfe41903c /end MEASUREMENT
/begin MEASUREMENT Tlib_BTGRegRead_GetI2tSetting_O_S_ODH04 "" ULONG RB_RBA_Common_CentralElements_CompuMethods_Identical 1 100 0.0 4294967295 FORMAT "%8.2" ECU_ADDRESS 0xfe419040 /end MEASUREMENT
/begin MEASUREMENT Tlib_BTGRegRead_GetI2tStatus_O_S_ODH04 "" ULONG RB_RBA_Common_CentralElements_CompuMethods_Identical 1 100 0.0 4294967295 FORMAT "%8.2" ECU_ADDRESS 0xfe419044 /end MEASUREMENT
/begin MEASUREMENT Tlib_BTGRegRead_GetOctSetting_O_S_ODH04 "" ULONG RB_RBA_Common_CentralElements_CompuMethods_Identical 1 100 0.0 4294967295 FORMAT "%8.2" ECU_ADDRESS 0xfe419048 /end MEASUREMENT
/begin MEASUREMENT Tlib_BTGRegRead_GetCurrent_O_S_ODH04 "" ULONG RB_RBA_Common_CentralElements_CompuMethods_Identical 1 100 0.0 4294967295 FORMAT "%8.2" ECU_ADDRESS 0xfe41904c /end MEASUREMENT
/begin MEASUREMENT Tlib_BTGRegRead_GetI2tSetting_O_S_ODH29 "" ULONG RB_RBA_Common_CentralElements_CompuMethods_Identical 1 100 0.0 4294967295 FORMAT "%8.2" ECU_ADDRESS 0xfe419050 /end MEASUREMENT
/begin MEASUREMENT Tlib_BTGRegRead_GetI2tStatus_O_S_ODH29 "" ULONG RB_RBA_Common_CentralElements_CompuMethods_Identical 1 100 0.0 4294967295 FORMAT "%8.2" ECU_ADDRESS 0xfe419054 /end MEASUREMENT
/begin MEASUREMENT Tlib_BTGRegRead_GetOctSetting_O_S_ODH29 "" ULONG RB_RBA_Common_CentralElements_CompuMethods_Identical 1 100 0.0 4294967295 FORMAT "%8.2" ECU_ADDRESS 0xfe419058 /end MEASUREMENT
/begin MEASUREMENT Tlib_BTGRegRead_GetCurrent_O_S_ODH29 "" ULONG RB_RBA_Common_CentralElements_CompuMethods_Identical 1 100 0.0 4294967295 FORMAT "%8.2" ECU_ADDRESS 0xfe41905c /end MEASUREMENT
/begin MEASUREMENT Tlib_BTGRegRead_GetI2tSetting_O_S_ODH22 "" ULONG RB_RBA_Common_CentralElements_CompuMethods_Identical 1 100 0.0 4294967295 FORMAT "%8.2" ECU_ADDRESS 0xfe419060 /end MEASUREMENT
/begin MEASUREMENT Tlib_BTGRegRead_GetI2tStatus_O_S_ODH22 "" ULONG RB_RBA_Common_CentralElements_CompuMethods_Identical 1 100 0.0 4294967295 FORMAT "%8.2" ECU_ADDRESS 0xfe419064 /end MEASUREMENT
/begin MEASUREMENT Tlib_BTGRegRead_GetOctSetting_O_S_ODH22 "" ULONG RB_RBA_Common_CentralElements_CompuMethods_Identical 1 100 0.0 4294967295 FORMAT "%8.2" ECU_ADDRESS 0xfe419068 /end MEASUREMENT
/begin MEASUREMENT Tlib_BTGRegRead_GetCurrent_O_S_ODH22 "" ULONG RB_RBA_Common_CentralElements_CompuMethods_Identical 1 100 0.0 4294967295 FORMAT "%8.2" ECU_ADDRESS 0xfe41906c /end MEASUREMENT
/begin MEASUREMENT Tlib_BTGRegRead_GetI2tSetting_O_S_ODH25 "" ULONG RB_RBA_Common_CentralElements_CompuMethods_Identical 1 100 0.0 4294967295 FORMAT "%8.2" ECU_ADDRESS 0xfe419070 /end MEASUREMENT
/begin MEASUREMENT Tlib_BTGRegRead_GetI2tStatus_O_S_ODH25 "" ULONG RB_RBA_Common_CentralElements_CompuMethods_Identical 1 100 0.0 4294967295 FORMAT "%8.2" ECU_ADDRESS 0xfe419074 /end MEASUREMENT
/begin MEASUREMENT Tlib_BTGRegRead_GetOctSetting_O_S_ODH25 "" ULONG RB_RBA_Common_CentralElements_CompuMethods_Identical 1 100 0.0 4294967295 FORMAT "%8.2" ECU_ADDRESS 0xfe419078 /end MEASUREMENT
/begin MEASUREMENT Tlib_BTGRegRead_GetCurrent_O_S_ODH25 "" ULONG RB_RBA_Common_CentralElements_CompuMethods_Identical 1 100 0.0 4294967295 FORMAT "%8.2" ECU_ADDRESS 0xfe41907c /end MEASUREMENT
/begin MEASUREMENT Tlib_BTGRegRead_GetI2tSetting_O_S_ODH21 "" ULONG RB_RBA_Common_CentralElements_CompuMethods_Identical 1 100 0.0 4294967295 FORMAT "%8.2" ECU_ADDRESS 0xfe419080 /end MEASUREMENT
/begin MEASUREMENT Tlib_BTGRegRead_GetI2tStatus_O_S_ODH21 "" ULONG RB_RBA_Common_CentralElements_CompuMethods_Identical 1 100 0.0 4294967295 FORMAT "%8.2" ECU_ADDRESS 0xfe419084 /end MEASUREMENT
/begin MEASUREMENT Tlib_BTGRegRead_GetOctSetting_O_S_ODH21 "" ULONG RB_RBA_Common_CentralElements_CompuMethods_Identical 1 100 0.0 4294967295 FORMAT "%8.2" ECU_ADDRESS 0xfe419088 /end MEASUREMENT
/begin MEASUREMENT Tlib_BTGRegRead_GetCurrent_O_S_ODH21 "" ULONG RB_RBA_Common_CentralElements_CompuMethods_Identical 1 100 0.0 4294967295 FORMAT "%8.2" ECU_ADDRESS 0xfe41908c /end MEASUREMENT
/begin MEASUREMENT Tlib_BTGRegRead_GetI2tSetting_O_S_EFUSE22 "" ULONG RB_RBA_Common_CentralElements_CompuMethods_Identical 1 100 0.0 4294967295 FORMAT "%8.2" ECU_ADDRESS 0xfe419090 /end MEASUREMENT
/begin MEASUREMENT Tlib_BTGRegRead_GetI2tStatus_O_S_EFUSE22 "" ULONG RB_RBA_Common_CentralElements_CompuMethods_Identical 1 100 0.0 4294967295 FORMAT "%8.2" ECU_ADDRESS 0xfe419094 /end MEASUREMENT
/begin MEASUREMENT Tlib_BTGRegRead_GetOctSetting_O_S_EFUSE22 "" ULONG RB_RBA_Common_CentralElements_CompuMethods_Identical 1 100 0.0 4294967295 FORMAT "%8.2" ECU_ADDRESS 0xfe419098 /end MEASUREMENT
/begin MEASUREMENT Tlib_BTGRegRead_GetCurrent_O_S_EFUSE22 "" ULONG RB_RBA_Common_CentralElements_CompuMethods_Identical 1 100 0.0 4294967295 FORMAT "%8.2" ECU_ADDRESS 0xfe41909c /end MEASUREMENT
/begin MEASUREMENT Tlib_BTGRegRead_GetI2tSetting_O_S_ODH39 "" ULONG RB_RBA_Common_CentralElements_CompuMethods_Identical 1 100 0.0 4294967295 FORMAT "%8.2" ECU_ADDRESS 0xfe4190a0 /end MEASUREMENT
/begin MEASUREMENT Tlib_BTGRegRead_GetI2tStatus_O_S_ODH39 "" ULONG RB_RBA_Common_CentralElements_CompuMethods_Identical 1 100 0.0 4294967295 FORMAT "%8.2" ECU_ADDRESS 0xfe4190a4 /end MEASUREMENT
/begin MEASUREMENT Tlib_BTGRegRead_GetOctSetting_O_S_ODH39 "" ULONG RB_RBA_Common_CentralElements_CompuMethods_Identical 1 100 0.0 4294967295 FORMAT "%8.2" ECU_ADDRESS 0xfe4190a8 /end MEASUREMENT
/begin MEASUREMENT Tlib_BTGRegRead_GetCurrent_O_S_ODH39 "" ULONG RB_RBA_Common_CentralElements_CompuMethods_Identical 1 100 0.0 4294967295 FORMAT "%8.2" ECU_ADDRESS 0xfe4190ac /end MEASUREMENT
/begin MEASUREMENT Tlib_BTGRegRead_GetI2tSetting_O_S_ODH37 "" ULONG RB_RBA_Common_CentralElements_CompuMethods_Identical 1 100 0.0 4294967295 FORMAT "%8.2" ECU_ADDRESS 0xfe4190b0 /end MEASUREMENT
/begin MEASUREMENT Tlib_BTGRegRead_GetI2tStatus_O_S_ODH37 "" ULONG RB_RBA_Common_CentralElements_CompuMethods_Identical 1 100 0.0 4294967295 FORMAT "%8.2" ECU_ADDRESS 0xfe4190b4 /end MEASUREMENT
/begin MEASUREMENT Tlib_BTGRegRead_GetOctSetting_O_S_ODH37 "" ULONG RB_RBA_Common_CentralElements_CompuMethods_Identical 1 100 0.0 4294967295 FORMAT "%8.2" ECU_ADDRESS 0xfe4190b8 /end MEASUREMENT
/begin MEASUREMENT Tlib_BTGRegRead_GetCurrent_O_S_ODH37 "" ULONG RB_RBA_Common_CentralElements_CompuMethods_Identical 1 100 0.0 4294967295 FORMAT "%8.2" ECU_ADDRESS 0xfe4190bc /end MEASUREMENT
/begin MEASUREMENT Tlib_BTGRegRead_GetI2tSetting_O_S_ODH75 "" ULONG RB_RBA_Common_CentralElements_CompuMethods_Identical 1 100 0.0 4294967295 FORMAT "%8.2" ECU_ADDRESS 0xfe4190c0 /end MEASUREMENT
/begin MEASUREMENT Tlib_BTGRegRead_GetI2tStatus_O_S_ODH75 "" ULONG RB_RBA_Common_CentralElements_CompuMethods_Identical 1 100 0.0 4294967295 FORMAT "%8.2" ECU_ADDRESS 0xfe4190c4 /end MEASUREMENT
/begin MEASUREMENT Tlib_BTGRegRead_GetOctSetting_O_S_ODH75 "" ULONG RB_RBA_Common_CentralElements_CompuMethods_Identical 1 100 0.0 4294967295 FORMAT "%8.2" ECU_ADDRESS 0xfe4190c8 /end MEASUREMENT
/begin MEASUREMENT Tlib_BTGRegRead_GetCurrent_O_S_ODH75 "" ULONG RB_RBA_Common_CentralElements_CompuMethods_Identical 1 100 0.0 4294967295 FORMAT "%8.2" ECU_ADDRESS 0xfe4190cc /end MEASUREMENT
/begin MEASUREMENT Tlib_BTGRegRead_GetI2tSetting_O_S_EFUSE17 "" ULONG RB_RBA_Common_CentralElements_CompuMethods_Identical 1 100 0.0 4294967295 FORMAT "%8.2" ECU_ADDRESS 0xfe4190d0 /end MEASUREMENT
/begin MEASUREMENT Tlib_BTGRegRead_GetI2tStatus_O_S_EFUSE17 "" ULONG RB_RBA_Common_CentralElements_CompuMethods_Identical 1 100 0.0 4294967295 FORMAT "%8.2" ECU_ADDRESS 0xfe4190d4 /end MEASUREMENT
/begin MEASUREMENT Tlib_BTGRegRead_GetOctSetting_O_S_EFUSE17 "" ULONG RB_RBA_Common_CentralElements_CompuMethods_Identical 1 100 0.0 4294967295 FORMAT "%8.2" ECU_ADDRESS 0xfe4190d8 /end MEASUREMENT
/begin MEASUREMENT Tlib_BTGRegRead_GetCurrent_O_S_EFUSE17 "" ULONG RB_RBA_Common_CentralElements_CompuMethods_Identical 1 100 0.0 4294967295 FORMAT "%8.2" ECU_ADDRESS 0xfe4190dc /end MEASUREMENT
/begin MEASUREMENT Tlib_BTGRegRead_GetI2tSetting_O_S_ODH66 "" ULONG RB_RBA_Common_CentralElements_CompuMethods_Identical 1 100 0.0 4294967295 FORMAT "%8.2" ECU_ADDRESS 0xfe4190e0 /end MEASUREMENT
/begin MEASUREMENT Tlib_BTGRegRead_GetI2tStatus_O_S_ODH66 "" ULONG RB_RBA_Common_CentralElements_CompuMethods_Identical 1 100 0.0 4294967295 FORMAT "%8.2" ECU_ADDRESS 0xfe4190e4 /end MEASUREMENT
/begin MEASUREMENT Tlib_BTGRegRead_GetOctSetting_O_S_ODH66 "" ULONG RB_RBA_Common_CentralElements_CompuMethods_Identical 1 100 0.0 4294967295 FORMAT "%8.2" ECU_ADDRESS 0xfe4190e8 /end MEASUREMENT
/begin MEASUREMENT Tlib_BTGRegRead_GetCurrent_O_S_ODH66 "" ULONG RB_RBA_Common_CentralElements_CompuMethods_Identical 1 100 0.0 4294967295 FORMAT "%8.2" ECU_ADDRESS 0xfe4190ec /end MEASUREMENT
/begin MEASUREMENT Tlib_BTGRegRead_GetI2tSetting_O_S_ODH34 "" ULONG RB_RBA_Common_CentralElements_CompuMethods_Identical 1 100 0.0 4294967295 FORMAT "%8.2" ECU_ADDRESS 0xfe4190f0 /end MEASUREMENT
/begin MEASUREMENT Tlib_BTGRegRead_GetI2tStatus_O_S_ODH34 "" ULONG RB_RBA_Common_CentralElements_CompuMethods_Identical 1 100 0.0 4294967295 FORMAT "%8.2" ECU_ADDRESS 0xfe4190f4 /end MEASUREMENT
/begin MEASUREMENT Tlib_BTGRegRead_GetOctSetting_O_S_ODH34 "" ULONG RB_RBA_Common_CentralElements_CompuMethods_Identical 1 100 0.0 4294967295 FORMAT "%8.2" ECU_ADDRESS 0xfe4190f8 /end MEASUREMENT
/begin MEASUREMENT Tlib_BTGRegRead_GetCurrent_O_S_ODH34 "" ULONG RB_RBA_Common_CentralElements_CompuMethods_Identical 1 100 0.0 4294967295 FORMAT "%8.2" ECU_ADDRESS 0xfe4190fc /end MEASUREMENT
/begin MEASUREMENT Tlib_BTGRegRead_GetI2tSetting_O_S_EFUSE31 "" ULONG RB_RBA_Common_CentralElements_CompuMethods_Identical 1 100 0.0 4294967295 FORMAT "%8.2" ECU_ADDRESS 0xfe419100 /end MEASUREMENT
/begin MEASUREMENT Tlib_BTGRegRead_GetI2tStatus_O_S_EFUSE31 "" ULONG RB_RBA_Common_CentralElements_CompuMethods_Identical 1 100 0.0 4294967295 FORMAT "%8.2" ECU_ADDRESS 0xfe419104 /end MEASUREMENT
/begin MEASUREMENT Tlib_BTGRegRead_GetOctSetting_O_S_EFUSE31 "" ULONG RB_RBA_Common_CentralElements_CompuMethods_Identical 1 100 0.0 4294967295 FORMAT "%8.2" ECU_ADDRESS 0xfe419108 /end MEASUREMENT
/begin MEASUREMENT Tlib_BTGRegRead_GetCurrent_O_S_EFUSE31 "" ULONG RB_RBA_Common_CentralElements_CompuMethods_Identical 1 100 0.0 4294967295 FORMAT "%8.2" ECU_ADDRESS 0xfe41910c /end MEASUREMENT
/begin MEASUREMENT Tlib_BTGRegRead_GetI2tSetting_O_S_ODH30 "" ULONG RB_RBA_Common_CentralElements_CompuMethods_Identical 1 100 0.0 4294967295 FORMAT "%8.2" ECU_ADDRESS 0xfe419110 /end MEASUREMENT
/begin MEASUREMENT Tlib_BTGRegRead_GetI2tStatus_O_S_ODH30 "" ULONG RB_RBA_Common_CentralElements_CompuMethods_Identical 1 100 0.0 4294967295 FORMAT "%8.2" ECU_ADDRESS 0xfe419114 /end MEASUREMENT
/begin MEASUREMENT Tlib_BTGRegRead_GetOctSetting_O_S_ODH30 "" ULONG RB_RBA_Common_CentralElements_CompuMethods_Identical 1 100 0.0 4294967295 FORMAT "%8.2" ECU_ADDRESS 0xfe419118 /end MEASUREMENT
/begin MEASUREMENT Tlib_BTGRegRead_GetCurrent_O_S_ODH30 "" ULONG RB_RBA_Common_CentralElements_CompuMethods_Identical 1 100 0.0 4294967295 FORMAT "%8.2" ECU_ADDRESS 0xfe41911c /end MEASUREMENT
/begin MEASUREMENT Tlib_BTGRegRead_GetI2tSetting_O_S_EFUSE29 "" ULONG RB_RBA_Common_CentralElements_CompuMethods_Identical 1 100 0.0 4294967295 FORMAT "%8.2" ECU_ADDRESS 0xfe419120 /end MEASUREMENT
/begin MEASUREMENT Tlib_BTGRegRead_GetI2tStatus_O_S_EFUSE29 "" ULONG RB_RBA_Common_CentralElements_CompuMethods_Identical 1 100 0.0 4294967295 FORMAT "%8.2" ECU_ADDRESS 0xfe419124 /end MEASUREMENT
/begin MEASUREMENT Tlib_BTGRegRead_GetOctSetting_O_S_EFUSE29 "" ULONG RB_RBA_Common_CentralElements_CompuMethods_Identical 1 100 0.0 4294967295 FORMAT "%8.2" ECU_ADDRESS 0xfe419128 /end MEASUREMENT
/begin MEASUREMENT Tlib_BTGRegRead_GetCurrent_O_S_EFUSE29 "" ULONG RB_RBA_Common_CentralElements_CompuMethods_Identical 1 100 0.0 4294967295 FORMAT "%8.2" ECU_ADDRESS 0xfe41912c /end MEASUREMENT
/begin MEASUREMENT Tlib_BTGRegRead_GetI2tSetting_O_S_ODH100 "" ULONG RB_RBA_Common_CentralElements_CompuMethods_Identical 1 100 0.0 4294967295 FORMAT "%8.2" ECU_ADDRESS 0xfe419130 /end MEASUREMENT
/begin MEASUREMENT Tlib_BTGRegRead_GetI2tStatus_O_S_ODH100 "" ULONG RB_RBA_Common_CentralElements_CompuMethods_Identical 1 100 0.0 4294967295 FORMAT "%8.2" ECU_ADDRESS 0xfe419134 /end MEASUREMENT
/begin MEASUREMENT Tlib_BTGRegRead_GetOctSetting_O_S_ODH100 "" ULONG RB_RBA_Common_CentralElements_CompuMethods_Identical 1 100 0.0 4294967295 FORMAT "%8.2" ECU_ADDRESS 0xfe419138 /end MEASUREMENT
/begin MEASUREMENT Tlib_BTGRegRead_GetCurrent_O_S_ODH100 "" ULONG RB_RBA_Common_CentralElements_CompuMethods_Identical 1 100 0.0 4294967295 FORMAT "%8.2" ECU_ADDRESS 0xfe41913c /end MEASUREMENT
/begin MEASUREMENT Tlib_BTGRegRead_GetI2tSetting_O_S_ODH86 "" ULONG RB_RBA_Common_CentralElements_CompuMethods_Identical 1 100 0.0 4294967295 FORMAT "%8.2" ECU_ADDRESS 0xfe419140 /end MEASUREMENT
/begin MEASUREMENT Tlib_BTGRegRead_GetI2tStatus_O_S_ODH86 "" ULONG RB_RBA_Common_CentralElements_CompuMethods_Identical 1 100 0.0 4294967295 FORMAT "%8.2" ECU_ADDRESS 0xfe419144 /end MEASUREMENT
/begin MEASUREMENT Tlib_BTGRegRead_GetOctSetting_O_S_ODH86 "" ULONG RB_RBA_Common_CentralElements_CompuMethods_Identical 1 100 0.0 4294967295 FORMAT "%8.2" ECU_ADDRESS 0xfe419148 /end MEASUREMENT
/begin MEASUREMENT Tlib_BTGRegRead_GetCurrent_O_S_ODH86 "" ULONG RB_RBA_Common_CentralElements_CompuMethods_Identical 1 100 0.0 4294967295 FORMAT "%8.2" ECU_ADDRESS 0xfe41914c /end MEASUREMENT
/begin MEASUREMENT Tlib_BTGRegRead_GetI2tSetting_O_S_ODH13 "" ULONG RB_RBA_Common_CentralElements_CompuMethods_Identical 1 100 0.0 4294967295 FORMAT "%8.2" ECU_ADDRESS 0xfe419150 /end MEASUREMENT
/begin MEASUREMENT Tlib_BTGRegRead_GetI2tStatus_O_S_ODH13 "" ULONG RB_RBA_Common_CentralElements_CompuMethods_Identical 1 100 0.0 4294967295 FORMAT "%8.2" ECU_ADDRESS 0xfe419154 /end MEASUREMENT
/begin MEASUREMENT Tlib_BTGRegRead_GetOctSetting_O_S_ODH13 "" ULONG RB_RBA_Common_CentralElements_CompuMethods_Identical 1 100 0.0 4294967295 FORMAT "%8.2" ECU_ADDRESS 0xfe419158 /end MEASUREMENT
/begin MEASUREMENT Tlib_BTGRegRead_GetCurrent_O_S_ODH13 "" ULONG RB_RBA_Common_CentralElements_CompuMethods_Identical 1 100 0.0 4294967295 FORMAT "%8.2" ECU_ADDRESS 0xfe41915c /end MEASUREMENT
/begin MEASUREMENT Tlib_BTGRegRead_GetI2tSetting_O_S_5V09 "" ULONG RB_RBA_Common_CentralElements_CompuMethods_Identical 1 100 0.0 4294967295 FORMAT "%8.2" ECU_ADDRESS 0xfe419160 /end MEASUREMENT
/begin MEASUREMENT Tlib_BTGRegRead_GetI2tStatus_O_S_5V09 "" ULONG RB_RBA_Common_CentralElements_CompuMethods_Identical 1 100 0.0 4294967295 FORMAT "%8.2" ECU_ADDRESS 0xfe419164 /end MEASUREMENT
/begin MEASUREMENT Tlib_BTGRegRead_GetOctSetting_O_S_5V09 "" ULONG RB_RBA_Common_CentralElements_CompuMethods_Identical 1 100 0.0 4294967295 FORMAT "%8.2" ECU_ADDRESS 0xfe419168 /end MEASUREMENT
/begin MEASUREMENT Tlib_BTGRegRead_GetCurrent_O_S_5V09 "" ULONG RB_RBA_Common_CentralElements_CompuMethods_Identical 1 100 0.0 4294967295 FORMAT "%8.2" ECU_ADDRESS 0xfe41916c /end MEASUREMENT
/begin MEASUREMENT Tlib_BTGRegRead_GetI2tSetting_O_S_ODH23 "" ULONG RB_RBA_Common_CentralElements_CompuMethods_Identical 1 100 0.0 4294967295 FORMAT "%8.2" ECU_ADDRESS 0xfe419170 /end MEASUREMENT
/begin MEASUREMENT Tlib_BTGRegRead_GetI2tStatus_O_S_ODH23 "" ULONG RB_RBA_Common_CentralElements_CompuMethods_Identical 1 100 0.0 4294967295 FORMAT "%8.2" ECU_ADDRESS 0xfe419174 /end MEASUREMENT
/begin MEASUREMENT Tlib_BTGRegRead_GetOctSetting_O_S_ODH23 "" ULONG RB_RBA_Common_CentralElements_CompuMethods_Identical 1 100 0.0 4294967295 FORMAT "%8.2" ECU_ADDRESS 0xfe419178 /end MEASUREMENT
/begin MEASUREMENT Tlib_BTGRegRead_GetCurrent_O_S_ODH23 "" ULONG RB_RBA_Common_CentralElements_CompuMethods_Identical 1 100 0.0 4294967295 FORMAT "%8.2" ECU_ADDRESS 0xfe41917c /end MEASUREMENT
/begin MEASUREMENT Tlib_BTGRegRead_GetI2tSetting_O_S_EFUSE10 "" ULONG RB_RBA_Common_CentralElements_CompuMethods_Identical 1 100 0.0 4294967295 FORMAT "%8.2" ECU_ADDRESS 0xfe419180 /end MEASUREMENT
/begin MEASUREMENT Tlib_BTGRegRead_GetI2tStatus_O_S_EFUSE10 "" ULONG RB_RBA_Common_CentralElements_CompuMethods_Identical 1 100 0.0 4294967295 FORMAT "%8.2" ECU_ADDRESS 0xfe419184 /end MEASUREMENT
/begin MEASUREMENT Tlib_BTGRegRead_GetOctSetting_O_S_EFUSE10 "" ULONG RB_RBA_Common_CentralElements_CompuMethods_Identical 1 100 0.0 4294967295 FORMAT "%8.2" ECU_ADDRESS 0xfe419188 /end MEASUREMENT
/begin MEASUREMENT Tlib_BTGRegRead_GetCurrent_O_S_EFUSE10 "" ULONG RB_RBA_Common_CentralElements_CompuMethods_Identical 1 100 0.0 4294967295 FORMAT "%8.2" ECU_ADDRESS 0xfe41918c /end MEASUREMENT
/begin MEASUREMENT Tlib_BTGRegRead_GetI2tSetting_O_S_EFUSE18 "" ULONG RB_RBA_Common_CentralElements_CompuMethods_Identical 1 100 0.0 4294967295 FORMAT "%8.2" ECU_ADDRESS 0xfe419190 /end MEASUREMENT
/begin MEASUREMENT Tlib_BTGRegRead_GetI2tStatus_O_S_EFUSE18 "" ULONG RB_RBA_Common_CentralElements_CompuMethods_Identical 1 100 0.0 4294967295 FORMAT "%8.2" ECU_ADDRESS 0xfe419194 /end MEASUREMENT
/begin MEASUREMENT Tlib_BTGRegRead_GetOctSetting_O_S_EFUSE18 "" ULONG RB_RBA_Common_CentralElements_CompuMethods_Identical 1 100 0.0 4294967295 FORMAT "%8.2" ECU_ADDRESS 0xfe419198 /end MEASUREMENT
/begin MEASUREMENT Tlib_BTGRegRead_GetCurrent_O_S_EFUSE18 "" ULONG RB_RBA_Common_CentralElements_CompuMethods_Identical 1 100 0.0 4294967295 FORMAT "%8.2" ECU_ADDRESS 0xfe41919c /end MEASUREMENT
/begin MEASUREMENT Tlib_BTGRegRead_GetI2tSetting_O_S_ODH27 "" ULONG RB_RBA_Common_CentralElements_CompuMethods_Identical 1 100 0.0 4294967295 FORMAT "%8.2" ECU_ADDRESS 0xfe4191a0 /end MEASUREMENT
/begin MEASUREMENT Tlib_BTGRegRead_GetI2tStatus_O_S_ODH27 "" ULONG RB_RBA_Common_CentralElements_CompuMethods_Identical 1 100 0.0 4294967295 FORMAT "%8.2" ECU_ADDRESS 0xfe4191a4 /end MEASUREMENT
/begin MEASUREMENT Tlib_BTGRegRead_GetOctSetting_O_S_ODH27 "" ULONG RB_RBA_Common_CentralElements_CompuMethods_Identical 1 100 0.0 4294967295 FORMAT "%8.2" ECU_ADDRESS 0xfe4191a8 /end MEASUREMENT
/begin MEASUREMENT Tlib_BTGRegRead_GetCurrent_O_S_ODH27 "" ULONG RB_RBA_Common_CentralElements_CompuMethods_Identical 1 100 0.0 4294967295 FORMAT "%8.2" ECU_ADDRESS 0xfe4191ac /end MEASUREMENT
/begin MEASUREMENT Tlib_BTGRegRead_GetI2tSetting_O_S_ODH20 "" ULONG RB_RBA_Common_CentralElements_CompuMethods_Identical 1 100 0.0 4294967295 FORMAT "%8.2" ECU_ADDRESS 0xfe4191b0 /end MEASUREMENT
/begin MEASUREMENT Tlib_BTGRegRead_GetI2tStatus_O_S_ODH20 "" ULONG RB_RBA_Common_CentralElements_CompuMethods_Identical 1 100 0.0 4294967295 FORMAT "%8.2" ECU_ADDRESS 0xfe4191b4 /end MEASUREMENT
/begin MEASUREMENT Tlib_BTGRegRead_GetOctSetting_O_S_ODH20 "" ULONG RB_RBA_Common_CentralElements_CompuMethods_Identical 1 100 0.0 4294967295 FORMAT "%8.2" ECU_ADDRESS 0xfe4191b8 /end MEASUREMENT
/begin MEASUREMENT Tlib_BTGRegRead_GetCurrent_O_S_ODH20 "" ULONG RB_RBA_Common_CentralElements_CompuMethods_Identical 1 100 0.0 4294967295 FORMAT "%8.2" ECU_ADDRESS 0xfe4191bc /end MEASUREMENT
/begin MEASUREMENT Tlib_BTGRegRead_GetI2tSetting_O_S_ODH56 "" ULONG RB_RBA_Common_CentralElements_CompuMethods_Identical 1 100 0.0 4294967295 FORMAT "%8.2" ECU_ADDRESS 0xfe4191c0 /end MEASUREMENT
/begin MEASUREMENT Tlib_BTGRegRead_GetI2tStatus_O_S_ODH56 "" ULONG RB_RBA_Common_CentralElements_CompuMethods_Identical 1 100 0.0 4294967295 FORMAT "%8.2" ECU_ADDRESS 0xfe4191c4 /end MEASUREMENT
/begin MEASUREMENT Tlib_BTGRegRead_GetOctSetting_O_S_ODH56 "" ULONG RB_RBA_Common_CentralElements_CompuMethods_Identical 1 100 0.0 4294967295 FORMAT "%8.2" ECU_ADDRESS 0xfe4191c8 /end MEASUREMENT
/begin MEASUREMENT Tlib_BTGRegRead_GetCurrent_O_S_ODH56 "" ULONG RB_RBA_Common_CentralElements_CompuMethods_Identical 1 100 0.0 4294967295 FORMAT "%8.2" ECU_ADDRESS 0xfe4191cc /end MEASUREMENT
/begin MEASUREMENT Tlib_BTGRegRead_GetI2tSetting_O_S_ODH98 "" ULONG RB_RBA_Common_CentralElements_CompuMethods_Identical 1 100 0.0 4294967295 FORMAT "%8.2" ECU_ADDRESS 0xfe4191d0 /end MEASUREMENT
/begin MEASUREMENT Tlib_BTGRegRead_GetI2tStatus_O_S_ODH98 "" ULONG RB_RBA_Common_CentralElements_CompuMethods_Identical 1 100 0.0 4294967295 FORMAT "%8.2" ECU_ADDRESS 0xfe4191d4 /end MEASUREMENT
/begin MEASUREMENT Tlib_BTGRegRead_GetOctSetting_O_S_ODH98 "" ULONG RB_RBA_Common_CentralElements_CompuMethods_Identical 1 100 0.0 4294967295 FORMAT "%8.2" ECU_ADDRESS 0xfe4191d8 /end MEASUREMENT
/begin MEASUREMENT Tlib_BTGRegRead_GetCurrent_O_S_ODH98 "" ULONG RB_RBA_Common_CentralElements_CompuMethods_Identical 1 100 0.0 4294967295 FORMAT "%8.2" ECU_ADDRESS 0xfe4191dc /end MEASUREMENT
/begin MEASUREMENT Tlib_BTGRegRead_GetI2tSetting_O_S_ODH82 "" ULONG RB_RBA_Common_CentralElements_CompuMethods_Identical 1 100 0.0 4294967295 FORMAT "%8.2" ECU_ADDRESS 0xfe4191e0 /end MEASUREMENT
/begin MEASUREMENT Tlib_BTGRegRead_GetI2tStatus_O_S_ODH82 "" ULONG RB_RBA_Common_CentralElements_CompuMethods_Identical 1 100 0.0 4294967295 FORMAT "%8.2" ECU_ADDRESS 0xfe4191e4 /end MEASUREMENT
/begin MEASUREMENT Tlib_BTGRegRead_GetOctSetting_O_S_ODH82 "" ULONG RB_RBA_Common_CentralElements_CompuMethods_Identical 1 100 0.0 4294967295 FORMAT "%8.2" ECU_ADDRESS 0xfe4191e8 /end MEASUREMENT
/begin MEASUREMENT Tlib_BTGRegRead_GetCurrent_O_S_ODH82 "" ULONG RB_RBA_Common_CentralElements_CompuMethods_Identical 1 100 0.0 4294967295 FORMAT "%8.2" ECU_ADDRESS 0xfe4191ec /end MEASUREMENT
/begin MEASUREMENT Tlib_BTGRegRead_GetI2tSetting_O_S_EFUSE23 "" ULONG RB_RBA_Common_CentralElements_CompuMethods_Identical 1 100 0.0 4294967295 FORMAT "%8.2" ECU_ADDRESS 0xfe4191f0 /end MEASUREMENT
/begin MEASUREMENT Tlib_BTGRegRead_GetI2tStatus_O_S_EFUSE23 "" ULONG RB_RBA_Common_CentralElements_CompuMethods_Identical 1 100 0.0 4294967295 FORMAT "%8.2" ECU_ADDRESS 0xfe4191f4 /end MEASUREMENT
/begin MEASUREMENT Tlib_BTGRegRead_GetOctSetting_O_S_EFUSE23 "" ULONG RB_RBA_Common_CentralElements_CompuMethods_Identical 1 100 0.0 4294967295 FORMAT "%8.2" ECU_ADDRESS 0xfe4191f8 /end MEASUREMENT
/begin MEASUREMENT Tlib_BTGRegRead_GetCurrent_O_S_EFUSE23 "" ULONG RB_RBA_Common_CentralElements_CompuMethods_Identical 1 100 0.0 4294967295 FORMAT "%8.2" ECU_ADDRESS 0xfe4191fc /end MEASUREMENT
/begin MEASUREMENT Tlib_BTGRegRead_GetI2tSetting_O_S_EFUSE24 "" ULONG RB_RBA_Common_CentralElements_CompuMethods_Identical 1 100 0.0 4294967295 FORMAT "%8.2" ECU_ADDRESS 0xfe419200 /end MEASUREMENT
/begin MEASUREMENT Tlib_BTGRegRead_GetI2tStatus_O_S_EFUSE24 "" ULONG RB_RBA_Common_CentralElements_CompuMethods_Identical 1 100 0.0 4294967295 FORMAT "%8.2" ECU_ADDRESS 0xfe419204 /end MEASUREMENT
/begin MEASUREMENT Tlib_BTGRegRead_GetOctSetting_O_S_EFUSE24 "" ULONG RB_RBA_Common_CentralElements_CompuMethods_Identical 1 100 0.0 4294967295 FORMAT "%8.2" ECU_ADDRESS 0xfe419208 /end MEASUREMENT
/begin MEASUREMENT Tlib_BTGRegRead_GetCurrent_O_S_EFUSE24 "" ULONG RB_RBA_Common_CentralElements_CompuMethods_Identical 1 100 0.0 4294967295 FORMAT "%8.2" ECU_ADDRESS 0xfe41920c /end MEASUREMENT
/begin MEASUREMENT Tlib_BTGRegRead_GetI2tSetting_O_S_ODH53 "" ULONG RB_RBA_Common_CentralElements_CompuMethods_Identical 1 100 0.0 4294967295 FORMAT "%8.2" ECU_ADDRESS 0xfe419210 /end MEASUREMENT
/begin MEASUREMENT Tlib_BTGRegRead_GetI2tStatus_O_S_ODH53 "" ULONG RB_RBA_Common_CentralElements_CompuMethods_Identical 1 100 0.0 4294967295 FORMAT "%8.2" ECU_ADDRESS 0xfe419214 /end MEASUREMENT
/begin MEASUREMENT Tlib_BTGRegRead_GetOctSetting_O_S_ODH53 "" ULONG RB_RBA_Common_CentralElements_CompuMethods_Identical 1 100 0.0 4294967295 FORMAT "%8.2" ECU_ADDRESS 0xfe419218 /end MEASUREMENT
/begin MEASUREMENT Tlib_BTGRegRead_GetCurrent_O_S_ODH53 "" ULONG RB_RBA_Common_CentralElements_CompuMethods_Identical 1 100 0.0 4294967295 FORMAT "%8.2" ECU_ADDRESS 0xfe41921c /end MEASUREMENT
/begin MEASUREMENT Tlib_BTGRegRead_GetI2tSetting_O_S_ODH76 "" ULONG RB_RBA_Common_CentralElements_CompuMethods_Identical 1 100 0.0 4294967295 FORMAT "%8.2" ECU_ADDRESS 0xfe419220 /end MEASUREMENT
/begin MEASUREMENT Tlib_BTGRegRead_GetI2tStatus_O_S_ODH76 "" ULONG RB_RBA_Common_CentralElements_CompuMethods_Identical 1 100 0.0 4294967295 FORMAT "%8.2" ECU_ADDRESS 0xfe419224 /end MEASUREMENT
/begin MEASUREMENT Tlib_BTGRegRead_GetOctSetting_O_S_ODH76 "" ULONG RB_RBA_Common_CentralElements_CompuMethods_Identical 1 100 0.0 4294967295 FORMAT "%8.2" ECU_ADDRESS 0xfe419228 /end MEASUREMENT
/begin MEASUREMENT Tlib_BTGRegRead_GetCurrent_O_S_ODH76 "" ULONG RB_RBA_Common_CentralElements_CompuMethods_Identical 1 100 0.0 4294967295 FORMAT "%8.2" ECU_ADDRESS 0xfe41922c /end MEASUREMENT
/begin MEASUREMENT Tlib_BTGRegRead_GetI2tSetting_O_S_ODH65 "" ULONG RB_RBA_Common_CentralElements_CompuMethods_Identical 1 100 0.0 4294967295 FORMAT "%8.2" ECU_ADDRESS 0xfe419230 /end MEASUREMENT
/begin MEASUREMENT Tlib_BTGRegRead_GetI2tStatus_O_S_ODH65 "" ULONG RB_RBA_Common_CentralElements_CompuMethods_Identical 1 100 0.0 4294967295 FORMAT "%8.2" ECU_ADDRESS 0xfe419234 /end MEASUREMENT
/begin MEASUREMENT Tlib_BTGRegRead_GetOctSetting_O_S_ODH65 "" ULONG RB_RBA_Common_CentralElements_CompuMethods_Identical 1 100 0.0 4294967295 FORMAT "%8.2" ECU_ADDRESS 0xfe419238 /end MEASUREMENT
/begin MEASUREMENT Tlib_BTGRegRead_GetCurrent_O_S_ODH65 "" ULONG RB_RBA_Common_CentralElements_CompuMethods_Identical 1 100 0.0 4294967295 FORMAT "%8.2" ECU_ADDRESS 0xfe41923c /end MEASUREMENT
/begin MEASUREMENT Tlib_BTGRegRead_GetI2tSetting_O_S_ODH83 "" ULONG RB_RBA_Common_CentralElements_CompuMethods_Identical 1 100 0.0 4294967295 FORMAT "%8.2" ECU_ADDRESS 0xfe419240 /end MEASUREMENT
/begin MEASUREMENT Tlib_BTGRegRead_GetI2tStatus_O_S_ODH83 "" ULONG RB_RBA_Common_CentralElements_CompuMethods_Identical 1 100 0.0 4294967295 FORMAT "%8.2" ECU_ADDRESS 0xfe419244 /end MEASUREMENT
/begin MEASUREMENT Tlib_BTGRegRead_GetOctSetting_O_S_ODH83 "" ULONG RB_RBA_Common_CentralElements_CompuMethods_Identical 1 100 0.0 4294967295 FORMAT "%8.2" ECU_ADDRESS 0xfe419248 /end MEASUREMENT
/begin MEASUREMENT Tlib_BTGRegRead_GetCurrent_O_S_ODH83 "" ULONG RB_RBA_Common_CentralElements_CompuMethods_Identical 1 100 0.0 4294967295 FORMAT "%8.2" ECU_ADDRESS 0xfe41924c /end MEASUREMENT
/begin MEASUREMENT Tlib_BTGRegRead_GetI2tSetting_O_S_ODH54 "" ULONG RB_RBA_Common_CentralElements_CompuMethods_Identical 1 100 0.0 4294967295 FORMAT "%8.2" ECU_ADDRESS 0xfe419250 /end MEASUREMENT
/begin MEASUREMENT Tlib_BTGRegRead_GetI2tStatus_O_S_ODH54 "" ULONG RB_RBA_Common_CentralElements_CompuMethods_Identical 1 100 0.0 4294967295 FORMAT "%8.2" ECU_ADDRESS 0xfe419254 /end MEASUREMENT
/begin MEASUREMENT Tlib_BTGRegRead_GetOctSetting_O_S_ODH54 "" ULONG RB_RBA_Common_CentralElements_CompuMethods_Identical 1 100 0.0 4294967295 FORMAT "%8.2" ECU_ADDRESS 0xfe419258 /end MEASUREMENT
/begin MEASUREMENT Tlib_BTGRegRead_GetCurrent_O_S_ODH54 "" ULONG RB_RBA_Common_CentralElements_CompuMethods_Identical 1 100 0.0 4294967295 FORMAT "%8.2" ECU_ADDRESS 0xfe41925c /end MEASUREMENT
/begin MEASUREMENT Tlib_BTGRegRead_GetI2tSetting_O_S_ODH42 "" ULONG RB_RBA_Common_CentralElements_CompuMethods_Identical 1 100 0.0 4294967295 FORMAT "%8.2" ECU_ADDRESS 0xfe419260 /end MEASUREMENT
/begin MEASUREMENT Tlib_BTGRegRead_GetI2tStatus_O_S_ODH42 "" ULONG RB_RBA_Common_CentralElements_CompuMethods_Identical 1 100 0.0 4294967295 FORMAT "%8.2" ECU_ADDRESS 0xfe419264 /end MEASUREMENT
/begin MEASUREMENT Tlib_BTGRegRead_GetOctSetting_O_S_ODH42 "" ULONG RB_RBA_Common_CentralElements_CompuMethods_Identical 1 100 0.0 4294967295 FORMAT "%8.2" ECU_ADDRESS 0xfe419268 /end MEASUREMENT
/begin MEASUREMENT Tlib_BTGRegRead_GetCurrent_O_S_ODH42 "" ULONG RB_RBA_Common_CentralElements_CompuMethods_Identical 1 100 0.0 4294967295 FORMAT "%8.2" ECU_ADDRESS 0xfe41926c /end MEASUREMENT
/begin MEASUREMENT Tlib_BTGRegRead_GetI2tSetting_O_S_ODH80 "" ULONG RB_RBA_Common_CentralElements_CompuMethods_Identical 1 100 0.0 4294967295 FORMAT "%8.2" ECU_ADDRESS 0xfe419270 /end MEASUREMENT
/begin MEASUREMENT Tlib_BTGRegRead_GetI2tStatus_O_S_ODH80 "" ULONG RB_RBA_Common_CentralElements_CompuMethods_Identical 1 100 0.0 4294967295 FORMAT "%8.2" ECU_ADDRESS 0xfe419274 /end MEASUREMENT
/begin MEASUREMENT Tlib_BTGRegRead_GetOctSetting_O_S_ODH80 "" ULONG RB_RBA_Common_CentralElements_CompuMethods_Identical 1 100 0.0 4294967295 FORMAT "%8.2" ECU_ADDRESS 0xfe419278 /end MEASUREMENT
/begin MEASUREMENT Tlib_BTGRegRead_GetCurrent_O_S_ODH80 "" ULONG RB_RBA_Common_CentralElements_CompuMethods_Identical 1 100 0.0 4294967295 FORMAT "%8.2" ECU_ADDRESS 0xfe41927c /end MEASUREMENT
/begin MEASUREMENT Tlib_BTGRegRead_GetI2tSetting_O_S_ODH81 "" ULONG RB_RBA_Common_CentralElements_CompuMethods_Identical 1 100 0.0 4294967295 FORMAT "%8.2" ECU_ADDRESS 0xfe419280 /end MEASUREMENT
/begin MEASUREMENT Tlib_BTGRegRead_GetI2tStatus_O_S_ODH81 "" ULONG RB_RBA_Common_CentralElements_CompuMethods_Identical 1 100 0.0 4294967295 FORMAT "%8.2" ECU_ADDRESS 0xfe419284 /end MEASUREMENT
/begin MEASUREMENT Tlib_BTGRegRead_GetOctSetting_O_S_ODH81 "" ULONG RB_RBA_Common_CentralElements_CompuMethods_Identical 1 100 0.0 4294967295 FORMAT "%8.2" ECU_ADDRESS 0xfe419288 /end MEASUREMENT
/begin MEASUREMENT Tlib_BTGRegRead_GetCurrent_O_S_ODH81 "" ULONG RB_RBA_Common_CentralElements_CompuMethods_Identical 1 100 0.0 4294967295 FORMAT "%8.2" ECU_ADDRESS 0xfe41928c /end MEASUREMENT
/begin MEASUREMENT Tlib_BTGRegRead_GetI2tSetting_O_S_EFUSE25 "" ULONG RB_RBA_Common_CentralElements_CompuMethods_Identical 1 100 0.0 4294967295 FORMAT "%8.2" ECU_ADDRESS 0xfe419290 /end MEASUREMENT
/begin MEASUREMENT Tlib_BTGRegRead_GetI2tStatus_O_S_EFUSE25 "" ULONG RB_RBA_Common_CentralElements_CompuMethods_Identical 1 100 0.0 4294967295 FORMAT "%8.2" ECU_ADDRESS 0xfe419294 /end MEASUREMENT
/begin MEASUREMENT Tlib_BTGRegRead_GetOctSetting_O_S_EFUSE25 "" ULONG RB_RBA_Common_CentralElements_CompuMethods_Identical 1 100 0.0 4294967295 FORMAT "%8.2" ECU_ADDRESS 0xfe419298 /end MEASUREMENT
/begin MEASUREMENT Tlib_BTGRegRead_GetCurrent_O_S_EFUSE25 "" ULONG RB_RBA_Common_CentralElements_CompuMethods_Identical 1 100 0.0 4294967295 FORMAT "%8.2" ECU_ADDRESS 0xfe41929c /end MEASUREMENT
/begin MEASUREMENT Tlib_BTGRegRead_GetI2tSetting_O_S_ODH79 "" ULONG RB_RBA_Common_CentralElements_CompuMethods_Identical 1 100 0.0 4294967295 FORMAT "%8.2" ECU_ADDRESS 0xfe4192a0 /end MEASUREMENT
/begin MEASUREMENT Tlib_BTGRegRead_GetI2tStatus_O_S_ODH79 "" ULONG RB_RBA_Common_CentralElements_CompuMethods_Identical 1 100 0.0 4294967295 FORMAT "%8.2" ECU_ADDRESS 0xfe4192a4 /end MEASUREMENT
/begin MEASUREMENT Tlib_BTGRegRead_GetOctSetting_O_S_ODH79 "" ULONG RB_RBA_Common_CentralElements_CompuMethods_Identical 1 100 0.0 4294967295 FORMAT "%8.2" ECU_ADDRESS 0xfe4192a8 /end MEASUREMENT
/begin MEASUREMENT Tlib_BTGRegRead_GetCurrent_O_S_ODH79 "" ULONG RB_RBA_Common_CentralElements_CompuMethods_Identical 1 100 0.0 4294967295 FORMAT "%8.2" ECU_ADDRESS 0xfe4192ac /end MEASUREMENT
/begin MEASUREMENT Tlib_BTGRegRead_GetI2tSetting_O_S_ODH78 "" ULONG RB_RBA_Common_CentralElements_CompuMethods_Identical 1 100 0.0 4294967295 FORMAT "%8.2" ECU_ADDRESS 0xfe4192b0 /end MEASUREMENT
/begin MEASUREMENT Tlib_BTGRegRead_GetI2tStatus_O_S_ODH78 "" ULONG RB_RBA_Common_CentralElements_CompuMethods_Identical 1 100 0.0 4294967295 FORMAT "%8.2" ECU_ADDRESS 0xfe4192b4 /end MEASUREMENT
/begin MEASUREMENT Tlib_BTGRegRead_GetOctSetting_O_S_ODH78 "" ULONG RB_RBA_Common_CentralElements_CompuMethods_Identical 1 100 0.0 4294967295 FORMAT "%8.2" ECU_ADDRESS 0xfe4192b8 /end MEASUREMENT
/begin MEASUREMENT Tlib_BTGRegRead_GetCurrent_O_S_ODH78 "" ULONG RB_RBA_Common_CentralElements_CompuMethods_Identical 1 100 0.0 4294967295 FORMAT "%8.2" ECU_ADDRESS 0xfe4192bc /end MEASUREMENT
/begin MEASUREMENT Tlib_BTGRegRead_GetI2tSetting_O_S_ODH74 "" ULONG RB_RBA_Common_CentralElements_CompuMethods_Identical 1 100 0.0 4294967295 FORMAT "%8.2" ECU_ADDRESS 0xfe4192c0 /end MEASUREMENT
/begin MEASUREMENT Tlib_BTGRegRead_GetI2tStatus_O_S_ODH74 "" ULONG RB_RBA_Common_CentralElements_CompuMethods_Identical 1 100 0.0 4294967295 FORMAT "%8.2" ECU_ADDRESS 0xfe4192c4 /end MEASUREMENT
/begin MEASUREMENT Tlib_BTGRegRead_GetOctSetting_O_S_ODH74 "" ULONG RB_RBA_Common_CentralElements_CompuMethods_Identical 1 100 0.0 4294967295 FORMAT "%8.2" ECU_ADDRESS 0xfe4192c8 /end MEASUREMENT
/begin MEASUREMENT Tlib_BTGRegRead_GetCurrent_O_S_ODH74 "" ULONG RB_RBA_Common_CentralElements_CompuMethods_Identical 1 100 0.0 4294967295 FORMAT "%8.2" ECU_ADDRESS 0xfe4192cc /end MEASUREMENT
/begin MEASUREMENT Tlib_BTGRegRead_GetI2tSetting_O_S_EFUSE26 "" ULONG RB_RBA_Common_CentralElements_CompuMethods_Identical 1 100 0.0 4294967295 FORMAT "%8.2" ECU_ADDRESS 0xfe4192d0 /end MEASUREMENT
/begin MEASUREMENT Tlib_BTGRegRead_GetI2tStatus_O_S_EFUSE26 "" ULONG RB_RBA_Common_CentralElements_CompuMethods_Identical 1 100 0.0 4294967295 FORMAT "%8.2" ECU_ADDRESS 0xfe4192d4 /end MEASUREMENT
/begin MEASUREMENT Tlib_BTGRegRead_GetOctSetting_O_S_EFUSE26 "" ULONG RB_RBA_Common_CentralElements_CompuMethods_Identical 1 100 0.0 4294967295 FORMAT "%8.2" ECU_ADDRESS 0xfe4192d8 /end MEASUREMENT
/begin MEASUREMENT Tlib_BTGRegRead_GetCurrent_O_S_EFUSE26 "" ULONG RB_RBA_Common_CentralElements_CompuMethods_Identical 1 100 0.0 4294967295 FORMAT "%8.2" ECU_ADDRESS 0xfe4192dc /end MEASUREMENT
/begin MEASUREMENT Tlib_BTGRegRead_GetI2tSetting_O_S_EFUSE28 "" ULONG RB_RBA_Common_CentralElements_CompuMethods_Identical 1 100 0.0 4294967295 FORMAT "%8.2" ECU_ADDRESS 0xfe4192e0 /end MEASUREMENT
/begin MEASUREMENT Tlib_BTGRegRead_GetI2tStatus_O_S_EFUSE28 "" ULONG RB_RBA_Common_CentralElements_CompuMethods_Identical 1 100 0.0 4294967295 FORMAT "%8.2" ECU_ADDRESS 0xfe4192e4 /end MEASUREMENT
/begin MEASUREMENT Tlib_BTGRegRead_GetOctSetting_O_S_EFUSE28 "" ULONG RB_RBA_Common_CentralElements_CompuMethods_Identical 1 100 0.0 4294967295 FORMAT "%8.2" ECU_ADDRESS 0xfe4192e8 /end MEASUREMENT
/begin MEASUREMENT Tlib_BTGRegRead_GetCurrent_O_S_EFUSE28 "" ULONG RB_RBA_Common_CentralElements_CompuMethods_Identical 1 100 0.0 4294967295 FORMAT "%8.2" ECU_ADDRESS 0xfe4192ec /end MEASUREMENT
/begin MEASUREMENT Tlib_BTGRegRead_GetI2tSetting_O_S_ODH33 "" ULONG RB_RBA_Common_CentralElements_CompuMethods_Identical 1 100 0.0 4294967295 FORMAT "%8.2" ECU_ADDRESS 0xfe4192f0 /end MEASUREMENT
/begin MEASUREMENT Tlib_BTGRegRead_GetI2tStatus_O_S_ODH33 "" ULONG RB_RBA_Common_CentralElements_CompuMethods_Identical 1 100 0.0 4294967295 FORMAT "%8.2" ECU_ADDRESS 0xfe4192f4 /end MEASUREMENT
/begin MEASUREMENT Tlib_BTGRegRead_GetOctSetting_O_S_ODH33 "" ULONG RB_RBA_Common_CentralElements_CompuMethods_Identical 1 100 0.0 4294967295 FORMAT "%8.2" ECU_ADDRESS 0xfe4192f8 /end MEASUREMENT
/begin MEASUREMENT Tlib_BTGRegRead_GetCurrent_O_S_ODH33 "" ULONG RB_RBA_Common_CentralElements_CompuMethods_Identical 1 100 0.0 4294967295 FORMAT "%8.2" ECU_ADDRESS 0xfe4192fc /end MEASUREMENT
/begin MEASUREMENT Tlib_BTGRegRead_GetI2tSetting_O_S_ODH73 "" ULONG RB_RBA_Common_CentralElements_CompuMethods_Identical 1 100 0.0 4294967295 FORMAT "%8.2" ECU_ADDRESS 0xfe419300 /end MEASUREMENT
/begin MEASUREMENT Tlib_BTGRegRead_GetI2tStatus_O_S_ODH73 "" ULONG RB_RBA_Common_CentralElements_CompuMethods_Identical 1 100 0.0 4294967295 FORMAT "%8.2" ECU_ADDRESS 0xfe419304 /end MEASUREMENT
/begin MEASUREMENT Tlib_BTGRegRead_GetOctSetting_O_S_ODH73 "" ULONG RB_RBA_Common_CentralElements_CompuMethods_Identical 1 100 0.0 4294967295 FORMAT "%8.2" ECU_ADDRESS 0xfe419308 /end MEASUREMENT
/begin MEASUREMENT Tlib_BTGRegRead_GetCurrent_O_S_ODH73 "" ULONG RB_RBA_Common_CentralElements_CompuMethods_Identical 1 100 0.0 4294967295 FORMAT "%8.2" ECU_ADDRESS 0xfe41930c /end MEASUREMENT
/begin MEASUREMENT Tlib_BTGRegRead_GetI2tSetting_O_S_ODH18 "" ULONG RB_RBA_Common_CentralElements_CompuMethods_Identical 1 100 0.0 4294967295 FORMAT "%8.2" ECU_ADDRESS 0xfe419310 /end MEASUREMENT
/begin MEASUREMENT Tlib_BTGRegRead_GetI2tStatus_O_S_ODH18 "" ULONG RB_RBA_Common_CentralElements_CompuMethods_Identical 1 100 0.0 4294967295 FORMAT "%8.2" ECU_ADDRESS 0xfe419314 /end MEASUREMENT
/begin MEASUREMENT Tlib_BTGRegRead_GetOctSetting_O_S_ODH18 "" ULONG RB_RBA_Common_CentralElements_CompuMethods_Identical 1 100 0.0 4294967295 FORMAT "%8.2" ECU_ADDRESS 0xfe419318 /end MEASUREMENT
/begin MEASUREMENT Tlib_BTGRegRead_GetCurrent_O_S_ODH18 "" ULONG RB_RBA_Common_CentralElements_CompuMethods_Identical 1 100 0.0 4294967295 FORMAT "%8.2" ECU_ADDRESS 0xfe41931c /end MEASUREMENT
/begin MEASUREMENT Tlib_BTGRegRead_GetI2tSetting_O_S_ODH77 "" ULONG RB_RBA_Common_CentralElements_CompuMethods_Identical 1 100 0.0 4294967295 FORMAT "%8.2" ECU_ADDRESS 0xfe419320 /end MEASUREMENT
/begin MEASUREMENT Tlib_BTGRegRead_GetI2tStatus_O_S_ODH77 "" ULONG RB_RBA_Common_CentralElements_CompuMethods_Identical 1 100 0.0 4294967295 FORMAT "%8.2" ECU_ADDRESS 0xfe419324 /end MEASUREMENT
/begin MEASUREMENT Tlib_BTGRegRead_GetOctSetting_O_S_ODH77 "" ULONG RB_RBA_Common_CentralElements_CompuMethods_Identical 1 100 0.0 4294967295 FORMAT "%8.2" ECU_ADDRESS 0xfe419328 /end MEASUREMENT
/begin MEASUREMENT Tlib_BTGRegRead_GetCurrent_O_S_ODH77 "" ULONG RB_RBA_Common_CentralElements_CompuMethods_Identical 1 100 0.0 4294967295 FORMAT "%8.2" ECU_ADDRESS 0xfe41932c /end MEASUREMENT
/begin MEASUREMENT Tlib_BTGRegRead_GetI2tSetting_O_S_ODH61 "" ULONG RB_RBA_Common_CentralElements_CompuMethods_Identical 1 100 0.0 4294967295 FORMAT "%8.2" ECU_ADDRESS 0xfe419330 /end MEASUREMENT
/begin MEASUREMENT Tlib_BTGRegRead_GetI2tStatus_O_S_ODH61 "" ULONG RB_RBA_Common_CentralElements_CompuMethods_Identical 1 100 0.0 4294967295 FORMAT "%8.2" ECU_ADDRESS 0xfe419334 /end MEASUREMENT
/begin MEASUREMENT Tlib_BTGRegRead_GetOctSetting_O_S_ODH61 "" ULONG RB_RBA_Common_CentralElements_CompuMethods_Identical 1 100 0.0 4294967295 FORMAT "%8.2" ECU_ADDRESS 0xfe419338 /end MEASUREMENT
/begin MEASUREMENT Tlib_BTGRegRead_GetCurrent_O_S_ODH61 "" ULONG RB_RBA_Common_CentralElements_CompuMethods_Identical 1 100 0.0 4294967295 FORMAT "%8.2" ECU_ADDRESS 0xfe41933c /end MEASUREMENT
/begin MEASUREMENT Tlib_BTGRegRead_GetI2tSetting_O_S_ODH62 "" ULONG RB_RBA_Common_CentralElements_CompuMethods_Identical 1 100 0.0 4294967295 FORMAT "%8.2" ECU_ADDRESS 0xfe419340 /end MEASUREMENT
/begin MEASUREMENT Tlib_BTGRegRead_GetI2tStatus_O_S_ODH62 "" ULONG RB_RBA_Common_CentralElements_CompuMethods_Identical 1 100 0.0 4294967295 FORMAT "%8.2" ECU_ADDRESS 0xfe419344 /end MEASUREMENT
/begin MEASUREMENT Tlib_BTGRegRead_GetOctSetting_O_S_ODH62 "" ULONG RB_RBA_Common_CentralElements_CompuMethods_Identical 1 100 0.0 4294967295 FORMAT "%8.2" ECU_ADDRESS 0xfe419348 /end MEASUREMENT
/begin MEASUREMENT Tlib_BTGRegRead_GetCurrent_O_S_ODH62 "" ULONG RB_RBA_Common_CentralElements_CompuMethods_Identical 1 100 0.0 4294967295 FORMAT "%8.2" ECU_ADDRESS 0xfe41934c /end MEASUREMENT
/begin MEASUREMENT Tlib_BTGRegRead_GetI2tSetting_O_S_ODH63 "" ULONG RB_RBA_Common_CentralElements_CompuMethods_Identical 1 100 0.0 4294967295 FORMAT "%8.2" ECU_ADDRESS 0xfe419350 /end MEASUREMENT
/begin MEASUREMENT Tlib_BTGRegRead_GetI2tStatus_O_S_ODH63 "" ULONG RB_RBA_Common_CentralElements_CompuMethods_Identical 1 100 0.0 4294967295 FORMAT "%8.2" ECU_ADDRESS 0xfe419354 /end MEASUREMENT
/begin MEASUREMENT Tlib_BTGRegRead_GetOctSetting_O_S_ODH63 "" ULONG RB_RBA_Common_CentralElements_CompuMethods_Identical 1 100 0.0 4294967295 FORMAT "%8.2" ECU_ADDRESS 0xfe419358 /end MEASUREMENT
/begin MEASUREMENT Tlib_BTGRegRead_GetCurrent_O_S_ODH63 "" ULONG RB_RBA_Common_CentralElements_CompuMethods_Identical 1 100 0.0 4294967295 FORMAT "%8.2" ECU_ADDRESS 0xfe41935c /end MEASUREMENT
/begin MEASUREMENT Tlib_BTGRegRead_GetI2tSetting_O_S_ODH64 "" ULONG RB_RBA_Common_CentralElements_CompuMethods_Identical 1 100 0.0 4294967295 FORMAT "%8.2" ECU_ADDRESS 0xfe419360 /end MEASUREMENT
/begin MEASUREMENT Tlib_BTGRegRead_GetI2tStatus_O_S_ODH64 "" ULONG RB_RBA_Common_CentralElements_CompuMethods_Identical 1 100 0.0 4294967295 FORMAT "%8.2" ECU_ADDRESS 0xfe419364 /end MEASUREMENT
/begin MEASUREMENT Tlib_BTGRegRead_GetOctSetting_O_S_ODH64 "" ULONG RB_RBA_Common_CentralElements_CompuMethods_Identical 1 100 0.0 4294967295 FORMAT "%8.2" ECU_ADDRESS 0xfe419368 /end MEASUREMENT
/begin MEASUREMENT Tlib_BTGRegRead_GetCurrent_O_S_ODH64 "" ULONG RB_RBA_Common_CentralElements_CompuMethods_Identical 1 100 0.0 4294967295 FORMAT "%8.2" ECU_ADDRESS 0xfe41936c /end MEASUREMENT
/begin MEASUREMENT Tlib_BTGRegRead_GetI2tSetting_O_S_ODH106 "" ULONG RB_RBA_Common_CentralElements_CompuMethods_Identical 1 100 0.0 4294967295 FORMAT "%8.2" ECU_ADDRESS 0xfe419370 /end MEASUREMENT
/begin MEASUREMENT Tlib_BTGRegRead_GetI2tStatus_O_S_ODH106 "" ULONG RB_RBA_Common_CentralElements_CompuMethods_Identical 1 100 0.0 4294967295 FORMAT "%8.2" ECU_ADDRESS 0xfe419374 /end MEASUREMENT
/begin MEASUREMENT Tlib_BTGRegRead_GetOctSetting_O_S_ODH106 "" ULONG RB_RBA_Common_CentralElements_CompuMethods_Identical 1 100 0.0 4294967295 FORMAT "%8.2" ECU_ADDRESS 0xfe419378 /end MEASUREMENT
/begin MEASUREMENT Tlib_BTGRegRead_GetCurrent_O_S_ODH106 "" ULONG RB_RBA_Common_CentralElements_CompuMethods_Identical 1 100 0.0 4294967295 FORMAT "%8.2" ECU_ADDRESS 0xfe41937c /end MEASUREMENT
/begin MEASUREMENT Tlib_BTGRegRead_GetI2tSetting_O_S_ODH40 "" ULONG RB_RBA_Common_CentralElements_CompuMethods_Identical 1 100 0.0 4294967295 FORMAT "%8.2" ECU_ADDRESS 0xfe419380 /end MEASUREMENT
/begin MEASUREMENT Tlib_BTGRegRead_GetI2tStatus_O_S_ODH40 "" ULONG RB_RBA_Common_CentralElements_CompuMethods_Identical 1 100 0.0 4294967295 FORMAT "%8.2" ECU_ADDRESS 0xfe419384 /end MEASUREMENT
/begin MEASUREMENT Tlib_BTGRegRead_GetOctSetting_O_S_ODH40 "" ULONG RB_RBA_Common_CentralElements_CompuMethods_Identical 1 100 0.0 4294967295 FORMAT "%8.2" ECU_ADDRESS 0xfe419388 /end MEASUREMENT
/begin MEASUREMENT Tlib_BTGRegRead_GetCurrent_O_S_ODH40 "" ULONG RB_RBA_Common_CentralElements_CompuMethods_Identical 1 100 0.0 4294967295 FORMAT "%8.2" ECU_ADDRESS 0xfe41938c /end MEASUREMENT
/begin MEASUREMENT Tlib_BTGRegRead_GetI2tSetting_O_S_EFUSE27 "" ULONG RB_RBA_Common_CentralElements_CompuMethods_Identical 1 100 0.0 4294967295 FORMAT "%8.2" ECU_ADDRESS 0xfe419390 /end MEASUREMENT
/begin MEASUREMENT Tlib_BTGRegRead_GetI2tStatus_O_S_EFUSE27 "" ULONG RB_RBA_Common_CentralElements_CompuMethods_Identical 1 100 0.0 4294967295 FORMAT "%8.2" ECU_ADDRESS 0xfe419394 /end MEASUREMENT
/begin MEASUREMENT Tlib_BTGRegRead_GetOctSetting_O_S_EFUSE27 "" ULONG RB_RBA_Common_CentralElements_CompuMethods_Identical 1 100 0.0 4294967295 FORMAT "%8.2" ECU_ADDRESS 0xfe419398 /end MEASUREMENT
/begin MEASUREMENT Tlib_BTGRegRead_GetCurrent_O_S_EFUSE27 "" ULONG RB_RBA_Common_CentralElements_CompuMethods_Identical 1 100 0.0 4294967295 FORMAT "%8.2" ECU_ADDRESS 0xfe41939c /end MEASUREMENT
/begin MEASUREMENT Tlib_BTGRegRead_GetI2tSetting_O_S_ODH88 "" ULONG RB_RBA_Common_CentralElements_CompuMethods_Identical 1 100 0.0 4294967295 FORMAT "%8.2" ECU_ADDRESS 0xfe4193a0 /end MEASUREMENT
/begin MEASUREMENT Tlib_BTGRegRead_GetI2tStatus_O_S_ODH88 "" ULONG RB_RBA_Common_CentralElements_CompuMethods_Identical 1 100 0.0 4294967295 FORMAT "%8.2" ECU_ADDRESS 0xfe4193a4 /end MEASUREMENT
/begin MEASUREMENT Tlib_BTGRegRead_GetOctSetting_O_S_ODH88 "" ULONG RB_RBA_Common_CentralElements_CompuMethods_Identical 1 100 0.0 4294967295 FORMAT "%8.2" ECU_ADDRESS 0xfe4193a8 /end MEASUREMENT
/begin MEASUREMENT Tlib_BTGRegRead_GetCurrent_O_S_ODH88 "" ULONG RB_RBA_Common_CentralElements_CompuMethods_Identical 1 100 0.0 4294967295 FORMAT "%8.2" ECU_ADDRESS 0xfe4193ac /end MEASUREMENT
/begin MEASUREMENT Tlib_BTGRegRead_GetI2tSetting_O_S_ODH89 "" ULONG RB_RBA_Common_CentralElements_CompuMethods_Identical 1 100 0.0 4294967295 FORMAT "%8.2" ECU_ADDRESS 0xfe4193b0 /end MEASUREMENT
/begin MEASUREMENT Tlib_BTGRegRead_GetI2tStatus_O_S_ODH89 "" ULONG RB_RBA_Common_CentralElements_CompuMethods_Identical 1 100 0.0 4294967295 FORMAT "%8.2" ECU_ADDRESS 0xfe4193b4 /end MEASUREMENT
/begin MEASUREMENT Tlib_BTGRegRead_GetOctSetting_O_S_ODH89 "" ULONG RB_RBA_Common_CentralElements_CompuMethods_Identical 1 100 0.0 4294967295 FORMAT "%8.2" ECU_ADDRESS 0xfe4193b8 /end MEASUREMENT
/begin MEASUREMENT Tlib_BTGRegRead_GetCurrent_O_S_ODH89 "" ULONG RB_RBA_Common_CentralElements_CompuMethods_Identical 1 100 0.0 4294967295 FORMAT "%8.2" ECU_ADDRESS 0xfe4193bc /end MEASUREMENT
/begin MEASUREMENT Tlib_BTGRegRead_GetI2tSetting_O_S_ODH90 "" ULONG RB_RBA_Common_CentralElements_CompuMethods_Identical 1 100 0.0 4294967295 FORMAT "%8.2" ECU_ADDRESS 0xfe4193c0 /end MEASUREMENT
/begin MEASUREMENT Tlib_BTGRegRead_GetI2tStatus_O_S_ODH90 "" ULONG RB_RBA_Common_CentralElements_CompuMethods_Identical 1 100 0.0 4294967295 FORMAT "%8.2" ECU_ADDRESS 0xfe4193c4 /end MEASUREMENT
/begin MEASUREMENT Tlib_BTGRegRead_GetOctSetting_O_S_ODH90 "" ULONG RB_RBA_Common_CentralElements_CompuMethods_Identical 1 100 0.0 4294967295 FORMAT "%8.2" ECU_ADDRESS 0xfe4193c8 /end MEASUREMENT
/begin MEASUREMENT Tlib_BTGRegRead_GetCurrent_O_S_ODH90 "" ULONG RB_RBA_Common_CentralElements_CompuMethods_Identical 1 100 0.0 4294967295 FORMAT "%8.2" ECU_ADDRESS 0xfe4193cc /end MEASUREMENT
/begin MEASUREMENT Tlib_BTGRegRead_GetI2tSetting_O_S_ODH114 "" ULONG RB_RBA_Common_CentralElements_CompuMethods_Identical 1 100 0.0 4294967295 FORMAT "%8.2" ECU_ADDRESS 0xfe4193d0 /end MEASUREMENT
/begin MEASUREMENT Tlib_BTGRegRead_GetI2tStatus_O_S_ODH114 "" ULONG RB_RBA_Common_CentralElements_CompuMethods_Identical 1 100 0.0 4294967295 FORMAT "%8.2" ECU_ADDRESS 0xfe4193d4 /end MEASUREMENT
/begin MEASUREMENT Tlib_BTGRegRead_GetOctSetting_O_S_ODH114 "" ULONG RB_RBA_Common_CentralElements_CompuMethods_Identical 1 100 0.0 4294967295 FORMAT "%8.2" ECU_ADDRESS 0xfe4193d8 /end MEASUREMENT
/begin MEASUREMENT Tlib_BTGRegRead_GetCurrent_O_S_ODH114 "" ULONG RB_RBA_Common_CentralElements_CompuMethods_Identical 1 100 0.0 4294967295 FORMAT "%8.2" ECU_ADDRESS 0xfe4193dc /end MEASUREMENT
/begin MEASUREMENT Tlib_BTGRegRead_GetI2tSetting_O_S_ODH92 "" ULONG RB_RBA_Common_CentralElements_CompuMethods_Identical 1 100 0.0 4294967295 FORMAT "%8.2" ECU_ADDRESS 0xfe4193e0 /end MEASUREMENT
/begin MEASUREMENT Tlib_BTGRegRead_GetI2tStatus_O_S_ODH92 "" ULONG RB_RBA_Common_CentralElements_CompuMethods_Identical 1 100 0.0 4294967295 FORMAT "%8.2" ECU_ADDRESS 0xfe4193e4 /end MEASUREMENT
/begin MEASUREMENT Tlib_BTGRegRead_GetOctSetting_O_S_ODH92 "" ULONG RB_RBA_Common_CentralElements_CompuMethods_Identical 1 100 0.0 4294967295 FORMAT "%8.2" ECU_ADDRESS 0xfe4193e8 /end MEASUREMENT
/begin MEASUREMENT Tlib_BTGRegRead_GetCurrent_O_S_ODH92 "" ULONG RB_RBA_Common_CentralElements_CompuMethods_Identical 1 100 0.0 4294967295 FORMAT "%8.2" ECU_ADDRESS 0xfe4193ec /end MEASUREMENT
/begin MEASUREMENT Tlib_BTGRegRead_GetI2tSetting_O_S_ODH93 "" ULONG RB_RBA_Common_CentralElements_CompuMethods_Identical 1 100 0.0 4294967295 FORMAT "%8.2" ECU_ADDRESS 0xfe4193f0 /end MEASUREMENT
/begin MEASUREMENT Tlib_BTGRegRead_GetI2tStatus_O_S_ODH93 "" ULONG RB_RBA_Common_CentralElements_CompuMethods_Identical 1 100 0.0 4294967295 FORMAT "%8.2" ECU_ADDRESS 0xfe4193f4 /end MEASUREMENT
/begin MEASUREMENT Tlib_BTGRegRead_GetOctSetting_O_S_ODH93 "" ULONG RB_RBA_Common_CentralElements_CompuMethods_Identical 1 100 0.0 4294967295 FORMAT "%8.2" ECU_ADDRESS 0xfe4193f8 /end MEASUREMENT
/begin MEASUREMENT Tlib_BTGRegRead_GetCurrent_O_S_ODH93 "" ULONG RB_RBA_Common_CentralElements_CompuMethods_Identical 1 100 0.0 4294967295 FORMAT "%8.2" ECU_ADDRESS 0xfe4193fc /end MEASUREMENT
/begin MEASUREMENT Tlib_BTGRegRead_GetI2tSetting_O_S_ODH95 "" ULONG RB_RBA_Common_CentralElements_CompuMethods_Identical 1 100 0.0 4294967295 FORMAT "%8.2" ECU_ADDRESS 0xfe419400 /end MEASUREMENT
/begin MEASUREMENT Tlib_BTGRegRead_GetI2tStatus_O_S_ODH95 "" ULONG RB_RBA_Common_CentralElements_CompuMethods_Identical 1 100 0.0 4294967295 FORMAT "%8.2" ECU_ADDRESS 0xfe419404 /end MEASUREMENT
/begin MEASUREMENT Tlib_BTGRegRead_GetOctSetting_O_S_ODH95 "" ULONG RB_RBA_Common_CentralElements_CompuMethods_Identical 1 100 0.0 4294967295 FORMAT "%8.2" ECU_ADDRESS 0xfe419408 /end MEASUREMENT
/begin MEASUREMENT Tlib_BTGRegRead_GetCurrent_O_S_ODH95 "" ULONG RB_RBA_Common_CentralElements_CompuMethods_Identical 1 100 0.0 4294967295 FORMAT "%8.2" ECU_ADDRESS 0xfe41940c /end MEASUREMENT
/begin MEASUREMENT Tlib_BTGRegRead_GetI2tSetting_O_S_ODH51 "" ULONG RB_RBA_Common_CentralElements_CompuMethods_Identical 1 100 0.0 4294967295 FORMAT "%8.2" ECU_ADDRESS 0xfe419410 /end MEASUREMENT
/begin MEASUREMENT Tlib_BTGRegRead_GetI2tStatus_O_S_ODH51 "" ULONG RB_RBA_Common_CentralElements_CompuMethods_Identical 1 100 0.0 4294967295 FORMAT "%8.2" ECU_ADDRESS 0xfe419414 /end MEASUREMENT
/begin MEASUREMENT Tlib_BTGRegRead_GetOctSetting_O_S_ODH51 "" ULONG RB_RBA_Common_CentralElements_CompuMethods_Identical 1 100 0.0 4294967295 FORMAT "%8.2" ECU_ADDRESS 0xfe419418 /end MEASUREMENT
/begin MEASUREMENT Tlib_BTGRegRead_GetCurrent_O_S_ODH51 "" ULONG RB_RBA_Common_CentralElements_CompuMethods_Identical 1 100 0.0 4294967295 FORMAT "%8.2" ECU_ADDRESS 0xfe41941c /end MEASUREMENT
/begin MEASUREMENT Tlib_BTGRegRead_GetI2tSetting_O_S_ODH99 "" ULONG RB_RBA_Common_CentralElements_CompuMethods_Identical 1 100 0.0 4294967295 FORMAT "%8.2" ECU_ADDRESS 0xfe419420 /end MEASUREMENT
/begin MEASUREMENT Tlib_BTGRegRead_GetI2tStatus_O_S_ODH99 "" ULONG RB_RBA_Common_CentralElements_CompuMethods_Identical 1 100 0.0 4294967295 FORMAT "%8.2" ECU_ADDRESS 0xfe419424 /end MEASUREMENT
/begin MEASUREMENT Tlib_BTGRegRead_GetOctSetting_O_S_ODH99 "" ULONG RB_RBA_Common_CentralElements_CompuMethods_Identical 1 100 0.0 4294967295 FORMAT "%8.2" ECU_ADDRESS 0xfe419428 /end MEASUREMENT
/begin MEASUREMENT Tlib_BTGRegRead_GetCurrent_O_S_ODH99 "" ULONG RB_RBA_Common_CentralElements_CompuMethods_Identical 1 100 0.0 4294967295 FORMAT "%8.2" ECU_ADDRESS 0xfe41942c /end MEASUREMENT
/begin MEASUREMENT Tlib_BTGRegRead_GetI2tSetting_O_S_ODH71 "" ULONG RB_RBA_Common_CentralElements_CompuMethods_Identical 1 100 0.0 4294967295 FORMAT "%8.2" ECU_ADDRESS 0xfe419430 /end MEASUREMENT
/begin MEASUREMENT Tlib_BTGRegRead_GetI2tStatus_O_S_ODH71 "" ULONG RB_RBA_Common_CentralElements_CompuMethods_Identical 1 100 0.0 4294967295 FORMAT "%8.2" ECU_ADDRESS 0xfe419434 /end MEASUREMENT
/begin MEASUREMENT Tlib_BTGRegRead_GetOctSetting_O_S_ODH71 "" ULONG RB_RBA_Common_CentralElements_CompuMethods_Identical 1 100 0.0 4294967295 FORMAT "%8.2" ECU_ADDRESS 0xfe419438 /end MEASUREMENT
/begin MEASUREMENT Tlib_BTGRegRead_GetCurrent_O_S_ODH71 "" ULONG RB_RBA_Common_CentralElements_CompuMethods_Identical 1 100 0.0 4294967295 FORMAT "%8.2" ECU_ADDRESS 0xfe41943c /end MEASUREMENT
/begin MEASUREMENT Tlib_BTGRegRead_GetI2tSetting_O_S_ODH87 "" ULONG RB_RBA_Common_CentralElements_CompuMethods_Identical 1 100 0.0 4294967295 FORMAT "%8.2" ECU_ADDRESS 0xfe419440 /end MEASUREMENT
/begin MEASUREMENT Tlib_BTGRegRead_GetI2tStatus_O_S_ODH87 "" ULONG RB_RBA_Common_CentralElements_CompuMethods_Identical 1 100 0.0 4294967295 FORMAT "%8.2" ECU_ADDRESS 0xfe419444 /end MEASUREMENT
/begin MEASUREMENT Tlib_BTGRegRead_GetOctSetting_O_S_ODH87 "" ULONG RB_RBA_Common_CentralElements_CompuMethods_Identical 1 100 0.0 4294967295 FORMAT "%8.2" ECU_ADDRESS 0xfe419448 /end MEASUREMENT
/begin MEASUREMENT Tlib_BTGRegRead_GetCurrent_O_S_ODH87 "" ULONG RB_RBA_Common_CentralElements_CompuMethods_Identical 1 100 0.0 4294967295 FORMAT "%8.2" ECU_ADDRESS 0xfe41944c /end MEASUREMENT
/begin MEASUREMENT Tlib_BTGRegRead_GetI2tSetting_O_S_ODH28 "" ULONG RB_RBA_Common_CentralElements_CompuMethods_Identical 1 100 0.0 4294967295 FORMAT "%8.2" ECU_ADDRESS 0xfe419450 /end MEASUREMENT
/begin MEASUREMENT Tlib_BTGRegRead_GetI2tStatus_O_S_ODH28 "" ULONG RB_RBA_Common_CentralElements_CompuMethods_Identical 1 100 0.0 4294967295 FORMAT "%8.2" ECU_ADDRESS 0xfe419454 /end MEASUREMENT
/begin MEASUREMENT Tlib_BTGRegRead_GetOctSetting_O_S_ODH28 "" ULONG RB_RBA_Common_CentralElements_CompuMethods_Identical 1 100 0.0 4294967295 FORMAT "%8.2" ECU_ADDRESS 0xfe419458 /end MEASUREMENT
/begin MEASUREMENT Tlib_BTGRegRead_GetCurrent_O_S_ODH28 "" ULONG RB_RBA_Common_CentralElements_CompuMethods_Identical 1 100 0.0 4294967295 FORMAT "%8.2" ECU_ADDRESS 0xfe41945c /end MEASUREMENT
/begin MEASUREMENT Tlib_MCUPowerOVUV_Monitor "" UWORD RB_RBA_Common_CentralElements_CompuMethods_Identical 1 100 0.0 65535 FORMAT "%8.2" ECU_ADDRESS 0xfe419bb4 /end MEASUREMENT
/begin MEASUREMENT Tlib_Clock_Monitor "" UBYTE RB_RBA_Common_CentralElements_CompuMethods_Identical 1 100 0.0 255.00 FORMAT "%8.2" ECU_ADDRESS 0xfe419bb7 /end MEASUREMENT
/begin MEASUREMENT Tlib_Lockstep_Monitor "" UBYTE RB_RBA_Common_CentralElements_CompuMethods_Identical 1 100 0.0 255.00 FORMAT "%8.2" ECU_ADDRESS 0xfe419bb8 /end MEASUREMENT
/begin MEASUREMENT Tlib_ECCEDD1 "" UBYTE RB_RBA_Common_CentralElements_CompuMethods_Identical 1 100 0.0 255.00 FORMAT "%8.2" ECU_ADDRESS 0xfe419bb9 /end MEASUREMENT
/begin MEASUREMENT Tlib_ECCEDD2 "" UBYTE RB_RBA_Common_CentralElements_CompuMethods_Identical 1 100 0.0 255.00 FORMAT "%8.2" ECU_ADDRESS 0xfe419bba /end MEASUREMENT
/begin MEASUREMENT Tlib_MPU "" UBYTE RB_RBA_Common_CentralElements_CompuMethods_Identical 1 100 0.0 255.00 FORMAT "%8.2" ECU_ADDRESS 0xfe419bbb /end MEASUREMENT
/begin MEASUREMENT Tlib_Register_Check "" UWORD RB_RBA_Common_CentralElements_CompuMethods_Identical 1 100 0.0 65535 FORMAT "%8.2" ECU_ADDRESS 0xfe419bbe /end MEASUREMENT
/begin MEASUREMENT Tlib_ExternalWD_MoCCom_stComState "" UBYTE RB_RBA_Common_CentralElements_CompuMethods_Identical 1 100 0.0 255.00 FORMAT "%8.2" ECU_ADDRESS 0xfe419b99 /end MEASUREMENT
/begin MEASUREMENT Tlib_ExternalWD_MoCCom_stMmRespCnt "" UBYTE RB_RBA_Common_CentralElements_CompuMethods_Identical 1 100 0.0 255.00 FORMAT "%8.2" ECU_ADDRESS 0xfe419b9a /end MEASUREMENT
/begin MEASUREMENT Tlib_ExternalWD_MoCCom_ctCorRespCnt "" UBYTE RB_RBA_Common_CentralElements_CompuMethods_Identical 1 100 0.0 255.00 FORMAT "%8.2" ECU_ADDRESS 0xfe419b9b /end MEASUREMENT
/begin MEASUREMENT Tlib_ExternalWD_MoCCom_stBusErr "" UBYTE RB_RBA_Common_CentralElements_CompuMethods_Identical 1 100 0.0 255.00 FORMAT "%8.2" ECU_ADDRESS 0xfe419b9c /end MEASUREMENT
/begin MEASUREMENT Tlib_ExternalWD_MoCCom_stCheckState "" UBYTE RB_RBA_Common_CentralElements_CompuMethods_Identical 1 100 0.0 255.00 FORMAT "%8.2" ECU_ADDRESS 0xfe419b9d /end MEASUREMENT
/begin MEASUREMENT Tlib_ExternalWD_MoCCom_ctErrMM "" UBYTE RB_RBA_Common_CentralElements_CompuMethods_Identical 1 100 0.0 255.00 FORMAT "%8.2" ECU_ADDRESS 0xfe419b9e /end MEASUREMENT
/begin MEASUREMENT Tlib_ExternalWD_MoCCom_ctErrMMOld "" UBYTE RB_RBA_Common_CentralElements_CompuMethods_Identical 1 100 0.0 255.00 FORMAT "%8.2" ECU_ADDRESS 0xfe419b9f /end MEASUREMENT
/begin MEASUREMENT Tlib_ExternalWD_MoCCom_ctErrFC "" UBYTE RB_RBA_Common_CentralElements_CompuMethods_Identical 1 100 0.0 255.00 FORMAT "%8.2" ECU_ADDRESS 0xfe419ba0 /end MEASUREMENT
/begin MEASUREMENT Tlib_ExternalWD_MoCCom_stCondition "" UBYTE RB_RBA_Common_CentralElements_CompuMethods_Identical 1 100 0.0 255.00 FORMAT "%8.2" ECU_ADDRESS 0xfe419ba1 /end MEASUREMENT
/begin MEASUREMENT Tlib_ExternalWD_MoCCom_ctPermission "" UBYTE RB_RBA_Common_CentralElements_CompuMethods_Identical 1 100 0.0 255.00 FORMAT "%8.2" ECU_ADDRESS 0xfe419ba2 /end MEASUREMENT
/begin MEASUREMENT Tlib_ExternalWD_MoCCom_stExpired "" UBYTE RB_RBA_Common_CentralElements_CompuMethods_Identical 1 100 0.0 255.00 FORMAT "%8.2" ECU_ADDRESS 0xfe419ba3 /end MEASUREMENT
/begin MEASUREMENT Tlib_ExternalWD_MoCSOP_stDevSM "" UBYTE RB_RBA_Common_CentralElements_CompuMethods_Identical 1 100 0.0 255.00 FORMAT "%8.2" ECU_ADDRESS 0xfe419baa /end MEASUREMENT
/begin MEASUREMENT Tlib_ExternalWD_MoCSOP_stFWDF "" UBYTE RB_RBA_Common_CentralElements_CompuMethods_Identical 1 100 0.0 255.00 FORMAT "%8.2" ECU_ADDRESS 0xfe419bab /end MEASUREMENT
/begin MEASUREMENT Tlib_ExternalWD_MoCSOP_stWDCFG1 "" UBYTE RB_RBA_Common_CentralElements_CompuMethods_Identical 1 100 0.0 255.00 FORMAT "%8.2" ECU_ADDRESS 0xfe419bac /end MEASUREMENT
/begin MEASUREMENT Tlib_ExternalWD_MoCSOP_ctErrMM "" UBYTE RB_RBA_Common_CentralElements_CompuMethods_Identical 1 100 0.0 255.00 FORMAT "%8.2" ECU_ADDRESS 0xfe419bad /end MEASUREMENT
/begin MEASUREMENT Tlib_ExternalWD_MoCSOP_stFWDE "" UBYTE RB_RBA_Common_CentralElements_CompuMethods_Identical 1 100 0.0 255.00 FORMAT "%8.2" ECU_ADDRESS 0xfe419bae /end MEASUREMENT
/begin MEASUREMENT Tlib_ExternalWD_MoCSOP_sttiResp "" UBYTE RB_RBA_Common_CentralElements_CompuMethods_Identical 1 100 0.0 255.00 FORMAT "%8.2" ECU_ADDRESS 0xfe419baf /end MEASUREMENT
/begin MEASUREMENT Tlib_ExternalWD_MoCSOP_stAlreadyInNormal "" UBYTE RB_RBA_Common_CentralElements_CompuMethods_Identical 1 100 0.0 255.00 FORMAT "%8.2" ECU_ADDRESS 0xfe419ba4 /end MEASUREMENT
/begin MEASUREMENT Tlib_ExternalWD_MoCSOP_stToNormal "" UBYTE RB_RBA_Common_CentralElements_CompuMethods_Identical 1 100 0.0 255.00 FORMAT "%8.2" ECU_ADDRESS 0xfe419ba5 /end MEASUREMENT
/begin MEASUREMENT Tlib_ExternalWD_MoCSOP_ctDebNormal "" UBYTE RB_RBA_Common_CentralElements_CompuMethods_Identical 1 100 0.0 255.00 FORMAT "%8.2" ECU_ADDRESS 0xfe419ba6 /end MEASUREMENT
/begin MEASUREMENT Tlib_ExternalWD_MoCSOP_stErpn "" UBYTE RB_RBA_Common_CentralElements_CompuMethods_Identical 1 100 0.0 255.00 FORMAT "%8.2" ECU_ADDRESS 0xfe419ba7 /end MEASUREMENT
/begin MEASUREMENT Tlib_ExternalWD_MoCSOP_stErpnRel "" UBYTE RB_RBA_Common_CentralElements_CompuMethods_Identical 1 100 0.0 255.00 FORMAT "%8.2" ECU_ADDRESS 0xfe419ba8 /end MEASUREMENT
/begin MEASUREMENT Tlib_ExternalWD_MoCSOP_stMPS "" UBYTE RB_RBA_Common_CentralElements_CompuMethods_Identical 1 100 0.0 255.00 FORMAT "%8.2" ECU_ADDRESS 0xfe419ba9 /end MEASUREMENT
/begin MEASUREMENT Tlib_ExternalWD_Mo_flgIrrvErrTstMsg "" UBYTE RB_RBA_Common_CentralElements_CompuMethods_Identical 1 100 0.0 255.00 FORMAT "%8.2" ECU_ADDRESS 0xfe419b98 /end MEASUREMENT
/begin MEASUREMENT Tlib_ExternalWD_MoCSOP_stRdyEpb "" UBYTE RB_RBA_Common_CentralElements_CompuMethods_Identical 1 100 0.0 255.00 FORMAT "%8.2" ECU_ADDRESS 0xfe419bb0 /end MEASUREMENT
/begin MEASUREMENT Tlib_ExternalWD_MoCSOP_stRdyEth "" UBYTE RB_RBA_Common_CentralElements_CompuMethods_Identical 1 100 0.0 255.00 FORMAT "%8.2" ECU_ADDRESS 0xfe419bb1 /end MEASUREMENT
/begin MEASUREMENT Tlib_ExternalWD_MoCSOP_stRdyCan "" UBYTE RB_RBA_Common_CentralElements_CompuMethods_Identical 1 100 0.0 255.00 FORMAT "%8.2" ECU_ADDRESS 0xfe419bb2 /end MEASUREMENT
/begin MEASUREMENT Tlib_ExternalWD_MoCSOP_stRdyVfs "" UBYTE RB_RBA_Common_CentralElements_CompuMethods_Identical 1 100 0.0 255.00 FORMAT "%8.2" ECU_ADDRESS 0xfe419bb3 /end MEASUREMENT
/begin MEASUREMENT Tlib_QUCOVUV_Monitor "" ULONG RB_RBA_Common_CentralElements_CompuMethods_Identical 1 100 0.0 4294967295 FORMAT "%8.2" ECU_ADDRESS 0xfe406738 /end MEASUREMENT
/begin MEASUREMENT Tlib_QVROVUV_Monitor "" ULONG RB_RBA_Common_CentralElements_CompuMethods_Identical 1 100 0.0 4294967295 FORMAT "%8.2" ECU_ADDRESS 0xfe40673c /end MEASUREMENT
/begin MEASUREMENT Tlib_QCOOVUV_Monitor "" ULONG RB_RBA_Common_CentralElements_CompuMethods_Identical 1 100 0.0 4294967295 FORMAT "%8.2" ECU_ADDRESS 0xfe406740 /end MEASUREMENT
/begin MEASUREMENT Tlib_QT1OVUV_Monitor "" ULONG RB_RBA_Common_CentralElements_CompuMethods_Identical 1 100 0.0 4294967295 FORMAT "%8.2" ECU_ADDRESS 0xfe406744 /end MEASUREMENT
/begin MEASUREMENT Tlib_QT2OVUV_Monitor "" ULONG RB_RBA_Common_CentralElements_CompuMethods_Identical 1 100 0.0 4294967295 FORMAT "%8.2" ECU_ADDRESS 0xfe406748 /end MEASUREMENT
/begin MEASUREMENT Tlib_PreRegulator_ThermalShutDown "" ULONG RB_RBA_Common_CentralElements_CompuMethods_Identical 1 100 0.0 4294967295 FORMAT "%8.2" ECU_ADDRESS 0xfe40674c /end MEASUREMENT
/begin MEASUREMENT HardReset_Flag "" UBYTE RB_RBA_Common_CentralElements_CompuMethods_Identical 1 100 0.0 255.00 FORMAT "%8.2" ECU_ADDRESS 0xfe42f078 /end MEASUREMENT
/begin MEASUREMENT CbReset_Flag "" UBYTE RB_RBA_Common_CentralElements_CompuMethods_Identical 1 100 0.0 255.00 FORMAT "%8.2" ECU_ADDRESS 0xfe403e27 /end MEASUREMENT
/begin MEASUREMENT ICUMActiveFlag "" UBYTE RB_RBA_Common_CentralElements_CompuMethods_Identical 1 100 0.0 255.00 FORMAT "%8.2" ECU_ADDRESS 0xfe42f079 /end MEASUREMENT
/begin MEASUREMENT OsShell_CntrInitTask_OsCore0 "" ULONG RB_RBA_Common_CentralElements_CompuMethods_Identical 1 100 0.0 4294967295 FORMAT "%8.2" ECU_ADDRESS 0xfdc0c214 /end MEASUREMENT
/begin MEASUREMENT OsShell_Cntr1000msTask_OsCore0 "" ULONG RB_RBA_Common_CentralElements_CompuMethods_Identical 1 100 0.0 4294967295 FORMAT "%8.2" ECU_ADDRESS 0xfdc0c218 /end MEASUREMENT
/begin MEASUREMENT OsShell_Cntr500msTask_OsCore0 "" ULONG RB_RBA_Common_CentralElements_CompuMethods_Identical 1 100 0.0 4294967295 FORMAT "%8.2" ECU_ADDRESS 0xfdc0c21c /end MEASUREMENT
/begin MEASUREMENT OsShell_Cntr100msTask_OsCore0 "" ULONG RB_RBA_Common_CentralElements_CompuMethods_Identical 1 100 0.0 4294967295 FORMAT "%8.2" ECU_ADDRESS 0xfdc0c220 /end MEASUREMENT
/begin MEASUREMENT OsShell_Cntr50msTask_OsCore0 "" ULONG RB_RBA_Common_CentralElements_CompuMethods_Identical 1 100 0.0 4294967295 FORMAT "%8.2" ECU_ADDRESS 0xfdc0c224 /end MEASUREMENT
/begin MEASUREMENT OsShell_Cntr20msTask_OsCore0 "" ULONG RB_RBA_Common_CentralElements_CompuMethods_Identical 1 100 0.0 4294967295 FORMAT "%8.2" ECU_ADDRESS 0xfdc0c228 /end MEASUREMENT
/begin MEASUREMENT OsShell_Cntr10msTask_OsCore0 "" ULONG RB_RBA_Common_CentralElements_CompuMethods_Identical 1 100 0.0 4294967295 FORMAT "%8.2" ECU_ADDRESS 0xfdc0c22c /end MEASUREMENT
/begin MEASUREMENT OsShell_Cntr10msTask_OsCore0_Ext_ASW "" ULONG RB_RBA_Common_CentralElements_CompuMethods_Identical 1 100 0.0 4294967295 FORMAT "%8.2" ECU_ADDRESS 0xfdc0c230 /end MEASUREMENT
/begin MEASUREMENT OsShell_Cntr5msTask_OsCore0 "" ULONG RB_RBA_Common_CentralElements_CompuMethods_Identical 1 100 0.0 4294967295 FORMAT "%8.2" ECU_ADDRESS 0xfdc0c234 /end MEASUREMENT
/begin MEASUREMENT OsShell_Cntr5msTask_OsCore0_Ext_ASW "" ULONG RB_RBA_Common_CentralElements_CompuMethods_Identical 1 100 0.0 4294967295 FORMAT "%8.2" ECU_ADDRESS 0xfdc0c238 /end MEASUREMENT
/begin MEASUREMENT OsShell_Cntr2msTask_OsCore0 "" ULONG RB_RBA_Common_CentralElements_CompuMethods_Identical 1 100 0.0 4294967295 FORMAT "%8.2" ECU_ADDRESS 0xfdc0c23c /end MEASUREMENT
/begin MEASUREMENT OsShell_Cntr1msTask_OsCore0 "" ULONG RB_RBA_Common_CentralElements_CompuMethods_Identical 1 100 0.0 4294967295 FORMAT "%8.2" ECU_ADDRESS 0xfdc0c240 /end MEASUREMENT
/begin MEASUREMENT OsShell_CntrInitTask_OsCore1 "" ULONG RB_RBA_Common_CentralElements_CompuMethods_Identical 1 100 0.0 4294967295 FORMAT "%8.2" ECU_ADDRESS 0xfda0b408 /end MEASUREMENT
/begin MEASUREMENT OsShell_CntrInitTask_OsCore2 "" ULONG RB_RBA_Common_CentralElements_CompuMethods_Identical 1 100 0.0 4294967295 FORMAT "%8.2" ECU_ADDRESS 0xfd808408 /end MEASUREMENT
/begin MEASUREMENT OsShell_CntrInitTask_OsCore3 "" ULONG RB_RBA_Common_CentralElements_CompuMethods_Identical 1 100 0.0 4294967295 FORMAT "%8.2" ECU_ADDRESS 0xfd607008 /end MEASUREMENT
/begin MEASUREMENT OsShell_CntrInitTask_OsCore1 "" ULONG RB_RBA_Common_CentralElements_CompuMethods_Identical 1 100 0.0 4294967295 FORMAT "%8.2" ECU_ADDRESS 0xfda0b408 /end MEASUREMENT
/begin MEASUREMENT OsShell_Cntr1000msTask_OsCore1 "" ULONG RB_RBA_Common_CentralElements_CompuMethods_Identical 1 100 0.0 4294967295 FORMAT "%8.2" ECU_ADDRESS 0xfda0b40c /end MEASUREMENT
/begin MEASUREMENT OsShell_Cntr500msTask_OsCore1 "" ULONG RB_RBA_Common_CentralElements_CompuMethods_Identical 1 100 0.0 4294967295 FORMAT "%8.2" ECU_ADDRESS 0xfda0b410 /end MEASUREMENT
/begin MEASUREMENT OsShell_Cntr100msTask_OsCore1 "" ULONG RB_RBA_Common_CentralElements_CompuMethods_Identical 1 100 0.0 4294967295 FORMAT "%8.2" ECU_ADDRESS 0xfda0b414 /end MEASUREMENT
/begin MEASUREMENT OsShell_Cntr50msTask_OsCore1 "" ULONG RB_RBA_Common_CentralElements_CompuMethods_Identical 1 100 0.0 4294967295 FORMAT "%8.2" ECU_ADDRESS 0xfda0b418 /end MEASUREMENT
/begin MEASUREMENT OsShell_Cntr20msTask_OsCore1 "" ULONG RB_RBA_Common_CentralElements_CompuMethods_Identical 1 100 0.0 4294967295 FORMAT "%8.2" ECU_ADDRESS 0xfda0b41c /end MEASUREMENT
/begin MEASUREMENT OsShell_Cntr10msTask_OsCore1 "" ULONG RB_RBA_Common_CentralElements_CompuMethods_Identical 1 100 0.0 4294967295 FORMAT "%8.2" ECU_ADDRESS 0xfda0b420 /end MEASUREMENT
/begin MEASUREMENT OsShell_Cntr10msTask_OsCore1_Ext_ASW "" ULONG RB_RBA_Common_CentralElements_CompuMethods_Identical 1 100 0.0 4294967295 FORMAT "%8.2" ECU_ADDRESS 0xfda0b424 /end MEASUREMENT
/begin MEASUREMENT OsShell_Cntr5msTask_OsCore1 "" ULONG RB_RBA_Common_CentralElements_CompuMethods_Identical 1 100 0.0 4294967295 FORMAT "%8.2" ECU_ADDRESS 0xfda0b428 /end MEASUREMENT
/begin MEASUREMENT OsShell_Cntr5msTask_OsCore1_Ext_ASW "" ULONG RB_RBA_Common_CentralElements_CompuMethods_Identical 1 100 0.0 4294967295 FORMAT "%8.2" ECU_ADDRESS 0xfda0b42c /end MEASUREMENT
/begin MEASUREMENT OsShell_Cntr2msTask_OsCore1 "" ULONG RB_RBA_Common_CentralElements_CompuMethods_Identical 1 100 0.0 4294967295 FORMAT "%8.2" ECU_ADDRESS 0xfda0b430 /end MEASUREMENT
/begin MEASUREMENT OsShell_Cntr1msTask_OsCore1 "" ULONG RB_RBA_Common_CentralElements_CompuMethods_Identical 1 100 0.0 4294967295 FORMAT "%8.2" ECU_ADDRESS 0xfda0b434 /end MEASUREMENT
/begin MEASUREMENT OsShell_CntrInitTask_OsCore0 "" ULONG RB_RBA_Common_CentralElements_CompuMethods_Identical 1 100 0.0 4294967295 FORMAT "%8.2" ECU_ADDRESS 0xfdc0c214 /end MEASUREMENT
/begin MEASUREMENT OsShell_CntrInitTask_OsCore2 "" ULONG RB_RBA_Common_CentralElements_CompuMethods_Identical 1 100 0.0 4294967295 FORMAT "%8.2" ECU_ADDRESS 0xfd808408 /end MEASUREMENT
/begin MEASUREMENT OsShell_CntrInitTask_OsCore3 "" ULONG RB_RBA_Common_CentralElements_CompuMethods_Identical 1 100 0.0 4294967295 FORMAT "%8.2" ECU_ADDRESS 0xfd607008 /end MEASUREMENT
/begin MEASUREMENT OsShell_CntrInitTask_OsCore2 "" ULONG RB_RBA_Common_CentralElements_CompuMethods_Identical 1 100 0.0 4294967295 FORMAT "%8.2" ECU_ADDRESS 0xfd808408 /end MEASUREMENT
/begin MEASUREMENT OsShell_Cntr1000msTask_OsCore2 "" ULONG RB_RBA_Common_CentralElements_CompuMethods_Identical 1 100 0.0 4294967295 FORMAT "%8.2" ECU_ADDRESS 0xfd80840c /end MEASUREMENT
/begin MEASUREMENT OsShell_Cntr500msTask_OsCore2 "" ULONG RB_RBA_Common_CentralElements_CompuMethods_Identical 1 100 0.0 4294967295 FORMAT "%8.2" ECU_ADDRESS 0xfd808410 /end MEASUREMENT
/begin MEASUREMENT OsShell_Cntr100msTask_OsCore2 "" ULONG RB_RBA_Common_CentralElements_CompuMethods_Identical 1 100 0.0 4294967295 FORMAT "%8.2" ECU_ADDRESS 0xfd808414 /end MEASUREMENT
/begin MEASUREMENT OsShell_Cntr50msTask_OsCore2 "" ULONG RB_RBA_Common_CentralElements_CompuMethods_Identical 1 100 0.0 4294967295 FORMAT "%8.2" ECU_ADDRESS 0xfd808418 /end MEASUREMENT
/begin MEASUREMENT OsShell_Cntr20msTask_OsCore2 "" ULONG RB_RBA_Common_CentralElements_CompuMethods_Identical 1 100 0.0 4294967295 FORMAT "%8.2" ECU_ADDRESS 0xfd80841c /end MEASUREMENT
/begin MEASUREMENT OsShell_Cntr10msTask_OsCore2 "" ULONG RB_RBA_Common_CentralElements_CompuMethods_Identical 1 100 0.0 4294967295 FORMAT "%8.2" ECU_ADDRESS 0xfd808420 /end MEASUREMENT
/begin MEASUREMENT OsShell_Cntr10msTask_OsCore2_Ext_ASW "" ULONG RB_RBA_Common_CentralElements_CompuMethods_Identical 1 100 0.0 4294967295 FORMAT "%8.2" ECU_ADDRESS 0xfd808424 /end MEASUREMENT
/begin MEASUREMENT OsShell_Cntr5msTask_OsCore2 "" ULONG RB_RBA_Common_CentralElements_CompuMethods_Identical 1 100 0.0 4294967295 FORMAT "%8.2" ECU_ADDRESS 0xfd808428 /end MEASUREMENT
/begin MEASUREMENT OsShell_Cntr5msTask_OsCore2_Ext_ASW "" ULONG RB_RBA_Common_CentralElements_CompuMethods_Identical 1 100 0.0 4294967295 FORMAT "%8.2" ECU_ADDRESS 0xfd80842c /end MEASUREMENT
/begin MEASUREMENT OsShell_Cntr2msTask_OsCore2 "" ULONG RB_RBA_Common_CentralElements_CompuMethods_Identical 1 100 0.0 4294967295 FORMAT "%8.2" ECU_ADDRESS 0xfd808430 /end MEASUREMENT
/begin MEASUREMENT OsShell_Cntr1msTask_OsCore2 "" ULONG RB_RBA_Common_CentralElements_CompuMethods_Identical 1 100 0.0 4294967295 FORMAT "%8.2" ECU_ADDRESS 0xfd808434 /end MEASUREMENT
/begin MEASUREMENT OsShell_CntrInitTask_OsCore0 "" ULONG RB_RBA_Common_CentralElements_CompuMethods_Identical 1 100 0.0 4294967295 FORMAT "%8.2" ECU_ADDRESS 0xfdc0c214 /end MEASUREMENT
/begin MEASUREMENT OsShell_CntrInitTask_OsCore1 "" ULONG RB_RBA_Common_CentralElements_CompuMethods_Identical 1 100 0.0 4294967295 FORMAT "%8.2" ECU_ADDRESS 0xfda0b408 /end MEASUREMENT
/begin MEASUREMENT OsShell_CntrInitTask_OsCore3 "" ULONG RB_RBA_Common_CentralElements_CompuMethods_Identical 1 100 0.0 4294967295 FORMAT "%8.2" ECU_ADDRESS 0xfd607008 /end MEASUREMENT
/begin MEASUREMENT OsShell_CntrInitTask_OsCore3 "" ULONG RB_RBA_Common_CentralElements_CompuMethods_Identical 1 100 0.0 4294967295 FORMAT "%8.2" ECU_ADDRESS 0xfd607008 /end MEASUREMENT
/begin MEASUREMENT OsShell_Cntr1000msTask_OsCore3 "" ULONG RB_RBA_Common_CentralElements_CompuMethods_Identical 1 100 0.0 4294967295 FORMAT "%8.2" ECU_ADDRESS 0xfd60700c /end MEASUREMENT
/begin MEASUREMENT OsShell_Cntr500msTask_OsCore3 "" ULONG RB_RBA_Common_CentralElements_CompuMethods_Identical 1 100 0.0 4294967295 FORMAT "%8.2" ECU_ADDRESS 0xfd607010 /end MEASUREMENT
/begin MEASUREMENT OsShell_Cntr100msTask_OsCore3 "" ULONG RB_RBA_Common_CentralElements_CompuMethods_Identical 1 100 0.0 4294967295 FORMAT "%8.2" ECU_ADDRESS 0xfd607014 /end MEASUREMENT
/begin MEASUREMENT OsShell_Cntr50msTask_OsCore3 "" ULONG RB_RBA_Common_CentralElements_CompuMethods_Identical 1 100 0.0 4294967295 FORMAT "%8.2" ECU_ADDRESS 0xfd607018 /end MEASUREMENT
/begin MEASUREMENT OsShell_Cntr20msTask_OsCore3 "" ULONG RB_RBA_Common_CentralElements_CompuMethods_Identical 1 100 0.0 4294967295 FORMAT "%8.2" ECU_ADDRESS 0xfd60701c /end MEASUREMENT
/begin MEASUREMENT OsShell_Cntr10msTask_OsCore3 "" ULONG RB_RBA_Common_CentralElements_CompuMethods_Identical 1 100 0.0 4294967295 FORMAT "%8.2" ECU_ADDRESS 0xfd607020 /end MEASUREMENT
/begin MEASUREMENT OsShell_Cntr10msTask_OsCore3_Ext_ASW "" ULONG RB_RBA_Common_CentralElements_CompuMethods_Identical 1 100 0.0 4294967295 FORMAT "%8.2" ECU_ADDRESS 0xfd607024 /end MEASUREMENT
/begin MEASUREMENT OsShell_Cntr5msTask_OsCore3 "" ULONG RB_RBA_Common_CentralElements_CompuMethods_Identical 1 100 0.0 4294967295 FORMAT "%8.2" ECU_ADDRESS 0xfd607028 /end MEASUREMENT
/begin MEASUREMENT OsShell_Cntr5msTask_OsCore3_Ext_ASW "" ULONG RB_RBA_Common_CentralElements_CompuMethods_Identical 1 100 0.0 4294967295 FORMAT "%8.2" ECU_ADDRESS 0xfd60702c /end MEASUREMENT
/begin MEASUREMENT OsShell_Cntr2msTask_OsCore3 "" ULONG RB_RBA_Common_CentralElements_CompuMethods_Identical 1 100 0.0 4294967295 FORMAT "%8.2" ECU_ADDRESS 0xfd607030 /end MEASUREMENT
/begin MEASUREMENT OsShell_Cntr1msTask_OsCore3 "" ULONG RB_RBA_Common_CentralElements_CompuMethods_Identical 1 100 0.0 4294967295 FORMAT "%8.2" ECU_ADDRESS 0xfd607034 /end MEASUREMENT
/begin MEASUREMENT OsShell_CntrInitTask_OsCore0 "" ULONG RB_RBA_Common_CentralElements_CompuMethods_Identical 1 100 0.0 4294967295 FORMAT "%8.2" ECU_ADDRESS 0xfdc0c214 /end MEASUREMENT
/begin MEASUREMENT OsShell_CntrInitTask_OsCore1 "" ULONG RB_RBA_Common_CentralElements_CompuMethods_Identical 1 100 0.0 4294967295 FORMAT "%8.2" ECU_ADDRESS 0xfda0b408 /end MEASUREMENT
/begin MEASUREMENT OsShell_CntrInitTask_OsCore2 "" ULONG RB_RBA_Common_CentralElements_CompuMethods_Identical 1 100 0.0 4294967295 FORMAT "%8.2" ECU_ADDRESS 0xfd808408 /end MEASUREMENT
/begin MEASUREMENT OsShell_cntrErrAccess "" UBYTE RB_RBA_Common_CentralElements_CompuMethods_Identical 1 100 0.0 255.00 FORMAT "%8.2" ECU_ADDRESS 0xfe078030 /end MEASUREMENT
/begin MEASUREMENT OsShell_cntrErrCallevel "" UBYTE RB_RBA_Common_CentralElements_CompuMethods_Identical 1 100 0.0 255.00 FORMAT "%8.2" ECU_ADDRESS 0xfe078031 /end MEASUREMENT
/begin MEASUREMENT OsShell_cntrErrId "" UBYTE RB_RBA_Common_CentralElements_CompuMethods_Identical 1 100 0.0 255.00 FORMAT "%8.2" ECU_ADDRESS 0xfe078032 /end MEASUREMENT
/begin MEASUREMENT OsShell_cntrErrLimitSum "" UBYTE RB_RBA_Common_CentralElements_CompuMethods_Identical 1 100 0.0 255.00 FORMAT "%8.2" ECU_ADDRESS 0xfe078033 /end MEASUREMENT
/begin MEASUREMENT OsShell_cntrErrNoFunc "" UBYTE RB_RBA_Common_CentralElements_CompuMethods_Identical 1 100 0.0 255.00 FORMAT "%8.2" ECU_ADDRESS 0xfe078034 /end MEASUREMENT
/begin MEASUREMENT OsShell_cntrErrResource "" UBYTE RB_RBA_Common_CentralElements_CompuMethods_Identical 1 100 0.0 255.00 FORMAT "%8.2" ECU_ADDRESS 0xfe078035 /end MEASUREMENT
/begin MEASUREMENT OsShell_cntrErrState "" UBYTE RB_RBA_Common_CentralElements_CompuMethods_Identical 1 100 0.0 255.00 FORMAT "%8.2" ECU_ADDRESS 0xfe078036 /end MEASUREMENT
/begin MEASUREMENT OsShell_cntrErrValue "" UBYTE RB_RBA_Common_CentralElements_CompuMethods_Identical 1 100 0.0 255.00 FORMAT "%8.2" ECU_ADDRESS 0xfe078037 /end MEASUREMENT
/begin MEASUREMENT OsShell_cntrErrServiceId "" UBYTE RB_RBA_Common_CentralElements_CompuMethods_Identical 1 100 0.0 255.00 FORMAT "%8.2" ECU_ADDRESS 0xfe078038 /end MEASUREMENT
/begin MEASUREMENT OsShell_cntrErrIllegalAdress "" UBYTE RB_RBA_Common_CentralElements_CompuMethods_Identical 1 100 0.0 255.00 FORMAT "%8.2" ECU_ADDRESS 0xfe078039 /end MEASUREMENT
/begin MEASUREMENT OsShell_cntrErrMissingEnd "" UBYTE RB_RBA_Common_CentralElements_CompuMethods_Identical 1 100 0.0 255.00 FORMAT "%8.2" ECU_ADDRESS 0xfe07803a /end MEASUREMENT
/begin MEASUREMENT OsShell_cntrErrDisabledInt "" UBYTE RB_RBA_Common_CentralElements_CompuMethods_Identical 1 100 0.0 255.00 FORMAT "%8.2" ECU_ADDRESS 0xfe07803b /end MEASUREMENT
/begin MEASUREMENT OsShell_cntrErrStackFault "" UBYTE RB_RBA_Common_CentralElements_CompuMethods_Identical 1 100 0.0 255.00 FORMAT "%8.2" ECU_ADDRESS 0xfe07803c /end MEASUREMENT
/begin MEASUREMENT OsShell_cntrErrProtectionMemory "" UBYTE RB_RBA_Common_CentralElements_CompuMethods_Identical 1 100 0.0 255.00 FORMAT "%8.2" ECU_ADDRESS 0xfe07803d /end MEASUREMENT
/begin MEASUREMENT OsShell_cntrErrProtectionTime "" UBYTE RB_RBA_Common_CentralElements_CompuMethods_Identical 1 100 0.0 255.00 FORMAT "%8.2" ECU_ADDRESS 0xfe07803e /end MEASUREMENT
/begin MEASUREMENT OsShell_cntrErrProtectionArrival "" UBYTE RB_RBA_Common_CentralElements_CompuMethods_Identical 1 100 0.0 255.00 FORMAT "%8.2" ECU_ADDRESS 0xfe07803f /end MEASUREMENT
/begin MEASUREMENT OsShell_cntrErrProtectionLocked "" UBYTE RB_RBA_Common_CentralElements_CompuMethods_Identical 1 100 0.0 255.00 FORMAT "%8.2" ECU_ADDRESS 0xfe078040 /end MEASUREMENT
/begin MEASUREMENT OsShell_cntrErrProtectionException "" UBYTE RB_RBA_Common_CentralElements_CompuMethods_Identical 1 100 0.0 255.00 FORMAT "%8.2" ECU_ADDRESS 0xfe078041 /end MEASUREMENT
/begin MEASUREMENT OsShell_cntrErrCore "" UBYTE RB_RBA_Common_CentralElements_CompuMethods_Identical 1 100 0.0 255.00 FORMAT "%8.2" ECU_ADDRESS 0xfe078042 /end MEASUREMENT
/begin MEASUREMENT OsShell_cntrErrSpinlock "" UBYTE RB_RBA_Common_CentralElements_CompuMethods_Identical 1 100 0.0 255.00 FORMAT "%8.2" ECU_ADDRESS 0xfe078043 /end MEASUREMENT
/begin MEASUREMENT OsShell_cntrErrInterferenceDeadlock "" UBYTE RB_RBA_Common_CentralElements_CompuMethods_Identical 1 100 0.0 255.00 FORMAT "%8.2" ECU_ADDRESS 0xfe078044 /end MEASUREMENT
/begin MEASUREMENT OsShell_cntrErrNestingDeadlock "" UBYTE RB_RBA_Common_CentralElements_CompuMethods_Identical 1 100 0.0 255.00 FORMAT "%8.2" ECU_ADDRESS 0xfe078045 /end MEASUREMENT
/begin MEASUREMENT OsShell_cntrErrParamPointer "" UBYTE RB_RBA_Common_CentralElements_CompuMethods_Identical 1 100 0.0 255.00 FORMAT "%8.2" ECU_ADDRESS 0xfe078046 /end MEASUREMENT
/begin MEASUREMENT OsShell_cntrErrSysDisable "" UBYTE RB_RBA_Common_CentralElements_CompuMethods_Identical 1 100 0.0 255.00 FORMAT "%8.2" ECU_ADDRESS 0xfe078047 /end MEASUREMENT
/begin MEASUREMENT OsShell_cntrErrSysNoBarrierParticipant "" UBYTE RB_RBA_Common_CentralElements_CompuMethods_Identical 1 100 0.0 255.00 FORMAT "%8.2" ECU_ADDRESS 0xfe078048 /end MEASUREMENT
/begin MEASUREMENT OsShell_cntrErrSysUnImplementedFunctionality "" UBYTE RB_RBA_Common_CentralElements_CompuMethods_Identical 1 100 0.0 255.00 FORMAT "%8.2" ECU_ADDRESS 0xfe078049 /end MEASUREMENT
/begin MEASUREMENT OsShell_cntrErrSysNoNtfstack "" UBYTE RB_RBA_Common_CentralElements_CompuMethods_Identical 1 100 0.0 255.00 FORMAT "%8.2" ECU_ADDRESS 0xfe07804a /end MEASUREMENT
/begin MEASUREMENT OsShell_cntrErrSysOverflow "" UBYTE RB_RBA_Common_CentralElements_CompuMethods_Identical 1 100 0.0 255.00 FORMAT "%8.2" ECU_ADDRESS 0xfe07804b /end MEASUREMENT
/begin MEASUREMENT OsShell_cntrErrSysKillKernelObj "" UBYTE RB_RBA_Common_CentralElements_CompuMethods_Identical 1 100 0.0 255.00 FORMAT "%8.2" ECU_ADDRESS 0xfe07804c /end MEASUREMENT
/begin MEASUREMENT OsShell_cntrErrSysNoRestarttask "" UBYTE RB_RBA_Common_CentralElements_CompuMethods_Identical 1 100 0.0 255.00 FORMAT "%8.2" ECU_ADDRESS 0xfe07804d /end MEASUREMENT
/begin MEASUREMENT OsShell_cntrErrSysCallNotallowed "" UBYTE RB_RBA_Common_CentralElements_CompuMethods_Identical 1 100 0.0 255.00 FORMAT "%8.2" ECU_ADDRESS 0xfe07804e /end MEASUREMENT
/begin MEASUREMENT OsShell_cntrErrSysFunctionUnavailable "" UBYTE RB_RBA_Common_CentralElements_CompuMethods_Identical 1 100 0.0 255.00 FORMAT "%8.2" ECU_ADDRESS 0xfe07804f /end MEASUREMENT
/begin MEASUREMENT OsShell_cntrErrSysProtectionSyscall "" UBYTE RB_RBA_Common_CentralElements_CompuMethods_Identical 1 100 0.0 255.00 FORMAT "%8.2" ECU_ADDRESS 0xfe078050 /end MEASUREMENT
/begin MEASUREMENT OsShell_cntrErrSysProtectionIrq "" UBYTE RB_RBA_Common_CentralElements_CompuMethods_Identical 1 100 0.0 255.00 FORMAT "%8.2" ECU_ADDRESS 0xfe078051 /end MEASUREMENT
/begin MEASUREMENT OsShell_cntrErrSysApierror "" UBYTE RB_RBA_Common_CentralElements_CompuMethods_Identical 1 100 0.0 255.00 FORMAT "%8.2" ECU_ADDRESS 0xfe078052 /end MEASUREMENT
/begin MEASUREMENT OsShell_cntrErrSysAssertion "" UBYTE RB_RBA_Common_CentralElements_CompuMethods_Identical 1 100 0.0 255.00 FORMAT "%8.2" ECU_ADDRESS 0xfe078053 /end MEASUREMENT
/begin MEASUREMENT OsShell_cntrErrSysOverload "" UBYTE RB_RBA_Common_CentralElements_CompuMethods_Identical 1 100 0.0 255.00 FORMAT "%8.2" ECU_ADDRESS 0xfe078054 /end MEASUREMENT
/begin MEASUREMENT OsShell_cntrErrUnknownError "" UBYTE RB_RBA_Common_CentralElements_CompuMethods_Identical 1 100 0.0 255.00 FORMAT "%8.2" ECU_ADDRESS 0xfe078055 /end MEASUREMENT
/begin MEASUREMENT OsShell_cntrErrSum "" UBYTE RB_RBA_Common_CentralElements_CompuMethods_Identical 1 100 0.0 255.00 FORMAT "%8.2" ECU_ADDRESS 0xfe078056 /end MEASUREMENT
/begin MEASUREMENT OsShell_DebugHaltOff "" UBYTE RB_RBA_Common_CentralElements_CompuMethods_Identical 1 100 0.0 255.00 FORMAT "%8.2" ECU_ADDRESS 0xfe078057 /end MEASUREMENT
/begin MEASUREMENT gIoExtLM25149_u32CurrentVal "" ULONG RB_RBA_Common_CentralElements_CompuMethods_Identical 1 100 0.0 4294967295 FORMAT "%8.2" ECU_ADDRESS 0xfe440ed4 /end MEASUREMENT
/begin MEASUREMENT gIoExtLM25149_s16DiagVoltage_Val "" SWORD RB_RBA_Common_CentralElements_CompuMethods_Identical 1 100 -32768 32767 FORMAT "%8.2" ECU_ADDRESS 0xfe440ee4 /end MEASUREMENT
/begin MEASUREMENT gIoExtLM25149_u16DiagInfo "" UWORD RB_RBA_Common_CentralElements_CompuMethods_Identical 1 100 0.0 65535 FORMAT "%8.2" ECU_ADDRESS 0xfe440ee6 /end MEASUREMENT
/begin MEASUREMENT gIoExtLM25149_u16SCG_cnt "" UBYTE RB_RBA_Common_CentralElements_CompuMethods_Identical 1 100 0.0 255.00 FORMAT "%8.2" ECU_ADDRESS 0xfe440eea /end MEASUREMENT
/begin MEASUREMENT gIoExtLM25149_u16SCB_cnt "" UBYTE RB_RBA_Common_CentralElements_CompuMethods_Identical 1 100 0.0 255.00 FORMAT "%8.2" ECU_ADDRESS 0xfe440eeb /end MEASUREMENT
/begin MEASUREMENT gIoExtLM25149_s16VOUT "" SWORD RB_RBA_Common_CentralElements_CompuMethods_Identical 1 100 -32768 32767 FORMAT "%8.2" ECU_ADDRESS 0xfe440ee8 /end MEASUREMENT
/begin MEASUREMENT gIoExtTLS115B0_s16DiagVoltage_Val "" SWORD RB_RBA_Common_CentralElements_CompuMethods_Identical 1 100 -32768 32767 FORMAT "%8.2" ARRAY_SIZE 4 ECU_ADDRESS 0xfe440eb8 /end MEASUREMENT
/begin MEASUREMENT gIoExtTLS115B0_u32VOUT "" ULONG RB_RBA_Common_CentralElements_CompuMethods_Identical 1 100 0.0 4294967295 FORMAT "%8.2" ARRAY_SIZE 3 ECU_ADDRESS 0xfe440ed8 /end MEASUREMENT
/begin MEASUREMENT gIoExtTLS115B0_u16DiagInfo "" UWORD RB_RBA_Common_CentralElements_CompuMethods_Identical 1 100 0.0 65535 FORMAT "%8.2" ARRAY_SIZE 4 ECU_ADDRESS 0xfe440ec0 /end MEASUREMENT
/begin MEASUREMENT gIoExtTLS115B0_u16SCG_cnt "" UBYTE RB_RBA_Common_CentralElements_CompuMethods_Identical 1 100 0.0 255.00 FORMAT "%8.2" ARRAY_SIZE 3 ECU_ADDRESS 0xfe440eec /end MEASUREMENT
/begin MEASUREMENT gIoExtTLS115B0_u16SCB_cnt "" UBYTE RB_RBA_Common_CentralElements_CompuMethods_Identical 1 100 0.0 255.00 FORMAT "%8.2" ARRAY_SIZE 3 ECU_ADDRESS 0xfe440eef /end MEASUREMENT
/begin MEASUREMENT WindowAdBuff "" UWORD RB_RBA_Common_CentralElements_CompuMethods_Identical 1 100 0.0 65535 FORMAT "%8.2" ARRAY_SIZE 2 ECU_ADDRESS 0xfe4066d4 /end MEASUREMENT
/begin MEASUREMENT IoHwAb_State_Get_I_S_IAN83 "" UBYTE RB_RBA_Common_CentralElements_CompuMethods_Identical 1 100 0.0 255.00 FORMAT "%8.2" ECU_ADDRESS 0x00233f6c /end MEASUREMENT
/begin MEASUREMENT NvMBlock_SecOC_Verify_FailCntr_RAM "" UBYTE RB_RBA_Common_CentralElements_CompuMethods_Identical 1 100 0.0 255.00 FORMAT "%8.2" ARRAY_SIZE 32 ECU_ADDRESS 0xfe43c954 /end MEASUREMENT
/begin MEASUREMENT NvMBlock_SecOC_Verify_Faillimt_RAM "" UBYTE RB_RBA_Common_CentralElements_CompuMethods_Identical 1 100 0.0 255.00 FORMAT "%8.2" ARRAY_SIZE 4 ECU_ADDRESS 0xfe43c994 /end MEASUREMENT
/begin MEASUREMENT gIoExtBtg7xxx_xNvMBlock_au8 "" UBYTE RB_RBA_Common_CentralElements_CompuMethods_Identical 1 100 0.0 255.00 FORMAT "%8.2" ARRAY_SIZE 100 ECU_ADDRESS 0xfe43d400 /end MEASUREMENT
/begin MEASUREMENT gIoExtBtg7xxx_flgEfuseWakeUp_b "" UBYTE RB_RBA_Common_CentralElements_CompuMethods_Identical 1 100 0.0 255.00 FORMAT "%8.2" ECU_ADDRESS 0xfe43d470 /end MEASUREMENT
/begin MEASUREMENT gIoExtBtg7xxx_xFixRAM_au32 "" ULONG RB_RBA_Common_CentralElements_CompuMethods_Identical 1 100 0.0 4294967295 FORMAT "%8.2" ARRAY_SIZE 12 ECU_ADDRESS 0xfe806000 /end MEASUREMENT
/begin MEASUREMENT MoXWdgM_FirstExpiredSEID_OsCore0 "" UWORD RB_RBA_Common_CentralElements_CompuMethods_Identical 1 100 0.0 65535 FORMAT "%8.2" ECU_ADDRESS 0xfe037bc0 /end MEASUREMENT
/begin MEASUREMENT MoXWdgM_FirstExpiredSEIDAftRst_OsCore0 "" UWORD RB_RBA_Common_CentralElements_CompuMethods_Identical 1 100 0.0 65535 FORMAT "%8.2" ECU_ADDRESS 0xfe003578 /end MEASUREMENT
/begin MEASUREMENT MoXWdgM_FirstExpiredSEViolation_OsCore0 "" UBYTE RB_RBA_Common_CentralElements_CompuMethods_Identical 1 100 0.0 255.00 FORMAT "%8.2" ECU_ADDRESS 0xfe037bc8 /end MEASUREMENT
/begin MEASUREMENT MoXWdgM_FirstExpiredSEViolationAftRst_OsCore0 "" UBYTE RB_RBA_Common_CentralElements_CompuMethods_Identical 1 100 0.0 255.00 FORMAT "%8.2" ECU_ADDRESS 0xfe00357a /end MEASUREMENT
/begin MEASUREMENT MoXWdgM_GlobalStatus_OsCore0 "" UBYTE RB_RBA_Common_CentralElements_CompuMethods_Identical 1 100 0.0 255.00 FORMAT "%8.2" ECU_ADDRESS 0xfe037bc9 /end MEASUREMENT
/begin MEASUREMENT MoXWdgM_GlobalStatusAftRst_OsCore0 "" UBYTE RB_RBA_Common_CentralElements_CompuMethods_Identical 1 100 0.0 255.00 FORMAT "%8.2" ECU_ADDRESS 0xfe00357b /end MEASUREMENT
/begin MEASUREMENT MoXWdgM_FirstExpiredSEID_OsCore1 "" UWORD RB_RBA_Common_CentralElements_CompuMethods_Identical 1 100 0.0 65535 FORMAT "%8.2" ECU_ADDRESS 0xfe037bc2 /end MEASUREMENT
/begin MEASUREMENT MoXWdgM_FirstExpiredSEIDAftRst_OsCore1 "" UWORD RB_RBA_Common_CentralElements_CompuMethods_Identical 1 100 0.0 65535 FORMAT "%8.2" ECU_ADDRESS 0xfe048650 /end MEASUREMENT
/begin MEASUREMENT MoXWdgM_FirstExpiredSEViolation_OsCore1 "" UBYTE RB_RBA_Common_CentralElements_CompuMethods_Identical 1 100 0.0 255.00 FORMAT "%8.2" ECU_ADDRESS 0xfe037bca /end MEASUREMENT
/begin MEASUREMENT MoXWdgM_FirstExpiredSEViolationAftRst_OsCore1 "" UBYTE RB_RBA_Common_CentralElements_CompuMethods_Identical 1 100 0.0 255.00 FORMAT "%8.2" ECU_ADDRESS 0xfe048652 /end MEASUREMENT
/begin MEASUREMENT MoXWdgM_GlobalStatus_OsCore1 "" UBYTE RB_RBA_Common_CentralElements_CompuMethods_Identical 1 100 0.0 255.00 FORMAT "%8.2" ECU_ADDRESS 0xfe037bcb /end MEASUREMENT
/begin MEASUREMENT MoXWdgM_GlobalStatusAftRst_OsCore1 "" UBYTE RB_RBA_Common_CentralElements_CompuMethods_Identical 1 100 0.0 255.00 FORMAT "%8.2" ECU_ADDRESS 0xfe048653 /end MEASUREMENT
/begin MEASUREMENT MoXWdgM_FirstExpiredSEID_OsCore2 "" UWORD RB_RBA_Common_CentralElements_CompuMethods_Identical 1 100 0.0 65535 FORMAT "%8.2" ECU_ADDRESS 0xfe037bc4 /end MEASUREMENT
/begin MEASUREMENT MoXWdgM_FirstExpiredSEIDAftRst_OsCore2 "" UWORD RB_RBA_Common_CentralElements_CompuMethods_Identical 1 100 0.0 65535 FORMAT "%8.2" ECU_ADDRESS 0xfe100054 /end MEASUREMENT
/begin MEASUREMENT MoXWdgM_FirstExpiredSEViolation_OsCore2 "" UBYTE RB_RBA_Common_CentralElements_CompuMethods_Identical 1 100 0.0 255.00 FORMAT "%8.2" ECU_ADDRESS 0xfe037bcc /end MEASUREMENT
/begin MEASUREMENT MoXWdgM_FirstExpiredSEViolationAftRst_OsCore2 "" UBYTE RB_RBA_Common_CentralElements_CompuMethods_Identical 1 100 0.0 255.00 FORMAT "%8.2" ECU_ADDRESS 0xfe100056 /end MEASUREMENT
/begin MEASUREMENT MoXWdgM_GlobalStatus_OsCore2 "" UBYTE RB_RBA_Common_CentralElements_CompuMethods_Identical 1 100 0.0 255.00 FORMAT "%8.2" ECU_ADDRESS 0xfe037bcd /end MEASUREMENT
/begin MEASUREMENT MoXWdgM_GlobalStatusAftRst_OsCore2 "" UBYTE RB_RBA_Common_CentralElements_CompuMethods_Identical 1 100 0.0 255.00 FORMAT "%8.2" ECU_ADDRESS 0xfe100057 /end MEASUREMENT
/begin MEASUREMENT MoXWdgM_FirstExpiredSEID_OsCore3 "" UWORD RB_RBA_Common_CentralElements_CompuMethods_Identical 1 100 0.0 65535 FORMAT "%8.2" ECU_ADDRESS 0xfe037bc6 /end MEASUREMENT
/begin MEASUREMENT MoXWdgM_FirstExpiredSEIDAftRst_OsCore3 "" UWORD RB_RBA_Common_CentralElements_CompuMethods_Identical 1 100 0.0 65535 FORMAT "%8.2" ECU_ADDRESS 0xfe140050 /end MEASUREMENT
/begin MEASUREMENT MoXWdgM_FirstExpiredSEViolation_OsCore3 "" UBYTE RB_RBA_Common_CentralElements_CompuMethods_Identical 1 100 0.0 255.00 FORMAT "%8.2" ECU_ADDRESS 0xfe037bce /end MEASUREMENT
/begin MEASUREMENT MoXWdgM_FirstExpiredSEViolationAftRst_OsCore3 "" UBYTE RB_RBA_Common_CentralElements_CompuMethods_Identical 1 100 0.0 255.00 FORMAT "%8.2" ECU_ADDRESS 0xfe140052 /end MEASUREMENT
/begin MEASUREMENT MoXWdgM_GlobalStatus_OsCore3 "" UBYTE RB_RBA_Common_CentralElements_CompuMethods_Identical 1 100 0.0 255.00 FORMAT "%8.2" ECU_ADDRESS 0xfe037bcf /end MEASUREMENT
/begin MEASUREMENT MoXWdgM_GlobalStatusAftRst_OsCore3 "" UBYTE RB_RBA_Common_CentralElements_CompuMethods_Identical 1 100 0.0 255.00 FORMAT "%8.2" ECU_ADDRESS 0xfe140053 /end MEASUREMENT
/begin MEASUREMENT MoCMem_st "" ULONG RB_RBA_Common_CentralElements_CompuMethods_Identical 1 100 0.0 4294967295 FORMAT "%8.2" ECU_ADDRESS 0xfe037ba0 /end MEASUREMENT
/begin MEASUREMENT MoCMem_stCpl "" ULONG RB_RBA_Common_CentralElements_CompuMethods_Identical 1 100 0.0 4294967295 FORMAT "%8.2" ECU_ADDRESS 0xfe037ba4 /end MEASUREMENT
/begin MEASUREMENT Mo_stCplChk "" ULONG RB_RBA_Common_CentralElements_CompuMethods_Identical 1 100 0.0 4294967295 FORMAT "%8.2" ECU_ADDRESS 0xfe037ba8 /end MEASUREMENT
/begin MEASUREMENT MoCSOP_stRdyEpb "" UBYTE RB_RBA_Common_CentralElements_CompuMethods_Identical 1 100 0.0 255.00 FORMAT "%8.2" ECU_ADDRESS 0xfe008ba1 /end MEASUREMENT
/begin MEASUREMENT MoCSOP_stRdyEpbCpl "" UBYTE RB_RBA_Common_CentralElements_CompuMethods_Identical 1 100 0.0 255.00 FORMAT "%8.2" ECU_ADDRESS 0xfe008ba2 /end MEASUREMENT
/begin MEASUREMENT MoCSOP_stErpnRel "" UBYTE RB_RBA_Common_CentralElements_CompuMethods_Identical 1 100 0.0 255.00 FORMAT "%8.2" ECU_ADDRESS 0xfe008b78 /end MEASUREMENT
/begin MEASUREMENT MoCSOP_stErpn "" UBYTE RB_RBA_Common_CentralElements_CompuMethods_Identical 1 100 0.0 255.00 FORMAT "%8.2" ECU_ADDRESS 0xfe008b79 /end MEASUREMENT
/begin MEASUREMENT MoCSOP_stMMErr "" UBYTE RB_RBA_Common_CentralElements_CompuMethods_Identical 1 100 0.0 255.00 FORMAT "%8.2" ECU_ADDRESS 0xfe008b7b /end MEASUREMENT
/begin MEASUREMENT MoCSOP_stFCErr "" UBYTE RB_RBA_Common_CentralElements_CompuMethods_Identical 1 100 0.0 255.00 FORMAT "%8.2" ECU_ADDRESS 0xfe008b7c /end MEASUREMENT
/begin MEASUREMENT MoCSOP_ctDebNormal "" UBYTE RB_RBA_Common_CentralElements_CompuMethods_Identical 1 100 0.0 255.00 FORMAT "%8.2" ECU_ADDRESS 0xfe008b82 /end MEASUREMENT
/begin MEASUREMENT MoCSOP_stToNormal "" UBYTE RB_RBA_Common_CentralElements_CompuMethods_Identical 1 100 0.0 255.00 FORMAT "%8.2" ECU_ADDRESS 0xfe008b83 /end MEASUREMENT
/begin MEASUREMENT MoCSOP_stAlreadyInNormal "" UBYTE RB_RBA_Common_CentralElements_CompuMethods_Identical 1 100 0.0 255.00 FORMAT "%8.2" ECU_ADDRESS 0xfe008b84 /end MEASUREMENT
/begin MEASUREMENT MoCSOP_stTLF3558xErr "" UBYTE RB_RBA_Common_CentralElements_CompuMethods_Identical 1 100 0.0 255.00 FORMAT "%8.2" ECU_ADDRESS 0xfe008b85 /end MEASUREMENT
/begin MEASUREMENT MoCSOP_ctResponse "" UBYTE RB_RBA_Common_CentralElements_CompuMethods_Identical 1 100 0.0 255.00 FORMAT "%8.2" ECU_ADDRESS 0xfe008b86 /end MEASUREMENT
/begin MEASUREMENT MoCSOP_stCommMM "" UBYTE RB_RBA_Common_CentralElements_CompuMethods_Identical 1 100 0.0 255.00 FORMAT "%8.2" ECU_ADDRESS 0xfe008b87 /end MEASUREMENT
/begin MEASUREMENT MoCSOP_stMPS "" UBYTE RB_RBA_Common_CentralElements_CompuMethods_Identical 1 100 0.0 255.00 FORMAT "%8.2" ECU_ADDRESS 0xfe008b88 /end MEASUREMENT
/begin MEASUREMENT MoCSOP_stErpnRelCpl "" UBYTE RB_RBA_Common_CentralElements_CompuMethods_Identical 1 100 0.0 255.00 FORMAT "%8.2" ECU_ADDRESS 0xfe008b7f /end MEASUREMENT
/begin MEASUREMENT MoCSOP_stErpnCpl "" UBYTE RB_RBA_Common_CentralElements_CompuMethods_Identical 1 100 0.0 255.00 FORMAT "%8.2" ECU_ADDRESS 0xfe008b80 /end MEASUREMENT
/begin MEASUREMENT MoCSOP_ctErrMM "" UBYTE RB_RBA_Common_CentralElements_CompuMethods_Identical 1 100 0.0 255.00 FORMAT "%8.2" ECU_ADDRESS 0xfe008b7a /end MEASUREMENT
/begin MEASUREMENT MoCSOP_Query "" UBYTE RB_RBA_Common_CentralElements_CompuMethods_Identical 1 100 0.0 255.00 FORMAT "%8.2" ECU_ADDRESS 0xfe008b89 /end MEASUREMENT
/begin MEASUREMENT MoCSOP_stMm "" UBYTE RB_RBA_Common_CentralElements_CompuMethods_Identical 1 100 0.0 255.00 FORMAT "%8.2" ECU_ADDRESS 0xfe008b8a /end MEASUREMENT
/begin MEASUREMENT MoCSOP_stDevSM "" UBYTE RB_RBA_Common_CentralElements_CompuMethods_Identical 1 100 0.0 255.00 FORMAT "%8.2" ECU_ADDRESS 0xfe008b8b /end MEASUREMENT
/begin MEASUREMENT MoCSOP_stMmRespCnt "" UBYTE RB_RBA_Common_CentralElements_CompuMethods_Identical 1 100 0.0 255.00 FORMAT "%8.2" ECU_ADDRESS 0xfe008b8c /end MEASUREMENT
/begin MEASUREMENT MoCSOP_stBusErr "" UBYTE RB_RBA_Common_CentralElements_CompuMethods_Identical 1 100 0.0 255.00 FORMAT "%8.2" ECU_ADDRESS 0xfe008b8d /end MEASUREMENT
/begin MEASUREMENT MoCSOP_sttiResp "" ULONG RB_RBA_Common_CentralElements_CompuMethods_Identical 1 100 0.0 4294967295 FORMAT "%8.2" ECU_ADDRESS 0xfe008b74 /end MEASUREMENT
/begin MEASUREMENT MoCSOP_stFWDF "" UBYTE RB_RBA_Common_CentralElements_CompuMethods_Identical 1 100 0.0 255.00 FORMAT "%8.2" ECU_ADDRESS 0xfe008b8e /end MEASUREMENT
/begin MEASUREMENT MoCSOP_stFWDE "" UBYTE RB_RBA_Common_CentralElements_CompuMethods_Identical 1 100 0.0 255.00 FORMAT "%8.2" ECU_ADDRESS 0xfe008b8f /end MEASUREMENT
/begin MEASUREMENT MoCSOP_stWDCFG0 "" UBYTE RB_RBA_Common_CentralElements_CompuMethods_Identical 1 100 0.0 255.00 FORMAT "%8.2" ECU_ADDRESS 0xfe008b90 /end MEASUREMENT
/begin MEASUREMENT MoCSOP_stWDCFG1 "" UBYTE RB_RBA_Common_CentralElements_CompuMethods_Identical 1 100 0.0 255.00 FORMAT "%8.2" ECU_ADDRESS 0xfe008b91 /end MEASUREMENT
/begin MEASUREMENT MoCSOP_stFWDCFG "" UBYTE RB_RBA_Common_CentralElements_CompuMethods_Identical 1 100 0.0 255.00 FORMAT "%8.2" ECU_ADDRESS 0xfe008b92 /end MEASUREMENT
/begin MEASUREMENT MoCSOP_stMCSMON "" UBYTE RB_RBA_Common_CentralElements_CompuMethods_Identical 1 100 0.0 255.00 FORMAT "%8.2" ECU_ADDRESS 0xfe008b93 /end MEASUREMENT
/begin MEASUREMENT MoCSOP_Response "" ULONG RB_RBA_Common_CentralElements_CompuMethods_Identical 1 100 0.0 4294967295 FORMAT "%8.2" ECU_ADDRESS 0xfe008b0c /end MEASUREMENT
/begin MEASUREMENT MoCSOP_stCntMMWrite "" UBYTE RB_RBA_Common_CentralElements_CompuMethods_Identical 1 100 0.0 255.00 FORMAT "%8.2" ECU_ADDRESS 0xfe008b96 /end MEASUREMENT
/begin MEASUREMENT MoCSOP_stMMNVMHndlr "" UBYTE RB_RBA_Common_CentralElements_CompuMethods_Identical 1 100 0.0 255.00 FORMAT "%8.2" ECU_ADDRESS 0xfe008b97 /end MEASUREMENT
/begin MEASUREMENT MoCSOP_ctErrNvm "" UBYTE RB_RBA_Common_CentralElements_CompuMethods_Identical 1 100 0.0 255.00 FORMAT "%8.2" ECU_ADDRESS 0xfe008b98 /end MEASUREMENT
/begin MEASUREMENT MoCSOP_stRWNvMTimeOut "" UBYTE RB_RBA_Common_CentralElements_CompuMethods_Identical 1 100 0.0 255.00 FORMAT "%8.2" ECU_ADDRESS 0xfe008b99 /end MEASUREMENT
/begin MEASUREMENT MoCSOP_ctBusErr "" UBYTE RB_RBA_Common_CentralElements_CompuMethods_Identical 1 100 0.0 255.00 FORMAT "%8.2" ECU_ADDRESS 0xfe008b9a /end MEASUREMENT
/begin MEASUREMENT MoCSOP_stDebugRcvrErrPin "" UBYTE RB_RBA_Common_CentralElements_CompuMethods_Identical 1 100 0.0 255.00 FORMAT "%8.2" ECU_ADDRESS 0xfe008b9b /end MEASUREMENT
/begin MEASUREMENT MoCSOP_ctDebMMErr "" UBYTE RB_RBA_Common_CentralElements_CompuMethods_Identical 1 100 0.0 255.00 FORMAT "%8.2" ECU_ADDRESS 0xfe008b9c /end MEASUREMENT
/begin MEASUREMENT MoCSOP_ctDebFCErr "" UBYTE RB_RBA_Common_CentralElements_CompuMethods_Identical 1 100 0.0 255.00 FORMAT "%8.2" ECU_ADDRESS 0xfe008b9d /end MEASUREMENT
/begin MEASUREMENT MoCSOP_stCntMMWriteCpl "" UBYTE RB_RBA_Common_CentralElements_CompuMethods_Identical 1 100 0.0 255.00 FORMAT "%8.2" ECU_ADDRESS 0xfe008b9e /end MEASUREMENT
/begin MEASUREMENT MoCSOP_ctErrNvmCpl "" UBYTE RB_RBA_Common_CentralElements_CompuMethods_Identical 1 100 0.0 255.00 FORMAT "%8.2" ECU_ADDRESS 0xfe008b9f /end MEASUREMENT
/begin MEASUREMENT MoCSOP_wdgTout "" ULONG RB_RBA_Common_CentralElements_CompuMethods_Identical 1 100 0.0 4294967295 FORMAT "%8.2" ECU_ADDRESS 0xfe037bb4 /end MEASUREMENT
/begin MEASUREMENT MoCSOP_stINITERR "" UBYTE RB_RBA_Common_CentralElements_CompuMethods_Identical 1 100 0.0 255.00 FORMAT "%8.2" ECU_ADDRESS 0xfe037bba /end MEASUREMENT
/begin MEASUREMENT MoCSOP_ctDebRstFailRelErrPin "" UBYTE RB_RBA_Common_CentralElements_CompuMethods_Identical 1 100 0.0 255.00 FORMAT "%8.2" ECU_ADDRESS 0xfe037bb9 /end MEASUREMENT
/begin MEASUREMENT MoCSOP_stRdyEth "" UBYTE RB_RBA_Common_CentralElements_CompuMethods_Identical 1 100 0.0 255.00 FORMAT "%8.2" ECU_ADDRESS 0xfe008ba3 /end MEASUREMENT
/begin MEASUREMENT MoCSOP_stRdyVfs "" UBYTE RB_RBA_Common_CentralElements_CompuMethods_Identical 1 100 0.0 255.00 FORMAT "%8.2" ECU_ADDRESS 0xfe008ba7 /end MEASUREMENT
/begin MEASUREMENT u_Emm_Ecc_GetCFState "" UBYTE RB_RBA_Common_CentralElements_CompuMethods_Identical 1 100 0.0 255.00 FORMAT "%8.2" ECU_ADDRESS 0x002cbeb6 /end MEASUREMENT
/begin MEASUREMENT gNMW_bNetChannelState "" UBYTE RB_RBA_Common_CentralElements_CompuMethods_Identical 1 100 0.0 255.00 FORMAT "%8.2" ARRAY_SIZE 52 ECU_ADDRESS 0xfe40a384 /end MEASUREMENT
/begin MEASUREMENT gNMW_bComMState "" UBYTE RB_RBA_Common_CentralElements_CompuMethods_Identical 1 100 0.0 255.00 FORMAT "%8.2" ARRAY_SIZE 52 ECU_ADDRESS 0xfe40a350 /end MEASUREMENT
/begin MEASUREMENT gNMW_bNetState "" UBYTE RB_RBA_Common_CentralElements_CompuMethods_Identical 1 100 0.0 255.00 FORMAT "%8.2" ECU_ADDRESS 0xfe40a272 /end MEASUREMENT
/begin MEASUREMENT gNMW_au8DiagNetActiveFlag "" UBYTE RB_RBA_Common_CentralElements_CompuMethods_Identical 1 100 0.0 255.00 FORMAT "%8.2" ARRAY_SIZE 4 ECU_ADDRESS 0xfe40a260 /end MEASUREMENT
/begin MEASUREMENT gNMW_au8DiagNetActiveSource "" UBYTE RB_RBA_Common_CentralElements_CompuMethods_Identical 1 100 0.0 255.00 FORMAT "%8.2" ARRAY_SIZE 12 ECU_ADDRESS 0xfe40a3ec /end MEASUREMENT
/begin MEASUREMENT NMW_WakseSrc_RamBlock_au8 "" UBYTE RB_RBA_Common_CentralElements_CompuMethods_Identical 1 100 0.0 255.00 FORMAT "%8.2" ARRAY_SIZE 100 ECU_ADDRESS 0xfe40a52c /end MEASUREMENT
/begin MEASUREMENT sNMW_u16PduDelayCnt "" UWORD RB_RBA_Common_CentralElements_CompuMethods_Identical 1 100 0.0 65535 FORMAT "%8.2" ARRAY_SIZE 16 ECU_ADDRESS 0xfe40a7bc /end MEASUREMENT
/begin MEASUREMENT gNMW_u8ComCanWakeCode "" UBYTE RB_RBA_Common_CentralElements_CompuMethods_Identical 1 100 0.0 255.00 FORMAT "%8.2" ECU_ADDRESS 0xfe40aff4 /end MEASUREMENT
/begin MEASUREMENT gNMW_u8ComCanWakeRecordFlag "" UBYTE RB_RBA_Common_CentralElements_CompuMethods_Identical 1 100 0.0 255.00 FORMAT "%8.2" ECU_ADDRESS 0xfe40aff5 /end MEASUREMENT
/begin MEASUREMENT gNMW_u8ComLinWakeCode "" UBYTE RB_RBA_Common_CentralElements_CompuMethods_Identical 1 100 0.0 255.00 FORMAT "%8.2" ECU_ADDRESS 0xfe40aff6 /end MEASUREMENT
/begin MEASUREMENT gNMW_u8ComLinWakeRecordFlag "" UBYTE RB_RBA_Common_CentralElements_CompuMethods_Identical 1 100 0.0 255.00 FORMAT "%8.2" ECU_ADDRESS 0xfe40aff7 /end MEASUREMENT
/begin MEASUREMENT gNMW_u8channelWakeTmp "" UBYTE RB_RBA_Common_CentralElements_CompuMethods_Identical 1 100 0.0 255.00 FORMAT "%8.2" ARRAY_SIZE 16 ECU_ADDRESS 0xfe40a7ec /end MEASUREMENT
/begin MEASUREMENT sNMW_u8ComCounterIrq "" UBYTE RB_RBA_Common_CentralElements_CompuMethods_Identical 1 100 0.0 255.00 FORMAT "%8.2" ARRAY_SIZE 16 ECU_ADDRESS 0xfe40a2c8 /end MEASUREMENT
/begin MEASUREMENT sNMW_u16ComTimeOutCounter "" UWORD RB_RBA_Common_CentralElements_CompuMethods_Identical 1 100 0.0 65535 FORMAT "%8.2" ARRAY_SIZE 16 ECU_ADDRESS 0xfe40a2d8 /end MEASUREMENT
/begin MEASUREMENT sNMW_u8ComFlagCounter "" UBYTE RB_RBA_Common_CentralElements_CompuMethods_Identical 1 100 0.0 255.00 FORMAT "%8.2" ARRAY_SIZE 16 ECU_ADDRESS 0xfe40a2f8 /end MEASUREMENT
/begin MEASUREMENT sNMW_u8ComFlagCounterBefore "" UBYTE RB_RBA_Common_CentralElements_CompuMethods_Identical 1 100 0.0 255.00 FORMAT "%8.2" ARRAY_SIZE 16 ECU_ADDRESS 0xfe40a308 /end MEASUREMENT
/begin MEASUREMENT sNMW_u8ComFlag "" UBYTE RB_RBA_Common_CentralElements_CompuMethods_Identical 1 100 0.0 255.00 FORMAT "%8.2" ARRAY_SIZE 16 ECU_ADDRESS 0xfe40a318 /end MEASUREMENT
/begin MEASUREMENT sNMW_u8AppActiveCode "" UBYTE RB_RBA_Common_CentralElements_CompuMethods_Identical 1 100 0.0 255.00 FORMAT "%8.2" ECU_ADDRESS 0xfe40a271 /end MEASUREMENT
/begin MEASUREMENT sNMW_u8WksCodingChn "" UBYTE RB_RBA_Common_CentralElements_CompuMethods_Identical 1 100 0.0 255.00 FORMAT "%8.2" ARRAY_SIZE 16 ECU_ADDRESS 0xfe40a3f8 /end MEASUREMENT
/begin MEASUREMENT gNMW_u8CanNMNetState "" UBYTE RB_RBA_Common_CentralElements_CompuMethods_Identical 1 100 0.0 255.00 FORMAT "%8.2" ECU_ADDRESS 0xfe40a7b8 /end MEASUREMENT
/begin MEASUREMENT sNMW_u64WakeSourceVFC "" A_UINT64 RB_RBA_Common_CentralElements_CompuMethods_Identical 1 100 0.0 18446744073709551615 FORMAT "%8.2" ECU_ADDRESS 0xfe40a7b0 /end MEASUREMENT
/begin MEASUREMENT sNMW_u8WakeSourceVFCAnalysis "" UBYTE RB_RBA_Common_CentralElements_CompuMethods_Identical 1 100 0.0 255.00 FORMAT "%8.2" ECU_ADDRESS 0xfe40a7b9 /end MEASUREMENT
/begin MEASUREMENT Test_NMSleppFlag_C "" UBYTE RB_RBA_Common_CentralElements_CompuMethods_Identical 1 100 0.0 255.00 FORMAT "%8.2" ECU_ADDRESS 0xfe417a7a /end MEASUREMENT
/begin MEASUREMENT NMW_vGenericPrecopy "" UBYTE RB_RBA_Common_CentralElements_CompuMethods_Identical 1 100 0.0 255.00 FORMAT "%8.2" ECU_ADDRESS 0x002433e0 /end MEASUREMENT
/begin MEASUREMENT NMW_vBattU_buExcdCANVoltRng "" UBYTE RB_RBA_Common_CentralElements_CompuMethods_Identical 1 100 0.0 255.00 FORMAT "%8.2" ECU_ADDRESS 0x0024319a /end MEASUREMENT
/begin MEASUREMENT u8NMW_GetPassiveWakeupFlag "" UWORD RB_RBA_Common_CentralElements_CompuMethods_Identical 1 100 0.0 65535 FORMAT "%8.2" ECU_ADDRESS 0x002431bc /end MEASUREMENT
/begin MEASUREMENT Syc_LastState_MP "" UBYTE RB_RBA_Common_CentralElements_CompuMethods_Identical 1 100 0.0 255.00 FORMAT "%8.2" ECU_ADDRESS 0xfe417a54 /end MEASUREMENT
/begin MEASUREMENT Syc_CurrentState_MP "" UBYTE RB_RBA_Common_CentralElements_CompuMethods_Identical 1 100 0.0 255.00 FORMAT "%8.2" ECU_ADDRESS 0xfe417a55 /end MEASUREMENT
/begin MEASUREMENT ModeM_u8WakeUpResetType "" UBYTE RB_RBA_Common_CentralElements_CompuMethods_Identical 1 100 0.0 255.00 FORMAT "%8.2" ECU_ADDRESS 0xfe446f9f /end MEASUREMENT
/begin MEASUREMENT Tlib_ModeM_ASW_Debug "" UBYTE RB_RBA_Common_CentralElements_CompuMethods_Identical 1 100 0.0 255.00 FORMAT "%8.2" ECU_ADDRESS 0xfe479dce /end MEASUREMENT
/begin MEASUREMENT Tlib_ModeM_gSAC_au8AllowSleepLocal "" UBYTE RB_RBA_Common_CentralElements_CompuMethods_Identical 1 100 0.0 255.00 FORMAT "%8.2" ARRAY_SIZE 4 ECU_ADDRESS 0xfe479db4 /end MEASUREMENT
/begin MEASUREMENT Tlib_ModeM_gSAC_u8AwakeSourceLocal "" UBYTE RB_RBA_Common_CentralElements_CompuMethods_Identical 1 100 0.0 255.00 FORMAT "%8.2" ECU_ADDRESS 0xfe417a56 /end MEASUREMENT
/begin MEASUREMENT Tlib_gANC_u8IgnitionState "" UBYTE RB_RBA_Common_CentralElements_CompuMethods_Identical 1 100 0.0 255.00 FORMAT "%8.2" ECU_ADDRESS 0xfe479dcf /end MEASUREMENT
/begin MEASUREMENT Tlib_gWDL_bAllowSleepFlag "" UBYTE RB_RBA_Common_CentralElements_CompuMethods_Identical 1 100 0.0 255.00 FORMAT "%8.2" ECU_ADDRESS 0xfe479dd0 /end MEASUREMENT
/begin MEASUREMENT Tlib_gHORN_bFrontAllowSleep "" UBYTE RB_RBA_Common_CentralElements_CompuMethods_Identical 1 100 0.0 255.00 FORMAT "%8.2" ECU_ADDRESS 0xfe479dd1 /end MEASUREMENT
/begin MEASUREMENT Tlib_gALC_u16AllowSleep "" UWORD RB_RBA_Common_CentralElements_CompuMethods_Identical 1 100 0.0 65535 FORMAT "%8.2" ECU_ADDRESS 0xfe479dbc /end MEASUREMENT
/begin MEASUREMENT Tlib_gHVAC_u8HVACStepperAllowSleep "" UBYTE RB_RBA_Common_CentralElements_CompuMethods_Identical 1 100 0.0 255.00 FORMAT "%8.2" ECU_ADDRESS 0xfe479dd2 /end MEASUREMENT
/begin MEASUREMENT Tlib_EFuse_u8RightAllowSleep "" UBYTE RB_RBA_Common_CentralElements_CompuMethods_Identical 1 100 0.0 255.00 FORMAT "%8.2" ECU_ADDRESS 0xfe479dd3 /end MEASUREMENT
/begin MEASUREMENT Tlib_EFuse_u8FrontAllowSleep "" UBYTE RB_RBA_Common_CentralElements_CompuMethods_Identical 1 100 0.0 255.00 FORMAT "%8.2" ECU_ADDRESS 0xfe479dd4 /end MEASUREMENT
/begin MEASUREMENT Tlib_EFuse_u8LeftAllowSleep "" UBYTE RB_RBA_Common_CentralElements_CompuMethods_Identical 1 100 0.0 255.00 FORMAT "%8.2" ECU_ADDRESS 0xfe479dd5 /end MEASUREMENT
/begin MEASUREMENT Tlib_gEXL_u16LeftAllowSleep "" UWORD RB_RBA_Common_CentralElements_CompuMethods_Identical 1 100 0.0 65535 FORMAT "%8.2" ECU_ADDRESS 0xfe479dbe /end MEASUREMENT
/begin MEASUREMENT Tlib_gEXL_u16FrontAllowSleep "" UWORD RB_RBA_Common_CentralElements_CompuMethods_Identical 1 100 0.0 65535 FORMAT "%8.2" ECU_ADDRESS 0xfe479dc0 /end MEASUREMENT
/begin MEASUREMENT Tlib_gINL_u16LeftAllowSleep "" UWORD RB_RBA_Common_CentralElements_CompuMethods_Identical 1 100 0.0 65535 FORMAT "%8.2" ECU_ADDRESS 0xfe479dc2 /end MEASUREMENT
/begin MEASUREMENT Tlib_gINL_u16RightAllowSleep "" UWORD RB_RBA_Common_CentralElements_CompuMethods_Identical 1 100 0.0 65535 FORMAT "%8.2" ECU_ADDRESS 0xfe479dc4 /end MEASUREMENT
/begin MEASUREMENT Tlib_gLOC_u16LeftAllowSleep "" UWORD RB_RBA_Common_CentralElements_CompuMethods_Identical 1 100 0.0 65535 FORMAT "%8.2" ECU_ADDRESS 0xfe479dc6 /end MEASUREMENT
/begin MEASUREMENT Tlib_gLOC_u16RightAllowSleep "" UWORD RB_RBA_Common_CentralElements_CompuMethods_Identical 1 100 0.0 65535 FORMAT "%8.2" ECU_ADDRESS 0xfe479dc8 /end MEASUREMENT
/begin MEASUREMENT Tlib_gWIP_u16RearWiperAllowSleep "" UWORD RB_RBA_Common_CentralElements_CompuMethods_Identical 1 100 0.0 65535 FORMAT "%8.2" ECU_ADDRESS 0xfe479dca /end MEASUREMENT
/begin MEASUREMENT Tlib_gWIP_u16FrontWiperAllowSleep "" UWORD RB_RBA_Common_CentralElements_CompuMethods_Identical 1 100 0.0 65535 FORMAT "%8.2" ECU_ADDRESS 0xfe479dcc /end MEASUREMENT
/begin MEASUREMENT Tlib_gDebug_bAllowSleepFlag "" UBYTE RB_RBA_Common_CentralElements_CompuMethods_Identical 1 100 0.0 255.00 FORMAT "%8.2" ECU_ADDRESS 0xfe417a57 /end MEASUREMENT
/begin MEASUREMENT Tlib_gDebug_bCANKeepRunFlag "" UBYTE RB_RBA_Common_CentralElements_CompuMethods_Identical 1 100 0.0 255.00 FORMAT "%8.2" ECU_ADDRESS 0xfe417a58 /end MEASUREMENT
/begin MEASUREMENT Tlib_ModeM_PowerModeState "" UBYTE RB_RBA_Common_CentralElements_CompuMethods_Identical 1 100 0.0 255.00 FORMAT "%8.2" ECU_ADDRESS 0xfe479dd6 /end MEASUREMENT
/begin MEASUREMENT Tlib_ModeM_bPollingKeepAlive "" UBYTE RB_RBA_Common_CentralElements_CompuMethods_Identical 1 100 0.0 255.00 FORMAT "%8.2" ECU_ADDRESS 0xfe479dd7 /end MEASUREMENT
/begin MEASUREMENT Tlib_ModeM_bPollingState "" UBYTE RB_RBA_Common_CentralElements_CompuMethods_Identical 1 100 0.0 255.00 FORMAT "%8.2" ECU_ADDRESS 0xfe479dd8 /end MEASUREMENT
/begin MEASUREMENT Tlib_ModeM_u32PollingPeriod "" ULONG RB_RBA_Common_CentralElements_CompuMethods_Identical 1 100 0.0 4294967295 FORMAT "%8.2" ECU_ADDRESS 0xfe479db8 /end MEASUREMENT
/begin MEASUREMENT Tlib_change_log "" UBYTE RB_RBA_Common_CentralElements_CompuMethods_Identical 1 100 0.0 255.00 FORMAT "%8.2" ARRAY_SIZE 112 ECU_ADDRESS 0xfe479d3c /end MEASUREMENT
/begin MEASUREMENT Tlib_change_log_len "" UBYTE RB_RBA_Common_CentralElements_CompuMethods_Identical 1 100 0.0 255.00 FORMAT "%8.2" ECU_ADDRESS 0xfe479dd9 /end MEASUREMENT
/begin MEASUREMENT Tlib_bchange_log_test "" UBYTE RB_RBA_Common_CentralElements_CompuMethods_Identical 1 100 0.0 255.00 FORMAT "%8.2" ECU_ADDRESS 0xfe479dda /end MEASUREMENT
/begin MEASUREMENT Tlib_ModeM_bZCWorkRequest "" UBYTE RB_RBA_Common_CentralElements_CompuMethods_Identical 1 100 0.0 255.00 FORMAT "%8.2" ECU_ADDRESS 0xfe479ddb /end MEASUREMENT
/begin MEASUREMENT Tlib_gDebug_bLINKeepRunFlag "" UBYTE RB_RBA_Common_CentralElements_CompuMethods_Identical 1 100 0.0 255.00 FORMAT "%8.2" ECU_ADDRESS 0xfe479ddd /end MEASUREMENT
/begin MEASUREMENT Tlib_ModeM_PowerID "" UBYTE RB_RBA_Common_CentralElements_CompuMethods_Identical 1 100 0.0 255.00 FORMAT "%8.2" ECU_ADDRESS 0xfe479dde /end MEASUREMENT
/begin MEASUREMENT Tlib_ModeM_u8ZCWorkRequestList "" UBYTE RB_RBA_Common_CentralElements_CompuMethods_Identical 1 100 0.0 255.00 FORMAT "%8.2" ARRAY_SIZE 8 ECU_ADDRESS 0xfe479dac /end MEASUREMENT
/begin MEASUREMENT Tlib_BypassSourceID "" UBYTE RB_RBA_Common_CentralElements_CompuMethods_Identical 1 100 0.0 255.00 FORMAT "%8.2" ECU_ADDRESS 0xfe417a59 /end MEASUREMENT
/begin MEASUREMENT Tlib_bypassSwitch "" UBYTE RB_RBA_Common_CentralElements_CompuMethods_Identical 1 100 0.0 255.00 FORMAT "%8.2" ECU_ADDRESS 0xfe417a5a /end MEASUREMENT
/begin MEASUREMENT Tlib_ModeM_gSAC_u32AllowSleepLocal "" ULONG RB_RBA_Common_CentralElements_CompuMethods_Identical 1 100 0.0 4294967295 FORMAT "%8.2" ECU_ADDRESS 0xfe417a50 /end MEASUREMENT
/begin MEASUREMENT Tlib_Switch_ETH1000_1_2_Status "" UWORD RB_RBA_Common_CentralElements_CompuMethods_Identical 1 100 0.0 65535 FORMAT "%8.2" ECU_ADDRESS 0xfe40644c /end MEASUREMENT
/begin MEASUREMENT Tlib_Switch_ETH100_3_4_Status "" UWORD RB_RBA_Common_CentralElements_CompuMethods_Identical 1 100 0.0 65535 FORMAT "%8.2" ECU_ADDRESS 0xfe40644e /end MEASUREMENT
/begin MEASUREMENT Tlib_Switch_ETH100_5_PHY_Status "" UWORD RB_RBA_Common_CentralElements_CompuMethods_Identical 1 100 0.0 65535 FORMAT "%8.2" ECU_ADDRESS 0xfe406450 /end MEASUREMENT
/begin MEASUREMENT Tlib_IoExtE3731i_CountLed "" UWORD RB_RBA_Common_CentralElements_CompuMethods_Identical 1 100 0.0 65535 FORMAT "%8.2" ECU_ADDRESS 0xfe4060fa /end MEASUREMENT
/begin MEASUREMENT Tlib_IoExtE3731i_AddressGetID "" UWORD RB_RBA_Common_CentralElements_CompuMethods_Identical 1 100 0.0 65535 FORMAT "%8.2" ARRAY_SIZE 6 ECU_ADDRESS 0xfe406118 /end MEASUREMENT
/begin MEASUREMENT Tlib_IoExtE3731i_TempGetID "" ULONG RB_RBA_Common_CentralElements_CompuMethods_Identical 1 100 0.0 4294967295 FORMAT "%8.2" ARRAY_SIZE 5 ECU_ADDRESS 0xfe406104 /end MEASUREMENT
/begin MEASUREMENT IoExtE3731i_Job_Schedule_Ctnr "" UBYTE RB_RBA_Common_CentralElements_CompuMethods_Identical 1 100 0.0 255.00 FORMAT "%8.2" ECU_ADDRESS 0xfe4060fe /end MEASUREMENT
/begin MEASUREMENT IoExtE3731i_TempReq_RgbiId "" UWORD RB_RBA_Common_CentralElements_CompuMethods_Identical 1 100 0.0 65535 FORMAT "%8.2" ARRAY_SIZE 12 ECU_ADDRESS 0xfe433cf0 /end MEASUREMENT
/begin MEASUREMENT IoExtE3731i_5V_AD_VALUE "" SWORD RB_RBA_Common_CentralElements_CompuMethods_Identical 1 100 -32768 32767 FORMAT "%8.2" ECU_ADDRESS 0xfe4060fc /end MEASUREMENT
/begin MEASUREMENT IoExtE3731i_u8Power_Supply_Flg "" UBYTE RB_RBA_Common_CentralElements_CompuMethods_Identical 1 100 0.0 255.00 FORMAT "%8.2" ECU_ADDRESS 0xfe4060ff /end MEASUREMENT
/begin MEASUREMENT IoExtE3731i_5V_EN "" UBYTE RB_RBA_Common_CentralElements_CompuMethods_Identical 1 100 0.0 255.00 FORMAT "%8.2" ECU_ADDRESS 0xfe406100 /end MEASUREMENT
/begin MEASUREMENT Test_E3731i_TempReqID "" UWORD RB_RBA_Common_CentralElements_CompuMethods_Identical 1 100 0.0 65535 FORMAT "%8.2" ARRAY_SIZE 6 ECU_ADDRESS 0xfe406124 /end MEASUREMENT
/begin MEASUREMENT Test_E3731i_TempShift "" UBYTE RB_RBA_Common_CentralElements_CompuMethods_Identical 1 100 0.0 255.00 FORMAT "%8.2" ECU_ADDRESS 0xfe406101 /end MEASUREMENT
/begin MEASUREMENT IoExtE3731i_Test1 "" UBYTE RB_RBA_Common_CentralElements_CompuMethods_Identical 1 100 0.0 255.00 FORMAT "%8.2" ECU_ADDRESS 0xfe406102 /end MEASUREMENT
/*********** End of merged FUNCTION blocks ***********/ /*********** Start of merged COMPU_METHOD blocks ***********/
/begin COMPU_METHOD RB_RBA_Common_CentralElements_CompuMethods_Identical "The internal value and the physical one are identical. No physical unit available" RAT_FUNC "%10.5" "noUnit" COEFFS 0.0 1.0 0.0 0.0 0.0 1.0 REF_UNIT RB_RBA_Common_CentralElements_Units_NoUnit /end COMPU_METHOD
/*********** Start of merged UNIT blocks ***********/
/begin UNIT RB_RBA_Common_CentralElements_Units_NoUnit "No Unit" "noUnit" EXTENDED_SI SI_EXPONENTS 0 0 0 0 0 0 0 /end UNIT
/begin UNIT RB_RBA_rba_OsShell_Units_Perc "Percent" "%" EXTENDED_SI /end UNIT
/begin UNIT RB_RBA_rba_OsShell_Units_NoUnit "No Unit" "noUnit" EXTENDED_SI SI_EXPONENTS 0 0 0 0 0 0 0 /end UNIT
/begin UNIT RB_RBA_rba_Reset_Units_NoUnit "No Unit" "noUnit" EXTENDED_SI SI_EXPONENTS 0 0 0 0 0 0 0 /end UNIT
/begin UNIT RB_RBA_rba_SyC_Rtc_Units_NoUnit "No Unit" "nounit" EXTENDED_SI SI_EXPONENTS 0 0 0 0 0 0 0 /end UNIT
/begin UNIT RB_RBA_rba_T15_Units_NoUnit "No Unit" "nounit" EXTENDED_SI SI_EXPONENTS 0 0 0 0 0 0 0 /end UNIT
/begin UNIT RB_RBA_rba_T15_Units_ms "Millisecond" "ms" EXTENDED_SI SI_EXPONENTS 0 0 1 0 0 0 0 /end UNIT
/end MODULE
/end PROJECT
