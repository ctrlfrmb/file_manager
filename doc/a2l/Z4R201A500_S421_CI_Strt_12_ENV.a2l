ASAP2_VERSION 1 61
/begin PROJECT ZCU "ZCU"
/begin HEADER "" VERSION "ZCU" PROJECT_NO ZCU /end HEADER
/begin MODULE DIM ""
/begin MOD_COMMON "" BYTE_ORDER MSB_LAST ALIGNMENT_BYTE 1 ALIGNMENT_WORD 2 ALIGNMENT_LONG 4 ALIGNMENT_INT64 4 ALIGNMENT_FLOAT32_IEEE 4 ALIGNMENT_FLOAT64_IEEE 4 DATA_SIZE 32 /end MOD_COMMON
/begin MEASUREMENT Tlib_Efuse_L3_GetCurrent_Val_I_C_ODH63 "" ULONG RB_RBA_Common_CentralElements_CompuMethods_Identical 1 100 0.0 4294967295 FORMAT "%8.2" ECU_ADDRESS 0xfe417c7c /end MEASUREMENT
/begin MEASUREMENT Tlib_Efuse_L3_GetVoltage_Val_O_S_ODH63 "" UWORD RB_RBA_Common_CentralElements_CompuMethods_Identical 1 100 0.0 65535 FORMAT "%8.2" ECU_ADDRESS 0xfe419706 /end MEASUREMENT
/begin MEASUREMENT Tlib_DoVoltage_L3_Get_FilterVal_O_S_ODH63 "" UBYTE RB_RBA_Common_CentralElements_CompuMethods_Identical 1 100 0.0 255.00 FORMAT "%8.2" ECU_ADDRESS 0xfe4198b7 /end MEASUREMENT
/begin MEASUREMENT Tlib_DO_L3_DIAG_Get_Val_O_S_ODH63 "" UWORD RB_RBA_Common_CentralElements_CompuMethods_Identical 1 100 0.0 65535 FORMAT "%8.2" ECU_ADDRESS 0xfe419708 /end MEASUREMENT
/begin MEASUREMENT Tlib_DIO_L3_GetStatus_Val_O_S_ODH64 "" UBYTE RB_RBA_Common_CentralElements_CompuMethods_Identical 1 100 0.0 255.00 FORMAT "%8.2" ECU_ADDRESS 0xfe4198b8 /end MEASUREMENT
/begin MEASUREMENT Tlib_Efuse_L3_GetCurrent_Val_I_C_ODH64 "" ULONG RB_RBA_Common_CentralElements_CompuMethods_Identical 1 100 0.0 4294967295 FORMAT "%8.2" ECU_ADDRESS 0xfe417c80 /end MEASUREMENT
/begin MEASUREMENT Tlib_Efuse_L3_GetVoltage_Val_O_S_ODH64 "" UWORD RB_RBA_Common_CentralElements_CompuMethods_Identical 1 100 0.0 65535 FORMAT "%8.2" ECU_ADDRESS 0xfe41970a /end MEASUREMENT
/begin MEASUREMENT Tlib_DoVoltage_L3_Get_FilterVal_O_S_ODH64 "" UBYTE RB_RBA_Common_CentralElements_CompuMethods_Identical 1 100 0.0 255.00 FORMAT "%8.2" ECU_ADDRESS 0xfe4198b9 /end MEASUREMENT
/begin MEASUREMENT Tlib_DO_L3_DIAG_Get_Val_O_S_ODH64 "" UWORD RB_RBA_Common_CentralElements_CompuMethods_Identical 1 100 0.0 65535 FORMAT "%8.2" ECU_ADDRESS 0xfe41970c /end MEASUREMENT
/begin MEASUREMENT Tlib_DIO_L3_GetStatus_Val_O_S_ODH106 "" UBYTE RB_RBA_Common_CentralElements_CompuMethods_Identical 1 100 0.0 255.00 FORMAT "%8.2" ECU_ADDRESS 0xfe4198ba /end MEASUREMENT
/begin MEASUREMENT Tlib_Efuse_L3_GetCurrent_Val_I_C_ODH106 "" ULONG RB_RBA_Common_CentralElements_CompuMethods_Identical 1 100 0.0 4294967295 FORMAT "%8.2" ECU_ADDRESS 0xfe417c84 /end MEASUREMENT
/begin MEASUREMENT Tlib_Efuse_L3_GetVoltage_Val_O_S_ODH106 "" UWORD RB_RBA_Common_CentralElements_CompuMethods_Identical 1 100 0.0 65535 FORMAT "%8.2" ECU_ADDRESS 0xfe41970e /end MEASUREMENT
/begin MEASUREMENT Tlib_DoVoltage_L3_Get_FilterVal_O_S_ODH106 "" UBYTE RB_RBA_Common_CentralElements_CompuMethods_Identical 1 100 0.0 255.00 FORMAT "%8.2" ECU_ADDRESS 0xfe4198bb /end MEASUREMENT
/begin MEASUREMENT Tlib_DO_L3_DIAG_Get_Val_O_S_ODH106 "" UWORD RB_RBA_Common_CentralElements_CompuMethods_Identical 1 100 0.0 65535 FORMAT "%8.2" ECU_ADDRESS 0xfe419710 /end MEASUREMENT
/begin MEASUREMENT Tlib_DIO_L3_GetStatus_Val_O_S_ODH40 "" UBYTE RB_RBA_Common_CentralElements_CompuMethods_Identical 1 100 0.0 255.00 FORMAT "%8.2" ECU_ADDRESS 0xfe4198bc /end MEASUREMENT
/begin MEASUREMENT Tlib_Efuse_L3_GetCurrent_Val_I_C_ODH40 "" ULONG RB_RBA_Common_CentralElements_CompuMethods_Identical 1 100 0.0 4294967295 FORMAT "%8.2" ECU_ADDRESS 0xfe417c88 /end MEASUREMENT
/begin MEASUREMENT Tlib_Efuse_L3_GetVoltage_Val_O_S_ODH40 "" UWORD RB_RBA_Common_CentralElements_CompuMethods_Identical 1 100 0.0 65535 FORMAT "%8.2" ECU_ADDRESS 0xfe419712 /end MEASUREMENT
/begin MEASUREMENT Tlib_DoVoltage_L3_Get_FilterVal_O_S_ODH40 "" UBYTE RB_RBA_Common_CentralElements_CompuMethods_Identical 1 100 0.0 255.00 FORMAT "%8.2" ECU_ADDRESS 0xfe4198bd /end MEASUREMENT
/begin MEASUREMENT Tlib_DO_L3_DIAG_Get_Val_O_S_ODH40 "" UWORD RB_RBA_Common_CentralElements_CompuMethods_Identical 1 100 0.0 65535 FORMAT "%8.2" ECU_ADDRESS 0xfe419714 /end MEASUREMENT
/begin MEASUREMENT Tlib_DIO_L3_GetStatus_Val_O_S_EFUSE27 "" UBYTE RB_RBA_Common_CentralElements_CompuMethods_Identical 1 100 0.0 255.00 FORMAT "%8.2" ECU_ADDRESS 0xfe4198be /end MEASUREMENT
/begin MEASUREMENT Tlib_Efuse_L3_GetCurrent_Val_I_C_EFUSE27 "" ULONG RB_RBA_Common_CentralElements_CompuMethods_Identical 1 100 0.0 4294967295 FORMAT "%8.2" ECU_ADDRESS 0xfe417c8c /end MEASUREMENT
/begin MEASUREMENT Tlib_Efuse_L3_GetVoltage_Val_O_S_EFUSE27 "" UWORD RB_RBA_Common_CentralElements_CompuMethods_Identical 1 100 0.0 65535 FORMAT "%8.2" ECU_ADDRESS 0xfe419716 /end MEASUREMENT
/begin MEASUREMENT Tlib_DoVoltage_L3_Get_FilterVal_O_S_EFUSE27 "" UBYTE RB_RBA_Common_CentralElements_CompuMethods_Identical 1 100 0.0 255.00 FORMAT "%8.2" ECU_ADDRESS 0xfe4198bf /end MEASUREMENT
/begin MEASUREMENT Tlib_DO_L3_DIAG_Get_Val_O_S_EFUSE27 "" UWORD RB_RBA_Common_CentralElements_CompuMethods_Identical 1 100 0.0 65535 FORMAT "%8.2" ECU_ADDRESS 0xfe419718 /end MEASUREMENT
/begin MEASUREMENT Tlib_DIO_L3_GetStatus_Val_O_S_ODH88 "" UBYTE RB_RBA_Common_CentralElements_CompuMethods_Identical 1 100 0.0 255.00 FORMAT "%8.2" ECU_ADDRESS 0xfe4198c0 /end MEASUREMENT
/begin MEASUREMENT Tlib_Efuse_L3_GetCurrent_Val_I_C_ODH88 "" ULONG RB_RBA_Common_CentralElements_CompuMethods_Identical 1 100 0.0 4294967295 FORMAT "%8.2" ECU_ADDRESS 0xfe417c90 /end MEASUREMENT
/begin MEASUREMENT Tlib_Efuse_L3_GetVoltage_Val_O_S_ODH88 "" UWORD RB_RBA_Common_CentralElements_CompuMethods_Identical 1 100 0.0 65535 FORMAT "%8.2" ECU_ADDRESS 0xfe41971a /end MEASUREMENT
/begin MEASUREMENT Tlib_DoVoltage_L3_Get_FilterVal_O_S_ODH88 "" UBYTE RB_RBA_Common_CentralElements_CompuMethods_Identical 1 100 0.0 255.00 FORMAT "%8.2" ECU_ADDRESS 0xfe4198c1 /end MEASUREMENT
/begin MEASUREMENT Tlib_DO_L3_DIAG_Get_Val_O_S_ODH88 "" UWORD RB_RBA_Common_CentralElements_CompuMethods_Identical 1 100 0.0 65535 FORMAT "%8.2" ECU_ADDRESS 0xfe41971c /end MEASUREMENT
/begin MEASUREMENT Tlib_DIO_L3_GetStatus_Val_O_S_ODH89 "" UBYTE RB_RBA_Common_CentralElements_CompuMethods_Identical 1 100 0.0 255.00 FORMAT "%8.2" ECU_ADDRESS 0xfe4198c2 /end MEASUREMENT
/begin MEASUREMENT Tlib_Efuse_L3_GetCurrent_Val_I_C_ODH89 "" ULONG RB_RBA_Common_CentralElements_CompuMethods_Identical 1 100 0.0 4294967295 FORMAT "%8.2" ECU_ADDRESS 0xfe417c94 /end MEASUREMENT
/begin MEASUREMENT Tlib_Efuse_L3_GetVoltage_Val_O_S_ODH89 "" UWORD RB_RBA_Common_CentralElements_CompuMethods_Identical 1 100 0.0 65535 FORMAT "%8.2" ECU_ADDRESS 0xfe41971e /end MEASUREMENT
/begin MEASUREMENT Tlib_DoVoltage_L3_Get_FilterVal_O_S_ODH89 "" UBYTE RB_RBA_Common_CentralElements_CompuMethods_Identical 1 100 0.0 255.00 FORMAT "%8.2" ECU_ADDRESS 0xfe4198c3 /end MEASUREMENT
/begin MEASUREMENT Tlib_DO_L3_DIAG_Get_Val_O_S_ODH89 "" UWORD RB_RBA_Common_CentralElements_CompuMethods_Identical 1 100 0.0 65535 FORMAT "%8.2" ECU_ADDRESS 0xfe419720 /end MEASUREMENT
/begin MEASUREMENT Tlib_DIO_L3_GetStatus_Val_O_S_ODH90 "" UBYTE RB_RBA_Common_CentralElements_CompuMethods_Identical 1 100 0.0 255.00 FORMAT "%8.2" ECU_ADDRESS 0xfe4198c4 /end MEASUREMENT
/begin MEASUREMENT Tlib_Efuse_L3_GetCurrent_Val_I_C_ODH90 "" ULONG RB_RBA_Common_CentralElements_CompuMethods_Identical 1 100 0.0 4294967295 FORMAT "%8.2" ECU_ADDRESS 0xfe417c98 /end MEASUREMENT
/begin MEASUREMENT Tlib_Efuse_L3_GetVoltage_Val_O_S_ODH90 "" UWORD RB_RBA_Common_CentralElements_CompuMethods_Identical 1 100 0.0 65535 FORMAT "%8.2" ECU_ADDRESS 0xfe419722 /end MEASUREMENT
/begin MEASUREMENT Tlib_DoVoltage_L3_Get_FilterVal_O_S_ODH90 "" UBYTE RB_RBA_Common_CentralElements_CompuMethods_Identical 1 100 0.0 255.00 FORMAT "%8.2" ECU_ADDRESS 0xfe4198c5 /end MEASUREMENT
/begin MEASUREMENT Tlib_DO_L3_DIAG_Get_Val_O_S_ODH90 "" UWORD RB_RBA_Common_CentralElements_CompuMethods_Identical 1 100 0.0 65535 FORMAT "%8.2" ECU_ADDRESS 0xfe419724 /end MEASUREMENT
/begin MEASUREMENT Tlib_DIO_L3_GetStatus_Val_O_S_ODH114 "" UBYTE RB_RBA_Common_CentralElements_CompuMethods_Identical 1 100 0.0 255.00 FORMAT "%8.2" ECU_ADDRESS 0xfe4198c6 /end MEASUREMENT
/begin MEASUREMENT Tlib_Efuse_L3_GetCurrent_Val_I_C_ODH114 "" ULONG RB_RBA_Common_CentralElements_CompuMethods_Identical 1 100 0.0 4294967295 FORMAT "%8.2" ECU_ADDRESS 0xfe417c9c /end MEASUREMENT
/begin MEASUREMENT Tlib_Efuse_L3_GetVoltage_Val_O_S_ODH114 "" UWORD RB_RBA_Common_CentralElements_CompuMethods_Identical 1 100 0.0 65535 FORMAT "%8.2" ECU_ADDRESS 0xfe419726 /end MEASUREMENT
/begin MEASUREMENT Tlib_DoVoltage_L3_Get_FilterVal_O_S_ODH114 "" UBYTE RB_RBA_Common_CentralElements_CompuMethods_Identical 1 100 0.0 255.00 FORMAT "%8.2" ECU_ADDRESS 0xfe4198c7 /end MEASUREMENT
/begin MEASUREMENT Tlib_DO_L3_DIAG_Get_Val_O_S_ODH114 "" UWORD RB_RBA_Common_CentralElements_CompuMethods_Identical 1 100 0.0 65535 FORMAT "%8.2" ECU_ADDRESS 0xfe419728 /end MEASUREMENT
/begin MEASUREMENT Tlib_DIO_L3_GetStatus_Val_O_S_ODH92 "" UBYTE RB_RBA_Common_CentralElements_CompuMethods_Identical 1 100 0.0 255.00 FORMAT "%8.2" ECU_ADDRESS 0xfe4198c8 /end MEASUREMENT
/begin MEASUREMENT Tlib_Efuse_L3_GetCurrent_Val_I_C_ODH92 "" ULONG RB_RBA_Common_CentralElements_CompuMethods_Identical 1 100 0.0 4294967295 FORMAT "%8.2" ECU_ADDRESS 0xfe417ca0 /end MEASUREMENT
/begin MEASUREMENT Tlib_Efuse_L3_GetVoltage_Val_O_S_ODH92 "" UWORD RB_RBA_Common_CentralElements_CompuMethods_Identical 1 100 0.0 65535 FORMAT "%8.2" ECU_ADDRESS 0xfe41972a /end MEASUREMENT
/begin MEASUREMENT Tlib_DoVoltage_L3_Get_FilterVal_O_S_ODH92 "" UBYTE RB_RBA_Common_CentralElements_CompuMethods_Identical 1 100 0.0 255.00 FORMAT "%8.2" ECU_ADDRESS 0xfe4198c9 /end MEASUREMENT
/begin MEASUREMENT Tlib_DO_L3_DIAG_Get_Val_O_S_ODH92 "" UWORD RB_RBA_Common_CentralElements_CompuMethods_Identical 1 100 0.0 65535 FORMAT "%8.2" ECU_ADDRESS 0xfe41972c /end MEASUREMENT
/begin MEASUREMENT Tlib_DIO_L3_GetStatus_Val_O_S_ODH93 "" UBYTE RB_RBA_Common_CentralElements_CompuMethods_Identical 1 100 0.0 255.00 FORMAT "%8.2" ECU_ADDRESS 0xfe4198ca /end MEASUREMENT
/begin MEASUREMENT Tlib_Efuse_L3_GetCurrent_Val_I_C_ODH93 "" ULONG RB_RBA_Common_CentralElements_CompuMethods_Identical 1 100 0.0 4294967295 FORMAT "%8.2" ECU_ADDRESS 0xfe417ca4 /end MEASUREMENT
/begin MEASUREMENT Tlib_Efuse_L3_GetVoltage_Val_O_S_ODH93 "" UWORD RB_RBA_Common_CentralElements_CompuMethods_Identical 1 100 0.0 65535 FORMAT "%8.2" ECU_ADDRESS 0xfe41972e /end MEASUREMENT
/begin MEASUREMENT Tlib_DoVoltage_L3_Get_FilterVal_O_S_ODH93 "" UBYTE RB_RBA_Common_CentralElements_CompuMethods_Identical 1 100 0.0 255.00 FORMAT "%8.2" ECU_ADDRESS 0xfe4198cb /end MEASUREMENT
/begin MEASUREMENT Tlib_DO_L3_DIAG_Get_Val_O_S_ODH93 "" UWORD RB_RBA_Common_CentralElements_CompuMethods_Identical 1 100 0.0 65535 FORMAT "%8.2" ECU_ADDRESS 0xfe419730 /end MEASUREMENT
/begin MEASUREMENT Tlib_DIO_L3_GetStatus_Val_O_S_ODH95 "" UBYTE RB_RBA_Common_CentralElements_CompuMethods_Identical 1 100 0.0 255.00 FORMAT "%8.2" ECU_ADDRESS 0xfe4198cc /end MEASUREMENT
/begin MEASUREMENT Tlib_Efuse_L3_GetCurrent_Val_I_C_ODH95 "" ULONG RB_RBA_Common_CentralElements_CompuMethods_Identical 1 100 0.0 4294967295 FORMAT "%8.2" ECU_ADDRESS 0xfe417ca8 /end MEASUREMENT
/begin MEASUREMENT Tlib_Efuse_L3_GetVoltage_Val_O_S_ODH95 "" UWORD RB_RBA_Common_CentralElements_CompuMethods_Identical 1 100 0.0 65535 FORMAT "%8.2" ECU_ADDRESS 0xfe419732 /end MEASUREMENT
/begin MEASUREMENT Tlib_DoVoltage_L3_Get_FilterVal_O_S_ODH95 "" UBYTE RB_RBA_Common_CentralElements_CompuMethods_Identical 1 100 0.0 255.00 FORMAT "%8.2" ECU_ADDRESS 0xfe4198cd /end MEASUREMENT
/begin MEASUREMENT Tlib_DO_L3_DIAG_Get_Val_O_S_ODH95 "" UWORD RB_RBA_Common_CentralElements_CompuMethods_Identical 1 100 0.0 65535 FORMAT "%8.2" ECU_ADDRESS 0xfe419734 /end MEASUREMENT
/begin MEASUREMENT Tlib_DIO_L3_GetStatus_Val_O_S_ODH51 "" UBYTE RB_RBA_Common_CentralElements_CompuMethods_Identical 1 100 0.0 255.00 FORMAT "%8.2" ECU_ADDRESS 0xfe4198ce /end MEASUREMENT
/begin MEASUREMENT Tlib_Efuse_L3_GetCurrent_Val_I_C_ODH51 "" ULONG RB_RBA_Common_CentralElements_CompuMethods_Identical 1 100 0.0 4294967295 FORMAT "%8.2" ECU_ADDRESS 0xfe417cac /end MEASUREMENT
/begin MEASUREMENT Tlib_Efuse_L3_GetVoltage_Val_O_S_ODH51 "" UWORD RB_RBA_Common_CentralElements_CompuMethods_Identical 1 100 0.0 65535 FORMAT "%8.2" ECU_ADDRESS 0xfe419736 /end MEASUREMENT
/begin MEASUREMENT Tlib_DoVoltage_L3_Get_FilterVal_O_S_ODH51 "" UBYTE RB_RBA_Common_CentralElements_CompuMethods_Identical 1 100 0.0 255.00 FORMAT "%8.2" ECU_ADDRESS 0xfe4198cf /end MEASUREMENT
/begin MEASUREMENT Tlib_DO_L3_DIAG_Get_Val_O_S_ODH51 "" UWORD RB_RBA_Common_CentralElements_CompuMethods_Identical 1 100 0.0 65535 FORMAT "%8.2" ECU_ADDRESS 0xfe419738 /end MEASUREMENT
/begin MEASUREMENT Tlib_DIO_L3_GetStatus_Val_O_S_ODH99 "" UBYTE RB_RBA_Common_CentralElements_CompuMethods_Identical 1 100 0.0 255.00 FORMAT "%8.2" ECU_ADDRESS 0xfe4198d0 /end MEASUREMENT
/begin MEASUREMENT Tlib_Efuse_L3_GetCurrent_Val_I_C_ODH99 "" ULONG RB_RBA_Common_CentralElements_CompuMethods_Identical 1 100 0.0 4294967295 FORMAT "%8.2" ECU_ADDRESS 0xfe417cb0 /end MEASUREMENT
/begin MEASUREMENT Tlib_Efuse_L3_GetVoltage_Val_O_S_ODH99 "" UWORD RB_RBA_Common_CentralElements_CompuMethods_Identical 1 100 0.0 65535 FORMAT "%8.2" ECU_ADDRESS 0xfe41973a /end MEASUREMENT
/begin MEASUREMENT Tlib_DoVoltage_L3_Get_FilterVal_O_S_ODH99 "" UBYTE RB_RBA_Common_CentralElements_CompuMethods_Identical 1 100 0.0 255.00 FORMAT "%8.2" ECU_ADDRESS 0xfe4198d1 /end MEASUREMENT
/begin MEASUREMENT Tlib_DO_L3_DIAG_Get_Val_O_S_ODH99 "" UWORD RB_RBA_Common_CentralElements_CompuMethods_Identical 1 100 0.0 65535 FORMAT "%8.2" ECU_ADDRESS 0xfe41973c /end MEASUREMENT
/begin MEASUREMENT Tlib_DIO_L3_GetStatus_Val_O_S_ODH71 "" UBYTE RB_RBA_Common_CentralElements_CompuMethods_Identical 1 100 0.0 255.00 FORMAT "%8.2" ECU_ADDRESS 0xfe4198d2 /end MEASUREMENT
/begin MEASUREMENT Tlib_Efuse_L3_GetCurrent_Val_I_C_ODH71 "" ULONG RB_RBA_Common_CentralElements_CompuMethods_Identical 1 100 0.0 4294967295 FORMAT "%8.2" ECU_ADDRESS 0xfe417cb4 /end MEASUREMENT
/begin MEASUREMENT Tlib_Efuse_L3_GetVoltage_Val_O_S_ODH71 "" UWORD RB_RBA_Common_CentralElements_CompuMethods_Identical 1 100 0.0 65535 FORMAT "%8.2" ECU_ADDRESS 0xfe41973e /end MEASUREMENT
/begin MEASUREMENT Tlib_DoVoltage_L3_Get_FilterVal_O_S_ODH71 "" UBYTE RB_RBA_Common_CentralElements_CompuMethods_Identical 1 100 0.0 255.00 FORMAT "%8.2" ECU_ADDRESS 0xfe4198d3 /end MEASUREMENT
/begin MEASUREMENT Tlib_DO_L3_DIAG_Get_Val_O_S_ODH71 "" UWORD RB_RBA_Common_CentralElements_CompuMethods_Identical 1 100 0.0 65535 FORMAT "%8.2" ECU_ADDRESS 0xfe419740 /end MEASUREMENT
/begin MEASUREMENT Tlib_DIO_L3_GetStatus_Val_O_S_ODH87 "" UBYTE RB_RBA_Common_CentralElements_CompuMethods_Identical 1 100 0.0 255.00 FORMAT "%8.2" ECU_ADDRESS 0xfe4198d4 /end MEASUREMENT
/begin MEASUREMENT Tlib_Efuse_L3_GetCurrent_Val_I_C_ODH87 "" ULONG RB_RBA_Common_CentralElements_CompuMethods_Identical 1 100 0.0 4294967295 FORMAT "%8.2" ECU_ADDRESS 0xfe417cb8 /end MEASUREMENT
/begin MEASUREMENT Tlib_Efuse_L3_GetVoltage_Val_O_S_ODH87 "" UWORD RB_RBA_Common_CentralElements_CompuMethods_Identical 1 100 0.0 65535 FORMAT "%8.2" ECU_ADDRESS 0xfe419742 /end MEASUREMENT
/begin MEASUREMENT Tlib_DoVoltage_L3_Get_FilterVal_O_S_ODH87 "" UBYTE RB_RBA_Common_CentralElements_CompuMethods_Identical 1 100 0.0 255.00 FORMAT "%8.2" ECU_ADDRESS 0xfe4198d5 /end MEASUREMENT
/begin MEASUREMENT Tlib_DO_L3_DIAG_Get_Val_O_S_ODH87 "" UWORD RB_RBA_Common_CentralElements_CompuMethods_Identical 1 100 0.0 65535 FORMAT "%8.2" ECU_ADDRESS 0xfe419744 /end MEASUREMENT
/begin MEASUREMENT Tlib_DIO_L3_GetStatus_Val_O_S_ODH28 "" UBYTE RB_RBA_Common_CentralElements_CompuMethods_Identical 1 100 0.0 255.00 FORMAT "%8.2" ECU_ADDRESS 0xfe4198d6 /end MEASUREMENT
/begin MEASUREMENT Tlib_Efuse_L3_GetCurrent_Val_I_C_ODH28 "" ULONG RB_RBA_Common_CentralElements_CompuMethods_Identical 1 100 0.0 4294967295 FORMAT "%8.2" ECU_ADDRESS 0xfe417cbc /end MEASUREMENT
/begin MEASUREMENT Tlib_Efuse_L3_GetVoltage_Val_O_S_ODH28 "" UWORD RB_RBA_Common_CentralElements_CompuMethods_Identical 1 100 0.0 65535 FORMAT "%8.2" ECU_ADDRESS 0xfe419746 /end MEASUREMENT
/begin MEASUREMENT Tlib_DoVoltage_L3_Get_FilterVal_O_S_ODH28 "" UBYTE RB_RBA_Common_CentralElements_CompuMethods_Identical 1 100 0.0 255.00 FORMAT "%8.2" ECU_ADDRESS 0xfe4198d7 /end MEASUREMENT
/begin MEASUREMENT Tlib_DO_L3_DIAG_Get_Val_O_S_ODH28 "" UWORD RB_RBA_Common_CentralElements_CompuMethods_Identical 1 100 0.0 65535 FORMAT "%8.2" ECU_ADDRESS 0xfe419748 /end MEASUREMENT
/begin MEASUREMENT Tlib_ICU_L3_Get_period_Val_I_P_IPL02 "" ULONG RB_RBA_Common_CentralElements_CompuMethods_Identical 1 100 0.0 4294967295 FORMAT "%8.2" ECU_ADDRESS 0xfe417cc0 /end MEASUREMENT
/begin MEASUREMENT Tlib_ICU_L3_Get_Duty_Val_IcuChannel_I_P_IPL02 "" UWORD RB_RBA_Common_CentralElements_CompuMethods_Identical 1 100 0.0 65535 FORMAT "%8.2" ECU_ADDRESS 0xfe41974a /end MEASUREMENT
/begin MEASUREMENT Tlib_PI_L3_DIAG_Get_Value_IcuChannel_I_P_IPL02 "" UWORD RB_RBA_Common_CentralElements_CompuMethods_Identical 1 100 0.0 65535 FORMAT "%8.2" ECU_ADDRESS 0xfe41974c /end MEASUREMENT
/begin MEASUREMENT Tlib_ICU_L3_Get_period_Val_I_P_IPL05 "" ULONG RB_RBA_Common_CentralElements_CompuMethods_Identical 1 100 0.0 4294967295 FORMAT "%8.2" ECU_ADDRESS 0xfe417cc4 /end MEASUREMENT
/begin MEASUREMENT Tlib_ICU_L3_Get_Duty_Val_IcuChannel_I_P_IPL05 "" UWORD RB_RBA_Common_CentralElements_CompuMethods_Identical 1 100 0.0 65535 FORMAT "%8.2" ECU_ADDRESS 0xfe41974e /end MEASUREMENT
/begin MEASUREMENT Tlib_PI_L3_DIAG_Get_Value_IcuChannel_I_P_IPL05 "" UWORD RB_RBA_Common_CentralElements_CompuMethods_Identical 1 100 0.0 65535 FORMAT "%8.2" ECU_ADDRESS 0xfe419750 /end MEASUREMENT
/begin MEASUREMENT Tlib_ICU_L3_Get_period_Val_I_P_IPL03 "" ULONG RB_RBA_Common_CentralElements_CompuMethods_Identical 1 100 0.0 4294967295 FORMAT "%8.2" ECU_ADDRESS 0xfe417cc8 /end MEASUREMENT
/begin MEASUREMENT Tlib_ICU_L3_Get_Duty_Val_IcuChannel_I_P_IPL03 "" UWORD RB_RBA_Common_CentralElements_CompuMethods_Identical 1 100 0.0 65535 FORMAT "%8.2" ECU_ADDRESS 0xfe419752 /end MEASUREMENT
/begin MEASUREMENT Tlib_PI_L3_DIAG_Get_Value_IcuChannel_I_P_IPL03 "" UWORD RB_RBA_Common_CentralElements_CompuMethods_Identical 1 100 0.0 65535 FORMAT "%8.2" ECU_ADDRESS 0xfe419754 /end MEASUREMENT
/begin MEASUREMENT Tlib_ICU_L3_Get_period_Val_I_P_IPL04 "" ULONG RB_RBA_Common_CentralElements_CompuMethods_Identical 1 100 0.0 4294967295 FORMAT "%8.2" ECU_ADDRESS 0xfe417ccc /end MEASUREMENT
/begin MEASUREMENT Tlib_ICU_L3_Get_Duty_Val_IcuChannel_I_P_IPL04 "" UWORD RB_RBA_Common_CentralElements_CompuMethods_Identical 1 100 0.0 65535 FORMAT "%8.2" ECU_ADDRESS 0xfe419756 /end MEASUREMENT
/begin MEASUREMENT Tlib_PI_L3_DIAG_Get_Value_IcuChannel_I_P_IPL04 "" UWORD RB_RBA_Common_CentralElements_CompuMethods_Identical 1 100 0.0 65535 FORMAT "%8.2" ECU_ADDRESS 0xfe419758 /end MEASUREMENT
/begin MEASUREMENT Tlib_ICU_L3_Get_period_Val_I_P_IPL07 "" ULONG RB_RBA_Common_CentralElements_CompuMethods_Identical 1 100 0.0 4294967295 FORMAT "%8.2" ECU_ADDRESS 0xfe417cd0 /end MEASUREMENT
/begin MEASUREMENT Tlib_ICU_L3_Get_Duty_Val_IcuChannel_I_P_IPL07 "" UWORD RB_RBA_Common_CentralElements_CompuMethods_Identical 1 100 0.0 65535 FORMAT "%8.2" ECU_ADDRESS 0xfe41975a /end MEASUREMENT
/begin MEASUREMENT Tlib_PI_L3_DIAG_Get_Value_IcuChannel_I_P_IPL07 "" UWORD RB_RBA_Common_CentralElements_CompuMethods_Identical 1 100 0.0 65535 FORMAT "%8.2" ECU_ADDRESS 0xfe41975c /end MEASUREMENT
/begin MEASUREMENT Tlib_ICU_L3_Get_period_Val_I_P_IPL08 "" ULONG RB_RBA_Common_CentralElements_CompuMethods_Identical 1 100 0.0 4294967295 FORMAT "%8.2" ECU_ADDRESS 0xfe417cd4 /end MEASUREMENT
/begin MEASUREMENT Tlib_ICU_L3_Get_Duty_Val_IcuChannel_I_P_IPL08 "" UWORD RB_RBA_Common_CentralElements_CompuMethods_Identical 1 100 0.0 65535 FORMAT "%8.2" ECU_ADDRESS 0xfe41975e /end MEASUREMENT
/begin MEASUREMENT Tlib_PI_L3_DIAG_Get_Value_IcuChannel_I_P_IPL08 "" UWORD RB_RBA_Common_CentralElements_CompuMethods_Identical 1 100 0.0 65535 FORMAT "%8.2" ECU_ADDRESS 0xfe419760 /end MEASUREMENT
/begin MEASUREMENT Tlib_ICU_L3_Get_period_Val_I_P_IPL09 "" ULONG RB_RBA_Common_CentralElements_CompuMethods_Identical 1 100 0.0 4294967295 FORMAT "%8.2" ECU_ADDRESS 0xfe417cd8 /end MEASUREMENT
/begin MEASUREMENT Tlib_ICU_L3_Get_Duty_Val_IcuChannel_I_P_IPL09 "" UWORD RB_RBA_Common_CentralElements_CompuMethods_Identical 1 100 0.0 65535 FORMAT "%8.2" ECU_ADDRESS 0xfe419762 /end MEASUREMENT
/begin MEASUREMENT Tlib_PI_L3_DIAG_Get_Value_IcuChannel_I_P_IPL09 "" UWORD RB_RBA_Common_CentralElements_CompuMethods_Identical 1 100 0.0 65535 FORMAT "%8.2" ECU_ADDRESS 0xfe419764 /end MEASUREMENT
/begin MEASUREMENT Tlib_ICU_L3_Get_period_Val_I_P_IPL10 "" ULONG RB_RBA_Common_CentralElements_CompuMethods_Identical 1 100 0.0 4294967295 FORMAT "%8.2" ECU_ADDRESS 0xfe417cdc /end MEASUREMENT
/begin MEASUREMENT Tlib_ICU_L3_Get_Duty_Val_IcuChannel_I_P_IPL10 "" UWORD RB_RBA_Common_CentralElements_CompuMethods_Identical 1 100 0.0 65535 FORMAT "%8.2" ECU_ADDRESS 0xfe419766 /end MEASUREMENT
/begin MEASUREMENT Tlib_PI_L3_DIAG_Get_Value_IcuChannel_I_P_IPL10 "" UWORD RB_RBA_Common_CentralElements_CompuMethods_Identical 1 100 0.0 65535 FORMAT "%8.2" ECU_ADDRESS 0xfe419768 /end MEASUREMENT
/begin MEASUREMENT Tlib_ICU_L3_Get_period_Val_I_P_IPL11 "" ULONG RB_RBA_Common_CentralElements_CompuMethods_Identical 1 100 0.0 4294967295 FORMAT "%8.2" ECU_ADDRESS 0xfe417ce0 /end MEASUREMENT
/begin MEASUREMENT Tlib_ICU_L3_Get_Duty_Val_IcuChannel_I_P_IPL11 "" UWORD RB_RBA_Common_CentralElements_CompuMethods_Identical 1 100 0.0 65535 FORMAT "%8.2" ECU_ADDRESS 0xfe41976a /end MEASUREMENT
/begin MEASUREMENT Tlib_PI_L3_DIAG_Get_Value_IcuChannel_I_P_IPL11 "" UWORD RB_RBA_Common_CentralElements_CompuMethods_Identical 1 100 0.0 65535 FORMAT "%8.2" ECU_ADDRESS 0xfe41976c /end MEASUREMENT
/begin MEASUREMENT Tlib_ICU_L3_Get_period_Val_I_P_IPL12 "" ULONG RB_RBA_Common_CentralElements_CompuMethods_Identical 1 100 0.0 4294967295 FORMAT "%8.2" ECU_ADDRESS 0xfe417ce4 /end MEASUREMENT
/begin MEASUREMENT Tlib_ICU_L3_Get_Duty_Val_IcuChannel_I_P_IPL12 "" UWORD RB_RBA_Common_CentralElements_CompuMethods_Identical 1 100 0.0 65535 FORMAT "%8.2" ECU_ADDRESS 0xfe41976e /end MEASUREMENT
/begin MEASUREMENT Tlib_PI_L3_DIAG_Get_Value_IcuChannel_I_P_IPL12 "" UWORD RB_RBA_Common_CentralElements_CompuMethods_Identical 1 100 0.0 65535 FORMAT "%8.2" ECU_ADDRESS 0xfe419770 /end MEASUREMENT
/begin MEASUREMENT Tlib_ICU_L3_Get_period_Val_I_P_IPL13 "" ULONG RB_RBA_Common_CentralElements_CompuMethods_Identical 1 100 0.0 4294967295 FORMAT "%8.2" ECU_ADDRESS 0xfe417ce8 /end MEASUREMENT
/begin MEASUREMENT Tlib_ICU_L3_Get_Duty_Val_IcuChannel_I_P_IPL13 "" UWORD RB_RBA_Common_CentralElements_CompuMethods_Identical 1 100 0.0 65535 FORMAT "%8.2" ECU_ADDRESS 0xfe419772 /end MEASUREMENT
/begin MEASUREMENT Tlib_PI_L3_DIAG_Get_Value_IcuChannel_I_P_IPL13 "" UWORD RB_RBA_Common_CentralElements_CompuMethods_Identical 1 100 0.0 65535 FORMAT "%8.2" ECU_ADDRESS 0xfe419774 /end MEASUREMENT
/begin MEASUREMENT Tlib_ICU_L3_Get_period_Val_I_P_IPL14 "" ULONG RB_RBA_Common_CentralElements_CompuMethods_Identical 1 100 0.0 4294967295 FORMAT "%8.2" ECU_ADDRESS 0xfe417cec /end MEASUREMENT
/begin MEASUREMENT Tlib_ICU_L3_Get_Duty_Val_IcuChannel_I_P_IPL14 "" UWORD RB_RBA_Common_CentralElements_CompuMethods_Identical 1 100 0.0 65535 FORMAT "%8.2" ECU_ADDRESS 0xfe419776 /end MEASUREMENT
/begin MEASUREMENT Tlib_PI_L3_DIAG_Get_Value_IcuChannel_I_P_IPL14 "" UWORD RB_RBA_Common_CentralElements_CompuMethods_Identical 1 100 0.0 65535 FORMAT "%8.2" ECU_ADDRESS 0xfe419778 /end MEASUREMENT
/begin MEASUREMENT Tlib_ICU_L3_Get_period_Val_I_P_IPL15 "" ULONG RB_RBA_Common_CentralElements_CompuMethods_Identical 1 100 0.0 4294967295 FORMAT "%8.2" ECU_ADDRESS 0xfe417cf0 /end MEASUREMENT
/begin MEASUREMENT Tlib_ICU_L3_Get_Duty_Val_IcuChannel_I_P_IPL15 "" UWORD RB_RBA_Common_CentralElements_CompuMethods_Identical 1 100 0.0 65535 FORMAT "%8.2" ECU_ADDRESS 0xfe41977a /end MEASUREMENT
/begin MEASUREMENT Tlib_PI_L3_DIAG_Get_Value_IcuChannel_I_P_IPL15 "" UWORD RB_RBA_Common_CentralElements_CompuMethods_Identical 1 100 0.0 65535 FORMAT "%8.2" ECU_ADDRESS 0xfe41977c /end MEASUREMENT
/begin MEASUREMENT Tlib_ICU_L3_Get_period_Val_I_P_IPL17 "" ULONG RB_RBA_Common_CentralElements_CompuMethods_Identical 1 100 0.0 4294967295 FORMAT "%8.2" ECU_ADDRESS 0xfe417cf4 /end MEASUREMENT
/begin MEASUREMENT Tlib_ICU_L3_Get_Duty_Val_IcuChannel_I_P_IPL17 "" UWORD RB_RBA_Common_CentralElements_CompuMethods_Identical 1 100 0.0 65535 FORMAT "%8.2" ECU_ADDRESS 0xfe41977e /end MEASUREMENT
/begin MEASUREMENT Tlib_PI_L3_DIAG_Get_Value_IcuChannel_I_P_IPL17 "" UWORD RB_RBA_Common_CentralElements_CompuMethods_Identical 1 100 0.0 65535 FORMAT "%8.2" ECU_ADDRESS 0xfe419780 /end MEASUREMENT
/begin MEASUREMENT Tlib_Hall_L3_Get_CNT_I_P_IPL09 "" ULONG RB_RBA_Common_CentralElements_CompuMethods_Identical 1 100 0.0 4294967295 FORMAT "%8.2" ECU_ADDRESS 0xfe417cf8 /end MEASUREMENT
/begin MEASUREMENT Tlib_Hall_L3_Get_Val_I_P_IPL09 "" UBYTE RB_RBA_Common_CentralElements_CompuMethods_Identical 1 100 0.0 255.00 FORMAT "%8.2" ECU_ADDRESS 0xfe4198d8 /end MEASUREMENT
/begin MEASUREMENT Tlib_Hall_L3_Get_Curr_I_P_IPL09 "" ULONG RB_RBA_Common_CentralElements_CompuMethods_Identical 1 100 0.0 4294967295 FORMAT "%8.2" ECU_ADDRESS 0xfe417cfc /end MEASUREMENT
/begin MEASUREMENT Tlib_HALL_L3_DIAG_Get_Value_I_P_IPL09 "" UWORD RB_RBA_Common_CentralElements_CompuMethods_Identical 1 100 0.0 65535 FORMAT "%8.2" ECU_ADDRESS 0xfe419782 /end MEASUREMENT
/begin MEASUREMENT Tlib_Hall_L3_Get_CNT_I_P_IPL10 "" ULONG RB_RBA_Common_CentralElements_CompuMethods_Identical 1 100 0.0 4294967295 FORMAT "%8.2" ECU_ADDRESS 0xfe417d00 /end MEASUREMENT
/begin MEASUREMENT Tlib_Hall_L3_Get_Val_I_P_IPL10 "" UBYTE RB_RBA_Common_CentralElements_CompuMethods_Identical 1 100 0.0 255.00 FORMAT "%8.2" ECU_ADDRESS 0xfe4198d9 /end MEASUREMENT
/begin MEASUREMENT Tlib_Hall_L3_Get_Curr_I_P_IPL10 "" ULONG RB_RBA_Common_CentralElements_CompuMethods_Identical 1 100 0.0 4294967295 FORMAT "%8.2" ECU_ADDRESS 0xfe417d04 /end MEASUREMENT
/begin MEASUREMENT Tlib_HALL_L3_DIAG_Get_Value_I_P_IPL10 "" UWORD RB_RBA_Common_CentralElements_CompuMethods_Identical 1 100 0.0 65535 FORMAT "%8.2" ECU_ADDRESS 0xfe419784 /end MEASUREMENT
/begin MEASUREMENT Tlib_Hall_L3_Get_CNT_I_P_IPL11 "" ULONG RB_RBA_Common_CentralElements_CompuMethods_Identical 1 100 0.0 4294967295 FORMAT "%8.2" ECU_ADDRESS 0xfe417d08 /end MEASUREMENT
/begin MEASUREMENT Tlib_Hall_L3_Get_Val_I_P_IPL11 "" UBYTE RB_RBA_Common_CentralElements_CompuMethods_Identical 1 100 0.0 255.00 FORMAT "%8.2" ECU_ADDRESS 0xfe4198da /end MEASUREMENT
/begin MEASUREMENT Tlib_Hall_L3_Get_Curr_I_P_IPL11 "" ULONG RB_RBA_Common_CentralElements_CompuMethods_Identical 1 100 0.0 4294967295 FORMAT "%8.2" ECU_ADDRESS 0xfe417d0c /end MEASUREMENT
/begin MEASUREMENT Tlib_HALL_L3_DIAG_Get_Value_I_P_IPL11 "" UWORD RB_RBA_Common_CentralElements_CompuMethods_Identical 1 100 0.0 65535 FORMAT "%8.2" ECU_ADDRESS 0xfe419786 /end MEASUREMENT
/begin MEASUREMENT Tlib_Hall_L3_Get_CNT_I_P_IPL12 "" ULONG RB_RBA_Common_CentralElements_CompuMethods_Identical 1 100 0.0 4294967295 FORMAT "%8.2" ECU_ADDRESS 0xfe417d10 /end MEASUREMENT
/begin MEASUREMENT Tlib_Hall_L3_Get_Val_I_P_IPL12 "" UBYTE RB_RBA_Common_CentralElements_CompuMethods_Identical 1 100 0.0 255.00 FORMAT "%8.2" ECU_ADDRESS 0xfe4198db /end MEASUREMENT
/begin MEASUREMENT Tlib_Hall_L3_Get_Curr_I_P_IPL12 "" ULONG RB_RBA_Common_CentralElements_CompuMethods_Identical 1 100 0.0 4294967295 FORMAT "%8.2" ECU_ADDRESS 0xfe417d14 /end MEASUREMENT
/begin MEASUREMENT Tlib_HALL_L3_DIAG_Get_Value_I_P_IPL12 "" UWORD RB_RBA_Common_CentralElements_CompuMethods_Identical 1 100 0.0 65535 FORMAT "%8.2" ECU_ADDRESS 0xfe419788 /end MEASUREMENT
/begin MEASUREMENT Tlib_Hall_L3_Get_CNT_I_P_IPL13 "" ULONG RB_RBA_Common_CentralElements_CompuMethods_Identical 1 100 0.0 4294967295 FORMAT "%8.2" ECU_ADDRESS 0xfe417d18 /end MEASUREMENT
/begin MEASUREMENT Tlib_Hall_L3_Get_Val_I_P_IPL13 "" UBYTE RB_RBA_Common_CentralElements_CompuMethods_Identical 1 100 0.0 255.00 FORMAT "%8.2" ECU_ADDRESS 0xfe4198dc /end MEASUREMENT
/begin MEASUREMENT Tlib_Hall_L3_Get_Curr_I_P_IPL13 "" ULONG RB_RBA_Common_CentralElements_CompuMethods_Identical 1 100 0.0 4294967295 FORMAT "%8.2" ECU_ADDRESS 0xfe417d1c /end MEASUREMENT
/begin MEASUREMENT Tlib_HALL_L3_DIAG_Get_Value_I_P_IPL13 "" UWORD RB_RBA_Common_CentralElements_CompuMethods_Identical 1 100 0.0 65535 FORMAT "%8.2" ECU_ADDRESS 0xfe41978a /end MEASUREMENT
/begin MEASUREMENT Tlib_Hall_L3_Get_CNT_I_P_IPL14 "" ULONG RB_RBA_Common_CentralElements_CompuMethods_Identical 1 100 0.0 4294967295 FORMAT "%8.2" ECU_ADDRESS 0xfe417d20 /end MEASUREMENT
/begin MEASUREMENT Tlib_Hall_L3_Get_Val_I_P_IPL14 "" UBYTE RB_RBA_Common_CentralElements_CompuMethods_Identical 1 100 0.0 255.00 FORMAT "%8.2" ECU_ADDRESS 0xfe4198dd /end MEASUREMENT
/begin MEASUREMENT Tlib_Hall_L3_Get_Curr_I_P_IPL14 "" ULONG RB_RBA_Common_CentralElements_CompuMethods_Identical 1 100 0.0 4294967295 FORMAT "%8.2" ECU_ADDRESS 0xfe417d24 /end MEASUREMENT
/begin MEASUREMENT Tlib_HALL_L3_DIAG_Get_Value_I_P_IPL14 "" UWORD RB_RBA_Common_CentralElements_CompuMethods_Identical 1 100 0.0 65535 FORMAT "%8.2" ECU_ADDRESS 0xfe41978c /end MEASUREMENT
/begin MEASUREMENT Tlib_Hall_L3_Get_CNT_I_P_IPL15 "" ULONG RB_RBA_Common_CentralElements_CompuMethods_Identical 1 100 0.0 4294967295 FORMAT "%8.2" ECU_ADDRESS 0xfe417d28 /end MEASUREMENT
/begin MEASUREMENT Tlib_Hall_L3_Get_Val_I_P_IPL15 "" UBYTE RB_RBA_Common_CentralElements_CompuMethods_Identical 1 100 0.0 255.00 FORMAT "%8.2" ECU_ADDRESS 0xfe4198de /end MEASUREMENT
/begin MEASUREMENT Tlib_Hall_L3_Get_Curr_I_P_IPL15 "" ULONG RB_RBA_Common_CentralElements_CompuMethods_Identical 1 100 0.0 4294967295 FORMAT "%8.2" ECU_ADDRESS 0xfe417d2c /end MEASUREMENT
/begin MEASUREMENT Tlib_HALL_L3_DIAG_Get_Value_I_P_IPL15 "" UWORD RB_RBA_Common_CentralElements_CompuMethods_Identical 1 100 0.0 65535 FORMAT "%8.2" ECU_ADDRESS 0xfe41978e /end MEASUREMENT
/begin MEASUREMENT Tlib_Hall_L3_Get_CNT_I_P_IPL17 "" ULONG RB_RBA_Common_CentralElements_CompuMethods_Identical 1 100 0.0 4294967295 FORMAT "%8.2" ECU_ADDRESS 0xfe417d30 /end MEASUREMENT
/begin MEASUREMENT Tlib_Hall_L3_Get_Val_I_P_IPL17 "" UBYTE RB_RBA_Common_CentralElements_CompuMethods_Identical 1 100 0.0 255.00 FORMAT "%8.2" ECU_ADDRESS 0xfe4198df /end MEASUREMENT
/begin MEASUREMENT Tlib_Hall_L3_Get_Curr_I_P_IPL17 "" ULONG RB_RBA_Common_CentralElements_CompuMethods_Identical 1 100 0.0 4294967295 FORMAT "%8.2" ECU_ADDRESS 0xfe417d34 /end MEASUREMENT
/begin MEASUREMENT Tlib_HALL_L3_DIAG_Get_Value_I_P_IPL17 "" UWORD RB_RBA_Common_CentralElements_CompuMethods_Identical 1 100 0.0 65535 FORMAT "%8.2" ECU_ADDRESS 0xfe419790 /end MEASUREMENT
/begin MEASUREMENT Tlib_Hall_L3_Get_CNT_I_P_IAN83 "" ULONG RB_RBA_Common_CentralElements_CompuMethods_Identical 1 100 0.0 4294967295 FORMAT "%8.2" ECU_ADDRESS 0xfe417d38 /end MEASUREMENT
/begin MEASUREMENT Tlib_Hall_L3_Get_Val_I_P_IAN83 "" UBYTE RB_RBA_Common_CentralElements_CompuMethods_Identical 1 100 0.0 255.00 FORMAT "%8.2" ECU_ADDRESS 0xfe4198e0 /end MEASUREMENT
/begin MEASUREMENT Tlib_Hall_L3_Get_Curr_I_P_IAN83 "" ULONG RB_RBA_Common_CentralElements_CompuMethods_Identical 1 100 0.0 4294967295 FORMAT "%8.2" ECU_ADDRESS 0xfe417d3c /end MEASUREMENT
/begin MEASUREMENT Tlib_HALL_L3_DIAG_Get_Value_I_P_IAN83 "" UWORD RB_RBA_Common_CentralElements_CompuMethods_Identical 1 100 0.0 65535 FORMAT "%8.2" ECU_ADDRESS 0xfe419792 /end MEASUREMENT
/begin MEASUREMENT Tlib_Hall_L3_Get_CNT_I_P_IPL07 "" ULONG RB_RBA_Common_CentralElements_CompuMethods_Identical 1 100 0.0 4294967295 FORMAT "%8.2" ECU_ADDRESS 0xfe417d40 /end MEASUREMENT
/begin MEASUREMENT Tlib_Hall_L3_Get_Val_I_P_IPL07 "" UBYTE RB_RBA_Common_CentralElements_CompuMethods_Identical 1 100 0.0 255.00 FORMAT "%8.2" ECU_ADDRESS 0xfe4198e1 /end MEASUREMENT
/begin MEASUREMENT Tlib_Hall_L3_Get_Curr_I_P_IPL07 "" ULONG RB_RBA_Common_CentralElements_CompuMethods_Identical 1 100 0.0 4294967295 FORMAT "%8.2" ECU_ADDRESS 0xfe417d44 /end MEASUREMENT
/begin MEASUREMENT Tlib_HALL_L3_DIAG_Get_Value_I_P_IPL07 "" UWORD RB_RBA_Common_CentralElements_CompuMethods_Identical 1 100 0.0 65535 FORMAT "%8.2" ECU_ADDRESS 0xfe419794 /end MEASUREMENT
/begin MEASUREMENT Tlib_Hall_L3_Get_CNT_I_P_IPL08 "" ULONG RB_RBA_Common_CentralElements_CompuMethods_Identical 1 100 0.0 4294967295 FORMAT "%8.2" ECU_ADDRESS 0xfe417d48 /end MEASUREMENT
/begin MEASUREMENT Tlib_Hall_L3_Get_Val_I_P_IPL08 "" UBYTE RB_RBA_Common_CentralElements_CompuMethods_Identical 1 100 0.0 255.00 FORMAT "%8.2" ECU_ADDRESS 0xfe4198e2 /end MEASUREMENT
/begin MEASUREMENT Tlib_Hall_L3_Get_Curr_I_P_IPL08 "" ULONG RB_RBA_Common_CentralElements_CompuMethods_Identical 1 100 0.0 4294967295 FORMAT "%8.2" ECU_ADDRESS 0xfe417d4c /end MEASUREMENT
/begin MEASUREMENT Tlib_HALL_L3_DIAG_Get_Value_I_P_IPL08 "" UWORD RB_RBA_Common_CentralElements_CompuMethods_Identical 1 100 0.0 65535 FORMAT "%8.2" ECU_ADDRESS 0xfe419796 /end MEASUREMENT
/begin MEASUREMENT Tlib_PO_L3_Status_Duty_Get_Vaulue_O_P_OPL04 "" UWORD RB_RBA_Common_CentralElements_CompuMethods_Identical 1 100 0.0 65535 FORMAT "%8.2" ECU_ADDRESS 0xfe419798 /end MEASUREMENT
/begin MEASUREMENT Tlib_PO_L3_Status_Period_Get_Info_Vaulue_O_P_OPL04 "" ULONG RB_RBA_Common_CentralElements_CompuMethods_Identical 1 100 0.0 4294967295 FORMAT "%8.2" ECU_ADDRESS 0xfe417d50 /end MEASUREMENT
/begin MEASUREMENT Tlib_PO_L3_Status_Duty_Get_Info_Vaulue_O_P_OPL04 "" UWORD RB_RBA_Common_CentralElements_CompuMethods_Identical 1 100 0.0 65535 FORMAT "%8.2" ECU_ADDRESS 0xfe41979a /end MEASUREMENT
/begin MEASUREMENT Tlib_Efuse_L3_GetCurrent_Val_I_C_OPL04 "" ULONG RB_RBA_Common_CentralElements_CompuMethods_Identical 1 100 0.0 4294967295 FORMAT "%8.2" ECU_ADDRESS 0xfe417d54 /end MEASUREMENT
/begin MEASUREMENT Tlib_PO_L3_Diag_Get_Vaulue_O_P_OPL04 "" UWORD RB_RBA_Common_CentralElements_CompuMethods_Identical 1 100 0.0 65535 FORMAT "%8.2" ECU_ADDRESS 0xfe41979c /end MEASUREMENT
/begin MEASUREMENT Tlib_PO_L3_Status_Duty_Get_Vaulue_O_P_OPL07 "" UWORD RB_RBA_Common_CentralElements_CompuMethods_Identical 1 100 0.0 65535 FORMAT "%8.2" ECU_ADDRESS 0xfe41979e /end MEASUREMENT
/begin MEASUREMENT Tlib_PO_L3_Status_Period_Get_Info_Vaulue_O_P_OPL07 "" ULONG RB_RBA_Common_CentralElements_CompuMethods_Identical 1 100 0.0 4294967295 FORMAT "%8.2" ECU_ADDRESS 0xfe417d58 /end MEASUREMENT
/begin MEASUREMENT Tlib_PO_L3_Status_Duty_Get_Info_Vaulue_O_P_OPL07 "" UWORD RB_RBA_Common_CentralElements_CompuMethods_Identical 1 100 0.0 65535 FORMAT "%8.2" ECU_ADDRESS 0xfe4197a0 /end MEASUREMENT
/begin MEASUREMENT Tlib_Efuse_L3_GetCurrent_Val_I_C_OPL07 "" ULONG RB_RBA_Common_CentralElements_CompuMethods_Identical 1 100 0.0 4294967295 FORMAT "%8.2" ECU_ADDRESS 0xfe417d5c /end MEASUREMENT
/begin MEASUREMENT Tlib_PO_L3_Diag_Get_Vaulue_O_P_OPL07 "" UWORD RB_RBA_Common_CentralElements_CompuMethods_Identical 1 100 0.0 65535 FORMAT "%8.2" ECU_ADDRESS 0xfe4197a2 /end MEASUREMENT
/begin MEASUREMENT Tlib_PO_L3_Status_Duty_Get_Vaulue_O_P_OPL08 "" UWORD RB_RBA_Common_CentralElements_CompuMethods_Identical 1 100 0.0 65535 FORMAT "%8.2" ECU_ADDRESS 0xfe4197a4 /end MEASUREMENT
/begin MEASUREMENT Tlib_PO_L3_Status_Period_Get_Info_Vaulue_O_P_OPL08 "" ULONG RB_RBA_Common_CentralElements_CompuMethods_Identical 1 100 0.0 4294967295 FORMAT "%8.2" ECU_ADDRESS 0xfe417d60 /end MEASUREMENT
/begin MEASUREMENT Tlib_PO_L3_Status_Duty_Get_Info_Vaulue_O_P_OPL08 "" UWORD RB_RBA_Common_CentralElements_CompuMethods_Identical 1 100 0.0 65535 FORMAT "%8.2" ECU_ADDRESS 0xfe4197a6 /end MEASUREMENT
/begin MEASUREMENT Tlib_Efuse_L3_GetCurrent_Val_I_C_OPL08 "" ULONG RB_RBA_Common_CentralElements_CompuMethods_Identical 1 100 0.0 4294967295 FORMAT "%8.2" ECU_ADDRESS 0xfe417d64 /end MEASUREMENT
/begin MEASUREMENT Tlib_PO_L3_Diag_Get_Vaulue_O_P_OPL08 "" UWORD RB_RBA_Common_CentralElements_CompuMethods_Identical 1 100 0.0 65535 FORMAT "%8.2" ECU_ADDRESS 0xfe4197a8 /end MEASUREMENT
/begin MEASUREMENT Tlib_PO_L3_Status_Duty_Get_Vaulue_O_P_OPL09 "" UWORD RB_RBA_Common_CentralElements_CompuMethods_Identical 1 100 0.0 65535 FORMAT "%8.2" ECU_ADDRESS 0xfe4197aa /end MEASUREMENT
/begin MEASUREMENT Tlib_PO_L3_Status_Period_Get_Info_Vaulue_O_P_OPL09 "" ULONG RB_RBA_Common_CentralElements_CompuMethods_Identical 1 100 0.0 4294967295 FORMAT "%8.2" ECU_ADDRESS 0xfe417d68 /end MEASUREMENT
/begin MEASUREMENT Tlib_PO_L3_Status_Duty_Get_Info_Vaulue_O_P_OPL09 "" UWORD RB_RBA_Common_CentralElements_CompuMethods_Identical 1 100 0.0 65535 FORMAT "%8.2" ECU_ADDRESS 0xfe4197ac /end MEASUREMENT
/begin MEASUREMENT Tlib_Efuse_L3_GetCurrent_Val_I_C_OPL09 "" ULONG RB_RBA_Common_CentralElements_CompuMethods_Identical 1 100 0.0 4294967295 FORMAT "%8.2" ECU_ADDRESS 0xfe417d6c /end MEASUREMENT
/begin MEASUREMENT Tlib_PO_L3_Diag_Get_Vaulue_O_P_OPL09 "" UWORD RB_RBA_Common_CentralElements_CompuMethods_Identical 1 100 0.0 65535 FORMAT "%8.2" ECU_ADDRESS 0xfe4197ae /end MEASUREMENT
/begin MEASUREMENT Tlib_PO_L3_Status_Duty_Get_Vaulue_O_P_OPH12 "" UWORD RB_RBA_Common_CentralElements_CompuMethods_Identical 1 100 0.0 65535 FORMAT "%8.2" ECU_ADDRESS 0xfe4197b0 /end MEASUREMENT
/begin MEASUREMENT Tlib_PO_L3_Status_Period_Get_Info_Vaulue_O_P_OPH12 "" ULONG RB_RBA_Common_CentralElements_CompuMethods_Identical 1 100 0.0 4294967295 FORMAT "%8.2" ECU_ADDRESS 0xfe417d70 /end MEASUREMENT
/begin MEASUREMENT Tlib_PO_L3_Status_Duty_Get_Info_Vaulue_O_P_OPH12 "" UWORD RB_RBA_Common_CentralElements_CompuMethods_Identical 1 100 0.0 65535 FORMAT "%8.2" ECU_ADDRESS 0xfe4197b2 /end MEASUREMENT
/begin MEASUREMENT Tlib_Efuse_L3_GetCurrent_Val_I_C_OPH12 "" ULONG RB_RBA_Common_CentralElements_CompuMethods_Identical 1 100 0.0 4294967295 FORMAT "%8.2" ECU_ADDRESS 0xfe417d74 /end MEASUREMENT
/begin MEASUREMENT Tlib_PO_L3_Diag_Get_Vaulue_O_P_OPH12 "" UWORD RB_RBA_Common_CentralElements_CompuMethods_Identical 1 100 0.0 65535 FORMAT "%8.2" ECU_ADDRESS 0xfe4197b4 /end MEASUREMENT
/begin MEASUREMENT Tlib_PO_L3_Status_Duty_Get_Vaulue_O_P_OPH02 "" UWORD RB_RBA_Common_CentralElements_CompuMethods_Identical 1 100 0.0 65535 FORMAT "%8.2" ECU_ADDRESS 0xfe4197b6 /end MEASUREMENT
/begin MEASUREMENT Tlib_PO_L3_Status_Period_Get_Info_Vaulue_O_P_OPH02 "" ULONG RB_RBA_Common_CentralElements_CompuMethods_Identical 1 100 0.0 4294967295 FORMAT "%8.2" ECU_ADDRESS 0xfe417d78 /end MEASUREMENT
/begin MEASUREMENT Tlib_PO_L3_Status_Duty_Get_Info_Vaulue_O_P_OPH02 "" UWORD RB_RBA_Common_CentralElements_CompuMethods_Identical 1 100 0.0 65535 FORMAT "%8.2" ECU_ADDRESS 0xfe4197b8 /end MEASUREMENT
/begin MEASUREMENT Tlib_Efuse_L3_GetCurrent_Val_I_C_OPH02 "" ULONG RB_RBA_Common_CentralElements_CompuMethods_Identical 1 100 0.0 4294967295 FORMAT "%8.2" ECU_ADDRESS 0xfe417d7c /end MEASUREMENT
/begin MEASUREMENT Tlib_PO_L3_Diag_Get_Vaulue_O_P_OPH02 "" UWORD RB_RBA_Common_CentralElements_CompuMethods_Identical 1 100 0.0 65535 FORMAT "%8.2" ECU_ADDRESS 0xfe4197ba /end MEASUREMENT
/begin MEASUREMENT Tlib_PO_L3_Status_Duty_Get_Vaulue_O_P_OPH09 "" UWORD RB_RBA_Common_CentralElements_CompuMethods_Identical 1 100 0.0 65535 FORMAT "%8.2" ECU_ADDRESS 0xfe4197bc /end MEASUREMENT
/begin MEASUREMENT Tlib_PO_L3_Status_Period_Get_Info_Vaulue_O_P_OPH09 "" ULONG RB_RBA_Common_CentralElements_CompuMethods_Identical 1 100 0.0 4294967295 FORMAT "%8.2" ECU_ADDRESS 0xfe417d80 /end MEASUREMENT
/begin MEASUREMENT Tlib_PO_L3_Status_Duty_Get_Info_Vaulue_O_P_OPH09 "" UWORD RB_RBA_Common_CentralElements_CompuMethods_Identical 1 100 0.0 65535 FORMAT "%8.2" ECU_ADDRESS 0xfe4197be /end MEASUREMENT
/begin MEASUREMENT Tlib_Efuse_L3_GetCurrent_Val_I_C_OPH09 "" ULONG RB_RBA_Common_CentralElements_CompuMethods_Identical 1 100 0.0 4294967295 FORMAT "%8.2" ECU_ADDRESS 0xfe417d84 /end MEASUREMENT
/begin MEASUREMENT Tlib_PO_L3_Diag_Get_Vaulue_O_P_OPH09 "" UWORD RB_RBA_Common_CentralElements_CompuMethods_Identical 1 100 0.0 65535 FORMAT "%8.2" ECU_ADDRESS 0xfe4197c0 /end MEASUREMENT
/begin MEASUREMENT Tlib_PO_L3_Status_Duty_Get_Vaulue_O_P_OPH10 "" UWORD RB_RBA_Common_CentralElements_CompuMethods_Identical 1 100 0.0 65535 FORMAT "%8.2" ECU_ADDRESS 0xfe4197c2 /end MEASUREMENT
/begin MEASUREMENT Tlib_PO_L3_Status_Period_Get_Info_Vaulue_O_P_OPH10 "" ULONG RB_RBA_Common_CentralElements_CompuMethods_Identical 1 100 0.0 4294967295 FORMAT "%8.2" ECU_ADDRESS 0xfe417d88 /end MEASUREMENT
/begin MEASUREMENT Tlib_PO_L3_Status_Duty_Get_Info_Vaulue_O_P_OPH10 "" UWORD RB_RBA_Common_CentralElements_CompuMethods_Identical 1 100 0.0 65535 FORMAT "%8.2" ECU_ADDRESS 0xfe4197c4 /end MEASUREMENT
/begin MEASUREMENT Tlib_Efuse_L3_GetCurrent_Val_I_C_OPH10 "" ULONG RB_RBA_Common_CentralElements_CompuMethods_Identical 1 100 0.0 4294967295 FORMAT "%8.2" ECU_ADDRESS 0xfe417d8c /end MEASUREMENT
/begin MEASUREMENT Tlib_PO_L3_Diag_Get_Vaulue_O_P_OPH10 "" UWORD RB_RBA_Common_CentralElements_CompuMethods_Identical 1 100 0.0 65535 FORMAT "%8.2" ECU_ADDRESS 0xfe4197c6 /end MEASUREMENT
/begin MEASUREMENT Tlib_PO_L3_Status_Duty_Get_Vaulue_O_P_OPH14 "" UWORD RB_RBA_Common_CentralElements_CompuMethods_Identical 1 100 0.0 65535 FORMAT "%8.2" ECU_ADDRESS 0xfe4197c8 /end MEASUREMENT
/begin MEASUREMENT Tlib_PO_L3_Status_Period_Get_Info_Vaulue_O_P_OPH14 "" ULONG RB_RBA_Common_CentralElements_CompuMethods_Identical 1 100 0.0 4294967295 FORMAT "%8.2" ECU_ADDRESS 0xfe417d90 /end MEASUREMENT
/begin MEASUREMENT Tlib_PO_L3_Status_Duty_Get_Info_Vaulue_O_P_OPH14 "" UWORD RB_RBA_Common_CentralElements_CompuMethods_Identical 1 100 0.0 65535 FORMAT "%8.2" ECU_ADDRESS 0xfe4197ca /end MEASUREMENT
/begin MEASUREMENT Tlib_Efuse_L3_GetCurrent_Val_I_C_OPH14 "" ULONG RB_RBA_Common_CentralElements_CompuMethods_Identical 1 100 0.0 4294967295 FORMAT "%8.2" ECU_ADDRESS 0xfe417d94 /end MEASUREMENT
/begin MEASUREMENT Tlib_PO_L3_Diag_Get_Vaulue_O_P_OPH14 "" UWORD RB_RBA_Common_CentralElements_CompuMethods_Identical 1 100 0.0 65535 FORMAT "%8.2" ECU_ADDRESS 0xfe4197cc /end MEASUREMENT
/begin MEASUREMENT Tlib_PO_L3_Status_Duty_Get_Vaulue_O_P_OPH11 "" UWORD RB_RBA_Common_CentralElements_CompuMethods_Identical 1 100 0.0 65535 FORMAT "%8.2" ECU_ADDRESS 0xfe4197ce /end MEASUREMENT
/begin MEASUREMENT Tlib_PO_L3_Status_Period_Get_Info_Vaulue_O_P_OPH11 "" ULONG RB_RBA_Common_CentralElements_CompuMethods_Identical 1 100 0.0 4294967295 FORMAT "%8.2" ECU_ADDRESS 0xfe417d98 /end MEASUREMENT
/begin MEASUREMENT Tlib_PO_L3_Status_Duty_Get_Info_Vaulue_O_P_OPH11 "" UWORD RB_RBA_Common_CentralElements_CompuMethods_Identical 1 100 0.0 65535 FORMAT "%8.2" ECU_ADDRESS 0xfe4197d0 /end MEASUREMENT
/begin MEASUREMENT Tlib_Efuse_L3_GetCurrent_Val_I_C_OPH11 "" ULONG RB_RBA_Common_CentralElements_CompuMethods_Identical 1 100 0.0 4294967295 FORMAT "%8.2" ECU_ADDRESS 0xfe417d9c /end MEASUREMENT
/begin MEASUREMENT Tlib_PO_L3_Diag_Get_Vaulue_O_P_OPH11 "" UWORD RB_RBA_Common_CentralElements_CompuMethods_Identical 1 100 0.0 65535 FORMAT "%8.2" ECU_ADDRESS 0xfe4197d2 /end MEASUREMENT
/begin MEASUREMENT Tlib_Hbr_L3_GetStatus_Val_O_H_OHB01_02 "" UBYTE RB_RBA_Common_CentralElements_CompuMethods_Identical 1 100 0.0 255.00 FORMAT "%8.2" ECU_ADDRESS 0xfe4198e3 /end MEASUREMENT
/begin MEASUREMENT Tlib_Efuse_L3_GetCurrent_Val_I_C_OHB01_02 "" ULONG RB_RBA_Common_CentralElements_CompuMethods_Identical 1 100 0.0 4294967295 FORMAT "%8.2" ECU_ADDRESS 0xfe417da0 /end MEASUREMENT
/begin MEASUREMENT Tlib_Hbr_L3_GetDiag_Val_O_H_OHB01_02 "" ULONG RB_RBA_Common_CentralElements_CompuMethods_Identical 1 100 0.0 4294967295 FORMAT "%8.2" ECU_ADDRESS 0xfe417da4 /end MEASUREMENT
/begin MEASUREMENT Tlib_Hbr_L3_GetStatus_Val_O_H_OHB03_04 "" UBYTE RB_RBA_Common_CentralElements_CompuMethods_Identical 1 100 0.0 255.00 FORMAT "%8.2" ECU_ADDRESS 0xfe4198e4 /end MEASUREMENT
/begin MEASUREMENT Tlib_Efuse_L3_GetCurrent_Val_I_C_OHB03_04 "" ULONG RB_RBA_Common_CentralElements_CompuMethods_Identical 1 100 0.0 4294967295 FORMAT "%8.2" ECU_ADDRESS 0xfe417da8 /end MEASUREMENT
/begin MEASUREMENT Tlib_Hbr_L3_GetDiag_Val_O_H_OHB03_04 "" ULONG RB_RBA_Common_CentralElements_CompuMethods_Identical 1 100 0.0 4294967295 FORMAT "%8.2" ECU_ADDRESS 0xfe417dac /end MEASUREMENT
/begin MEASUREMENT Tlib_Hbr_L3_GetStatus_Val_O_H_OHB05_06 "" UBYTE RB_RBA_Common_CentralElements_CompuMethods_Identical 1 100 0.0 255.00 FORMAT "%8.2" ECU_ADDRESS 0xfe4198e5 /end MEASUREMENT
/begin MEASUREMENT Tlib_Efuse_L3_GetCurrent_Val_I_C_OHB05_06 "" ULONG RB_RBA_Common_CentralElements_CompuMethods_Identical 1 100 0.0 4294967295 FORMAT "%8.2" ECU_ADDRESS 0xfe417db0 /end MEASUREMENT
/begin MEASUREMENT Tlib_Hbr_L3_GetDiag_Val_O_H_OHB05_06 "" ULONG RB_RBA_Common_CentralElements_CompuMethods_Identical 1 100 0.0 4294967295 FORMAT "%8.2" ECU_ADDRESS 0xfe417db4 /end MEASUREMENT
/begin MEASUREMENT Tlib_Hbr_L3_GetStatus_Val_O_H_OHB07_08 "" UBYTE RB_RBA_Common_CentralElements_CompuMethods_Identical 1 100 0.0 255.00 FORMAT "%8.2" ECU_ADDRESS 0xfe4198e6 /end MEASUREMENT
/begin MEASUREMENT Tlib_Efuse_L3_GetCurrent_Val_I_C_OHB07_08 "" ULONG RB_RBA_Common_CentralElements_CompuMethods_Identical 1 100 0.0 4294967295 FORMAT "%8.2" ECU_ADDRESS 0xfe417db8 /end MEASUREMENT
/begin MEASUREMENT Tlib_Hbr_L3_GetDiag_Val_O_H_OHB07_08 "" ULONG RB_RBA_Common_CentralElements_CompuMethods_Identical 1 100 0.0 4294967295 FORMAT "%8.2" ECU_ADDRESS 0xfe417dbc /end MEASUREMENT
/begin MEASUREMENT Tlib_Hbr_L3_GetStatus_Val_O_H_OHB09_10 "" UBYTE RB_RBA_Common_CentralElements_CompuMethods_Identical 1 100 0.0 255.00 FORMAT "%8.2" ECU_ADDRESS 0xfe4198e7 /end MEASUREMENT
/begin MEASUREMENT Tlib_Efuse_L3_GetCurrent_Val_I_C_OHB09_10 "" ULONG RB_RBA_Common_CentralElements_CompuMethods_Identical 1 100 0.0 4294967295 FORMAT "%8.2" ECU_ADDRESS 0xfe417dc0 /end MEASUREMENT
/begin MEASUREMENT Tlib_Hbr_L3_GetDiag_Val_O_H_OHB09_10 "" ULONG RB_RBA_Common_CentralElements_CompuMethods_Identical 1 100 0.0 4294967295 FORMAT "%8.2" ECU_ADDRESS 0xfe417dc4 /end MEASUREMENT
/begin MEASUREMENT Tlib_Hbr_L3_GetStatus_Val_O_H_OHB11_12 "" UBYTE RB_RBA_Common_CentralElements_CompuMethods_Identical 1 100 0.0 255.00 FORMAT "%8.2" ECU_ADDRESS 0xfe4198e8 /end MEASUREMENT
/begin MEASUREMENT Tlib_Efuse_L3_GetCurrent_Val_I_C_OHB11_12 "" ULONG RB_RBA_Common_CentralElements_CompuMethods_Identical 1 100 0.0 4294967295 FORMAT "%8.2" ECU_ADDRESS 0xfe417dc8 /end MEASUREMENT
/begin MEASUREMENT Tlib_Hbr_L3_GetDiag_Val_O_H_OHB11_12 "" ULONG RB_RBA_Common_CentralElements_CompuMethods_Identical 1 100 0.0 4294967295 FORMAT "%8.2" ECU_ADDRESS 0xfe417dcc /end MEASUREMENT
/begin MEASUREMENT Tlib_Hbr_L3_GetStatus_Val_O_H_OHB13_14 "" UBYTE RB_RBA_Common_CentralElements_CompuMethods_Identical 1 100 0.0 255.00 FORMAT "%8.2" ECU_ADDRESS 0xfe4198e9 /end MEASUREMENT
/begin MEASUREMENT Tlib_Efuse_L3_GetCurrent_Val_I_C_OHB13_14 "" ULONG RB_RBA_Common_CentralElements_CompuMethods_Identical 1 100 0.0 4294967295 FORMAT "%8.2" ECU_ADDRESS 0xfe417dd0 /end MEASUREMENT
/begin MEASUREMENT Tlib_Hbr_L3_GetDiag_Val_O_H_OHB13_14 "" ULONG RB_RBA_Common_CentralElements_CompuMethods_Identical 1 100 0.0 4294967295 FORMAT "%8.2" ECU_ADDRESS 0xfe417dd4 /end MEASUREMENT
/begin MEASUREMENT Tlib_Hbr_L3_GetStatus_Val_O_H_OHB15_16 "" UBYTE RB_RBA_Common_CentralElements_CompuMethods_Identical 1 100 0.0 255.00 FORMAT "%8.2" ECU_ADDRESS 0xfe4198ea /end MEASUREMENT
/begin MEASUREMENT Tlib_Efuse_L3_GetCurrent_Val_I_C_OHB15_16 "" ULONG RB_RBA_Common_CentralElements_CompuMethods_Identical 1 100 0.0 4294967295 FORMAT "%8.2" ECU_ADDRESS 0xfe417dd8 /end MEASUREMENT
/begin MEASUREMENT Tlib_Hbr_L3_GetDiag_Val_O_H_OHB15_16 "" ULONG RB_RBA_Common_CentralElements_CompuMethods_Identical 1 100 0.0 4294967295 FORMAT "%8.2" ECU_ADDRESS 0xfe417ddc /end MEASUREMENT
/begin MEASUREMENT Tlib_Hbr_L3_GetStatus_Val_O_H_OPB31_32 "" UBYTE RB_RBA_Common_CentralElements_CompuMethods_Identical 1 100 0.0 255.00 FORMAT "%8.2" ECU_ADDRESS 0xfe4198eb /end MEASUREMENT
/begin MEASUREMENT Tlib_Efuse_L3_GetCurrent_Val_I_C_OPB31_32 "" ULONG RB_RBA_Common_CentralElements_CompuMethods_Identical 1 100 0.0 4294967295 FORMAT "%8.2" ECU_ADDRESS 0xfe417de0 /end MEASUREMENT
/begin MEASUREMENT Tlib_Hbr_L3_GetDiag_Val_O_H_OPB31_32 "" ULONG RB_RBA_Common_CentralElements_CompuMethods_Identical 1 100 0.0 4294967295 FORMAT "%8.2" ECU_ADDRESS 0xfe417de4 /end MEASUREMENT
/begin MEASUREMENT Tlib_Hbr_L3_GetStatus_Val_O_H_OPB05_06 "" UBYTE RB_RBA_Common_CentralElements_CompuMethods_Identical 1 100 0.0 255.00 FORMAT "%8.2" ECU_ADDRESS 0xfe4198ec /end MEASUREMENT
/begin MEASUREMENT Tlib_Efuse_L3_GetCurrent_Val_I_C_OPB05_06 "" ULONG RB_RBA_Common_CentralElements_CompuMethods_Identical 1 100 0.0 4294967295 FORMAT "%8.2" ECU_ADDRESS 0xfe417de8 /end MEASUREMENT
/begin MEASUREMENT Tlib_Hbr_L3_GetDiag_Val_O_H_OPB05_06 "" ULONG RB_RBA_Common_CentralElements_CompuMethods_Identical 1 100 0.0 4294967295 FORMAT "%8.2" ECU_ADDRESS 0xfe417dec /end MEASUREMENT
/begin MEASUREMENT Tlib_Hbr_L3_GetStatus_Val_O_H_OPB07_08 "" UBYTE RB_RBA_Common_CentralElements_CompuMethods_Identical 1 100 0.0 255.00 FORMAT "%8.2" ECU_ADDRESS 0xfe4198ed /end MEASUREMENT
/begin MEASUREMENT Tlib_Efuse_L3_GetCurrent_Val_I_C_OPB07_08 "" ULONG RB_RBA_Common_CentralElements_CompuMethods_Identical 1 100 0.0 4294967295 FORMAT "%8.2" ECU_ADDRESS 0xfe417df0 /end MEASUREMENT
/begin MEASUREMENT Tlib_Hbr_L3_GetDiag_Val_O_H_OPB07_08 "" ULONG RB_RBA_Common_CentralElements_CompuMethods_Identical 1 100 0.0 4294967295 FORMAT "%8.2" ECU_ADDRESS 0xfe417df4 /end MEASUREMENT
/begin MEASUREMENT Tlib_Hbr_L3_GetStatus_Val_O_H_OPB09_10 "" UBYTE RB_RBA_Common_CentralElements_CompuMethods_Identical 1 100 0.0 255.00 FORMAT "%8.2" ECU_ADDRESS 0xfe4198ee /end MEASUREMENT
/begin MEASUREMENT Tlib_Efuse_L3_GetCurrent_Val_I_C_OPB09_10 "" ULONG RB_RBA_Common_CentralElements_CompuMethods_Identical 1 100 0.0 4294967295 FORMAT "%8.2" ECU_ADDRESS 0xfe417df8 /end MEASUREMENT
/begin MEASUREMENT Tlib_Hbr_L3_GetDiag_Val_O_H_OPB09_10 "" ULONG RB_RBA_Common_CentralElements_CompuMethods_Identical 1 100 0.0 4294967295 FORMAT "%8.2" ECU_ADDRESS 0xfe417dfc /end MEASUREMENT
/begin MEASUREMENT Tlib_Hbr_L3_GetStatus_Val_O_H_OPB09_16 "" UBYTE RB_RBA_Common_CentralElements_CompuMethods_Identical 1 100 0.0 255.00 FORMAT "%8.2" ECU_ADDRESS 0xfe4198ef /end MEASUREMENT
/begin MEASUREMENT Tlib_Efuse_L3_GetCurrent_Val_I_C_OPB09_16 "" ULONG RB_RBA_Common_CentralElements_CompuMethods_Identical 1 100 0.0 4294967295 FORMAT "%8.2" ECU_ADDRESS 0xfe417e00 /end MEASUREMENT
/begin MEASUREMENT Tlib_Hbr_L3_GetDiag_Val_O_H_OPB09_16 "" ULONG RB_RBA_Common_CentralElements_CompuMethods_Identical 1 100 0.0 4294967295 FORMAT "%8.2" ECU_ADDRESS 0xfe417e04 /end MEASUREMENT
/begin MEASUREMENT Tlib_Hbr_L3_GetStatus_Val_O_H_OPB12_13 "" UBYTE RB_RBA_Common_CentralElements_CompuMethods_Identical 1 100 0.0 255.00 FORMAT "%8.2" ECU_ADDRESS 0xfe4198f0 /end MEASUREMENT
/begin MEASUREMENT Tlib_Efuse_L3_GetCurrent_Val_I_C_OPB12_13 "" ULONG RB_RBA_Common_CentralElements_CompuMethods_Identical 1 100 0.0 4294967295 FORMAT "%8.2" ECU_ADDRESS 0xfe417e08 /end MEASUREMENT
/begin MEASUREMENT Tlib_Hbr_L3_GetDiag_Val_O_H_OPB12_13 "" ULONG RB_RBA_Common_CentralElements_CompuMethods_Identical 1 100 0.0 4294967295 FORMAT "%8.2" ECU_ADDRESS 0xfe417e0c /end MEASUREMENT
/begin MEASUREMENT Tlib_Hbr_L3_GetStatus_Val_O_H_OPB11_12 "" UBYTE RB_RBA_Common_CentralElements_CompuMethods_Identical 1 100 0.0 255.00 FORMAT "%8.2" ECU_ADDRESS 0xfe4198f1 /end MEASUREMENT
/begin MEASUREMENT Tlib_Efuse_L3_GetCurrent_Val_I_C_OPB11_12 "" ULONG RB_RBA_Common_CentralElements_CompuMethods_Identical 1 100 0.0 4294967295 FORMAT "%8.2" ECU_ADDRESS 0xfe417e10 /end MEASUREMENT
/begin MEASUREMENT Tlib_Hbr_L3_GetDiag_Val_O_H_OPB11_12 "" ULONG RB_RBA_Common_CentralElements_CompuMethods_Identical 1 100 0.0 4294967295 FORMAT "%8.2" ECU_ADDRESS 0xfe417e14 /end MEASUREMENT
/begin MEASUREMENT Tlib_Hbr_L3_GetStatus_Val_O_H_OPB14_15 "" UBYTE RB_RBA_Common_CentralElements_CompuMethods_Identical 1 100 0.0 255.00 FORMAT "%8.2" ECU_ADDRESS 0xfe4198f2 /end MEASUREMENT
/begin MEASUREMENT Tlib_Efuse_L3_GetCurrent_Val_I_C_OPB14_15 "" ULONG RB_RBA_Common_CentralElements_CompuMethods_Identical 1 100 0.0 4294967295 FORMAT "%8.2" ECU_ADDRESS 0xfe417e18 /end MEASUREMENT
/begin MEASUREMENT Tlib_Hbr_L3_GetDiag_Val_O_H_OPB14_15 "" ULONG RB_RBA_Common_CentralElements_CompuMethods_Identical 1 100 0.0 4294967295 FORMAT "%8.2" ECU_ADDRESS 0xfe417e1c /end MEASUREMENT
/begin MEASUREMENT Tlib_Hbr_L3_GetStatus_Val_O_H_OPB14_17 "" UBYTE RB_RBA_Common_CentralElements_CompuMethods_Identical 1 100 0.0 255.00 FORMAT "%8.2" ECU_ADDRESS 0xfe4198f3 /end MEASUREMENT
/begin MEASUREMENT Tlib_Efuse_L3_GetCurrent_Val_I_C_OPB14_17 "" ULONG RB_RBA_Common_CentralElements_CompuMethods_Identical 1 100 0.0 4294967295 FORMAT "%8.2" ECU_ADDRESS 0xfe417e20 /end MEASUREMENT
/begin MEASUREMENT Tlib_Hbr_L3_GetDiag_Val_O_H_OPB14_17 "" ULONG RB_RBA_Common_CentralElements_CompuMethods_Identical 1 100 0.0 4294967295 FORMAT "%8.2" ECU_ADDRESS 0xfe417e24 /end MEASUREMENT
/begin MEASUREMENT Tlib_Hbr_L3_GetStatus_Val_O_H_OPB18_30 "" UBYTE RB_RBA_Common_CentralElements_CompuMethods_Identical 1 100 0.0 255.00 FORMAT "%8.2" ECU_ADDRESS 0xfe4198f4 /end MEASUREMENT
/begin MEASUREMENT Tlib_Efuse_L3_GetCurrent_Val_I_C_OPB18_30 "" ULONG RB_RBA_Common_CentralElements_CompuMethods_Identical 1 100 0.0 4294967295 FORMAT "%8.2" ECU_ADDRESS 0xfe417e28 /end MEASUREMENT
/begin MEASUREMENT Tlib_Hbr_L3_GetDiag_Val_O_H_OPB18_30 "" ULONG RB_RBA_Common_CentralElements_CompuMethods_Identical 1 100 0.0 4294967295 FORMAT "%8.2" ECU_ADDRESS 0xfe417e2c /end MEASUREMENT
/begin MEASUREMENT Tlib_Hbr_L3_GetStatus_Val_O_H_OPB19_20 "" UBYTE RB_RBA_Common_CentralElements_CompuMethods_Identical 1 100 0.0 255.00 FORMAT "%8.2" ECU_ADDRESS 0xfe4198f5 /end MEASUREMENT
/begin MEASUREMENT Tlib_Efuse_L3_GetCurrent_Val_I_C_OPB19_20 "" ULONG RB_RBA_Common_CentralElements_CompuMethods_Identical 1 100 0.0 4294967295 FORMAT "%8.2" ECU_ADDRESS 0xfe417e30 /end MEASUREMENT
/begin MEASUREMENT Tlib_Hbr_L3_GetDiag_Val_O_H_OPB19_20 "" ULONG RB_RBA_Common_CentralElements_CompuMethods_Identical 1 100 0.0 4294967295 FORMAT "%8.2" ECU_ADDRESS 0xfe417e34 /end MEASUREMENT
/begin MEASUREMENT Tlib_Hbr_L3_GetStatus_Val_O_H_OPB21_22 "" UBYTE RB_RBA_Common_CentralElements_CompuMethods_Identical 1 100 0.0 255.00 FORMAT "%8.2" ECU_ADDRESS 0xfe4198f6 /end MEASUREMENT
/begin MEASUREMENT Tlib_Efuse_L3_GetCurrent_Val_I_C_OPB21_22 "" ULONG RB_RBA_Common_CentralElements_CompuMethods_Identical 1 100 0.0 4294967295 FORMAT "%8.2" ECU_ADDRESS 0xfe417e38 /end MEASUREMENT
/begin MEASUREMENT Tlib_Hbr_L3_GetDiag_Val_O_H_OPB21_22 "" ULONG RB_RBA_Common_CentralElements_CompuMethods_Identical 1 100 0.0 4294967295 FORMAT "%8.2" ECU_ADDRESS 0xfe417e3c /end MEASUREMENT
/begin MEASUREMENT Tlib_Hbr_L3_GetStatus_Val_O_H_OPB22_23 "" UBYTE RB_RBA_Common_CentralElements_CompuMethods_Identical 1 100 0.0 255.00 FORMAT "%8.2" ECU_ADDRESS 0xfe4198f7 /end MEASUREMENT
/begin MEASUREMENT Tlib_Efuse_L3_GetCurrent_Val_I_C_OPB22_23 "" ULONG RB_RBA_Common_CentralElements_CompuMethods_Identical 1 100 0.0 4294967295 FORMAT "%8.2" ECU_ADDRESS 0xfe417e40 /end MEASUREMENT
/begin MEASUREMENT Tlib_Hbr_L3_GetDiag_Val_O_H_OPB22_23 "" ULONG RB_RBA_Common_CentralElements_CompuMethods_Identical 1 100 0.0 4294967295 FORMAT "%8.2" ECU_ADDRESS 0xfe417e44 /end MEASUREMENT
/begin MEASUREMENT Tlib_Hbr_L3_GetStatus_Val_O_H_OPB23_24 "" UBYTE RB_RBA_Common_CentralElements_CompuMethods_Identical 1 100 0.0 255.00 FORMAT "%8.2" ECU_ADDRESS 0xfe4198f8 /end MEASUREMENT
/begin MEASUREMENT Tlib_Efuse_L3_GetCurrent_Val_I_C_OPB23_24 "" ULONG RB_RBA_Common_CentralElements_CompuMethods_Identical 1 100 0.0 4294967295 FORMAT "%8.2" ECU_ADDRESS 0xfe417e48 /end MEASUREMENT
/begin MEASUREMENT Tlib_Hbr_L3_GetDiag_Val_O_H_OPB23_24 "" ULONG RB_RBA_Common_CentralElements_CompuMethods_Identical 1 100 0.0 4294967295 FORMAT "%8.2" ECU_ADDRESS 0xfe417e4c /end MEASUREMENT
/begin MEASUREMENT Tlib_Hbr_L3_GetStatus_Val_O_H_OPB27_28 "" UBYTE RB_RBA_Common_CentralElements_CompuMethods_Identical 1 100 0.0 255.00 FORMAT "%8.2" ECU_ADDRESS 0xfe4198f9 /end MEASUREMENT
/begin MEASUREMENT Tlib_Efuse_L3_GetCurrent_Val_I_C_OPB27_28 "" ULONG RB_RBA_Common_CentralElements_CompuMethods_Identical 1 100 0.0 4294967295 FORMAT "%8.2" ECU_ADDRESS 0xfe417e50 /end MEASUREMENT
/begin MEASUREMENT Tlib_Hbr_L3_GetDiag_Val_O_H_OPB27_28 "" ULONG RB_RBA_Common_CentralElements_CompuMethods_Identical 1 100 0.0 4294967295 FORMAT "%8.2" ECU_ADDRESS 0xfe417e54 /end MEASUREMENT
/begin MEASUREMENT Tlib_Hbr_L3_GetStatus_Val_O_H_OPB25 "" UBYTE RB_RBA_Common_CentralElements_CompuMethods_Identical 1 100 0.0 255.00 FORMAT "%8.2" ECU_ADDRESS 0xfe4198fa /end MEASUREMENT
/begin MEASUREMENT Tlib_Efuse_L3_GetCurrent_Val_I_C_OPB25 "" ULONG RB_RBA_Common_CentralElements_CompuMethods_Identical 1 100 0.0 4294967295 FORMAT "%8.2" ECU_ADDRESS 0xfe417e58 /end MEASUREMENT
/begin MEASUREMENT Tlib_Hbr_L3_GetDiag_Val_O_H_OPB25 "" ULONG RB_RBA_Common_CentralElements_CompuMethods_Identical 1 100 0.0 4294967295 FORMAT "%8.2" ECU_ADDRESS 0xfe417e5c /end MEASUREMENT
/begin MEASUREMENT Tlib_Hbr_L3_GetStatus_Val_O_H_OPB26 "" UBYTE RB_RBA_Common_CentralElements_CompuMethods_Identical 1 100 0.0 255.00 FORMAT "%8.2" ECU_ADDRESS 0xfe4198fb /end MEASUREMENT
/begin MEASUREMENT Tlib_Efuse_L3_GetCurrent_Val_I_C_OPB26 "" ULONG RB_RBA_Common_CentralElements_CompuMethods_Identical 1 100 0.0 4294967295 FORMAT "%8.2" ECU_ADDRESS 0xfe417e60 /end MEASUREMENT
/begin MEASUREMENT Tlib_Hbr_L3_GetDiag_Val_O_H_OPB26 "" ULONG RB_RBA_Common_CentralElements_CompuMethods_Identical 1 100 0.0 4294967295 FORMAT "%8.2" ECU_ADDRESS 0xfe417e64 /end MEASUREMENT
/begin MEASUREMENT Tlib_Hbr_L3_GetStatus_Val_O_H_OPB29 "" UBYTE RB_RBA_Common_CentralElements_CompuMethods_Identical 1 100 0.0 255.00 FORMAT "%8.2" ECU_ADDRESS 0xfe4198fc /end MEASUREMENT
/begin MEASUREMENT Tlib_Efuse_L3_GetCurrent_Val_I_C_OPB29 "" ULONG RB_RBA_Common_CentralElements_CompuMethods_Identical 1 100 0.0 4294967295 FORMAT "%8.2" ECU_ADDRESS 0xfe417e68 /end MEASUREMENT
/begin MEASUREMENT Tlib_Hbr_L3_GetDiag_Val_O_H_OPB29 "" ULONG RB_RBA_Common_CentralElements_CompuMethods_Identical 1 100 0.0 4294967295 FORMAT "%8.2" ECU_ADDRESS 0xfe417e6c /end MEASUREMENT
/begin MEASUREMENT Tlib_EfuseRegRead_GetCr1_O_S_5V05 "" ULONG RB_RBA_Common_CentralElements_CompuMethods_Identical 1 100 0.0 4294967295 FORMAT "%8.2" ECU_ADDRESS 0xfe417e70 /end MEASUREMENT
/begin MEASUREMENT Tlib_EfuseRegRead_GetCR3_O_S_5V05 "" ULONG RB_RBA_Common_CentralElements_CompuMethods_Identical 1 100 0.0 4294967295 FORMAT "%8.2" ECU_ADDRESS 0xfe417e74 /end MEASUREMENT
/begin MEASUREMENT Tlib_EfuseRegRead_GetSR1_O_S_5V05 "" ULONG RB_RBA_Common_CentralElements_CompuMethods_Identical 1 100 0.0 4294967295 FORMAT "%8.2" ECU_ADDRESS 0xfe417e78 /end MEASUREMENT
/begin MEASUREMENT Tlib_EfuseRegRead_GetCurrent_O_S_5V05 "" ULONG RB_RBA_Common_CentralElements_CompuMethods_Identical 1 100 0.0 4294967295 FORMAT "%8.2" ECU_ADDRESS 0xfe417e7c /end MEASUREMENT
/begin MEASUREMENT Tlib_EfuseRegRead_GetTJ_O_S_5V05 "" ULONG RB_RBA_Common_CentralElements_CompuMethods_Identical 1 100 0.0 4294967295 FORMAT "%8.2" ECU_ADDRESS 0xfe417e80 /end MEASUREMENT
/begin MEASUREMENT Tlib_EfuseRegRead_GetTMOS_O_S_5V05 "" ULONG RB_RBA_Common_CentralElements_CompuMethods_Identical 1 100 0.0 4294967295 FORMAT "%8.2" ECU_ADDRESS 0xfe417e84 /end MEASUREMENT
/begin MEASUREMENT Tlib_EfuseRegRead_GetVDS_O_S_5V05 "" ULONG RB_RBA_Common_CentralElements_CompuMethods_Identical 1 100 0.0 4294967295 FORMAT "%8.2" ECU_ADDRESS 0xfe417e88 /end MEASUREMENT
/begin MEASUREMENT Tlib_EfuseRegRead_GetVOUT_O_S_5V05 "" ULONG RB_RBA_Common_CentralElements_CompuMethods_Identical 1 100 0.0 4294967295 FORMAT "%8.2" ECU_ADDRESS 0xfe417e8c /end MEASUREMENT
/begin MEASUREMENT Tlib_EfuseRegRead_GetT_NOM_O_S_5V05 "" ULONG RB_RBA_Common_CentralElements_CompuMethods_Identical 1 100 0.0 4294967295 FORMAT "%8.2" ECU_ADDRESS 0xfe417e90 /end MEASUREMENT
/begin MEASUREMENT Tlib_EfuseRegRead_GetOVC_THR_O_S_5V05 "" ULONG RB_RBA_Common_CentralElements_CompuMethods_Identical 1 100 0.0 4294967295 FORMAT "%8.2" ECU_ADDRESS 0xfe417e94 /end MEASUREMENT
/begin MEASUREMENT Tlib_EfuseRegRead_GetHSHT_THR_O_S_5V05 "" ULONG RB_RBA_Common_CentralElements_CompuMethods_Identical 1 100 0.0 4294967295 FORMAT "%8.2" ECU_ADDRESS 0xfe417e98 /end MEASUREMENT
/begin MEASUREMENT Tlib_EfuseRegRead_GetVDS_THR_O_S_5V05 "" ULONG RB_RBA_Common_CentralElements_CompuMethods_Identical 1 100 0.0 4294967295 FORMAT "%8.2" ECU_ADDRESS 0xfe417e9c /end MEASUREMENT
/begin MEASUREMENT Tlib_EfuseRegRead_GetNTC_THR_O_S_5V05 "" ULONG RB_RBA_Common_CentralElements_CompuMethods_Identical 1 100 0.0 4294967295 FORMAT "%8.2" ECU_ADDRESS 0xfe417ea0 /end MEASUREMENT
/begin MEASUREMENT Tlib_EfuseRegRead_R_Shunt_O_S_5V05 "" ULONG RB_RBA_Common_CentralElements_CompuMethods_Identical 1 100 0.0 4294967295 FORMAT "%8.2" ECU_ADDRESS 0xfe417ea4 /end MEASUREMENT
/begin MEASUREMENT Tlib_EfuseRegRead_GetCr1_O_S_5V02 "" ULONG RB_RBA_Common_CentralElements_CompuMethods_Identical 1 100 0.0 4294967295 FORMAT "%8.2" ECU_ADDRESS 0xfe417ea8 /end MEASUREMENT
/begin MEASUREMENT Tlib_EfuseRegRead_GetCR3_O_S_5V02 "" ULONG RB_RBA_Common_CentralElements_CompuMethods_Identical 1 100 0.0 4294967295 FORMAT "%8.2" ECU_ADDRESS 0xfe417eac /end MEASUREMENT
/begin MEASUREMENT Tlib_EfuseRegRead_GetSR1_O_S_5V02 "" ULONG RB_RBA_Common_CentralElements_CompuMethods_Identical 1 100 0.0 4294967295 FORMAT "%8.2" ECU_ADDRESS 0xfe417eb0 /end MEASUREMENT
/begin MEASUREMENT Tlib_EfuseRegRead_GetCurrent_O_S_5V02 "" ULONG RB_RBA_Common_CentralElements_CompuMethods_Identical 1 100 0.0 4294967295 FORMAT "%8.2" ECU_ADDRESS 0xfe417eb4 /end MEASUREMENT
/begin MEASUREMENT Tlib_EfuseRegRead_GetTJ_O_S_5V02 "" ULONG RB_RBA_Common_CentralElements_CompuMethods_Identical 1 100 0.0 4294967295 FORMAT "%8.2" ECU_ADDRESS 0xfe417eb8 /end MEASUREMENT
/begin MEASUREMENT Tlib_EfuseRegRead_GetTMOS_O_S_5V02 "" ULONG RB_RBA_Common_CentralElements_CompuMethods_Identical 1 100 0.0 4294967295 FORMAT "%8.2" ECU_ADDRESS 0xfe417ebc /end MEASUREMENT
/begin MEASUREMENT Tlib_EfuseRegRead_GetVDS_O_S_5V02 "" ULONG RB_RBA_Common_CentralElements_CompuMethods_Identical 1 100 0.0 4294967295 FORMAT "%8.2" ECU_ADDRESS 0xfe417ec0 /end MEASUREMENT
/begin MEASUREMENT Tlib_EfuseRegRead_GetVOUT_O_S_5V02 "" ULONG RB_RBA_Common_CentralElements_CompuMethods_Identical 1 100 0.0 4294967295 FORMAT "%8.2" ECU_ADDRESS 0xfe417ec4 /end MEASUREMENT
/begin MEASUREMENT Tlib_EfuseRegRead_GetT_NOM_O_S_5V02 "" ULONG RB_RBA_Common_CentralElements_CompuMethods_Identical 1 100 0.0 4294967295 FORMAT "%8.2" ECU_ADDRESS 0xfe417ec8 /end MEASUREMENT
/begin MEASUREMENT Tlib_EfuseRegRead_GetOVC_THR_O_S_5V02 "" ULONG RB_RBA_Common_CentralElements_CompuMethods_Identical 1 100 0.0 4294967295 FORMAT "%8.2" ECU_ADDRESS 0xfe417ecc /end MEASUREMENT
/begin MEASUREMENT Tlib_EfuseRegRead_GetHSHT_THR_O_S_5V02 "" ULONG RB_RBA_Common_CentralElements_CompuMethods_Identical 1 100 0.0 4294967295 FORMAT "%8.2" ECU_ADDRESS 0xfe417ed0 /end MEASUREMENT
/begin MEASUREMENT Tlib_EfuseRegRead_GetVDS_THR_O_S_5V02 "" ULONG RB_RBA_Common_CentralElements_CompuMethods_Identical 1 100 0.0 4294967295 FORMAT "%8.2" ECU_ADDRESS 0xfe417ed4 /end MEASUREMENT
/begin MEASUREMENT Tlib_EfuseRegRead_GetNTC_THR_O_S_5V02 "" ULONG RB_RBA_Common_CentralElements_CompuMethods_Identical 1 100 0.0 4294967295 FORMAT "%8.2" ECU_ADDRESS 0xfe417ed8 /end MEASUREMENT
/begin MEASUREMENT Tlib_EfuseRegRead_R_Shunt_O_S_5V02 "" ULONG RB_RBA_Common_CentralElements_CompuMethods_Identical 1 100 0.0 4294967295 FORMAT "%8.2" ECU_ADDRESS 0xfe417edc /end MEASUREMENT
/begin MEASUREMENT Tlib_EfuseRegRead_GetCr1_O_S_5V06 "" ULONG RB_RBA_Common_CentralElements_CompuMethods_Identical 1 100 0.0 4294967295 FORMAT "%8.2" ECU_ADDRESS 0xfe417ee0 /end MEASUREMENT
/begin MEASUREMENT Tlib_EfuseRegRead_GetCR3_O_S_5V06 "" ULONG RB_RBA_Common_CentralElements_CompuMethods_Identical 1 100 0.0 4294967295 FORMAT "%8.2" ECU_ADDRESS 0xfe417ee4 /end MEASUREMENT
/begin MEASUREMENT Tlib_EfuseRegRead_GetSR1_O_S_5V06 "" ULONG RB_RBA_Common_CentralElements_CompuMethods_Identical 1 100 0.0 4294967295 FORMAT "%8.2" ECU_ADDRESS 0xfe417ee8 /end MEASUREMENT
/begin MEASUREMENT Tlib_EfuseRegRead_GetCurrent_O_S_5V06 "" ULONG RB_RBA_Common_CentralElements_CompuMethods_Identical 1 100 0.0 4294967295 FORMAT "%8.2" ECU_ADDRESS 0xfe417eec /end MEASUREMENT
/begin MEASUREMENT Tlib_EfuseRegRead_GetTJ_O_S_5V06 "" ULONG RB_RBA_Common_CentralElements_CompuMethods_Identical 1 100 0.0 4294967295 FORMAT "%8.2" ECU_ADDRESS 0xfe417ef0 /end MEASUREMENT
/begin MEASUREMENT Tlib_EfuseRegRead_GetTMOS_O_S_5V06 "" ULONG RB_RBA_Common_CentralElements_CompuMethods_Identical 1 100 0.0 4294967295 FORMAT "%8.2" ECU_ADDRESS 0xfe417ef4 /end MEASUREMENT
/begin MEASUREMENT Tlib_EfuseRegRead_GetVDS_O_S_5V06 "" ULONG RB_RBA_Common_CentralElements_CompuMethods_Identical 1 100 0.0 4294967295 FORMAT "%8.2" ECU_ADDRESS 0xfe417ef8 /end MEASUREMENT
/begin MEASUREMENT Tlib_EfuseRegRead_GetVOUT_O_S_5V06 "" ULONG RB_RBA_Common_CentralElements_CompuMethods_Identical 1 100 0.0 4294967295 FORMAT "%8.2" ECU_ADDRESS 0xfe417efc /end MEASUREMENT
/begin MEASUREMENT Tlib_EfuseRegRead_GetT_NOM_O_S_5V06 "" ULONG RB_RBA_Common_CentralElements_CompuMethods_Identical 1 100 0.0 4294967295 FORMAT "%8.2" ECU_ADDRESS 0xfe417f00 /end MEASUREMENT
/begin MEASUREMENT Tlib_EfuseRegRead_GetOVC_THR_O_S_5V06 "" ULONG RB_RBA_Common_CentralElements_CompuMethods_Identical 1 100 0.0 4294967295 FORMAT "%8.2" ECU_ADDRESS 0xfe417f04 /end MEASUREMENT
/begin MEASUREMENT Tlib_EfuseRegRead_GetHSHT_THR_O_S_5V06 "" ULONG RB_RBA_Common_CentralElements_CompuMethods_Identical 1 100 0.0 4294967295 FORMAT "%8.2" ECU_ADDRESS 0xfe417f08 /end MEASUREMENT
/begin MEASUREMENT Tlib_EfuseRegRead_GetVDS_THR_O_S_5V06 "" ULONG RB_RBA_Common_CentralElements_CompuMethods_Identical 1 100 0.0 4294967295 FORMAT "%8.2" ECU_ADDRESS 0xfe417f0c /end MEASUREMENT
/begin MEASUREMENT Tlib_EfuseRegRead_GetNTC_THR_O_S_5V06 "" ULONG RB_RBA_Common_CentralElements_CompuMethods_Identical 1 100 0.0 4294967295 FORMAT "%8.2" ECU_ADDRESS 0xfe417f10 /end MEASUREMENT
/begin MEASUREMENT Tlib_EfuseRegRead_R_Shunt_O_S_5V06 "" ULONG RB_RBA_Common_CentralElements_CompuMethods_Identical 1 100 0.0 4294967295 FORMAT "%8.2" ECU_ADDRESS 0xfe417f14 /end MEASUREMENT
/begin MEASUREMENT Tlib_EfuseRegRead_GetCr1_O_S_5V07 "" ULONG RB_RBA_Common_CentralElements_CompuMethods_Identical 1 100 0.0 4294967295 FORMAT "%8.2" ECU_ADDRESS 0xfe417f18 /end MEASUREMENT
/begin MEASUREMENT Tlib_EfuseRegRead_GetCR3_O_S_5V07 "" ULONG RB_RBA_Common_CentralElements_CompuMethods_Identical 1 100 0.0 4294967295 FORMAT "%8.2" ECU_ADDRESS 0xfe417f1c /end MEASUREMENT
/begin MEASUREMENT Tlib_EfuseRegRead_GetSR1_O_S_5V07 "" ULONG RB_RBA_Common_CentralElements_CompuMethods_Identical 1 100 0.0 4294967295 FORMAT "%8.2" ECU_ADDRESS 0xfe417f20 /end MEASUREMENT
/begin MEASUREMENT Tlib_EfuseRegRead_GetCurrent_O_S_5V07 "" ULONG RB_RBA_Common_CentralElements_CompuMethods_Identical 1 100 0.0 4294967295 FORMAT "%8.2" ECU_ADDRESS 0xfe417f24 /end MEASUREMENT
/begin MEASUREMENT Tlib_EfuseRegRead_GetTJ_O_S_5V07 "" ULONG RB_RBA_Common_CentralElements_CompuMethods_Identical 1 100 0.0 4294967295 FORMAT "%8.2" ECU_ADDRESS 0xfe417f28 /end MEASUREMENT
/begin MEASUREMENT Tlib_EfuseRegRead_GetTMOS_O_S_5V07 "" ULONG RB_RBA_Common_CentralElements_CompuMethods_Identical 1 100 0.0 4294967295 FORMAT "%8.2" ECU_ADDRESS 0xfe417f2c /end MEASUREMENT
/begin MEASUREMENT Tlib_EfuseRegRead_GetVDS_O_S_5V07 "" ULONG RB_RBA_Common_CentralElements_CompuMethods_Identical 1 100 0.0 4294967295 FORMAT "%8.2" ECU_ADDRESS 0xfe417f30 /end MEASUREMENT
/begin MEASUREMENT Tlib_EfuseRegRead_GetVOUT_O_S_5V07 "" ULONG RB_RBA_Common_CentralElements_CompuMethods_Identical 1 100 0.0 4294967295 FORMAT "%8.2" ECU_ADDRESS 0xfe417f34 /end MEASUREMENT
/begin MEASUREMENT Tlib_EfuseRegRead_GetT_NOM_O_S_5V07 "" ULONG RB_RBA_Common_CentralElements_CompuMethods_Identical 1 100 0.0 4294967295 FORMAT "%8.2" ECU_ADDRESS 0xfe417f38 /end MEASUREMENT
/begin MEASUREMENT Tlib_EfuseRegRead_GetOVC_THR_O_S_5V07 "" ULONG RB_RBA_Common_CentralElements_CompuMethods_Identical 1 100 0.0 4294967295 FORMAT "%8.2" ECU_ADDRESS 0xfe417f3c /end MEASUREMENT
/begin MEASUREMENT Tlib_EfuseRegRead_GetHSHT_THR_O_S_5V07 "" ULONG RB_RBA_Common_CentralElements_CompuMethods_Identical 1 100 0.0 4294967295 FORMAT "%8.2" ECU_ADDRESS 0xfe417f40 /end MEASUREMENT
/begin MEASUREMENT Tlib_EfuseRegRead_GetVDS_THR_O_S_5V07 "" ULONG RB_RBA_Common_CentralElements_CompuMethods_Identical 1 100 0.0 4294967295 FORMAT "%8.2" ECU_ADDRESS 0xfe417f44 /end MEASUREMENT
/begin MEASUREMENT Tlib_EfuseRegRead_GetNTC_THR_O_S_5V07 "" ULONG RB_RBA_Common_CentralElements_CompuMethods_Identical 1 100 0.0 4294967295 FORMAT "%8.2" ECU_ADDRESS 0xfe417f48 /end MEASUREMENT
/begin MEASUREMENT Tlib_EfuseRegRead_R_Shunt_O_S_5V07 "" ULONG RB_RBA_Common_CentralElements_CompuMethods_Identical 1 100 0.0 4294967295 FORMAT "%8.2" ECU_ADDRESS 0xfe417f4c /end MEASUREMENT
/begin MEASUREMENT Tlib_EfuseRegRead_GetCr1_O_S_5V10 "" ULONG RB_RBA_Common_CentralElements_CompuMethods_Identical 1 100 0.0 4294967295 FORMAT "%8.2" ECU_ADDRESS 0xfe417f50 /end MEASUREMENT
/begin MEASUREMENT Tlib_EfuseRegRead_GetCR3_O_S_5V10 "" ULONG RB_RBA_Common_CentralElements_CompuMethods_Identical 1 100 0.0 4294967295 FORMAT "%8.2" ECU_ADDRESS 0xfe417f54 /end MEASUREMENT
/begin MEASUREMENT Tlib_EfuseRegRead_GetSR1_O_S_5V10 "" ULONG RB_RBA_Common_CentralElements_CompuMethods_Identical 1 100 0.0 4294967295 FORMAT "%8.2" ECU_ADDRESS 0xfe417f58 /end MEASUREMENT
/begin MEASUREMENT Tlib_EfuseRegRead_GetCurrent_O_S_5V10 "" ULONG RB_RBA_Common_CentralElements_CompuMethods_Identical 1 100 0.0 4294967295 FORMAT "%8.2" ECU_ADDRESS 0xfe417f5c /end MEASUREMENT
/begin MEASUREMENT Tlib_EfuseRegRead_GetTJ_O_S_5V10 "" ULONG RB_RBA_Common_CentralElements_CompuMethods_Identical 1 100 0.0 4294967295 FORMAT "%8.2" ECU_ADDRESS 0xfe417f60 /end MEASUREMENT
/begin MEASUREMENT Tlib_EfuseRegRead_GetTMOS_O_S_5V10 "" ULONG RB_RBA_Common_CentralElements_CompuMethods_Identical 1 100 0.0 4294967295 FORMAT "%8.2" ECU_ADDRESS 0xfe417f64 /end MEASUREMENT
/begin MEASUREMENT Tlib_EfuseRegRead_GetVDS_O_S_5V10 "" ULONG RB_RBA_Common_CentralElements_CompuMethods_Identical 1 100 0.0 4294967295 FORMAT "%8.2" ECU_ADDRESS 0xfe417f68 /end MEASUREMENT
/begin MEASUREMENT Tlib_EfuseRegRead_GetVOUT_O_S_5V10 "" ULONG RB_RBA_Common_CentralElements_CompuMethods_Identical 1 100 0.0 4294967295 FORMAT "%8.2" ECU_ADDRESS 0xfe417f6c /end MEASUREMENT
/begin MEASUREMENT Tlib_EfuseRegRead_GetT_NOM_O_S_5V10 "" ULONG RB_RBA_Common_CentralElements_CompuMethods_Identical 1 100 0.0 4294967295 FORMAT "%8.2" ECU_ADDRESS 0xfe417f70 /end MEASUREMENT
/begin MEASUREMENT Tlib_EfuseRegRead_GetOVC_THR_O_S_5V10 "" ULONG RB_RBA_Common_CentralElements_CompuMethods_Identical 1 100 0.0 4294967295 FORMAT "%8.2" ECU_ADDRESS 0xfe417f74 /end MEASUREMENT
/begin MEASUREMENT Tlib_EfuseRegRead_GetHSHT_THR_O_S_5V10 "" ULONG RB_RBA_Common_CentralElements_CompuMethods_Identical 1 100 0.0 4294967295 FORMAT "%8.2" ECU_ADDRESS 0xfe417f78 /end MEASUREMENT
/begin MEASUREMENT Tlib_EfuseRegRead_GetVDS_THR_O_S_5V10 "" ULONG RB_RBA_Common_CentralElements_CompuMethods_Identical 1 100 0.0 4294967295 FORMAT "%8.2" ECU_ADDRESS 0xfe417f7c /end MEASUREMENT
/begin MEASUREMENT Tlib_EfuseRegRead_GetNTC_THR_O_S_5V10 "" ULONG RB_RBA_Common_CentralElements_CompuMethods_Identical 1 100 0.0 4294967295 FORMAT "%8.2" ECU_ADDRESS 0xfe417f80 /end MEASUREMENT
/begin MEASUREMENT Tlib_EfuseRegRead_R_Shunt_O_S_5V10 "" ULONG RB_RBA_Common_CentralElements_CompuMethods_Identical 1 100 0.0 4294967295 FORMAT "%8.2" ECU_ADDRESS 0xfe417f84 /end MEASUREMENT
/begin MEASUREMENT Tlib_EfuseRegRead_GetCr1_O_S_ODH110 "" ULONG RB_RBA_Common_CentralElements_CompuMethods_Identical 1 100 0.0 4294967295 FORMAT "%8.2" ECU_ADDRESS 0xfe417f88 /end MEASUREMENT
/begin MEASUREMENT Tlib_EfuseRegRead_GetCR3_O_S_ODH110 "" ULONG RB_RBA_Common_CentralElements_CompuMethods_Identical 1 100 0.0 4294967295 FORMAT "%8.2" ECU_ADDRESS 0xfe417f8c /end MEASUREMENT
/begin MEASUREMENT Tlib_EfuseRegRead_GetSR1_O_S_ODH110 "" ULONG RB_RBA_Common_CentralElements_CompuMethods_Identical 1 100 0.0 4294967295 FORMAT "%8.2" ECU_ADDRESS 0xfe417f90 /end MEASUREMENT
/begin MEASUREMENT Tlib_EfuseRegRead_GetCurrent_O_S_ODH110 "" ULONG RB_RBA_Common_CentralElements_CompuMethods_Identical 1 100 0.0 4294967295 FORMAT "%8.2" ECU_ADDRESS 0xfe417f94 /end MEASUREMENT
/begin MEASUREMENT Tlib_EfuseRegRead_GetTJ_O_S_ODH110 "" ULONG RB_RBA_Common_CentralElements_CompuMethods_Identical 1 100 0.0 4294967295 FORMAT "%8.2" ECU_ADDRESS 0xfe417f98 /end MEASUREMENT
/begin MEASUREMENT Tlib_EfuseRegRead_GetTMOS_O_S_ODH110 "" ULONG RB_RBA_Common_CentralElements_CompuMethods_Identical 1 100 0.0 4294967295 FORMAT "%8.2" ECU_ADDRESS 0xfe417f9c /end MEASUREMENT
/begin MEASUREMENT Tlib_EfuseRegRead_GetVDS_O_S_ODH110 "" ULONG RB_RBA_Common_CentralElements_CompuMethods_Identical 1 100 0.0 4294967295 FORMAT "%8.2" ECU_ADDRESS 0xfe417fa0 /end MEASUREMENT
/begin MEASUREMENT Tlib_EfuseRegRead_GetVOUT_O_S_ODH110 "" ULONG RB_RBA_Common_CentralElements_CompuMethods_Identical 1 100 0.0 4294967295 FORMAT "%8.2" ECU_ADDRESS 0xfe417fa4 /end MEASUREMENT
/begin MEASUREMENT Tlib_EfuseRegRead_GetT_NOM_O_S_ODH110 "" ULONG RB_RBA_Common_CentralElements_CompuMethods_Identical 1 100 0.0 4294967295 FORMAT "%8.2" ECU_ADDRESS 0xfe417fa8 /end MEASUREMENT
/begin MEASUREMENT Tlib_EfuseRegRead_GetOVC_THR_O_S_ODH110 "" ULONG RB_RBA_Common_CentralElements_CompuMethods_Identical 1 100 0.0 4294967295 FORMAT "%8.2" ECU_ADDRESS 0xfe417fac /end MEASUREMENT
/begin MEASUREMENT Tlib_EfuseRegRead_GetHSHT_THR_O_S_ODH110 "" ULONG RB_RBA_Common_CentralElements_CompuMethods_Identical 1 100 0.0 4294967295 FORMAT "%8.2" ECU_ADDRESS 0xfe417fb0 /end MEASUREMENT
/begin MEASUREMENT Tlib_EfuseRegRead_GetVDS_THR_O_S_ODH110 "" ULONG RB_RBA_Common_CentralElements_CompuMethods_Identical 1 100 0.0 4294967295 FORMAT "%8.2" ECU_ADDRESS 0xfe417fb4 /end MEASUREMENT
/begin MEASUREMENT Tlib_EfuseRegRead_GetNTC_THR_O_S_ODH110 "" ULONG RB_RBA_Common_CentralElements_CompuMethods_Identical 1 100 0.0 4294967295 FORMAT "%8.2" ECU_ADDRESS 0xfe417fb8 /end MEASUREMENT
/begin MEASUREMENT Tlib_EfuseRegRead_R_Shunt_O_S_ODH110 "" ULONG RB_RBA_Common_CentralElements_CompuMethods_Identical 1 100 0.0 4294967295 FORMAT "%8.2" ECU_ADDRESS 0xfe417fbc /end MEASUREMENT
/begin MEASUREMENT Tlib_EfuseRegRead_GetCr1_O_S_ODH111 "" ULONG RB_RBA_Common_CentralElements_CompuMethods_Identical 1 100 0.0 4294967295 FORMAT "%8.2" ECU_ADDRESS 0xfe417fc0 /end MEASUREMENT
/begin MEASUREMENT Tlib_EfuseRegRead_GetCR3_O_S_ODH111 "" ULONG RB_RBA_Common_CentralElements_CompuMethods_Identical 1 100 0.0 4294967295 FORMAT "%8.2" ECU_ADDRESS 0xfe417fc4 /end MEASUREMENT
/begin MEASUREMENT Tlib_EfuseRegRead_GetSR1_O_S_ODH111 "" ULONG RB_RBA_Common_CentralElements_CompuMethods_Identical 1 100 0.0 4294967295 FORMAT "%8.2" ECU_ADDRESS 0xfe417fc8 /end MEASUREMENT
/begin MEASUREMENT Tlib_EfuseRegRead_GetCurrent_O_S_ODH111 "" ULONG RB_RBA_Common_CentralElements_CompuMethods_Identical 1 100 0.0 4294967295 FORMAT "%8.2" ECU_ADDRESS 0xfe417fcc /end MEASUREMENT
/begin MEASUREMENT Tlib_EfuseRegRead_GetTJ_O_S_ODH111 "" ULONG RB_RBA_Common_CentralElements_CompuMethods_Identical 1 100 0.0 4294967295 FORMAT "%8.2" ECU_ADDRESS 0xfe417fd0 /end MEASUREMENT
/begin MEASUREMENT Tlib_EfuseRegRead_GetTMOS_O_S_ODH111 "" ULONG RB_RBA_Common_CentralElements_CompuMethods_Identical 1 100 0.0 4294967295 FORMAT "%8.2" ECU_ADDRESS 0xfe417fd4 /end MEASUREMENT
/begin MEASUREMENT Tlib_EfuseRegRead_GetVDS_O_S_ODH111 "" ULONG RB_RBA_Common_CentralElements_CompuMethods_Identical 1 100 0.0 4294967295 FORMAT "%8.2" ECU_ADDRESS 0xfe417fd8 /end MEASUREMENT
/begin MEASUREMENT Tlib_EfuseRegRead_GetVOUT_O_S_ODH111 "" ULONG RB_RBA_Common_CentralElements_CompuMethods_Identical 1 100 0.0 4294967295 FORMAT "%8.2" ECU_ADDRESS 0xfe417fdc /end MEASUREMENT
/begin MEASUREMENT Tlib_EfuseRegRead_GetT_NOM_O_S_ODH111 "" ULONG RB_RBA_Common_CentralElements_CompuMethods_Identical 1 100 0.0 4294967295 FORMAT "%8.2" ECU_ADDRESS 0xfe417fe0 /end MEASUREMENT
/begin MEASUREMENT Tlib_EfuseRegRead_GetOVC_THR_O_S_ODH111 "" ULONG RB_RBA_Common_CentralElements_CompuMethods_Identical 1 100 0.0 4294967295 FORMAT "%8.2" ECU_ADDRESS 0xfe417fe4 /end MEASUREMENT
/begin MEASUREMENT Tlib_EfuseRegRead_GetHSHT_THR_O_S_ODH111 "" ULONG RB_RBA_Common_CentralElements_CompuMethods_Identical 1 100 0.0 4294967295 FORMAT "%8.2" ECU_ADDRESS 0xfe417fe8 /end MEASUREMENT
/begin MEASUREMENT Tlib_EfuseRegRead_GetVDS_THR_O_S_ODH111 "" ULONG RB_RBA_Common_CentralElements_CompuMethods_Identical 1 100 0.0 4294967295 FORMAT "%8.2" ECU_ADDRESS 0xfe417fec /end MEASUREMENT
/begin MEASUREMENT Tlib_EfuseRegRead_GetNTC_THR_O_S_ODH111 "" ULONG RB_RBA_Common_CentralElements_CompuMethods_Identical 1 100 0.0 4294967295 FORMAT "%8.2" ECU_ADDRESS 0xfe417ff0 /end MEASUREMENT
/begin MEASUREMENT Tlib_EfuseRegRead_R_Shunt_O_S_ODH111 "" ULONG RB_RBA_Common_CentralElements_CompuMethods_Identical 1 100 0.0 4294967295 FORMAT "%8.2" ECU_ADDRESS 0xfe417ff4 /end MEASUREMENT
/begin MEASUREMENT Tlib_EfuseRegRead_GetCr1_O_S_ODH112 "" ULONG RB_RBA_Common_CentralElements_CompuMethods_Identical 1 100 0.0 4294967295 FORMAT "%8.2" ECU_ADDRESS 0xfe417ff8 /end MEASUREMENT
/begin MEASUREMENT Tlib_EfuseRegRead_GetCR3_O_S_ODH112 "" ULONG RB_RBA_Common_CentralElements_CompuMethods_Identical 1 100 0.0 4294967295 FORMAT "%8.2" ECU_ADDRESS 0xfe417ffc /end MEASUREMENT
/begin MEASUREMENT Tlib_EfuseRegRead_GetSR1_O_S_ODH112 "" ULONG RB_RBA_Common_CentralElements_CompuMethods_Identical 1 100 0.0 4294967295 FORMAT "%8.2" ECU_ADDRESS 0xfe418000 /end MEASUREMENT
/begin MEASUREMENT Tlib_EfuseRegRead_GetCurrent_O_S_ODH112 "" ULONG RB_RBA_Common_CentralElements_CompuMethods_Identical 1 100 0.0 4294967295 FORMAT "%8.2" ECU_ADDRESS 0xfe418004 /end MEASUREMENT
/begin MEASUREMENT Tlib_EfuseRegRead_GetTJ_O_S_ODH112 "" ULONG RB_RBA_Common_CentralElements_CompuMethods_Identical 1 100 0.0 4294967295 FORMAT "%8.2" ECU_ADDRESS 0xfe418008 /end MEASUREMENT
/begin MEASUREMENT Tlib_EfuseRegRead_GetTMOS_O_S_ODH112 "" ULONG RB_RBA_Common_CentralElements_CompuMethods_Identical 1 100 0.0 4294967295 FORMAT "%8.2" ECU_ADDRESS 0xfe41800c /end MEASUREMENT
/begin MEASUREMENT Tlib_EfuseRegRead_GetVDS_O_S_ODH112 "" ULONG RB_RBA_Common_CentralElements_CompuMethods_Identical 1 100 0.0 4294967295 FORMAT "%8.2" ECU_ADDRESS 0xfe418010 /end MEASUREMENT
/begin MEASUREMENT Tlib_EfuseRegRead_GetVOUT_O_S_ODH112 "" ULONG RB_RBA_Common_CentralElements_CompuMethods_Identical 1 100 0.0 4294967295 FORMAT "%8.2" ECU_ADDRESS 0xfe418014 /end MEASUREMENT
/begin MEASUREMENT Tlib_EfuseRegRead_GetT_NOM_O_S_ODH112 "" ULONG RB_RBA_Common_CentralElements_CompuMethods_Identical 1 100 0.0 4294967295 FORMAT "%8.2" ECU_ADDRESS 0xfe418018 /end MEASUREMENT
/begin MEASUREMENT Tlib_EfuseRegRead_GetOVC_THR_O_S_ODH112 "" ULONG RB_RBA_Common_CentralElements_CompuMethods_Identical 1 100 0.0 4294967295 FORMAT "%8.2" ECU_ADDRESS 0xfe41801c /end MEASUREMENT
/begin MEASUREMENT Tlib_EfuseRegRead_GetHSHT_THR_O_S_ODH112 "" ULONG RB_RBA_Common_CentralElements_CompuMethods_Identical 1 100 0.0 4294967295 FORMAT "%8.2" ECU_ADDRESS 0xfe418020 /end MEASUREMENT
/begin MEASUREMENT Tlib_EfuseRegRead_GetVDS_THR_O_S_ODH112 "" ULONG RB_RBA_Common_CentralElements_CompuMethods_Identical 1 100 0.0 4294967295 FORMAT "%8.2" ECU_ADDRESS 0xfe418024 /end MEASUREMENT
/begin MEASUREMENT Tlib_EfuseRegRead_GetNTC_THR_O_S_ODH112 "" ULONG RB_RBA_Common_CentralElements_CompuMethods_Identical 1 100 0.0 4294967295 FORMAT "%8.2" ECU_ADDRESS 0xfe418028 /end MEASUREMENT
/begin MEASUREMENT Tlib_EfuseRegRead_R_Shunt_O_S_ODH112 "" ULONG RB_RBA_Common_CentralElements_CompuMethods_Identical 1 100 0.0 4294967295 FORMAT "%8.2" ECU_ADDRESS 0xfe41802c /end MEASUREMENT
/begin MEASUREMENT Tlib_EfuseRegRead_GetCr1_O_S_ODH113 "" ULONG RB_RBA_Common_CentralElements_CompuMethods_Identical 1 100 0.0 4294967295 FORMAT "%8.2" ECU_ADDRESS 0xfe418030 /end MEASUREMENT
/begin MEASUREMENT Tlib_EfuseRegRead_GetCR3_O_S_ODH113 "" ULONG RB_RBA_Common_CentralElements_CompuMethods_Identical 1 100 0.0 4294967295 FORMAT "%8.2" ECU_ADDRESS 0xfe418034 /end MEASUREMENT
/begin MEASUREMENT Tlib_EfuseRegRead_GetSR1_O_S_ODH113 "" ULONG RB_RBA_Common_CentralElements_CompuMethods_Identical 1 100 0.0 4294967295 FORMAT "%8.2" ECU_ADDRESS 0xfe418038 /end MEASUREMENT
/begin MEASUREMENT Tlib_EfuseRegRead_GetCurrent_O_S_ODH113 "" ULONG RB_RBA_Common_CentralElements_CompuMethods_Identical 1 100 0.0 4294967295 FORMAT "%8.2" ECU_ADDRESS 0xfe41803c /end MEASUREMENT
/begin MEASUREMENT Tlib_EfuseRegRead_GetTJ_O_S_ODH113 "" ULONG RB_RBA_Common_CentralElements_CompuMethods_Identical 1 100 0.0 4294967295 FORMAT "%8.2" ECU_ADDRESS 0xfe418040 /end MEASUREMENT
/begin MEASUREMENT Tlib_EfuseRegRead_GetTMOS_O_S_ODH113 "" ULONG RB_RBA_Common_CentralElements_CompuMethods_Identical 1 100 0.0 4294967295 FORMAT "%8.2" ECU_ADDRESS 0xfe418044 /end MEASUREMENT
/begin MEASUREMENT Tlib_EfuseRegRead_GetVDS_O_S_ODH113 "" ULONG RB_RBA_Common_CentralElements_CompuMethods_Identical 1 100 0.0 4294967295 FORMAT "%8.2" ECU_ADDRESS 0xfe418048 /end MEASUREMENT
/begin MEASUREMENT Tlib_EfuseRegRead_GetVOUT_O_S_ODH113 "" ULONG RB_RBA_Common_CentralElements_CompuMethods_Identical 1 100 0.0 4294967295 FORMAT "%8.2" ECU_ADDRESS 0xfe41804c /end MEASUREMENT
/begin MEASUREMENT Tlib_EfuseRegRead_GetT_NOM_O_S_ODH113 "" ULONG RB_RBA_Common_CentralElements_CompuMethods_Identical 1 100 0.0 4294967295 FORMAT "%8.2" ECU_ADDRESS 0xfe418050 /end MEASUREMENT
/begin MEASUREMENT Tlib_EfuseRegRead_GetOVC_THR_O_S_ODH113 "" ULONG RB_RBA_Common_CentralElements_CompuMethods_Identical 1 100 0.0 4294967295 FORMAT "%8.2" ECU_ADDRESS 0xfe418054 /end MEASUREMENT
/begin MEASUREMENT Tlib_EfuseRegRead_GetHSHT_THR_O_S_ODH113 "" ULONG RB_RBA_Common_CentralElements_CompuMethods_Identical 1 100 0.0 4294967295 FORMAT "%8.2" ECU_ADDRESS 0xfe418058 /end MEASUREMENT
/begin MEASUREMENT Tlib_EfuseRegRead_GetVDS_THR_O_S_ODH113 "" ULONG RB_RBA_Common_CentralElements_CompuMethods_Identical 1 100 0.0 4294967295 FORMAT "%8.2" ECU_ADDRESS 0xfe41805c /end MEASUREMENT
/begin MEASUREMENT Tlib_EfuseRegRead_GetNTC_THR_O_S_ODH113 "" ULONG RB_RBA_Common_CentralElements_CompuMethods_Identical 1 100 0.0 4294967295 FORMAT "%8.2" ECU_ADDRESS 0xfe418060 /end MEASUREMENT
/begin MEASUREMENT Tlib_EfuseRegRead_R_Shunt_O_S_ODH113 "" ULONG RB_RBA_Common_CentralElements_CompuMethods_Identical 1 100 0.0 4294967295 FORMAT "%8.2" ECU_ADDRESS 0xfe418064 /end MEASUREMENT
/begin MEASUREMENT Tlib_EfuseRegRead_GetCr1_O_S_EFUSE08 "" ULONG RB_RBA_Common_CentralElements_CompuMethods_Identical 1 100 0.0 4294967295 FORMAT "%8.2" ECU_ADDRESS 0xfe418068 /end MEASUREMENT
/begin MEASUREMENT Tlib_EfuseRegRead_GetCR3_O_S_EFUSE08 "" ULONG RB_RBA_Common_CentralElements_CompuMethods_Identical 1 100 0.0 4294967295 FORMAT "%8.2" ECU_ADDRESS 0xfe41806c /end MEASUREMENT
/begin MEASUREMENT Tlib_EfuseRegRead_GetSR1_O_S_EFUSE08 "" ULONG RB_RBA_Common_CentralElements_CompuMethods_Identical 1 100 0.0 4294967295 FORMAT "%8.2" ECU_ADDRESS 0xfe418070 /end MEASUREMENT
/begin MEASUREMENT Tlib_EfuseRegRead_GetCurrent_O_S_EFUSE08 "" ULONG RB_RBA_Common_CentralElements_CompuMethods_Identical 1 100 0.0 4294967295 FORMAT "%8.2" ECU_ADDRESS 0xfe418074 /end MEASUREMENT
/begin MEASUREMENT Tlib_EfuseRegRead_GetTJ_O_S_EFUSE08 "" ULONG RB_RBA_Common_CentralElements_CompuMethods_Identical 1 100 0.0 4294967295 FORMAT "%8.2" ECU_ADDRESS 0xfe418078 /end MEASUREMENT
/begin MEASUREMENT Tlib_EfuseRegRead_GetTMOS_O_S_EFUSE08 "" ULONG RB_RBA_Common_CentralElements_CompuMethods_Identical 1 100 0.0 4294967295 FORMAT "%8.2" ECU_ADDRESS 0xfe41807c /end MEASUREMENT
/begin MEASUREMENT Tlib_EfuseRegRead_GetVDS_O_S_EFUSE08 "" ULONG RB_RBA_Common_CentralElements_CompuMethods_Identical 1 100 0.0 4294967295 FORMAT "%8.2" ECU_ADDRESS 0xfe418080 /end MEASUREMENT
/begin MEASUREMENT Tlib_EfuseRegRead_GetVOUT_O_S_EFUSE08 "" ULONG RB_RBA_Common_CentralElements_CompuMethods_Identical 1 100 0.0 4294967295 FORMAT "%8.2" ECU_ADDRESS 0xfe418084 /end MEASUREMENT
/begin MEASUREMENT Tlib_EfuseRegRead_GetT_NOM_O_S_EFUSE08 "" ULONG RB_RBA_Common_CentralElements_CompuMethods_Identical 1 100 0.0 4294967295 FORMAT "%8.2" ECU_ADDRESS 0xfe418088 /end MEASUREMENT
/begin MEASUREMENT Tlib_EfuseRegRead_GetOVC_THR_O_S_EFUSE08 "" ULONG RB_RBA_Common_CentralElements_CompuMethods_Identical 1 100 0.0 4294967295 FORMAT "%8.2" ECU_ADDRESS 0xfe41808c /end MEASUREMENT
/begin MEASUREMENT Tlib_EfuseRegRead_GetHSHT_THR_O_S_EFUSE08 "" ULONG RB_RBA_Common_CentralElements_CompuMethods_Identical 1 100 0.0 4294967295 FORMAT "%8.2" ECU_ADDRESS 0xfe418090 /end MEASUREMENT
/begin MEASUREMENT Tlib_EfuseRegRead_GetVDS_THR_O_S_EFUSE08 "" ULONG RB_RBA_Common_CentralElements_CompuMethods_Identical 1 100 0.0 4294967295 FORMAT "%8.2" ECU_ADDRESS 0xfe418094 /end MEASUREMENT
/begin MEASUREMENT Tlib_EfuseRegRead_GetNTC_THR_O_S_EFUSE08 "" ULONG RB_RBA_Common_CentralElements_CompuMethods_Identical 1 100 0.0 4294967295 FORMAT "%8.2" ECU_ADDRESS 0xfe418098 /end MEASUREMENT
/begin MEASUREMENT Tlib_EfuseRegRead_R_Shunt_O_S_EFUSE08 "" ULONG RB_RBA_Common_CentralElements_CompuMethods_Identical 1 100 0.0 4294967295 FORMAT "%8.2" ECU_ADDRESS 0xfe41809c /end MEASUREMENT
/begin MEASUREMENT Tlib_EfuseRegRead_GetCr1_O_S_ODH02 "" ULONG RB_RBA_Common_CentralElements_CompuMethods_Identical 1 100 0.0 4294967295 FORMAT "%8.2" ECU_ADDRESS 0xfe4180a0 /end MEASUREMENT
/begin MEASUREMENT Tlib_EfuseRegRead_GetCR3_O_S_ODH02 "" ULONG RB_RBA_Common_CentralElements_CompuMethods_Identical 1 100 0.0 4294967295 FORMAT "%8.2" ECU_ADDRESS 0xfe4180a4 /end MEASUREMENT
/begin MEASUREMENT Tlib_EfuseRegRead_GetSR1_O_S_ODH02 "" ULONG RB_RBA_Common_CentralElements_CompuMethods_Identical 1 100 0.0 4294967295 FORMAT "%8.2" ECU_ADDRESS 0xfe4180a8 /end MEASUREMENT
/begin MEASUREMENT Tlib_EfuseRegRead_GetCurrent_O_S_ODH02 "" ULONG RB_RBA_Common_CentralElements_CompuMethods_Identical 1 100 0.0 4294967295 FORMAT "%8.2" ECU_ADDRESS 0xfe4180ac /end MEASUREMENT
/begin MEASUREMENT Tlib_EfuseRegRead_GetTJ_O_S_ODH02 "" ULONG RB_RBA_Common_CentralElements_CompuMethods_Identical 1 100 0.0 4294967295 FORMAT "%8.2" ECU_ADDRESS 0xfe4180b0 /end MEASUREMENT
/begin MEASUREMENT Tlib_EfuseRegRead_GetTMOS_O_S_ODH02 "" ULONG RB_RBA_Common_CentralElements_CompuMethods_Identical 1 100 0.0 4294967295 FORMAT "%8.2" ECU_ADDRESS 0xfe4180b4 /end MEASUREMENT
/begin MEASUREMENT Tlib_EfuseRegRead_GetVDS_O_S_ODH02 "" ULONG RB_RBA_Common_CentralElements_CompuMethods_Identical 1 100 0.0 4294967295 FORMAT "%8.2" ECU_ADDRESS 0xfe4180b8 /end MEASUREMENT
/begin MEASUREMENT Tlib_EfuseRegRead_GetVOUT_O_S_ODH02 "" ULONG RB_RBA_Common_CentralElements_CompuMethods_Identical 1 100 0.0 4294967295 FORMAT "%8.2" ECU_ADDRESS 0xfe4180bc /end MEASUREMENT
/begin MEASUREMENT Tlib_EfuseRegRead_GetT_NOM_O_S_ODH02 "" ULONG RB_RBA_Common_CentralElements_CompuMethods_Identical 1 100 0.0 4294967295 FORMAT "%8.2" ECU_ADDRESS 0xfe4180c0 /end MEASUREMENT
/begin MEASUREMENT Tlib_EfuseRegRead_GetOVC_THR_O_S_ODH02 "" ULONG RB_RBA_Common_CentralElements_CompuMethods_Identical 1 100 0.0 4294967295 FORMAT "%8.2" ECU_ADDRESS 0xfe4180c4 /end MEASUREMENT
/begin MEASUREMENT Tlib_EfuseRegRead_GetHSHT_THR_O_S_ODH02 "" ULONG RB_RBA_Common_CentralElements_CompuMethods_Identical 1 100 0.0 4294967295 FORMAT "%8.2" ECU_ADDRESS 0xfe4180c8 /end MEASUREMENT
/begin MEASUREMENT Tlib_EfuseRegRead_GetVDS_THR_O_S_ODH02 "" ULONG RB_RBA_Common_CentralElements_CompuMethods_Identical 1 100 0.0 4294967295 FORMAT "%8.2" ECU_ADDRESS 0xfe4180cc /end MEASUREMENT
/begin MEASUREMENT Tlib_EfuseRegRead_GetNTC_THR_O_S_ODH02 "" ULONG RB_RBA_Common_CentralElements_CompuMethods_Identical 1 100 0.0 4294967295 FORMAT "%8.2" ECU_ADDRESS 0xfe4180d0 /end MEASUREMENT
/begin MEASUREMENT Tlib_EfuseRegRead_R_Shunt_O_S_ODH02 "" ULONG RB_RBA_Common_CentralElements_CompuMethods_Identical 1 100 0.0 4294967295 FORMAT "%8.2" ECU_ADDRESS 0xfe4180d4 /end MEASUREMENT
/begin MEASUREMENT Tlib_EfuseRegRead_GetCr1_O_S_ODH24 "" ULONG RB_RBA_Common_CentralElements_CompuMethods_Identical 1 100 0.0 4294967295 FORMAT "%8.2" ECU_ADDRESS 0xfe4180d8 /end MEASUREMENT
/begin MEASUREMENT Tlib_EfuseRegRead_GetCR3_O_S_ODH24 "" ULONG RB_RBA_Common_CentralElements_CompuMethods_Identical 1 100 0.0 4294967295 FORMAT "%8.2" ECU_ADDRESS 0xfe4180dc /end MEASUREMENT
/begin MEASUREMENT Tlib_EfuseRegRead_GetSR1_O_S_ODH24 "" ULONG RB_RBA_Common_CentralElements_CompuMethods_Identical 1 100 0.0 4294967295 FORMAT "%8.2" ECU_ADDRESS 0xfe4180e0 /end MEASUREMENT
/begin MEASUREMENT Tlib_EfuseRegRead_GetCurrent_O_S_ODH24 "" ULONG RB_RBA_Common_CentralElements_CompuMethods_Identical 1 100 0.0 4294967295 FORMAT "%8.2" ECU_ADDRESS 0xfe4180e4 /end MEASUREMENT
/begin MEASUREMENT Tlib_EfuseRegRead_GetTJ_O_S_ODH24 "" ULONG RB_RBA_Common_CentralElements_CompuMethods_Identical 1 100 0.0 4294967295 FORMAT "%8.2" ECU_ADDRESS 0xfe4180e8 /end MEASUREMENT
/begin MEASUREMENT Tlib_EfuseRegRead_GetTMOS_O_S_ODH24 "" ULONG RB_RBA_Common_CentralElements_CompuMethods_Identical 1 100 0.0 4294967295 FORMAT "%8.2" ECU_ADDRESS 0xfe4180ec /end MEASUREMENT
/begin MEASUREMENT Tlib_EfuseRegRead_GetVDS_O_S_ODH24 "" ULONG RB_RBA_Common_CentralElements_CompuMethods_Identical 1 100 0.0 4294967295 FORMAT "%8.2" ECU_ADDRESS 0xfe4180f0 /end MEASUREMENT
/begin MEASUREMENT Tlib_EfuseRegRead_GetVOUT_O_S_ODH24 "" ULONG RB_RBA_Common_CentralElements_CompuMethods_Identical 1 100 0.0 4294967295 FORMAT "%8.2" ECU_ADDRESS 0xfe4180f4 /end MEASUREMENT
/begin MEASUREMENT Tlib_EfuseRegRead_GetT_NOM_O_S_ODH24 "" ULONG RB_RBA_Common_CentralElements_CompuMethods_Identical 1 100 0.0 4294967295 FORMAT "%8.2" ECU_ADDRESS 0xfe4180f8 /end MEASUREMENT
/begin MEASUREMENT Tlib_EfuseRegRead_GetOVC_THR_O_S_ODH24 "" ULONG RB_RBA_Common_CentralElements_CompuMethods_Identical 1 100 0.0 4294967295 FORMAT "%8.2" ECU_ADDRESS 0xfe4180fc /end MEASUREMENT
/begin MEASUREMENT Tlib_EfuseRegRead_GetHSHT_THR_O_S_ODH24 "" ULONG RB_RBA_Common_CentralElements_CompuMethods_Identical 1 100 0.0 4294967295 FORMAT "%8.2" ECU_ADDRESS 0xfe418100 /end MEASUREMENT
/begin MEASUREMENT Tlib_EfuseRegRead_GetVDS_THR_O_S_ODH24 "" ULONG RB_RBA_Common_CentralElements_CompuMethods_Identical 1 100 0.0 4294967295 FORMAT "%8.2" ECU_ADDRESS 0xfe418104 /end MEASUREMENT
/begin MEASUREMENT Tlib_EfuseRegRead_GetNTC_THR_O_S_ODH24 "" ULONG RB_RBA_Common_CentralElements_CompuMethods_Identical 1 100 0.0 4294967295 FORMAT "%8.2" ECU_ADDRESS 0xfe418108 /end MEASUREMENT
/begin MEASUREMENT Tlib_EfuseRegRead_R_Shunt_O_S_ODH24 "" ULONG RB_RBA_Common_CentralElements_CompuMethods_Identical 1 100 0.0 4294967295 FORMAT "%8.2" ECU_ADDRESS 0xfe41810c /end MEASUREMENT
/begin MEASUREMENT Tlib_EfuseRegRead_GetCr1_O_S_ODH04 "" ULONG RB_RBA_Common_CentralElements_CompuMethods_Identical 1 100 0.0 4294967295 FORMAT "%8.2" ECU_ADDRESS 0xfe418110 /end MEASUREMENT
/begin MEASUREMENT Tlib_EfuseRegRead_GetCR3_O_S_ODH04 "" ULONG RB_RBA_Common_CentralElements_CompuMethods_Identical 1 100 0.0 4294967295 FORMAT "%8.2" ECU_ADDRESS 0xfe418114 /end MEASUREMENT
/begin MEASUREMENT Tlib_EfuseRegRead_GetSR1_O_S_ODH04 "" ULONG RB_RBA_Common_CentralElements_CompuMethods_Identical 1 100 0.0 4294967295 FORMAT "%8.2" ECU_ADDRESS 0xfe418118 /end MEASUREMENT
/begin MEASUREMENT Tlib_EfuseRegRead_GetCurrent_O_S_ODH04 "" ULONG RB_RBA_Common_CentralElements_CompuMethods_Identical 1 100 0.0 4294967295 FORMAT "%8.2" ECU_ADDRESS 0xfe41811c /end MEASUREMENT
/begin MEASUREMENT Tlib_EfuseRegRead_GetTJ_O_S_ODH04 "" ULONG RB_RBA_Common_CentralElements_CompuMethods_Identical 1 100 0.0 4294967295 FORMAT "%8.2" ECU_ADDRESS 0xfe418120 /end MEASUREMENT
/begin MEASUREMENT Tlib_EfuseRegRead_GetTMOS_O_S_ODH04 "" ULONG RB_RBA_Common_CentralElements_CompuMethods_Identical 1 100 0.0 4294967295 FORMAT "%8.2" ECU_ADDRESS 0xfe418124 /end MEASUREMENT
/begin MEASUREMENT Tlib_EfuseRegRead_GetVDS_O_S_ODH04 "" ULONG RB_RBA_Common_CentralElements_CompuMethods_Identical 1 100 0.0 4294967295 FORMAT "%8.2" ECU_ADDRESS 0xfe418128 /end MEASUREMENT
/begin MEASUREMENT Tlib_EfuseRegRead_GetVOUT_O_S_ODH04 "" ULONG RB_RBA_Common_CentralElements_CompuMethods_Identical 1 100 0.0 4294967295 FORMAT "%8.2" ECU_ADDRESS 0xfe41812c /end MEASUREMENT
/begin MEASUREMENT Tlib_EfuseRegRead_GetT_NOM_O_S_ODH04 "" ULONG RB_RBA_Common_CentralElements_CompuMethods_Identical 1 100 0.0 4294967295 FORMAT "%8.2" ECU_ADDRESS 0xfe418130 /end MEASUREMENT
/begin MEASUREMENT Tlib_EfuseRegRead_GetOVC_THR_O_S_ODH04 "" ULONG RB_RBA_Common_CentralElements_CompuMethods_Identical 1 100 0.0 4294967295 FORMAT "%8.2" ECU_ADDRESS 0xfe418134 /end MEASUREMENT
/begin MEASUREMENT Tlib_EfuseRegRead_GetHSHT_THR_O_S_ODH04 "" ULONG RB_RBA_Common_CentralElements_CompuMethods_Identical 1 100 0.0 4294967295 FORMAT "%8.2" ECU_ADDRESS 0xfe418138 /end MEASUREMENT
/begin MEASUREMENT Tlib_EfuseRegRead_GetVDS_THR_O_S_ODH04 "" ULONG RB_RBA_Common_CentralElements_CompuMethods_Identical 1 100 0.0 4294967295 FORMAT "%8.2" ECU_ADDRESS 0xfe41813c /end MEASUREMENT
/begin MEASUREMENT Tlib_EfuseRegRead_GetNTC_THR_O_S_ODH04 "" ULONG RB_RBA_Common_CentralElements_CompuMethods_Identical 1 100 0.0 4294967295 FORMAT "%8.2" ECU_ADDRESS 0xfe418140 /end MEASUREMENT
/begin MEASUREMENT Tlib_EfuseRegRead_R_Shunt_O_S_ODH04 "" ULONG RB_RBA_Common_CentralElements_CompuMethods_Identical 1 100 0.0 4294967295 FORMAT "%8.2" ECU_ADDRESS 0xfe418144 /end MEASUREMENT
/begin MEASUREMENT Tlib_EfuseRegRead_GetCr1_O_S_ODH29 "" ULONG RB_RBA_Common_CentralElements_CompuMethods_Identical 1 100 0.0 4294967295 FORMAT "%8.2" ECU_ADDRESS 0xfe418148 /end MEASUREMENT
/begin MEASUREMENT Tlib_EfuseRegRead_GetCR3_O_S_ODH29 "" ULONG RB_RBA_Common_CentralElements_CompuMethods_Identical 1 100 0.0 4294967295 FORMAT "%8.2" ECU_ADDRESS 0xfe41814c /end MEASUREMENT
/begin MEASUREMENT Tlib_EfuseRegRead_GetSR1_O_S_ODH29 "" ULONG RB_RBA_Common_CentralElements_CompuMethods_Identical 1 100 0.0 4294967295 FORMAT "%8.2" ECU_ADDRESS 0xfe418150 /end MEASUREMENT
/begin MEASUREMENT Tlib_EfuseRegRead_GetCurrent_O_S_ODH29 "" ULONG RB_RBA_Common_CentralElements_CompuMethods_Identical 1 100 0.0 4294967295 FORMAT "%8.2" ECU_ADDRESS 0xfe418154 /end MEASUREMENT
/begin MEASUREMENT Tlib_EfuseRegRead_GetTJ_O_S_ODH29 "" ULONG RB_RBA_Common_CentralElements_CompuMethods_Identical 1 100 0.0 4294967295 FORMAT "%8.2" ECU_ADDRESS 0xfe418158 /end MEASUREMENT
/begin MEASUREMENT Tlib_EfuseRegRead_GetTMOS_O_S_ODH29 "" ULONG RB_RBA_Common_CentralElements_CompuMethods_Identical 1 100 0.0 4294967295 FORMAT "%8.2" ECU_ADDRESS 0xfe41815c /end MEASUREMENT
/begin MEASUREMENT Tlib_EfuseRegRead_GetVDS_O_S_ODH29 "" ULONG RB_RBA_Common_CentralElements_CompuMethods_Identical 1 100 0.0 4294967295 FORMAT "%8.2" ECU_ADDRESS 0xfe418160 /end MEASUREMENT
/begin MEASUREMENT Tlib_EfuseRegRead_GetVOUT_O_S_ODH29 "" ULONG RB_RBA_Common_CentralElements_CompuMethods_Identical 1 100 0.0 4294967295 FORMAT "%8.2" ECU_ADDRESS 0xfe418164 /end MEASUREMENT
/begin MEASUREMENT Tlib_EfuseRegRead_GetT_NOM_O_S_ODH29 "" ULONG RB_RBA_Common_CentralElements_CompuMethods_Identical 1 100 0.0 4294967295 FORMAT "%8.2" ECU_ADDRESS 0xfe418168 /end MEASUREMENT
/begin MEASUREMENT Tlib_EfuseRegRead_GetOVC_THR_O_S_ODH29 "" ULONG RB_RBA_Common_CentralElements_CompuMethods_Identical 1 100 0.0 4294967295 FORMAT "%8.2" ECU_ADDRESS 0xfe41816c /end MEASUREMENT
/begin MEASUREMENT Tlib_EfuseRegRead_GetHSHT_THR_O_S_ODH29 "" ULONG RB_RBA_Common_CentralElements_CompuMethods_Identical 1 100 0.0 4294967295 FORMAT "%8.2" ECU_ADDRESS 0xfe418170 /end MEASUREMENT
/begin MEASUREMENT Tlib_EfuseRegRead_GetVDS_THR_O_S_ODH29 "" ULONG RB_RBA_Common_CentralElements_CompuMethods_Identical 1 100 0.0 4294967295 FORMAT "%8.2" ECU_ADDRESS 0xfe418174 /end MEASUREMENT
/begin MEASUREMENT Tlib_EfuseRegRead_GetNTC_THR_O_S_ODH29 "" ULONG RB_RBA_Common_CentralElements_CompuMethods_Identical 1 100 0.0 4294967295 FORMAT "%8.2" ECU_ADDRESS 0xfe418178 /end MEASUREMENT
/begin MEASUREMENT Tlib_EfuseRegRead_R_Shunt_O_S_ODH29 "" ULONG RB_RBA_Common_CentralElements_CompuMethods_Identical 1 100 0.0 4294967295 FORMAT "%8.2" ECU_ADDRESS 0xfe41817c /end MEASUREMENT
/begin MEASUREMENT Tlib_EfuseRegRead_GetCr1_O_S_ODH22 "" ULONG RB_RBA_Common_CentralElements_CompuMethods_Identical 1 100 0.0 4294967295 FORMAT "%8.2" ECU_ADDRESS 0xfe418180 /end MEASUREMENT
/begin MEASUREMENT Tlib_EfuseRegRead_GetCR3_O_S_ODH22 "" ULONG RB_RBA_Common_CentralElements_CompuMethods_Identical 1 100 0.0 4294967295 FORMAT "%8.2" ECU_ADDRESS 0xfe418184 /end MEASUREMENT
/begin MEASUREMENT Tlib_EfuseRegRead_GetSR1_O_S_ODH22 "" ULONG RB_RBA_Common_CentralElements_CompuMethods_Identical 1 100 0.0 4294967295 FORMAT "%8.2" ECU_ADDRESS 0xfe418188 /end MEASUREMENT
/begin MEASUREMENT Tlib_EfuseRegRead_GetCurrent_O_S_ODH22 "" ULONG RB_RBA_Common_CentralElements_CompuMethods_Identical 1 100 0.0 4294967295 FORMAT "%8.2" ECU_ADDRESS 0xfe41818c /end MEASUREMENT
/begin MEASUREMENT Tlib_EfuseRegRead_GetTJ_O_S_ODH22 "" ULONG RB_RBA_Common_CentralElements_CompuMethods_Identical 1 100 0.0 4294967295 FORMAT "%8.2" ECU_ADDRESS 0xfe418190 /end MEASUREMENT
/begin MEASUREMENT Tlib_EfuseRegRead_GetTMOS_O_S_ODH22 "" ULONG RB_RBA_Common_CentralElements_CompuMethods_Identical 1 100 0.0 4294967295 FORMAT "%8.2" ECU_ADDRESS 0xfe418194 /end MEASUREMENT
/begin MEASUREMENT Tlib_EfuseRegRead_GetVDS_O_S_ODH22 "" ULONG RB_RBA_Common_CentralElements_CompuMethods_Identical 1 100 0.0 4294967295 FORMAT "%8.2" ECU_ADDRESS 0xfe418198 /end MEASUREMENT
/begin MEASUREMENT Tlib_EfuseRegRead_GetVOUT_O_S_ODH22 "" ULONG RB_RBA_Common_CentralElements_CompuMethods_Identical 1 100 0.0 4294967295 FORMAT "%8.2" ECU_ADDRESS 0xfe41819c /end MEASUREMENT
/begin MEASUREMENT Tlib_EfuseRegRead_GetT_NOM_O_S_ODH22 "" ULONG RB_RBA_Common_CentralElements_CompuMethods_Identical 1 100 0.0 4294967295 FORMAT "%8.2" ECU_ADDRESS 0xfe4181a0 /end MEASUREMENT
/begin MEASUREMENT Tlib_EfuseRegRead_GetOVC_THR_O_S_ODH22 "" ULONG RB_RBA_Common_CentralElements_CompuMethods_Identical 1 100 0.0 4294967295 FORMAT "%8.2" ECU_ADDRESS 0xfe4181a4 /end MEASUREMENT
/begin MEASUREMENT Tlib_EfuseRegRead_GetHSHT_THR_O_S_ODH22 "" ULONG RB_RBA_Common_CentralElements_CompuMethods_Identical 1 100 0.0 4294967295 FORMAT "%8.2" ECU_ADDRESS 0xfe4181a8 /end MEASUREMENT
/begin MEASUREMENT Tlib_EfuseRegRead_GetVDS_THR_O_S_ODH22 "" ULONG RB_RBA_Common_CentralElements_CompuMethods_Identical 1 100 0.0 4294967295 FORMAT "%8.2" ECU_ADDRESS 0xfe4181ac /end MEASUREMENT
/begin MEASUREMENT Tlib_EfuseRegRead_GetNTC_THR_O_S_ODH22 "" ULONG RB_RBA_Common_CentralElements_CompuMethods_Identical 1 100 0.0 4294967295 FORMAT "%8.2" ECU_ADDRESS 0xfe4181b0 /end MEASUREMENT
/begin MEASUREMENT Tlib_EfuseRegRead_R_Shunt_O_S_ODH22 "" ULONG RB_RBA_Common_CentralElements_CompuMethods_Identical 1 100 0.0 4294967295 FORMAT "%8.2" ECU_ADDRESS 0xfe4181b4 /end MEASUREMENT
/begin MEASUREMENT Tlib_EfuseRegRead_GetCr1_O_S_ODH25 "" ULONG RB_RBA_Common_CentralElements_CompuMethods_Identical 1 100 0.0 4294967295 FORMAT "%8.2" ECU_ADDRESS 0xfe4181b8 /end MEASUREMENT
/begin MEASUREMENT Tlib_EfuseRegRead_GetCR3_O_S_ODH25 "" ULONG RB_RBA_Common_CentralElements_CompuMethods_Identical 1 100 0.0 4294967295 FORMAT "%8.2" ECU_ADDRESS 0xfe4181bc /end MEASUREMENT
/begin MEASUREMENT Tlib_EfuseRegRead_GetSR1_O_S_ODH25 "" ULONG RB_RBA_Common_CentralElements_CompuMethods_Identical 1 100 0.0 4294967295 FORMAT "%8.2" ECU_ADDRESS 0xfe4181c0 /end MEASUREMENT
/begin MEASUREMENT Tlib_EfuseRegRead_GetCurrent_O_S_ODH25 "" ULONG RB_RBA_Common_CentralElements_CompuMethods_Identical 1 100 0.0 4294967295 FORMAT "%8.2" ECU_ADDRESS 0xfe4181c4 /end MEASUREMENT
/begin MEASUREMENT Tlib_EfuseRegRead_GetTJ_O_S_ODH25 "" ULONG RB_RBA_Common_CentralElements_CompuMethods_Identical 1 100 0.0 4294967295 FORMAT "%8.2" ECU_ADDRESS 0xfe4181c8 /end MEASUREMENT
/begin MEASUREMENT Tlib_EfuseRegRead_GetTMOS_O_S_ODH25 "" ULONG RB_RBA_Common_CentralElements_CompuMethods_Identical 1 100 0.0 4294967295 FORMAT "%8.2" ECU_ADDRESS 0xfe4181cc /end MEASUREMENT
/begin MEASUREMENT Tlib_EfuseRegRead_GetVDS_O_S_ODH25 "" ULONG RB_RBA_Common_CentralElements_CompuMethods_Identical 1 100 0.0 4294967295 FORMAT "%8.2" ECU_ADDRESS 0xfe4181d0 /end MEASUREMENT
/begin MEASUREMENT Tlib_EfuseRegRead_GetVOUT_O_S_ODH25 "" ULONG RB_RBA_Common_CentralElements_CompuMethods_Identical 1 100 0.0 4294967295 FORMAT "%8.2" ECU_ADDRESS 0xfe4181d4 /end MEASUREMENT
/begin MEASUREMENT Tlib_EfuseRegRead_GetT_NOM_O_S_ODH25 "" ULONG RB_RBA_Common_CentralElements_CompuMethods_Identical 1 100 0.0 4294967295 FORMAT "%8.2" ECU_ADDRESS 0xfe4181d8 /end MEASUREMENT
/begin MEASUREMENT Tlib_EfuseRegRead_GetOVC_THR_O_S_ODH25 "" ULONG RB_RBA_Common_CentralElements_CompuMethods_Identical 1 100 0.0 4294967295 FORMAT "%8.2" ECU_ADDRESS 0xfe4181dc /end MEASUREMENT
/begin MEASUREMENT Tlib_EfuseRegRead_GetHSHT_THR_O_S_ODH25 "" ULONG RB_RBA_Common_CentralElements_CompuMethods_Identical 1 100 0.0 4294967295 FORMAT "%8.2" ECU_ADDRESS 0xfe4181e0 /end MEASUREMENT
/begin MEASUREMENT Tlib_EfuseRegRead_GetVDS_THR_O_S_ODH25 "" ULONG RB_RBA_Common_CentralElements_CompuMethods_Identical 1 100 0.0 4294967295 FORMAT "%8.2" ECU_ADDRESS 0xfe4181e4 /end MEASUREMENT
/begin MEASUREMENT Tlib_EfuseRegRead_GetNTC_THR_O_S_ODH25 "" ULONG RB_RBA_Common_CentralElements_CompuMethods_Identical 1 100 0.0 4294967295 FORMAT "%8.2" ECU_ADDRESS 0xfe4181e8 /end MEASUREMENT
/begin MEASUREMENT Tlib_EfuseRegRead_R_Shunt_O_S_ODH25 "" ULONG RB_RBA_Common_CentralElements_CompuMethods_Identical 1 100 0.0 4294967295 FORMAT "%8.2" ECU_ADDRESS 0xfe4181ec /end MEASUREMENT
/begin MEASUREMENT Tlib_EfuseRegRead_GetCr1_O_S_ODH21 "" ULONG RB_RBA_Common_CentralElements_CompuMethods_Identical 1 100 0.0 4294967295 FORMAT "%8.2" ECU_ADDRESS 0xfe4181f0 /end MEASUREMENT
/begin MEASUREMENT Tlib_EfuseRegRead_GetCR3_O_S_ODH21 "" ULONG RB_RBA_Common_CentralElements_CompuMethods_Identical 1 100 0.0 4294967295 FORMAT "%8.2" ECU_ADDRESS 0xfe4181f4 /end MEASUREMENT
/begin MEASUREMENT Tlib_EfuseRegRead_GetSR1_O_S_ODH21 "" ULONG RB_RBA_Common_CentralElements_CompuMethods_Identical 1 100 0.0 4294967295 FORMAT "%8.2" ECU_ADDRESS 0xfe4181f8 /end MEASUREMENT
/begin MEASUREMENT Tlib_EfuseRegRead_GetCurrent_O_S_ODH21 "" ULONG RB_RBA_Common_CentralElements_CompuMethods_Identical 1 100 0.0 4294967295 FORMAT "%8.2" ECU_ADDRESS 0xfe4181fc /end MEASUREMENT
/begin MEASUREMENT Tlib_EfuseRegRead_GetTJ_O_S_ODH21 "" ULONG RB_RBA_Common_CentralElements_CompuMethods_Identical 1 100 0.0 4294967295 FORMAT "%8.2" ECU_ADDRESS 0xfe418200 /end MEASUREMENT
/begin MEASUREMENT Tlib_EfuseRegRead_GetTMOS_O_S_ODH21 "" ULONG RB_RBA_Common_CentralElements_CompuMethods_Identical 1 100 0.0 4294967295 FORMAT "%8.2" ECU_ADDRESS 0xfe418204 /end MEASUREMENT
/begin MEASUREMENT Tlib_EfuseRegRead_GetVDS_O_S_ODH21 "" ULONG RB_RBA_Common_CentralElements_CompuMethods_Identical 1 100 0.0 4294967295 FORMAT "%8.2" ECU_ADDRESS 0xfe418208 /end MEASUREMENT
/begin MEASUREMENT Tlib_EfuseRegRead_GetVOUT_O_S_ODH21 "" ULONG RB_RBA_Common_CentralElements_CompuMethods_Identical 1 100 0.0 4294967295 FORMAT "%8.2" ECU_ADDRESS 0xfe41820c /end MEASUREMENT
/begin MEASUREMENT Tlib_EfuseRegRead_GetT_NOM_O_S_ODH21 "" ULONG RB_RBA_Common_CentralElements_CompuMethods_Identical 1 100 0.0 4294967295 FORMAT "%8.2" ECU_ADDRESS 0xfe418210 /end MEASUREMENT
/begin MEASUREMENT Tlib_EfuseRegRead_GetOVC_THR_O_S_ODH21 "" ULONG RB_RBA_Common_CentralElements_CompuMethods_Identical 1 100 0.0 4294967295 FORMAT "%8.2" ECU_ADDRESS 0xfe418214 /end MEASUREMENT
/begin MEASUREMENT Tlib_EfuseRegRead_GetHSHT_THR_O_S_ODH21 "" ULONG RB_RBA_Common_CentralElements_CompuMethods_Identical 1 100 0.0 4294967295 FORMAT "%8.2" ECU_ADDRESS 0xfe418218 /end MEASUREMENT
/begin MEASUREMENT Tlib_EfuseRegRead_GetVDS_THR_O_S_ODH21 "" ULONG RB_RBA_Common_CentralElements_CompuMethods_Identical 1 100 0.0 4294967295 FORMAT "%8.2" ECU_ADDRESS 0xfe41821c /end MEASUREMENT
/begin MEASUREMENT Tlib_EfuseRegRead_GetNTC_THR_O_S_ODH21 "" ULONG RB_RBA_Common_CentralElements_CompuMethods_Identical 1 100 0.0 4294967295 FORMAT "%8.2" ECU_ADDRESS 0xfe418220 /end MEASUREMENT
/begin MEASUREMENT Tlib_EfuseRegRead_R_Shunt_O_S_ODH21 "" ULONG RB_RBA_Common_CentralElements_CompuMethods_Identical 1 100 0.0 4294967295 FORMAT "%8.2" ECU_ADDRESS 0xfe418224 /end MEASUREMENT
/begin MEASUREMENT Tlib_EfuseRegRead_GetCr1_O_S_EFUSE22 "" ULONG RB_RBA_Common_CentralElements_CompuMethods_Identical 1 100 0.0 4294967295 FORMAT "%8.2" ECU_ADDRESS 0xfe418228 /end MEASUREMENT
/begin MEASUREMENT Tlib_EfuseRegRead_GetCR3_O_S_EFUSE22 "" ULONG RB_RBA_Common_CentralElements_CompuMethods_Identical 1 100 0.0 4294967295 FORMAT "%8.2" ECU_ADDRESS 0xfe41822c /end MEASUREMENT
/begin MEASUREMENT Tlib_EfuseRegRead_GetSR1_O_S_EFUSE22 "" ULONG RB_RBA_Common_CentralElements_CompuMethods_Identical 1 100 0.0 4294967295 FORMAT "%8.2" ECU_ADDRESS 0xfe418230 /end MEASUREMENT
/begin MEASUREMENT Tlib_EfuseRegRead_GetCurrent_O_S_EFUSE22 "" ULONG RB_RBA_Common_CentralElements_CompuMethods_Identical 1 100 0.0 4294967295 FORMAT "%8.2" ECU_ADDRESS 0xfe418234 /end MEASUREMENT
/begin MEASUREMENT Tlib_EfuseRegRead_GetTJ_O_S_EFUSE22 "" ULONG RB_RBA_Common_CentralElements_CompuMethods_Identical 1 100 0.0 4294967295 FORMAT "%8.2" ECU_ADDRESS 0xfe418238 /end MEASUREMENT
/begin MEASUREMENT Tlib_EfuseRegRead_GetTMOS_O_S_EFUSE22 "" ULONG RB_RBA_Common_CentralElements_CompuMethods_Identical 1 100 0.0 4294967295 FORMAT "%8.2" ECU_ADDRESS 0xfe41823c /end MEASUREMENT
/begin MEASUREMENT Tlib_EfuseRegRead_GetVDS_O_S_EFUSE22 "" ULONG RB_RBA_Common_CentralElements_CompuMethods_Identical 1 100 0.0 4294967295 FORMAT "%8.2" ECU_ADDRESS 0xfe418240 /end MEASUREMENT
/begin MEASUREMENT Tlib_EfuseRegRead_GetVOUT_O_S_EFUSE22 "" ULONG RB_RBA_Common_CentralElements_CompuMethods_Identical 1 100 0.0 4294967295 FORMAT "%8.2" ECU_ADDRESS 0xfe418244 /end MEASUREMENT
/begin MEASUREMENT Tlib_EfuseRegRead_GetT_NOM_O_S_EFUSE22 "" ULONG RB_RBA_Common_CentralElements_CompuMethods_Identical 1 100 0.0 4294967295 FORMAT "%8.2" ECU_ADDRESS 0xfe418248 /end MEASUREMENT
/begin MEASUREMENT Tlib_EfuseRegRead_GetOVC_THR_O_S_EFUSE22 "" ULONG RB_RBA_Common_CentralElements_CompuMethods_Identical 1 100 0.0 4294967295 FORMAT "%8.2" ECU_ADDRESS 0xfe41824c /end MEASUREMENT
/begin MEASUREMENT Tlib_EfuseRegRead_GetHSHT_THR_O_S_EFUSE22 "" ULONG RB_RBA_Common_CentralElements_CompuMethods_Identical 1 100 0.0 4294967295 FORMAT "%8.2" ECU_ADDRESS 0xfe418250 /end MEASUREMENT
/begin MEASUREMENT Tlib_EfuseRegRead_GetVDS_THR_O_S_EFUSE22 "" ULONG RB_RBA_Common_CentralElements_CompuMethods_Identical 1 100 0.0 4294967295 FORMAT "%8.2" ECU_ADDRESS 0xfe418254 /end MEASUREMENT
/begin MEASUREMENT Tlib_EfuseRegRead_GetNTC_THR_O_S_EFUSE22 "" ULONG RB_RBA_Common_CentralElements_CompuMethods_Identical 1 100 0.0 4294967295 FORMAT "%8.2" ECU_ADDRESS 0xfe418258 /end MEASUREMENT
/begin MEASUREMENT Tlib_EfuseRegRead_R_Shunt_O_S_EFUSE22 "" ULONG RB_RBA_Common_CentralElements_CompuMethods_Identical 1 100 0.0 4294967295 FORMAT "%8.2" ECU_ADDRESS 0xfe41825c /end MEASUREMENT
/begin MEASUREMENT Tlib_EfuseRegRead_GetCr1_O_S_ODH39 "" ULONG RB_RBA_Common_CentralElements_CompuMethods_Identical 1 100 0.0 4294967295 FORMAT "%8.2" ECU_ADDRESS 0xfe418260 /end MEASUREMENT
/begin MEASUREMENT Tlib_EfuseRegRead_GetCR3_O_S_ODH39 "" ULONG RB_RBA_Common_CentralElements_CompuMethods_Identical 1 100 0.0 4294967295 FORMAT "%8.2" ECU_ADDRESS 0xfe418264 /end MEASUREMENT
/begin MEASUREMENT Tlib_EfuseRegRead_GetSR1_O_S_ODH39 "" ULONG RB_RBA_Common_CentralElements_CompuMethods_Identical 1 100 0.0 4294967295 FORMAT "%8.2" ECU_ADDRESS 0xfe418268 /end MEASUREMENT
/begin MEASUREMENT Tlib_EfuseRegRead_GetCurrent_O_S_ODH39 "" ULONG RB_RBA_Common_CentralElements_CompuMethods_Identical 1 100 0.0 4294967295 FORMAT "%8.2" ECU_ADDRESS 0xfe41826c /end MEASUREMENT
/begin MEASUREMENT Tlib_EfuseRegRead_GetTJ_O_S_ODH39 "" ULONG RB_RBA_Common_CentralElements_CompuMethods_Identical 1 100 0.0 4294967295 FORMAT "%8.2" ECU_ADDRESS 0xfe418270 /end MEASUREMENT
/begin MEASUREMENT Tlib_EfuseRegRead_GetTMOS_O_S_ODH39 "" ULONG RB_RBA_Common_CentralElements_CompuMethods_Identical 1 100 0.0 4294967295 FORMAT "%8.2" ECU_ADDRESS 0xfe418274 /end MEASUREMENT
/begin MEASUREMENT Tlib_EfuseRegRead_GetVDS_O_S_ODH39 "" ULONG RB_RBA_Common_CentralElements_CompuMethods_Identical 1 100 0.0 4294967295 FORMAT "%8.2" ECU_ADDRESS 0xfe418278 /end MEASUREMENT
/begin MEASUREMENT Tlib_EfuseRegRead_GetVOUT_O_S_ODH39 "" ULONG RB_RBA_Common_CentralElements_CompuMethods_Identical 1 100 0.0 4294967295 FORMAT "%8.2" ECU_ADDRESS 0xfe41827c /end MEASUREMENT
/begin MEASUREMENT Tlib_EfuseRegRead_GetT_NOM_O_S_ODH39 "" ULONG RB_RBA_Common_CentralElements_CompuMethods_Identical 1 100 0.0 4294967295 FORMAT "%8.2" ECU_ADDRESS 0xfe418280 /end MEASUREMENT
/begin MEASUREMENT Tlib_EfuseRegRead_GetOVC_THR_O_S_ODH39 "" ULONG RB_RBA_Common_CentralElements_CompuMethods_Identical 1 100 0.0 4294967295 FORMAT "%8.2" ECU_ADDRESS 0xfe418284 /end MEASUREMENT
/begin MEASUREMENT Tlib_EfuseRegRead_GetHSHT_THR_O_S_ODH39 "" ULONG RB_RBA_Common_CentralElements_CompuMethods_Identical 1 100 0.0 4294967295 FORMAT "%8.2" ECU_ADDRESS 0xfe418288 /end MEASUREMENT
/begin MEASUREMENT Tlib_EfuseRegRead_GetVDS_THR_O_S_ODH39 "" ULONG RB_RBA_Common_CentralElements_CompuMethods_Identical 1 100 0.0 4294967295 FORMAT "%8.2" ECU_ADDRESS 0xfe41828c /end MEASUREMENT
/begin MEASUREMENT Tlib_EfuseRegRead_GetNTC_THR_O_S_ODH39 "" ULONG RB_RBA_Common_CentralElements_CompuMethods_Identical 1 100 0.0 4294967295 FORMAT "%8.2" ECU_ADDRESS 0xfe418290 /end MEASUREMENT
/begin MEASUREMENT Tlib_EfuseRegRead_R_Shunt_O_S_ODH39 "" ULONG RB_RBA_Common_CentralElements_CompuMethods_Identical 1 100 0.0 4294967295 FORMAT "%8.2" ECU_ADDRESS 0xfe418294 /end MEASUREMENT
/begin MEASUREMENT Tlib_EfuseRegRead_GetCr1_O_S_ODH37 "" ULONG RB_RBA_Common_CentralElements_CompuMethods_Identical 1 100 0.0 4294967295 FORMAT "%8.2" ECU_ADDRESS 0xfe418298 /end MEASUREMENT
/begin MEASUREMENT Tlib_EfuseRegRead_GetCR3_O_S_ODH37 "" ULONG RB_RBA_Common_CentralElements_CompuMethods_Identical 1 100 0.0 4294967295 FORMAT "%8.2" ECU_ADDRESS 0xfe41829c /end MEASUREMENT
/begin MEASUREMENT Tlib_EfuseRegRead_GetSR1_O_S_ODH37 "" ULONG RB_RBA_Common_CentralElements_CompuMethods_Identical 1 100 0.0 4294967295 FORMAT "%8.2" ECU_ADDRESS 0xfe4182a0 /end MEASUREMENT
/begin MEASUREMENT Tlib_EfuseRegRead_GetCurrent_O_S_ODH37 "" ULONG RB_RBA_Common_CentralElements_CompuMethods_Identical 1 100 0.0 4294967295 FORMAT "%8.2" ECU_ADDRESS 0xfe4182a4 /end MEASUREMENT
/begin MEASUREMENT Tlib_EfuseRegRead_GetTJ_O_S_ODH37 "" ULONG RB_RBA_Common_CentralElements_CompuMethods_Identical 1 100 0.0 4294967295 FORMAT "%8.2" ECU_ADDRESS 0xfe4182a8 /end MEASUREMENT
/begin MEASUREMENT Tlib_EfuseRegRead_GetTMOS_O_S_ODH37 "" ULONG RB_RBA_Common_CentralElements_CompuMethods_Identical 1 100 0.0 4294967295 FORMAT "%8.2" ECU_ADDRESS 0xfe4182ac /end MEASUREMENT
/begin MEASUREMENT Tlib_EfuseRegRead_GetVDS_O_S_ODH37 "" ULONG RB_RBA_Common_CentralElements_CompuMethods_Identical 1 100 0.0 4294967295 FORMAT "%8.2" ECU_ADDRESS 0xfe4182b0 /end MEASUREMENT
/begin MEASUREMENT Tlib_EfuseRegRead_GetVOUT_O_S_ODH37 "" ULONG RB_RBA_Common_CentralElements_CompuMethods_Identical 1 100 0.0 4294967295 FORMAT "%8.2" ECU_ADDRESS 0xfe4182b4 /end MEASUREMENT
/begin MEASUREMENT Tlib_EfuseRegRead_GetT_NOM_O_S_ODH37 "" ULONG RB_RBA_Common_CentralElements_CompuMethods_Identical 1 100 0.0 4294967295 FORMAT "%8.2" ECU_ADDRESS 0xfe4182b8 /end MEASUREMENT
/begin MEASUREMENT Tlib_EfuseRegRead_GetOVC_THR_O_S_ODH37 "" ULONG RB_RBA_Common_CentralElements_CompuMethods_Identical 1 100 0.0 4294967295 FORMAT "%8.2" ECU_ADDRESS 0xfe4182bc /end MEASUREMENT
/begin MEASUREMENT Tlib_EfuseRegRead_GetHSHT_THR_O_S_ODH37 "" ULONG RB_RBA_Common_CentralElements_CompuMethods_Identical 1 100 0.0 4294967295 FORMAT "%8.2" ECU_ADDRESS 0xfe4182c0 /end MEASUREMENT
/begin MEASUREMENT Tlib_EfuseRegRead_GetVDS_THR_O_S_ODH37 "" ULONG RB_RBA_Common_CentralElements_CompuMethods_Identical 1 100 0.0 4294967295 FORMAT "%8.2" ECU_ADDRESS 0xfe4182c4 /end MEASUREMENT
/begin MEASUREMENT Tlib_EfuseRegRead_GetNTC_THR_O_S_ODH37 "" ULONG RB_RBA_Common_CentralElements_CompuMethods_Identical 1 100 0.0 4294967295 FORMAT "%8.2" ECU_ADDRESS 0xfe4182c8 /end MEASUREMENT
/begin MEASUREMENT Tlib_EfuseRegRead_R_Shunt_O_S_ODH37 "" ULONG RB_RBA_Common_CentralElements_CompuMethods_Identical 1 100 0.0 4294967295 FORMAT "%8.2" ECU_ADDRESS 0xfe4182cc /end MEASUREMENT
/begin MEASUREMENT Tlib_EfuseRegRead_GetCr1_O_S_ODH75 "" ULONG RB_RBA_Common_CentralElements_CompuMethods_Identical 1 100 0.0 4294967295 FORMAT "%8.2" ECU_ADDRESS 0xfe4182d0 /end MEASUREMENT
/begin MEASUREMENT Tlib_EfuseRegRead_GetCR3_O_S_ODH75 "" ULONG RB_RBA_Common_CentralElements_CompuMethods_Identical 1 100 0.0 4294967295 FORMAT "%8.2" ECU_ADDRESS 0xfe4182d4 /end MEASUREMENT
/begin MEASUREMENT Tlib_EfuseRegRead_GetSR1_O_S_ODH75 "" ULONG RB_RBA_Common_CentralElements_CompuMethods_Identical 1 100 0.0 4294967295 FORMAT "%8.2" ECU_ADDRESS 0xfe4182d8 /end MEASUREMENT
/begin MEASUREMENT Tlib_EfuseRegRead_GetCurrent_O_S_ODH75 "" ULONG RB_RBA_Common_CentralElements_CompuMethods_Identical 1 100 0.0 4294967295 FORMAT "%8.2" ECU_ADDRESS 0xfe4182dc /end MEASUREMENT
/begin MEASUREMENT Tlib_EfuseRegRead_GetTJ_O_S_ODH75 "" ULONG RB_RBA_Common_CentralElements_CompuMethods_Identical 1 100 0.0 4294967295 FORMAT "%8.2" ECU_ADDRESS 0xfe4182e0 /end MEASUREMENT
/begin MEASUREMENT Tlib_EfuseRegRead_GetTMOS_O_S_ODH75 "" ULONG RB_RBA_Common_CentralElements_CompuMethods_Identical 1 100 0.0 4294967295 FORMAT "%8.2" ECU_ADDRESS 0xfe4182e4 /end MEASUREMENT
/begin MEASUREMENT Tlib_EfuseRegRead_GetVDS_O_S_ODH75 "" ULONG RB_RBA_Common_CentralElements_CompuMethods_Identical 1 100 0.0 4294967295 FORMAT "%8.2" ECU_ADDRESS 0xfe4182e8 /end MEASUREMENT
/begin MEASUREMENT Tlib_EfuseRegRead_GetVOUT_O_S_ODH75 "" ULONG RB_RBA_Common_CentralElements_CompuMethods_Identical 1 100 0.0 4294967295 FORMAT "%8.2" ECU_ADDRESS 0xfe4182ec /end MEASUREMENT
/begin MEASUREMENT Tlib_EfuseRegRead_GetT_NOM_O_S_ODH75 "" ULONG RB_RBA_Common_CentralElements_CompuMethods_Identical 1 100 0.0 4294967295 FORMAT "%8.2" ECU_ADDRESS 0xfe4182f0 /end MEASUREMENT
/begin MEASUREMENT Tlib_EfuseRegRead_GetOVC_THR_O_S_ODH75 "" ULONG RB_RBA_Common_CentralElements_CompuMethods_Identical 1 100 0.0 4294967295 FORMAT "%8.2" ECU_ADDRESS 0xfe4182f4 /end MEASUREMENT
/begin MEASUREMENT Tlib_EfuseRegRead_GetHSHT_THR_O_S_ODH75 "" ULONG RB_RBA_Common_CentralElements_CompuMethods_Identical 1 100 0.0 4294967295 FORMAT "%8.2" ECU_ADDRESS 0xfe4182f8 /end MEASUREMENT
/begin MEASUREMENT Tlib_EfuseRegRead_GetVDS_THR_O_S_ODH75 "" ULONG RB_RBA_Common_CentralElements_CompuMethods_Identical 1 100 0.0 4294967295 FORMAT "%8.2" ECU_ADDRESS 0xfe4182fc /end MEASUREMENT
/begin MEASUREMENT Tlib_EfuseRegRead_GetNTC_THR_O_S_ODH75 "" ULONG RB_RBA_Common_CentralElements_CompuMethods_Identical 1 100 0.0 4294967295 FORMAT "%8.2" ECU_ADDRESS 0xfe418300 /end MEASUREMENT
/begin MEASUREMENT Tlib_EfuseRegRead_R_Shunt_O_S_ODH75 "" ULONG RB_RBA_Common_CentralElements_CompuMethods_Identical 1 100 0.0 4294967295 FORMAT "%8.2" ECU_ADDRESS 0xfe418304 /end MEASUREMENT
/begin MEASUREMENT Tlib_EfuseRegRead_GetCr1_O_S_EFUSE17 "" ULONG RB_RBA_Common_CentralElements_CompuMethods_Identical 1 100 0.0 4294967295 FORMAT "%8.2" ECU_ADDRESS 0xfe418308 /end MEASUREMENT
/begin MEASUREMENT Tlib_EfuseRegRead_GetCR3_O_S_EFUSE17 "" ULONG RB_RBA_Common_CentralElements_CompuMethods_Identical 1 100 0.0 4294967295 FORMAT "%8.2" ECU_ADDRESS 0xfe41830c /end MEASUREMENT
/begin MEASUREMENT Tlib_EfuseRegRead_GetSR1_O_S_EFUSE17 "" ULONG RB_RBA_Common_CentralElements_CompuMethods_Identical 1 100 0.0 4294967295 FORMAT "%8.2" ECU_ADDRESS 0xfe418310 /end MEASUREMENT
/begin MEASUREMENT Tlib_EfuseRegRead_GetCurrent_O_S_EFUSE17 "" ULONG RB_RBA_Common_CentralElements_CompuMethods_Identical 1 100 0.0 4294967295 FORMAT "%8.2" ECU_ADDRESS 0xfe418314 /end MEASUREMENT
/begin MEASUREMENT Tlib_EfuseRegRead_GetTJ_O_S_EFUSE17 "" ULONG RB_RBA_Common_CentralElements_CompuMethods_Identical 1 100 0.0 4294967295 FORMAT "%8.2" ECU_ADDRESS 0xfe418318 /end MEASUREMENT
/begin MEASUREMENT Tlib_EfuseRegRead_GetTMOS_O_S_EFUSE17 "" ULONG RB_RBA_Common_CentralElements_CompuMethods_Identical 1 100 0.0 4294967295 FORMAT "%8.2" ECU_ADDRESS 0xfe41831c /end MEASUREMENT
/begin MEASUREMENT Tlib_EfuseRegRead_GetVDS_O_S_EFUSE17 "" ULONG RB_RBA_Common_CentralElements_CompuMethods_Identical 1 100 0.0 4294967295 FORMAT "%8.2" ECU_ADDRESS 0xfe418320 /end MEASUREMENT
/begin MEASUREMENT Tlib_EfuseRegRead_GetVOUT_O_S_EFUSE17 "" ULONG RB_RBA_Common_CentralElements_CompuMethods_Identical 1 100 0.0 4294967295 FORMAT "%8.2" ECU_ADDRESS 0xfe418324 /end MEASUREMENT
/begin MEASUREMENT Tlib_EfuseRegRead_GetT_NOM_O_S_EFUSE17 "" ULONG RB_RBA_Common_CentralElements_CompuMethods_Identical 1 100 0.0 4294967295 FORMAT "%8.2" ECU_ADDRESS 0xfe418328 /end MEASUREMENT
/begin MEASUREMENT Tlib_EfuseRegRead_GetOVC_THR_O_S_EFUSE17 "" ULONG RB_RBA_Common_CentralElements_CompuMethods_Identical 1 100 0.0 4294967295 FORMAT "%8.2" ECU_ADDRESS 0xfe41832c /end MEASUREMENT
/begin MEASUREMENT Tlib_EfuseRegRead_GetHSHT_THR_O_S_EFUSE17 "" ULONG RB_RBA_Common_CentralElements_CompuMethods_Identical 1 100 0.0 4294967295 FORMAT "%8.2" ECU_ADDRESS 0xfe418330 /end MEASUREMENT
/begin MEASUREMENT Tlib_EfuseRegRead_GetVDS_THR_O_S_EFUSE17 "" ULONG RB_RBA_Common_CentralElements_CompuMethods_Identical 1 100 0.0 4294967295 FORMAT "%8.2" ECU_ADDRESS 0xfe418334 /end MEASUREMENT
/begin MEASUREMENT Tlib_EfuseRegRead_GetNTC_THR_O_S_EFUSE17 "" ULONG RB_RBA_Common_CentralElements_CompuMethods_Identical 1 100 0.0 4294967295 FORMAT "%8.2" ECU_ADDRESS 0xfe418338 /end MEASUREMENT
/begin MEASUREMENT Tlib_EfuseRegRead_R_Shunt_O_S_EFUSE17 "" ULONG RB_RBA_Common_CentralElements_CompuMethods_Identical 1 100 0.0 4294967295 FORMAT "%8.2" ECU_ADDRESS 0xfe41833c /end MEASUREMENT
/begin MEASUREMENT Tlib_EfuseRegRead_GetCr1_O_S_ODH66 "" ULONG RB_RBA_Common_CentralElements_CompuMethods_Identical 1 100 0.0 4294967295 FORMAT "%8.2" ECU_ADDRESS 0xfe418340 /end MEASUREMENT
/begin MEASUREMENT Tlib_EfuseRegRead_GetCR3_O_S_ODH66 "" ULONG RB_RBA_Common_CentralElements_CompuMethods_Identical 1 100 0.0 4294967295 FORMAT "%8.2" ECU_ADDRESS 0xfe418344 /end MEASUREMENT
/begin MEASUREMENT Tlib_EfuseRegRead_GetSR1_O_S_ODH66 "" ULONG RB_RBA_Common_CentralElements_CompuMethods_Identical 1 100 0.0 4294967295 FORMAT "%8.2" ECU_ADDRESS 0xfe418348 /end MEASUREMENT
/begin MEASUREMENT Tlib_EfuseRegRead_GetCurrent_O_S_ODH66 "" ULONG RB_RBA_Common_CentralElements_CompuMethods_Identical 1 100 0.0 4294967295 FORMAT "%8.2" ECU_ADDRESS 0xfe41834c /end MEASUREMENT
/begin MEASUREMENT Tlib_EfuseRegRead_GetTJ_O_S_ODH66 "" ULONG RB_RBA_Common_CentralElements_CompuMethods_Identical 1 100 0.0 4294967295 FORMAT "%8.2" ECU_ADDRESS 0xfe418350 /end MEASUREMENT
/begin MEASUREMENT Tlib_EfuseRegRead_GetTMOS_O_S_ODH66 "" ULONG RB_RBA_Common_CentralElements_CompuMethods_Identical 1 100 0.0 4294967295 FORMAT "%8.2" ECU_ADDRESS 0xfe418354 /end MEASUREMENT
/begin MEASUREMENT Tlib_EfuseRegRead_GetVDS_O_S_ODH66 "" ULONG RB_RBA_Common_CentralElements_CompuMethods_Identical 1 100 0.0 4294967295 FORMAT "%8.2" ECU_ADDRESS 0xfe418358 /end MEASUREMENT
/begin MEASUREMENT Tlib_EfuseRegRead_GetVOUT_O_S_ODH66 "" ULONG RB_RBA_Common_CentralElements_CompuMethods_Identical 1 100 0.0 4294967295 FORMAT "%8.2" ECU_ADDRESS 0xfe41835c /end MEASUREMENT
/begin MEASUREMENT Tlib_EfuseRegRead_GetT_NOM_O_S_ODH66 "" ULONG RB_RBA_Common_CentralElements_CompuMethods_Identical 1 100 0.0 4294967295 FORMAT "%8.2" ECU_ADDRESS 0xfe418360 /end MEASUREMENT
/begin MEASUREMENT Tlib_EfuseRegRead_GetOVC_THR_O_S_ODH66 "" ULONG RB_RBA_Common_CentralElements_CompuMethods_Identical 1 100 0.0 4294967295 FORMAT "%8.2" ECU_ADDRESS 0xfe418364 /end MEASUREMENT
/begin MEASUREMENT Tlib_EfuseRegRead_GetHSHT_THR_O_S_ODH66 "" ULONG RB_RBA_Common_CentralElements_CompuMethods_Identical 1 100 0.0 4294967295 FORMAT "%8.2" ECU_ADDRESS 0xfe418368 /end MEASUREMENT
/begin MEASUREMENT Tlib_EfuseRegRead_GetVDS_THR_O_S_ODH66 "" ULONG RB_RBA_Common_CentralElements_CompuMethods_Identical 1 100 0.0 4294967295 FORMAT "%8.2" ECU_ADDRESS 0xfe41836c /end MEASUREMENT
/begin MEASUREMENT Tlib_EfuseRegRead_GetNTC_THR_O_S_ODH66 "" ULONG RB_RBA_Common_CentralElements_CompuMethods_Identical 1 100 0.0 4294967295 FORMAT "%8.2" ECU_ADDRESS 0xfe418370 /end MEASUREMENT
/begin MEASUREMENT Tlib_EfuseRegRead_R_Shunt_O_S_ODH66 "" ULONG RB_RBA_Common_CentralElements_CompuMethods_Identical 1 100 0.0 4294967295 FORMAT "%8.2" ECU_ADDRESS 0xfe418374 /end MEASUREMENT
/begin MEASUREMENT Tlib_EfuseRegRead_GetCr1_O_S_ODH34 "" ULONG RB_RBA_Common_CentralElements_CompuMethods_Identical 1 100 0.0 4294967295 FORMAT "%8.2" ECU_ADDRESS 0xfe418378 /end MEASUREMENT
/begin MEASUREMENT Tlib_EfuseRegRead_GetCR3_O_S_ODH34 "" ULONG RB_RBA_Common_CentralElements_CompuMethods_Identical 1 100 0.0 4294967295 FORMAT "%8.2" ECU_ADDRESS 0xfe41837c /end MEASUREMENT
/begin MEASUREMENT Tlib_EfuseRegRead_GetSR1_O_S_ODH34 "" ULONG RB_RBA_Common_CentralElements_CompuMethods_Identical 1 100 0.0 4294967295 FORMAT "%8.2" ECU_ADDRESS 0xfe418380 /end MEASUREMENT
/begin MEASUREMENT Tlib_EfuseRegRead_GetCurrent_O_S_ODH34 "" ULONG RB_RBA_Common_CentralElements_CompuMethods_Identical 1 100 0.0 4294967295 FORMAT "%8.2" ECU_ADDRESS 0xfe418384 /end MEASUREMENT
/begin MEASUREMENT Tlib_EfuseRegRead_GetTJ_O_S_ODH34 "" ULONG RB_RBA_Common_CentralElements_CompuMethods_Identical 1 100 0.0 4294967295 FORMAT "%8.2" ECU_ADDRESS 0xfe418388 /end MEASUREMENT
/begin MEASUREMENT Tlib_EfuseRegRead_GetTMOS_O_S_ODH34 "" ULONG RB_RBA_Common_CentralElements_CompuMethods_Identical 1 100 0.0 4294967295 FORMAT "%8.2" ECU_ADDRESS 0xfe41838c /end MEASUREMENT
/begin MEASUREMENT Tlib_EfuseRegRead_GetVDS_O_S_ODH34 "" ULONG RB_RBA_Common_CentralElements_CompuMethods_Identical 1 100 0.0 4294967295 FORMAT "%8.2" ECU_ADDRESS 0xfe418390 /end MEASUREMENT
/begin MEASUREMENT Tlib_EfuseRegRead_GetVOUT_O_S_ODH34 "" ULONG RB_RBA_Common_CentralElements_CompuMethods_Identical 1 100 0.0 4294967295 FORMAT "%8.2" ECU_ADDRESS 0xfe418394 /end MEASUREMENT
/begin MEASUREMENT Tlib_EfuseRegRead_GetT_NOM_O_S_ODH34 "" ULONG RB_RBA_Common_CentralElements_CompuMethods_Identical 1 100 0.0 4294967295 FORMAT "%8.2" ECU_ADDRESS 0xfe418398 /end MEASUREMENT
/begin MEASUREMENT Tlib_EfuseRegRead_GetOVC_THR_O_S_ODH34 "" ULONG RB_RBA_Common_CentralElements_CompuMethods_Identical 1 100 0.0 4294967295 FORMAT "%8.2" ECU_ADDRESS 0xfe41839c /end MEASUREMENT
/begin MEASUREMENT Tlib_EfuseRegRead_GetHSHT_THR_O_S_ODH34 "" ULONG RB_RBA_Common_CentralElements_CompuMethods_Identical 1 100 0.0 4294967295 FORMAT "%8.2" ECU_ADDRESS 0xfe4183a0 /end MEASUREMENT
/begin MEASUREMENT Tlib_EfuseRegRead_GetVDS_THR_O_S_ODH34 "" ULONG RB_RBA_Common_CentralElements_CompuMethods_Identical 1 100 0.0 4294967295 FORMAT "%8.2" ECU_ADDRESS 0xfe4183a4 /end MEASUREMENT
/begin MEASUREMENT Tlib_EfuseRegRead_GetNTC_THR_O_S_ODH34 "" ULONG RB_RBA_Common_CentralElements_CompuMethods_Identical 1 100 0.0 4294967295 FORMAT "%8.2" ECU_ADDRESS 0xfe4183a8 /end MEASUREMENT
/begin MEASUREMENT Tlib_EfuseRegRead_R_Shunt_O_S_ODH34 "" ULONG RB_RBA_Common_CentralElements_CompuMethods_Identical 1 100 0.0 4294967295 FORMAT "%8.2" ECU_ADDRESS 0xfe4183ac /end MEASUREMENT
/begin MEASUREMENT Tlib_EfuseRegRead_GetCr1_O_S_EFUSE31 "" ULONG RB_RBA_Common_CentralElements_CompuMethods_Identical 1 100 0.0 4294967295 FORMAT "%8.2" ECU_ADDRESS 0xfe4183b0 /end MEASUREMENT
/begin MEASUREMENT Tlib_EfuseRegRead_GetCR3_O_S_EFUSE31 "" ULONG RB_RBA_Common_CentralElements_CompuMethods_Identical 1 100 0.0 4294967295 FORMAT "%8.2" ECU_ADDRESS 0xfe4183b4 /end MEASUREMENT
/begin MEASUREMENT Tlib_EfuseRegRead_GetSR1_O_S_EFUSE31 "" ULONG RB_RBA_Common_CentralElements_CompuMethods_Identical 1 100 0.0 4294967295 FORMAT "%8.2" ECU_ADDRESS 0xfe4183b8 /end MEASUREMENT
/begin MEASUREMENT Tlib_EfuseRegRead_GetCurrent_O_S_EFUSE31 "" ULONG RB_RBA_Common_CentralElements_CompuMethods_Identical 1 100 0.0 4294967295 FORMAT "%8.2" ECU_ADDRESS 0xfe4183bc /end MEASUREMENT
/begin MEASUREMENT Tlib_EfuseRegRead_GetTJ_O_S_EFUSE31 "" ULONG RB_RBA_Common_CentralElements_CompuMethods_Identical 1 100 0.0 4294967295 FORMAT "%8.2" ECU_ADDRESS 0xfe4183c0 /end MEASUREMENT
/begin MEASUREMENT Tlib_EfuseRegRead_GetTMOS_O_S_EFUSE31 "" ULONG RB_RBA_Common_CentralElements_CompuMethods_Identical 1 100 0.0 4294967295 FORMAT "%8.2" ECU_ADDRESS 0xfe4183c4 /end MEASUREMENT
/begin MEASUREMENT Tlib_EfuseRegRead_GetVDS_O_S_EFUSE31 "" ULONG RB_RBA_Common_CentralElements_CompuMethods_Identical 1 100 0.0 4294967295 FORMAT "%8.2" ECU_ADDRESS 0xfe4183c8 /end MEASUREMENT
/begin MEASUREMENT Tlib_EfuseRegRead_GetVOUT_O_S_EFUSE31 "" ULONG RB_RBA_Common_CentralElements_CompuMethods_Identical 1 100 0.0 4294967295 FORMAT "%8.2" ECU_ADDRESS 0xfe4183cc /end MEASUREMENT
/begin MEASUREMENT Tlib_EfuseRegRead_GetT_NOM_O_S_EFUSE31 "" ULONG RB_RBA_Common_CentralElements_CompuMethods_Identical 1 100 0.0 4294967295 FORMAT "%8.2" ECU_ADDRESS 0xfe4183d0 /end MEASUREMENT
/begin MEASUREMENT Tlib_EfuseRegRead_GetOVC_THR_O_S_EFUSE31 "" ULONG RB_RBA_Common_CentralElements_CompuMethods_Identical 1 100 0.0 4294967295 FORMAT "%8.2" ECU_ADDRESS 0xfe4183d4 /end MEASUREMENT
/begin MEASUREMENT Tlib_EfuseRegRead_GetHSHT_THR_O_S_EFUSE31 "" ULONG RB_RBA_Common_CentralElements_CompuMethods_Identical 1 100 0.0 4294967295 FORMAT "%8.2" ECU_ADDRESS 0xfe4183d8 /end MEASUREMENT
/begin MEASUREMENT Tlib_EfuseRegRead_GetVDS_THR_O_S_EFUSE31 "" ULONG RB_RBA_Common_CentralElements_CompuMethods_Identical 1 100 0.0 4294967295 FORMAT "%8.2" ECU_ADDRESS 0xfe4183dc /end MEASUREMENT
/begin MEASUREMENT Tlib_EfuseRegRead_GetNTC_THR_O_S_EFUSE31 "" ULONG RB_RBA_Common_CentralElements_CompuMethods_Identical 1 100 0.0 4294967295 FORMAT "%8.2" ECU_ADDRESS 0xfe4183e0 /end MEASUREMENT
/begin MEASUREMENT Tlib_EfuseRegRead_R_Shunt_O_S_EFUSE31 "" ULONG RB_RBA_Common_CentralElements_CompuMethods_Identical 1 100 0.0 4294967295 FORMAT "%8.2" ECU_ADDRESS 0xfe4183e4 /end MEASUREMENT
/begin MEASUREMENT Tlib_EfuseRegRead_GetCr1_O_S_ODH30 "" ULONG RB_RBA_Common_CentralElements_CompuMethods_Identical 1 100 0.0 4294967295 FORMAT "%8.2" ECU_ADDRESS 0xfe4183e8 /end MEASUREMENT
/begin MEASUREMENT Tlib_EfuseRegRead_GetCR3_O_S_ODH30 "" ULONG RB_RBA_Common_CentralElements_CompuMethods_Identical 1 100 0.0 4294967295 FORMAT "%8.2" ECU_ADDRESS 0xfe4183ec /end MEASUREMENT
/begin MEASUREMENT Tlib_EfuseRegRead_GetSR1_O_S_ODH30 "" ULONG RB_RBA_Common_CentralElements_CompuMethods_Identical 1 100 0.0 4294967295 FORMAT "%8.2" ECU_ADDRESS 0xfe4183f0 /end MEASUREMENT
/begin MEASUREMENT Tlib_EfuseRegRead_GetCurrent_O_S_ODH30 "" ULONG RB_RBA_Common_CentralElements_CompuMethods_Identical 1 100 0.0 4294967295 FORMAT "%8.2" ECU_ADDRESS 0xfe4183f4 /end MEASUREMENT
/begin MEASUREMENT Tlib_EfuseRegRead_GetTJ_O_S_ODH30 "" ULONG RB_RBA_Common_CentralElements_CompuMethods_Identical 1 100 0.0 4294967295 FORMAT "%8.2" ECU_ADDRESS 0xfe4183f8 /end MEASUREMENT
/begin MEASUREMENT Tlib_EfuseRegRead_GetTMOS_O_S_ODH30 "" ULONG RB_RBA_Common_CentralElements_CompuMethods_Identical 1 100 0.0 4294967295 FORMAT "%8.2" ECU_ADDRESS 0xfe4183fc /end MEASUREMENT
/begin MEASUREMENT Tlib_EfuseRegRead_GetVDS_O_S_ODH30 "" ULONG RB_RBA_Common_CentralElements_CompuMethods_Identical 1 100 0.0 4294967295 FORMAT "%8.2" ECU_ADDRESS 0xfe418400 /end MEASUREMENT
/begin MEASUREMENT Tlib_EfuseRegRead_GetVOUT_O_S_ODH30 "" ULONG RB_RBA_Common_CentralElements_CompuMethods_Identical 1 100 0.0 4294967295 FORMAT "%8.2" ECU_ADDRESS 0xfe418404 /end MEASUREMENT
/begin MEASUREMENT Tlib_EfuseRegRead_GetT_NOM_O_S_ODH30 "" ULONG RB_RBA_Common_CentralElements_CompuMethods_Identical 1 100 0.0 4294967295 FORMAT "%8.2" ECU_ADDRESS 0xfe418408 /end MEASUREMENT
/begin MEASUREMENT Tlib_EfuseRegRead_GetOVC_THR_O_S_ODH30 "" ULONG RB_RBA_Common_CentralElements_CompuMethods_Identical 1 100 0.0 4294967295 FORMAT "%8.2" ECU_ADDRESS 0xfe41840c /end MEASUREMENT
/begin MEASUREMENT Tlib_EfuseRegRead_GetHSHT_THR_O_S_ODH30 "" ULONG RB_RBA_Common_CentralElements_CompuMethods_Identical 1 100 0.0 4294967295 FORMAT "%8.2" ECU_ADDRESS 0xfe418410 /end MEASUREMENT
/begin MEASUREMENT Tlib_EfuseRegRead_GetVDS_THR_O_S_ODH30 "" ULONG RB_RBA_Common_CentralElements_CompuMethods_Identical 1 100 0.0 4294967295 FORMAT "%8.2" ECU_ADDRESS 0xfe418414 /end MEASUREMENT
/begin MEASUREMENT Tlib_EfuseRegRead_GetNTC_THR_O_S_ODH30 "" ULONG RB_RBA_Common_CentralElements_CompuMethods_Identical 1 100 0.0 4294967295 FORMAT "%8.2" ECU_ADDRESS 0xfe418418 /end MEASUREMENT
/begin MEASUREMENT Tlib_EfuseRegRead_R_Shunt_O_S_ODH30 "" ULONG RB_RBA_Common_CentralElements_CompuMethods_Identical 1 100 0.0 4294967295 FORMAT "%8.2" ECU_ADDRESS 0xfe41841c /end MEASUREMENT
/begin MEASUREMENT Tlib_EfuseRegRead_GetCr1_O_S_EFUSE29 "" ULONG RB_RBA_Common_CentralElements_CompuMethods_Identical 1 100 0.0 4294967295 FORMAT "%8.2" ECU_ADDRESS 0xfe418420 /end MEASUREMENT
/begin MEASUREMENT Tlib_EfuseRegRead_GetCR3_O_S_EFUSE29 "" ULONG RB_RBA_Common_CentralElements_CompuMethods_Identical 1 100 0.0 4294967295 FORMAT "%8.2" ECU_ADDRESS 0xfe418424 /end MEASUREMENT
/begin MEASUREMENT Tlib_EfuseRegRead_GetSR1_O_S_EFUSE29 "" ULONG RB_RBA_Common_CentralElements_CompuMethods_Identical 1 100 0.0 4294967295 FORMAT "%8.2" ECU_ADDRESS 0xfe418428 /end MEASUREMENT
/begin MEASUREMENT Tlib_EfuseRegRead_GetCurrent_O_S_EFUSE29 "" ULONG RB_RBA_Common_CentralElements_CompuMethods_Identical 1 100 0.0 4294967295 FORMAT "%8.2" ECU_ADDRESS 0xfe41842c /end MEASUREMENT
/begin MEASUREMENT Tlib_EfuseRegRead_GetTJ_O_S_EFUSE29 "" ULONG RB_RBA_Common_CentralElements_CompuMethods_Identical 1 100 0.0 4294967295 FORMAT "%8.2" ECU_ADDRESS 0xfe418430 /end MEASUREMENT
/begin MEASUREMENT Tlib_EfuseRegRead_GetTMOS_O_S_EFUSE29 "" ULONG RB_RBA_Common_CentralElements_CompuMethods_Identical 1 100 0.0 4294967295 FORMAT "%8.2" ECU_ADDRESS 0xfe418434 /end MEASUREMENT
/begin MEASUREMENT Tlib_EfuseRegRead_GetVDS_O_S_EFUSE29 "" ULONG RB_RBA_Common_CentralElements_CompuMethods_Identical 1 100 0.0 4294967295 FORMAT "%8.2" ECU_ADDRESS 0xfe418438 /end MEASUREMENT
/begin MEASUREMENT Tlib_EfuseRegRead_GetVOUT_O_S_EFUSE29 "" ULONG RB_RBA_Common_CentralElements_CompuMethods_Identical 1 100 0.0 4294967295 FORMAT "%8.2" ECU_ADDRESS 0xfe41843c /end MEASUREMENT
/begin MEASUREMENT Tlib_EfuseRegRead_GetT_NOM_O_S_EFUSE29 "" ULONG RB_RBA_Common_CentralElements_CompuMethods_Identical 1 100 0.0 4294967295 FORMAT "%8.2" ECU_ADDRESS 0xfe418440 /end MEASUREMENT
/begin MEASUREMENT Tlib_EfuseRegRead_GetOVC_THR_O_S_EFUSE29 "" ULONG RB_RBA_Common_CentralElements_CompuMethods_Identical 1 100 0.0 4294967295 FORMAT "%8.2" ECU_ADDRESS 0xfe418444 /end MEASUREMENT
/begin MEASUREMENT Tlib_EfuseRegRead_GetHSHT_THR_O_S_EFUSE29 "" ULONG RB_RBA_Common_CentralElements_CompuMethods_Identical 1 100 0.0 4294967295 FORMAT "%8.2" ECU_ADDRESS 0xfe418448 /end MEASUREMENT
/begin MEASUREMENT Tlib_EfuseRegRead_GetVDS_THR_O_S_EFUSE29 "" ULONG RB_RBA_Common_CentralElements_CompuMethods_Identical 1 100 0.0 4294967295 FORMAT "%8.2" ECU_ADDRESS 0xfe41844c /end MEASUREMENT
/begin MEASUREMENT Tlib_EfuseRegRead_GetNTC_THR_O_S_EFUSE29 "" ULONG RB_RBA_Common_CentralElements_CompuMethods_Identical 1 100 0.0 4294967295 FORMAT "%8.2" ECU_ADDRESS 0xfe418450 /end MEASUREMENT
/begin MEASUREMENT Tlib_EfuseRegRead_R_Shunt_O_S_EFUSE29 "" ULONG RB_RBA_Common_CentralElements_CompuMethods_Identical 1 100 0.0 4294967295 FORMAT "%8.2" ECU_ADDRESS 0xfe418454 /end MEASUREMENT
/begin MEASUREMENT Tlib_EfuseRegRead_GetCr1_O_S_ODH100 "" ULONG RB_RBA_Common_CentralElements_CompuMethods_Identical 1 100 0.0 4294967295 FORMAT "%8.2" ECU_ADDRESS 0xfe418458 /end MEASUREMENT
/begin MEASUREMENT Tlib_EfuseRegRead_GetCR3_O_S_ODH100 "" ULONG RB_RBA_Common_CentralElements_CompuMethods_Identical 1 100 0.0 4294967295 FORMAT "%8.2" ECU_ADDRESS 0xfe41845c /end MEASUREMENT
/begin MEASUREMENT Tlib_EfuseRegRead_GetSR1_O_S_ODH100 "" ULONG RB_RBA_Common_CentralElements_CompuMethods_Identical 1 100 0.0 4294967295 FORMAT "%8.2" ECU_ADDRESS 0xfe418460 /end MEASUREMENT
/begin MEASUREMENT Tlib_EfuseRegRead_GetCurrent_O_S_ODH100 "" ULONG RB_RBA_Common_CentralElements_CompuMethods_Identical 1 100 0.0 4294967295 FORMAT "%8.2" ECU_ADDRESS 0xfe418464 /end MEASUREMENT
/begin MEASUREMENT Tlib_EfuseRegRead_GetTJ_O_S_ODH100 "" ULONG RB_RBA_Common_CentralElements_CompuMethods_Identical 1 100 0.0 4294967295 FORMAT "%8.2" ECU_ADDRESS 0xfe418468 /end MEASUREMENT
/begin MEASUREMENT Tlib_EfuseRegRead_GetTMOS_O_S_ODH100 "" ULONG RB_RBA_Common_CentralElements_CompuMethods_Identical 1 100 0.0 4294967295 FORMAT "%8.2" ECU_ADDRESS 0xfe41846c /end MEASUREMENT
/begin MEASUREMENT Tlib_EfuseRegRead_GetVDS_O_S_ODH100 "" ULONG RB_RBA_Common_CentralElements_CompuMethods_Identical 1 100 0.0 4294967295 FORMAT "%8.2" ECU_ADDRESS 0xfe418470 /end MEASUREMENT
/begin MEASUREMENT Tlib_EfuseRegRead_GetVOUT_O_S_ODH100 "" ULONG RB_RBA_Common_CentralElements_CompuMethods_Identical 1 100 0.0 4294967295 FORMAT "%8.2" ECU_ADDRESS 0xfe418474 /end MEASUREMENT
/begin MEASUREMENT Tlib_EfuseRegRead_GetT_NOM_O_S_ODH100 "" ULONG RB_RBA_Common_CentralElements_CompuMethods_Identical 1 100 0.0 4294967295 FORMAT "%8.2" ECU_ADDRESS 0xfe418478 /end MEASUREMENT
/begin MEASUREMENT Tlib_EfuseRegRead_GetOVC_THR_O_S_ODH100 "" ULONG RB_RBA_Common_CentralElements_CompuMethods_Identical 1 100 0.0 4294967295 FORMAT "%8.2" ECU_ADDRESS 0xfe41847c /end MEASUREMENT
/begin MEASUREMENT Tlib_EfuseRegRead_GetHSHT_THR_O_S_ODH100 "" ULONG RB_RBA_Common_CentralElements_CompuMethods_Identical 1 100 0.0 4294967295 FORMAT "%8.2" ECU_ADDRESS 0xfe418480 /end MEASUREMENT
/begin MEASUREMENT Tlib_EfuseRegRead_GetVDS_THR_O_S_ODH100 "" ULONG RB_RBA_Common_CentralElements_CompuMethods_Identical 1 100 0.0 4294967295 FORMAT "%8.2" ECU_ADDRESS 0xfe418484 /end MEASUREMENT
/begin MEASUREMENT Tlib_EfuseRegRead_GetNTC_THR_O_S_ODH100 "" ULONG RB_RBA_Common_CentralElements_CompuMethods_Identical 1 100 0.0 4294967295 FORMAT "%8.2" ECU_ADDRESS 0xfe418488 /end MEASUREMENT
/begin MEASUREMENT Tlib_EfuseRegRead_R_Shunt_O_S_ODH100 "" ULONG RB_RBA_Common_CentralElements_CompuMethods_Identical 1 100 0.0 4294967295 FORMAT "%8.2" ECU_ADDRESS 0xfe41848c /end MEASUREMENT
/begin MEASUREMENT Tlib_EfuseRegRead_GetCr1_O_S_ODH86 "" ULONG RB_RBA_Common_CentralElements_CompuMethods_Identical 1 100 0.0 4294967295 FORMAT "%8.2" ECU_ADDRESS 0xfe418490 /end MEASUREMENT
/begin MEASUREMENT Tlib_EfuseRegRead_GetCR3_O_S_ODH86 "" ULONG RB_RBA_Common_CentralElements_CompuMethods_Identical 1 100 0.0 4294967295 FORMAT "%8.2" ECU_ADDRESS 0xfe418494 /end MEASUREMENT
/begin MEASUREMENT Tlib_EfuseRegRead_GetSR1_O_S_ODH86 "" ULONG RB_RBA_Common_CentralElements_CompuMethods_Identical 1 100 0.0 4294967295 FORMAT "%8.2" ECU_ADDRESS 0xfe418498 /end MEASUREMENT
/begin MEASUREMENT Tlib_EfuseRegRead_GetCurrent_O_S_ODH86 "" ULONG RB_RBA_Common_CentralElements_CompuMethods_Identical 1 100 0.0 4294967295 FORMAT "%8.2" ECU_ADDRESS 0xfe41849c /end MEASUREMENT
/begin MEASUREMENT Tlib_EfuseRegRead_GetTJ_O_S_ODH86 "" ULONG RB_RBA_Common_CentralElements_CompuMethods_Identical 1 100 0.0 4294967295 FORMAT "%8.2" ECU_ADDRESS 0xfe4184a0 /end MEASUREMENT
/begin MEASUREMENT Tlib_EfuseRegRead_GetTMOS_O_S_ODH86 "" ULONG RB_RBA_Common_CentralElements_CompuMethods_Identical 1 100 0.0 4294967295 FORMAT "%8.2" ECU_ADDRESS 0xfe4184a4 /end MEASUREMENT
/begin MEASUREMENT Tlib_EfuseRegRead_GetVDS_O_S_ODH86 "" ULONG RB_RBA_Common_CentralElements_CompuMethods_Identical 1 100 0.0 4294967295 FORMAT "%8.2" ECU_ADDRESS 0xfe4184a8 /end MEASUREMENT
/begin MEASUREMENT Tlib_EfuseRegRead_GetVOUT_O_S_ODH86 "" ULONG RB_RBA_Common_CentralElements_CompuMethods_Identical 1 100 0.0 4294967295 FORMAT "%8.2" ECU_ADDRESS 0xfe4184ac /end MEASUREMENT
/begin MEASUREMENT Tlib_EfuseRegRead_GetT_NOM_O_S_ODH86 "" ULONG RB_RBA_Common_CentralElements_CompuMethods_Identical 1 100 0.0 4294967295 FORMAT "%8.2" ECU_ADDRESS 0xfe4184b0 /end MEASUREMENT
/begin MEASUREMENT Tlib_EfuseRegRead_GetOVC_THR_O_S_ODH86 "" ULONG RB_RBA_Common_CentralElements_CompuMethods_Identical 1 100 0.0 4294967295 FORMAT "%8.2" ECU_ADDRESS 0xfe4184b4 /end MEASUREMENT
/begin MEASUREMENT Tlib_EfuseRegRead_GetHSHT_THR_O_S_ODH86 "" ULONG RB_RBA_Common_CentralElements_CompuMethods_Identical 1 100 0.0 4294967295 FORMAT "%8.2" ECU_ADDRESS 0xfe4184b8 /end MEASUREMENT
/begin MEASUREMENT Tlib_EfuseRegRead_GetVDS_THR_O_S_ODH86 "" ULONG RB_RBA_Common_CentralElements_CompuMethods_Identical 1 100 0.0 4294967295 FORMAT "%8.2" ECU_ADDRESS 0xfe4184bc /end MEASUREMENT
/begin MEASUREMENT Tlib_EfuseRegRead_GetNTC_THR_O_S_ODH86 "" ULONG RB_RBA_Common_CentralElements_CompuMethods_Identical 1 100 0.0 4294967295 FORMAT "%8.2" ECU_ADDRESS 0xfe4184c0 /end MEASUREMENT
/begin MEASUREMENT Tlib_EfuseRegRead_R_Shunt_O_S_ODH86 "" ULONG RB_RBA_Common_CentralElements_CompuMethods_Identical 1 100 0.0 4294967295 FORMAT "%8.2" ECU_ADDRESS 0xfe4184c4 /end MEASUREMENT
/begin MEASUREMENT Tlib_EfuseRegRead_GetCr1_O_S_ODH13 "" ULONG RB_RBA_Common_CentralElements_CompuMethods_Identical 1 100 0.0 4294967295 FORMAT "%8.2" ECU_ADDRESS 0xfe4184c8 /end MEASUREMENT
/begin MEASUREMENT Tlib_EfuseRegRead_GetCR3_O_S_ODH13 "" ULONG RB_RBA_Common_CentralElements_CompuMethods_Identical 1 100 0.0 4294967295 FORMAT "%8.2" ECU_ADDRESS 0xfe4184cc /end MEASUREMENT
/begin MEASUREMENT Tlib_EfuseRegRead_GetSR1_O_S_ODH13 "" ULONG RB_RBA_Common_CentralElements_CompuMethods_Identical 1 100 0.0 4294967295 FORMAT "%8.2" ECU_ADDRESS 0xfe4184d0 /end MEASUREMENT
/begin MEASUREMENT Tlib_EfuseRegRead_GetCurrent_O_S_ODH13 "" ULONG RB_RBA_Common_CentralElements_CompuMethods_Identical 1 100 0.0 4294967295 FORMAT "%8.2" ECU_ADDRESS 0xfe4184d4 /end MEASUREMENT
/begin MEASUREMENT Tlib_EfuseRegRead_GetTJ_O_S_ODH13 "" ULONG RB_RBA_Common_CentralElements_CompuMethods_Identical 1 100 0.0 4294967295 FORMAT "%8.2" ECU_ADDRESS 0xfe4184d8 /end MEASUREMENT
/begin MEASUREMENT Tlib_EfuseRegRead_GetTMOS_O_S_ODH13 "" ULONG RB_RBA_Common_CentralElements_CompuMethods_Identical 1 100 0.0 4294967295 FORMAT "%8.2" ECU_ADDRESS 0xfe4184dc /end MEASUREMENT
/begin MEASUREMENT Tlib_EfuseRegRead_GetVDS_O_S_ODH13 "" ULONG RB_RBA_Common_CentralElements_CompuMethods_Identical 1 100 0.0 4294967295 FORMAT "%8.2" ECU_ADDRESS 0xfe4184e0 /end MEASUREMENT
/begin MEASUREMENT Tlib_EfuseRegRead_GetVOUT_O_S_ODH13 "" ULONG RB_RBA_Common_CentralElements_CompuMethods_Identical 1 100 0.0 4294967295 FORMAT "%8.2" ECU_ADDRESS 0xfe4184e4 /end MEASUREMENT
/begin MEASUREMENT Tlib_EfuseRegRead_GetT_NOM_O_S_ODH13 "" ULONG RB_RBA_Common_CentralElements_CompuMethods_Identical 1 100 0.0 4294967295 FORMAT "%8.2" ECU_ADDRESS 0xfe4184e8 /end MEASUREMENT
/begin MEASUREMENT Tlib_EfuseRegRead_GetOVC_THR_O_S_ODH13 "" ULONG RB_RBA_Common_CentralElements_CompuMethods_Identical 1 100 0.0 4294967295 FORMAT "%8.2" ECU_ADDRESS 0xfe4184ec /end MEASUREMENT
/begin MEASUREMENT Tlib_EfuseRegRead_GetHSHT_THR_O_S_ODH13 "" ULONG RB_RBA_Common_CentralElements_CompuMethods_Identical 1 100 0.0 4294967295 FORMAT "%8.2" ECU_ADDRESS 0xfe4184f0 /end MEASUREMENT
/begin MEASUREMENT Tlib_EfuseRegRead_GetVDS_THR_O_S_ODH13 "" ULONG RB_RBA_Common_CentralElements_CompuMethods_Identical 1 100 0.0 4294967295 FORMAT "%8.2" ECU_ADDRESS 0xfe4184f4 /end MEASUREMENT
/begin MEASUREMENT Tlib_EfuseRegRead_GetNTC_THR_O_S_ODH13 "" ULONG RB_RBA_Common_CentralElements_CompuMethods_Identical 1 100 0.0 4294967295 FORMAT "%8.2" ECU_ADDRESS 0xfe4184f8 /end MEASUREMENT
/begin MEASUREMENT Tlib_EfuseRegRead_R_Shunt_O_S_ODH13 "" ULONG RB_RBA_Common_CentralElements_CompuMethods_Identical 1 100 0.0 4294967295 FORMAT "%8.2" ECU_ADDRESS 0xfe4184fc /end MEASUREMENT
/begin MEASUREMENT Tlib_EfuseRegRead_GetCr1_O_S_5V09 "" ULONG RB_RBA_Common_CentralElements_CompuMethods_Identical 1 100 0.0 4294967295 FORMAT "%8.2" ECU_ADDRESS 0xfe418500 /end MEASUREMENT
/begin MEASUREMENT Tlib_EfuseRegRead_GetCR3_O_S_5V09 "" ULONG RB_RBA_Common_CentralElements_CompuMethods_Identical 1 100 0.0 4294967295 FORMAT "%8.2" ECU_ADDRESS 0xfe418504 /end MEASUREMENT
/begin MEASUREMENT Tlib_EfuseRegRead_GetSR1_O_S_5V09 "" ULONG RB_RBA_Common_CentralElements_CompuMethods_Identical 1 100 0.0 4294967295 FORMAT "%8.2" ECU_ADDRESS 0xfe418508 /end MEASUREMENT
/begin MEASUREMENT Tlib_EfuseRegRead_GetCurrent_O_S_5V09 "" ULONG RB_RBA_Common_CentralElements_CompuMethods_Identical 1 100 0.0 4294967295 FORMAT "%8.2" ECU_ADDRESS 0xfe41850c /end MEASUREMENT
/begin MEASUREMENT Tlib_EfuseRegRead_GetTJ_O_S_5V09 "" ULONG RB_RBA_Common_CentralElements_CompuMethods_Identical 1 100 0.0 4294967295 FORMAT "%8.2" ECU_ADDRESS 0xfe418510 /end MEASUREMENT
/begin MEASUREMENT Tlib_EfuseRegRead_GetTMOS_O_S_5V09 "" ULONG RB_RBA_Common_CentralElements_CompuMethods_Identical 1 100 0.0 4294967295 FORMAT "%8.2" ECU_ADDRESS 0xfe418514 /end MEASUREMENT
/begin MEASUREMENT Tlib_EfuseRegRead_GetVDS_O_S_5V09 "" ULONG RB_RBA_Common_CentralElements_CompuMethods_Identical 1 100 0.0 4294967295 FORMAT "%8.2" ECU_ADDRESS 0xfe418518 /end MEASUREMENT
/begin MEASUREMENT Tlib_EfuseRegRead_GetVOUT_O_S_5V09 "" ULONG RB_RBA_Common_CentralElements_CompuMethods_Identical 1 100 0.0 4294967295 FORMAT "%8.2" ECU_ADDRESS 0xfe41851c /end MEASUREMENT
/begin MEASUREMENT Tlib_EfuseRegRead_GetT_NOM_O_S_5V09 "" ULONG RB_RBA_Common_CentralElements_CompuMethods_Identical 1 100 0.0 4294967295 FORMAT "%8.2" ECU_ADDRESS 0xfe418520 /end MEASUREMENT
/begin MEASUREMENT Tlib_EfuseRegRead_GetOVC_THR_O_S_5V09 "" ULONG RB_RBA_Common_CentralElements_CompuMethods_Identical 1 100 0.0 4294967295 FORMAT "%8.2" ECU_ADDRESS 0xfe418524 /end MEASUREMENT
/begin MEASUREMENT Tlib_EfuseRegRead_GetHSHT_THR_O_S_5V09 "" ULONG RB_RBA_Common_CentralElements_CompuMethods_Identical 1 100 0.0 4294967295 FORMAT "%8.2" ECU_ADDRESS 0xfe418528 /end MEASUREMENT
/begin MEASUREMENT Tlib_EfuseRegRead_GetVDS_THR_O_S_5V09 "" ULONG RB_RBA_Common_CentralElements_CompuMethods_Identical 1 100 0.0 4294967295 FORMAT "%8.2" ECU_ADDRESS 0xfe41852c /end MEASUREMENT
/begin MEASUREMENT Tlib_EfuseRegRead_GetNTC_THR_O_S_5V09 "" ULONG RB_RBA_Common_CentralElements_CompuMethods_Identical 1 100 0.0 4294967295 FORMAT "%8.2" ECU_ADDRESS 0xfe418530 /end MEASUREMENT
/begin MEASUREMENT Tlib_EfuseRegRead_R_Shunt_O_S_5V09 "" ULONG RB_RBA_Common_CentralElements_CompuMethods_Identical 1 100 0.0 4294967295 FORMAT "%8.2" ECU_ADDRESS 0xfe418534 /end MEASUREMENT
/begin MEASUREMENT Tlib_EfuseRegRead_GetCr1_O_S_ODH23 "" ULONG RB_RBA_Common_CentralElements_CompuMethods_Identical 1 100 0.0 4294967295 FORMAT "%8.2" ECU_ADDRESS 0xfe418538 /end MEASUREMENT
/begin MEASUREMENT Tlib_EfuseRegRead_GetCR3_O_S_ODH23 "" ULONG RB_RBA_Common_CentralElements_CompuMethods_Identical 1 100 0.0 4294967295 FORMAT "%8.2" ECU_ADDRESS 0xfe41853c /end MEASUREMENT
/begin MEASUREMENT Tlib_EfuseRegRead_GetSR1_O_S_ODH23 "" ULONG RB_RBA_Common_CentralElements_CompuMethods_Identical 1 100 0.0 4294967295 FORMAT "%8.2" ECU_ADDRESS 0xfe418540 /end MEASUREMENT
/begin MEASUREMENT Tlib_EfuseRegRead_GetCurrent_O_S_ODH23 "" ULONG RB_RBA_Common_CentralElements_CompuMethods_Identical 1 100 0.0 4294967295 FORMAT "%8.2" ECU_ADDRESS 0xfe418544 /end MEASUREMENT
/begin MEASUREMENT Tlib_EfuseRegRead_GetTJ_O_S_ODH23 "" ULONG RB_RBA_Common_CentralElements_CompuMethods_Identical 1 100 0.0 4294967295 FORMAT "%8.2" ECU_ADDRESS 0xfe418548 /end MEASUREMENT
/begin MEASUREMENT Tlib_EfuseRegRead_GetTMOS_O_S_ODH23 "" ULONG RB_RBA_Common_CentralElements_CompuMethods_Identical 1 100 0.0 4294967295 FORMAT "%8.2" ECU_ADDRESS 0xfe41854c /end MEASUREMENT
/begin MEASUREMENT Tlib_EfuseRegRead_GetVDS_O_S_ODH23 "" ULONG RB_RBA_Common_CentralElements_CompuMethods_Identical 1 100 0.0 4294967295 FORMAT "%8.2" ECU_ADDRESS 0xfe418550 /end MEASUREMENT
/begin MEASUREMENT Tlib_EfuseRegRead_GetVOUT_O_S_ODH23 "" ULONG RB_RBA_Common_CentralElements_CompuMethods_Identical 1 100 0.0 4294967295 FORMAT "%8.2" ECU_ADDRESS 0xfe418554 /end MEASUREMENT
/begin MEASUREMENT Tlib_EfuseRegRead_GetT_NOM_O_S_ODH23 "" ULONG RB_RBA_Common_CentralElements_CompuMethods_Identical 1 100 0.0 4294967295 FORMAT "%8.2" ECU_ADDRESS 0xfe418558 /end MEASUREMENT
/begin MEASUREMENT Tlib_EfuseRegRead_GetOVC_THR_O_S_ODH23 "" ULONG RB_RBA_Common_CentralElements_CompuMethods_Identical 1 100 0.0 4294967295 FORMAT "%8.2" ECU_ADDRESS 0xfe41855c /end MEASUREMENT
/begin MEASUREMENT Tlib_EfuseRegRead_GetHSHT_THR_O_S_ODH23 "" ULONG RB_RBA_Common_CentralElements_CompuMethods_Identical 1 100 0.0 4294967295 FORMAT "%8.2" ECU_ADDRESS 0xfe418560 /end MEASUREMENT
/begin MEASUREMENT Tlib_EfuseRegRead_GetVDS_THR_O_S_ODH23 "" ULONG RB_RBA_Common_CentralElements_CompuMethods_Identical 1 100 0.0 4294967295 FORMAT "%8.2" ECU_ADDRESS 0xfe418564 /end MEASUREMENT
/begin MEASUREMENT Tlib_EfuseRegRead_GetNTC_THR_O_S_ODH23 "" ULONG RB_RBA_Common_CentralElements_CompuMethods_Identical 1 100 0.0 4294967295 FORMAT "%8.2" ECU_ADDRESS 0xfe418568 /end MEASUREMENT
/begin MEASUREMENT Tlib_EfuseRegRead_R_Shunt_O_S_ODH23 "" ULONG RB_RBA_Common_CentralElements_CompuMethods_Identical 1 100 0.0 4294967295 FORMAT "%8.2" ECU_ADDRESS 0xfe41856c /end MEASUREMENT
/begin MEASUREMENT Tlib_EfuseRegRead_GetCr1_O_S_EFUSE10 "" ULONG RB_RBA_Common_CentralElements_CompuMethods_Identical 1 100 0.0 4294967295 FORMAT "%8.2" ECU_ADDRESS 0xfe418570 /end MEASUREMENT
/begin MEASUREMENT Tlib_EfuseRegRead_GetCR3_O_S_EFUSE10 "" ULONG RB_RBA_Common_CentralElements_CompuMethods_Identical 1 100 0.0 4294967295 FORMAT "%8.2" ECU_ADDRESS 0xfe418574 /end MEASUREMENT
/begin MEASUREMENT Tlib_EfuseRegRead_GetSR1_O_S_EFUSE10 "" ULONG RB_RBA_Common_CentralElements_CompuMethods_Identical 1 100 0.0 4294967295 FORMAT "%8.2" ECU_ADDRESS 0xfe418578 /end MEASUREMENT
/begin MEASUREMENT Tlib_EfuseRegRead_GetCurrent_O_S_EFUSE10 "" ULONG RB_RBA_Common_CentralElements_CompuMethods_Identical 1 100 0.0 4294967295 FORMAT "%8.2" ECU_ADDRESS 0xfe41857c /end MEASUREMENT
/begin MEASUREMENT Tlib_EfuseRegRead_GetTJ_O_S_EFUSE10 "" ULONG RB_RBA_Common_CentralElements_CompuMethods_Identical 1 100 0.0 4294967295 FORMAT "%8.2" ECU_ADDRESS 0xfe418580 /end MEASUREMENT
/begin MEASUREMENT Tlib_EfuseRegRead_GetTMOS_O_S_EFUSE10 "" ULONG RB_RBA_Common_CentralElements_CompuMethods_Identical 1 100 0.0 4294967295 FORMAT "%8.2" ECU_ADDRESS 0xfe418584 /end MEASUREMENT
/begin MEASUREMENT Tlib_EfuseRegRead_GetVDS_O_S_EFUSE10 "" ULONG RB_RBA_Common_CentralElements_CompuMethods_Identical 1 100 0.0 4294967295 FORMAT "%8.2" ECU_ADDRESS 0xfe418588 /end MEASUREMENT
/begin MEASUREMENT Tlib_EfuseRegRead_GetVOUT_O_S_EFUSE10 "" ULONG RB_RBA_Common_CentralElements_CompuMethods_Identical 1 100 0.0 4294967295 FORMAT "%8.2" ECU_ADDRESS 0xfe41858c /end MEASUREMENT
/begin MEASUREMENT Tlib_EfuseRegRead_GetT_NOM_O_S_EFUSE10 "" ULONG RB_RBA_Common_CentralElements_CompuMethods_Identical 1 100 0.0 4294967295 FORMAT "%8.2" ECU_ADDRESS 0xfe418590 /end MEASUREMENT
/begin MEASUREMENT Tlib_EfuseRegRead_GetOVC_THR_O_S_EFUSE10 "" ULONG RB_RBA_Common_CentralElements_CompuMethods_Identical 1 100 0.0 4294967295 FORMAT "%8.2" ECU_ADDRESS 0xfe418594 /end MEASUREMENT
/begin MEASUREMENT Tlib_EfuseRegRead_GetHSHT_THR_O_S_EFUSE10 "" ULONG RB_RBA_Common_CentralElements_CompuMethods_Identical 1 100 0.0 4294967295 FORMAT "%8.2" ECU_ADDRESS 0xfe418598 /end MEASUREMENT
/begin MEASUREMENT Tlib_EfuseRegRead_GetVDS_THR_O_S_EFUSE10 "" ULONG RB_RBA_Common_CentralElements_CompuMethods_Identical 1 100 0.0 4294967295 FORMAT "%8.2" ECU_ADDRESS 0xfe41859c /end MEASUREMENT
/begin MEASUREMENT Tlib_EfuseRegRead_GetNTC_THR_O_S_EFUSE10 "" ULONG RB_RBA_Common_CentralElements_CompuMethods_Identical 1 100 0.0 4294967295 FORMAT "%8.2" ECU_ADDRESS 0xfe4185a0 /end MEASUREMENT
/begin MEASUREMENT Tlib_EfuseRegRead_R_Shunt_O_S_EFUSE10 "" ULONG RB_RBA_Common_CentralElements_CompuMethods_Identical 1 100 0.0 4294967295 FORMAT "%8.2" ECU_ADDRESS 0xfe4185a4 /end MEASUREMENT
/begin MEASUREMENT Tlib_EfuseRegRead_GetCr1_O_S_EFUSE18 "" ULONG RB_RBA_Common_CentralElements_CompuMethods_Identical 1 100 0.0 4294967295 FORMAT "%8.2" ECU_ADDRESS 0xfe4185a8 /end MEASUREMENT
/begin MEASUREMENT Tlib_EfuseRegRead_GetCR3_O_S_EFUSE18 "" ULONG RB_RBA_Common_CentralElements_CompuMethods_Identical 1 100 0.0 4294967295 FORMAT "%8.2" ECU_ADDRESS 0xfe4185ac /end MEASUREMENT
/begin MEASUREMENT Tlib_EfuseRegRead_GetSR1_O_S_EFUSE18 "" ULONG RB_RBA_Common_CentralElements_CompuMethods_Identical 1 100 0.0 4294967295 FORMAT "%8.2" ECU_ADDRESS 0xfe4185b0 /end MEASUREMENT
/begin MEASUREMENT Tlib_EfuseRegRead_GetCurrent_O_S_EFUSE18 "" ULONG RB_RBA_Common_CentralElements_CompuMethods_Identical 1 100 0.0 4294967295 FORMAT "%8.2" ECU_ADDRESS 0xfe4185b4 /end MEASUREMENT
/begin MEASUREMENT Tlib_EfuseRegRead_GetTJ_O_S_EFUSE18 "" ULONG RB_RBA_Common_CentralElements_CompuMethods_Identical 1 100 0.0 4294967295 FORMAT "%8.2" ECU_ADDRESS 0xfe4185b8 /end MEASUREMENT
/begin MEASUREMENT Tlib_EfuseRegRead_GetTMOS_O_S_EFUSE18 "" ULONG RB_RBA_Common_CentralElements_CompuMethods_Identical 1 100 0.0 4294967295 FORMAT "%8.2" ECU_ADDRESS 0xfe4185bc /end MEASUREMENT
/begin MEASUREMENT Tlib_EfuseRegRead_GetVDS_O_S_EFUSE18 "" ULONG RB_RBA_Common_CentralElements_CompuMethods_Identical 1 100 0.0 4294967295 FORMAT "%8.2" ECU_ADDRESS 0xfe4185c0 /end MEASUREMENT
/begin MEASUREMENT Tlib_EfuseRegRead_GetVOUT_O_S_EFUSE18 "" ULONG RB_RBA_Common_CentralElements_CompuMethods_Identical 1 100 0.0 4294967295 FORMAT "%8.2" ECU_ADDRESS 0xfe4185c4 /end MEASUREMENT
/begin MEASUREMENT Tlib_EfuseRegRead_GetT_NOM_O_S_EFUSE18 "" ULONG RB_RBA_Common_CentralElements_CompuMethods_Identical 1 100 0.0 4294967295 FORMAT "%8.2" ECU_ADDRESS 0xfe4185c8 /end MEASUREMENT
/begin MEASUREMENT Tlib_EfuseRegRead_GetOVC_THR_O_S_EFUSE18 "" ULONG RB_RBA_Common_CentralElements_CompuMethods_Identical 1 100 0.0 4294967295 FORMAT "%8.2" ECU_ADDRESS 0xfe4185cc /end MEASUREMENT
/begin MEASUREMENT Tlib_EfuseRegRead_GetHSHT_THR_O_S_EFUSE18 "" ULONG RB_RBA_Common_CentralElements_CompuMethods_Identical 1 100 0.0 4294967295 FORMAT "%8.2" ECU_ADDRESS 0xfe4185d0 /end MEASUREMENT
/begin MEASUREMENT Tlib_EfuseRegRead_GetVDS_THR_O_S_EFUSE18 "" ULONG RB_RBA_Common_CentralElements_CompuMethods_Identical 1 100 0.0 4294967295 FORMAT "%8.2" ECU_ADDRESS 0xfe4185d4 /end MEASUREMENT
/begin MEASUREMENT Tlib_EfuseRegRead_GetNTC_THR_O_S_EFUSE18 "" ULONG RB_RBA_Common_CentralElements_CompuMethods_Identical 1 100 0.0 4294967295 FORMAT "%8.2" ECU_ADDRESS 0xfe4185d8 /end MEASUREMENT
/begin MEASUREMENT Tlib_EfuseRegRead_R_Shunt_O_S_EFUSE18 "" ULONG RB_RBA_Common_CentralElements_CompuMethods_Identical 1 100 0.0 4294967295 FORMAT "%8.2" ECU_ADDRESS 0xfe4185dc /end MEASUREMENT
/begin MEASUREMENT Tlib_EfuseRegRead_GetCr1_O_S_ODH27 "" ULONG RB_RBA_Common_CentralElements_CompuMethods_Identical 1 100 0.0 4294967295 FORMAT "%8.2" ECU_ADDRESS 0xfe4185e0 /end MEASUREMENT
/begin MEASUREMENT Tlib_EfuseRegRead_GetCR3_O_S_ODH27 "" ULONG RB_RBA_Common_CentralElements_CompuMethods_Identical 1 100 0.0 4294967295 FORMAT "%8.2" ECU_ADDRESS 0xfe4185e4 /end MEASUREMENT
/begin MEASUREMENT Tlib_EfuseRegRead_GetSR1_O_S_ODH27 "" ULONG RB_RBA_Common_CentralElements_CompuMethods_Identical 1 100 0.0 4294967295 FORMAT "%8.2" ECU_ADDRESS 0xfe4185e8 /end MEASUREMENT
/begin MEASUREMENT Tlib_EfuseRegRead_GetCurrent_O_S_ODH27 "" ULONG RB_RBA_Common_CentralElements_CompuMethods_Identical 1 100 0.0 4294967295 FORMAT "%8.2" ECU_ADDRESS 0xfe4185ec /end MEASUREMENT
/begin MEASUREMENT Tlib_EfuseRegRead_GetTJ_O_S_ODH27 "" ULONG RB_RBA_Common_CentralElements_CompuMethods_Identical 1 100 0.0 4294967295 FORMAT "%8.2" ECU_ADDRESS 0xfe4185f0 /end MEASUREMENT
/begin MEASUREMENT Tlib_EfuseRegRead_GetTMOS_O_S_ODH27 "" ULONG RB_RBA_Common_CentralElements_CompuMethods_Identical 1 100 0.0 4294967295 FORMAT "%8.2" ECU_ADDRESS 0xfe4185f4 /end MEASUREMENT
/begin MEASUREMENT Tlib_EfuseRegRead_GetVDS_O_S_ODH27 "" ULONG RB_RBA_Common_CentralElements_CompuMethods_Identical 1 100 0.0 4294967295 FORMAT "%8.2" ECU_ADDRESS 0xfe4185f8 /end MEASUREMENT
/begin MEASUREMENT Tlib_EfuseRegRead_GetVOUT_O_S_ODH27 "" ULONG RB_RBA_Common_CentralElements_CompuMethods_Identical 1 100 0.0 4294967295 FORMAT "%8.2" ECU_ADDRESS 0xfe4185fc /end MEASUREMENT
/begin MEASUREMENT Tlib_EfuseRegRead_GetT_NOM_O_S_ODH27 "" ULONG RB_RBA_Common_CentralElements_CompuMethods_Identical 1 100 0.0 4294967295 FORMAT "%8.2" ECU_ADDRESS 0xfe418600 /end MEASUREMENT
/begin MEASUREMENT Tlib_EfuseRegRead_GetOVC_THR_O_S_ODH27 "" ULONG RB_RBA_Common_CentralElements_CompuMethods_Identical 1 100 0.0 4294967295 FORMAT "%8.2" ECU_ADDRESS 0xfe418604 /end MEASUREMENT
/begin MEASUREMENT Tlib_EfuseRegRead_GetHSHT_THR_O_S_ODH27 "" ULONG RB_RBA_Common_CentralElements_CompuMethods_Identical 1 100 0.0 4294967295 FORMAT "%8.2" ECU_ADDRESS 0xfe418608 /end MEASUREMENT
/begin MEASUREMENT Tlib_EfuseRegRead_GetVDS_THR_O_S_ODH27 "" ULONG RB_RBA_Common_CentralElements_CompuMethods_Identical 1 100 0.0 4294967295 FORMAT "%8.2" ECU_ADDRESS 0xfe41860c /end MEASUREMENT
/begin MEASUREMENT Tlib_EfuseRegRead_GetNTC_THR_O_S_ODH27 "" ULONG RB_RBA_Common_CentralElements_CompuMethods_Identical 1 100 0.0 4294967295 FORMAT "%8.2" ECU_ADDRESS 0xfe418610 /end MEASUREMENT
/begin MEASUREMENT Tlib_EfuseRegRead_R_Shunt_O_S_ODH27 "" ULONG RB_RBA_Common_CentralElements_CompuMethods_Identical 1 100 0.0 4294967295 FORMAT "%8.2" ECU_ADDRESS 0xfe418614 /end MEASUREMENT
/begin MEASUREMENT Tlib_EfuseRegRead_GetCr1_O_S_ODH20 "" ULONG RB_RBA_Common_CentralElements_CompuMethods_Identical 1 100 0.0 4294967295 FORMAT "%8.2" ECU_ADDRESS 0xfe418618 /end MEASUREMENT
/begin MEASUREMENT Tlib_EfuseRegRead_GetCR3_O_S_ODH20 "" ULONG RB_RBA_Common_CentralElements_CompuMethods_Identical 1 100 0.0 4294967295 FORMAT "%8.2" ECU_ADDRESS 0xfe41861c /end MEASUREMENT
/begin MEASUREMENT Tlib_EfuseRegRead_GetSR1_O_S_ODH20 "" ULONG RB_RBA_Common_CentralElements_CompuMethods_Identical 1 100 0.0 4294967295 FORMAT "%8.2" ECU_ADDRESS 0xfe418620 /end MEASUREMENT
/begin MEASUREMENT Tlib_EfuseRegRead_GetCurrent_O_S_ODH20 "" ULONG RB_RBA_Common_CentralElements_CompuMethods_Identical 1 100 0.0 4294967295 FORMAT "%8.2" ECU_ADDRESS 0xfe418624 /end MEASUREMENT
/begin MEASUREMENT Tlib_EfuseRegRead_GetTJ_O_S_ODH20 "" ULONG RB_RBA_Common_CentralElements_CompuMethods_Identical 1 100 0.0 4294967295 FORMAT "%8.2" ECU_ADDRESS 0xfe418628 /end MEASUREMENT
/begin MEASUREMENT Tlib_EfuseRegRead_GetTMOS_O_S_ODH20 "" ULONG RB_RBA_Common_CentralElements_CompuMethods_Identical 1 100 0.0 4294967295 FORMAT "%8.2" ECU_ADDRESS 0xfe41862c /end MEASUREMENT
/begin MEASUREMENT Tlib_EfuseRegRead_GetVDS_O_S_ODH20 "" ULONG RB_RBA_Common_CentralElements_CompuMethods_Identical 1 100 0.0 4294967295 FORMAT "%8.2" ECU_ADDRESS 0xfe418630 /end MEASUREMENT
/begin MEASUREMENT Tlib_EfuseRegRead_GetVOUT_O_S_ODH20 "" ULONG RB_RBA_Common_CentralElements_CompuMethods_Identical 1 100 0.0 4294967295 FORMAT "%8.2" ECU_ADDRESS 0xfe418634 /end MEASUREMENT
/begin MEASUREMENT Tlib_EfuseRegRead_GetT_NOM_O_S_ODH20 "" ULONG RB_RBA_Common_CentralElements_CompuMethods_Identical 1 100 0.0 4294967295 FORMAT "%8.2" ECU_ADDRESS 0xfe418638 /end MEASUREMENT
/begin MEASUREMENT Tlib_EfuseRegRead_GetOVC_THR_O_S_ODH20 "" ULONG RB_RBA_Common_CentralElements_CompuMethods_Identical 1 100 0.0 4294967295 FORMAT "%8.2" ECU_ADDRESS 0xfe41863c /end MEASUREMENT
/begin MEASUREMENT Tlib_EfuseRegRead_GetHSHT_THR_O_S_ODH20 "" ULONG RB_RBA_Common_CentralElements_CompuMethods_Identical 1 100 0.0 4294967295 FORMAT "%8.2" ECU_ADDRESS 0xfe418640 /end MEASUREMENT
/begin MEASUREMENT Tlib_EfuseRegRead_GetVDS_THR_O_S_ODH20 "" ULONG RB_RBA_Common_CentralElements_CompuMethods_Identical 1 100 0.0 4294967295 FORMAT "%8.2" ECU_ADDRESS 0xfe418644 /end MEASUREMENT
/begin MEASUREMENT Tlib_EfuseRegRead_GetNTC_THR_O_S_ODH20 "" ULONG RB_RBA_Common_CentralElements_CompuMethods_Identical 1 100 0.0 4294967295 FORMAT "%8.2" ECU_ADDRESS 0xfe418648 /end MEASUREMENT
/begin MEASUREMENT Tlib_EfuseRegRead_R_Shunt_O_S_ODH20 "" ULONG RB_RBA_Common_CentralElements_CompuMethods_Identical 1 100 0.0 4294967295 FORMAT "%8.2" ECU_ADDRESS 0xfe41864c /end MEASUREMENT
/begin MEASUREMENT Tlib_EfuseRegRead_GetCr1_O_S_ODH56 "" ULONG RB_RBA_Common_CentralElements_CompuMethods_Identical 1 100 0.0 4294967295 FORMAT "%8.2" ECU_ADDRESS 0xfe418650 /end MEASUREMENT
/begin MEASUREMENT Tlib_EfuseRegRead_GetCR3_O_S_ODH56 "" ULONG RB_RBA_Common_CentralElements_CompuMethods_Identical 1 100 0.0 4294967295 FORMAT "%8.2" ECU_ADDRESS 0xfe418654 /end MEASUREMENT
/begin MEASUREMENT Tlib_EfuseRegRead_GetSR1_O_S_ODH56 "" ULONG RB_RBA_Common_CentralElements_CompuMethods_Identical 1 100 0.0 4294967295 FORMAT "%8.2" ECU_ADDRESS 0xfe418658 /end MEASUREMENT
/begin MEASUREMENT Tlib_EfuseRegRead_GetCurrent_O_S_ODH56 "" ULONG RB_RBA_Common_CentralElements_CompuMethods_Identical 1 100 0.0 4294967295 FORMAT "%8.2" ECU_ADDRESS 0xfe41865c /end MEASUREMENT
/begin MEASUREMENT Tlib_EfuseRegRead_GetTJ_O_S_ODH56 "" ULONG RB_RBA_Common_CentralElements_CompuMethods_Identical 1 100 0.0 4294967295 FORMAT "%8.2" ECU_ADDRESS 0xfe418660 /end MEASUREMENT
/begin MEASUREMENT Tlib_EfuseRegRead_GetTMOS_O_S_ODH56 "" ULONG RB_RBA_Common_CentralElements_CompuMethods_Identical 1 100 0.0 4294967295 FORMAT "%8.2" ECU_ADDRESS 0xfe418664 /end MEASUREMENT
/begin MEASUREMENT Tlib_EfuseRegRead_GetVDS_O_S_ODH56 "" ULONG RB_RBA_Common_CentralElements_CompuMethods_Identical 1 100 0.0 4294967295 FORMAT "%8.2" ECU_ADDRESS 0xfe418668 /end MEASUREMENT
/begin MEASUREMENT Tlib_EfuseRegRead_GetVOUT_O_S_ODH56 "" ULONG RB_RBA_Common_CentralElements_CompuMethods_Identical 1 100 0.0 4294967295 FORMAT "%8.2" ECU_ADDRESS 0xfe41866c /end MEASUREMENT
/begin MEASUREMENT Tlib_EfuseRegRead_GetT_NOM_O_S_ODH56 "" ULONG RB_RBA_Common_CentralElements_CompuMethods_Identical 1 100 0.0 4294967295 FORMAT "%8.2" ECU_ADDRESS 0xfe418670 /end MEASUREMENT
/begin MEASUREMENT Tlib_EfuseRegRead_GetOVC_THR_O_S_ODH56 "" ULONG RB_RBA_Common_CentralElements_CompuMethods_Identical 1 100 0.0 4294967295 FORMAT "%8.2" ECU_ADDRESS 0xfe418674 /end MEASUREMENT
/begin MEASUREMENT Tlib_EfuseRegRead_GetHSHT_THR_O_S_ODH56 "" ULONG RB_RBA_Common_CentralElements_CompuMethods_Identical 1 100 0.0 4294967295 FORMAT "%8.2" ECU_ADDRESS 0xfe418678 /end MEASUREMENT
/begin MEASUREMENT Tlib_EfuseRegRead_GetVDS_THR_O_S_ODH56 "" ULONG RB_RBA_Common_CentralElements_CompuMethods_Identical 1 100 0.0 4294967295 FORMAT "%8.2" ECU_ADDRESS 0xfe41867c /end MEASUREMENT
/begin MEASUREMENT Tlib_EfuseRegRead_GetNTC_THR_O_S_ODH56 "" ULONG RB_RBA_Common_CentralElements_CompuMethods_Identical 1 100 0.0 4294967295 FORMAT "%8.2" ECU_ADDRESS 0xfe418680 /end MEASUREMENT
/begin MEASUREMENT Tlib_EfuseRegRead_R_Shunt_O_S_ODH56 "" ULONG RB_RBA_Common_CentralElements_CompuMethods_Identical 1 100 0.0 4294967295 FORMAT "%8.2" ECU_ADDRESS 0xfe418684 /end MEASUREMENT
/begin MEASUREMENT Tlib_EfuseRegRead_GetCr1_O_S_ODH98 "" ULONG RB_RBA_Common_CentralElements_CompuMethods_Identical 1 100 0.0 4294967295 FORMAT "%8.2" ECU_ADDRESS 0xfe418688 /end MEASUREMENT
/begin MEASUREMENT Tlib_EfuseRegRead_GetCR3_O_S_ODH98 "" ULONG RB_RBA_Common_CentralElements_CompuMethods_Identical 1 100 0.0 4294967295 FORMAT "%8.2" ECU_ADDRESS 0xfe41868c /end MEASUREMENT
/begin MEASUREMENT Tlib_EfuseRegRead_GetSR1_O_S_ODH98 "" ULONG RB_RBA_Common_CentralElements_CompuMethods_Identical 1 100 0.0 4294967295 FORMAT "%8.2" ECU_ADDRESS 0xfe418690 /end MEASUREMENT
/begin MEASUREMENT Tlib_EfuseRegRead_GetCurrent_O_S_ODH98 "" ULONG RB_RBA_Common_CentralElements_CompuMethods_Identical 1 100 0.0 4294967295 FORMAT "%8.2" ECU_ADDRESS 0xfe418694 /end MEASUREMENT
/begin MEASUREMENT Tlib_EfuseRegRead_GetTJ_O_S_ODH98 "" ULONG RB_RBA_Common_CentralElements_CompuMethods_Identical 1 100 0.0 4294967295 FORMAT "%8.2" ECU_ADDRESS 0xfe418698 /end MEASUREMENT
/begin MEASUREMENT Tlib_EfuseRegRead_GetTMOS_O_S_ODH98 "" ULONG RB_RBA_Common_CentralElements_CompuMethods_Identical 1 100 0.0 4294967295 FORMAT "%8.2" ECU_ADDRESS 0xfe41869c /end MEASUREMENT
/begin MEASUREMENT Tlib_EfuseRegRead_GetVDS_O_S_ODH98 "" ULONG RB_RBA_Common_CentralElements_CompuMethods_Identical 1 100 0.0 4294967295 FORMAT "%8.2" ECU_ADDRESS 0xfe4186a0 /end MEASUREMENT
/begin MEASUREMENT Tlib_EfuseRegRead_GetVOUT_O_S_ODH98 "" ULONG RB_RBA_Common_CentralElements_CompuMethods_Identical 1 100 0.0 4294967295 FORMAT "%8.2" ECU_ADDRESS 0xfe4186a4 /end MEASUREMENT
/begin MEASUREMENT Tlib_EfuseRegRead_GetT_NOM_O_S_ODH98 "" ULONG RB_RBA_Common_CentralElements_CompuMethods_Identical 1 100 0.0 4294967295 FORMAT "%8.2" ECU_ADDRESS 0xfe4186a8 /end MEASUREMENT
/begin MEASUREMENT Tlib_EfuseRegRead_GetOVC_THR_O_S_ODH98 "" ULONG RB_RBA_Common_CentralElements_CompuMethods_Identical 1 100 0.0 4294967295 FORMAT "%8.2" ECU_ADDRESS 0xfe4186ac /end MEASUREMENT
/begin MEASUREMENT Tlib_EfuseRegRead_GetHSHT_THR_O_S_ODH98 "" ULONG RB_RBA_Common_CentralElements_CompuMethods_Identical 1 100 0.0 4294967295 FORMAT "%8.2" ECU_ADDRESS 0xfe4186b0 /end MEASUREMENT
/begin MEASUREMENT Tlib_EfuseRegRead_GetVDS_THR_O_S_ODH98 "" ULONG RB_RBA_Common_CentralElements_CompuMethods_Identical 1 100 0.0 4294967295 FORMAT "%8.2" ECU_ADDRESS 0xfe4186b4 /end MEASUREMENT
/begin MEASUREMENT Tlib_EfuseRegRead_GetNTC_THR_O_S_ODH98 "" ULONG RB_RBA_Common_CentralElements_CompuMethods_Identical 1 100 0.0 4294967295 FORMAT "%8.2" ECU_ADDRESS 0xfe4186b8 /end MEASUREMENT
/begin MEASUREMENT Tlib_EfuseRegRead_R_Shunt_O_S_ODH98 "" ULONG RB_RBA_Common_CentralElements_CompuMethods_Identical 1 100 0.0 4294967295 FORMAT "%8.2" ECU_ADDRESS 0xfe4186bc /end MEASUREMENT
/begin MEASUREMENT Tlib_EfuseRegRead_GetCr1_O_S_ODH82 "" ULONG RB_RBA_Common_CentralElements_CompuMethods_Identical 1 100 0.0 4294967295 FORMAT "%8.2" ECU_ADDRESS 0xfe4186c0 /end MEASUREMENT
/begin MEASUREMENT Tlib_EfuseRegRead_GetCR3_O_S_ODH82 "" ULONG RB_RBA_Common_CentralElements_CompuMethods_Identical 1 100 0.0 4294967295 FORMAT "%8.2" ECU_ADDRESS 0xfe4186c4 /end MEASUREMENT
/begin MEASUREMENT Tlib_EfuseRegRead_GetSR1_O_S_ODH82 "" ULONG RB_RBA_Common_CentralElements_CompuMethods_Identical 1 100 0.0 4294967295 FORMAT "%8.2" ECU_ADDRESS 0xfe4186c8 /end MEASUREMENT
/begin MEASUREMENT Tlib_EfuseRegRead_GetCurrent_O_S_ODH82 "" ULONG RB_RBA_Common_CentralElements_CompuMethods_Identical 1 100 0.0 4294967295 FORMAT "%8.2" ECU_ADDRESS 0xfe4186cc /end MEASUREMENT
/begin MEASUREMENT Tlib_EfuseRegRead_GetTJ_O_S_ODH82 "" ULONG RB_RBA_Common_CentralElements_CompuMethods_Identical 1 100 0.0 4294967295 FORMAT "%8.2" ECU_ADDRESS 0xfe4186d0 /end MEASUREMENT
/begin MEASUREMENT Tlib_EfuseRegRead_GetTMOS_O_S_ODH82 "" ULONG RB_RBA_Common_CentralElements_CompuMethods_Identical 1 100 0.0 4294967295 FORMAT "%8.2" ECU_ADDRESS 0xfe4186d4 /end MEASUREMENT
/begin MEASUREMENT Tlib_EfuseRegRead_GetVDS_O_S_ODH82 "" ULONG RB_RBA_Common_CentralElements_CompuMethods_Identical 1 100 0.0 4294967295 FORMAT "%8.2" ECU_ADDRESS 0xfe4186d8 /end MEASUREMENT
/begin MEASUREMENT Tlib_EfuseRegRead_GetVOUT_O_S_ODH82 "" ULONG RB_RBA_Common_CentralElements_CompuMethods_Identical 1 100 0.0 4294967295 FORMAT "%8.2" ECU_ADDRESS 0xfe4186dc /end MEASUREMENT
/begin MEASUREMENT Tlib_EfuseRegRead_GetT_NOM_O_S_ODH82 "" ULONG RB_RBA_Common_CentralElements_CompuMethods_Identical 1 100 0.0 4294967295 FORMAT "%8.2" ECU_ADDRESS 0xfe4186e0 /end MEASUREMENT
/begin MEASUREMENT Tlib_EfuseRegRead_GetOVC_THR_O_S_ODH82 "" ULONG RB_RBA_Common_CentralElements_CompuMethods_Identical 1 100 0.0 4294967295 FORMAT "%8.2" ECU_ADDRESS 0xfe4186e4 /end MEASUREMENT
/begin MEASUREMENT Tlib_EfuseRegRead_GetHSHT_THR_O_S_ODH82 "" ULONG RB_RBA_Common_CentralElements_CompuMethods_Identical 1 100 0.0 4294967295 FORMAT "%8.2" ECU_ADDRESS 0xfe4186e8 /end MEASUREMENT
/begin MEASUREMENT Tlib_EfuseRegRead_GetVDS_THR_O_S_ODH82 "" ULONG RB_RBA_Common_CentralElements_CompuMethods_Identical 1 100 0.0 4294967295 FORMAT "%8.2" ECU_ADDRESS 0xfe4186ec /end MEASUREMENT
/begin MEASUREMENT Tlib_EfuseRegRead_GetNTC_THR_O_S_ODH82 "" ULONG RB_RBA_Common_CentralElements_CompuMethods_Identical 1 100 0.0 4294967295 FORMAT "%8.2" ECU_ADDRESS 0xfe4186f0 /end MEASUREMENT
/begin MEASUREMENT Tlib_EfuseRegRead_R_Shunt_O_S_ODH82 "" ULONG RB_RBA_Common_CentralElements_CompuMethods_Identical 1 100 0.0 4294967295 FORMAT "%8.2" ECU_ADDRESS 0xfe4186f4 /end MEASUREMENT
/begin MEASUREMENT Tlib_EfuseRegRead_GetCr1_O_S_EFUSE23 "" ULONG RB_RBA_Common_CentralElements_CompuMethods_Identical 1 100 0.0 4294967295 FORMAT "%8.2" ECU_ADDRESS 0xfe4186f8 /end MEASUREMENT
/begin MEASUREMENT Tlib_EfuseRegRead_GetCR3_O_S_EFUSE23 "" ULONG RB_RBA_Common_CentralElements_CompuMethods_Identical 1 100 0.0 4294967295 FORMAT "%8.2" ECU_ADDRESS 0xfe4186fc /end MEASUREMENT
/begin MEASUREMENT Tlib_EfuseRegRead_GetSR1_O_S_EFUSE23 "" ULONG RB_RBA_Common_CentralElements_CompuMethods_Identical 1 100 0.0 4294967295 FORMAT "%8.2" ECU_ADDRESS 0xfe418700 /end MEASUREMENT
/begin MEASUREMENT Tlib_EfuseRegRead_GetCurrent_O_S_EFUSE23 "" ULONG RB_RBA_Common_CentralElements_CompuMethods_Identical 1 100 0.0 4294967295 FORMAT "%8.2" ECU_ADDRESS 0xfe418704 /end MEASUREMENT
/begin MEASUREMENT Tlib_EfuseRegRead_GetTJ_O_S_EFUSE23 "" ULONG RB_RBA_Common_CentralElements_CompuMethods_Identical 1 100 0.0 4294967295 FORMAT "%8.2" ECU_ADDRESS 0xfe418708 /end MEASUREMENT
/begin MEASUREMENT Tlib_EfuseRegRead_GetTMOS_O_S_EFUSE23 "" ULONG RB_RBA_Common_CentralElements_CompuMethods_Identical 1 100 0.0 4294967295 FORMAT "%8.2" ECU_ADDRESS 0xfe41870c /end MEASUREMENT
/begin MEASUREMENT Tlib_EfuseRegRead_GetVDS_O_S_EFUSE23 "" ULONG RB_RBA_Common_CentralElements_CompuMethods_Identical 1 100 0.0 4294967295 FORMAT "%8.2" ECU_ADDRESS 0xfe418710 /end MEASUREMENT
/begin MEASUREMENT Tlib_EfuseRegRead_GetVOUT_O_S_EFUSE23 "" ULONG RB_RBA_Common_CentralElements_CompuMethods_Identical 1 100 0.0 4294967295 FORMAT "%8.2" ECU_ADDRESS 0xfe418714 /end MEASUREMENT
/begin MEASUREMENT Tlib_EfuseRegRead_GetT_NOM_O_S_EFUSE23 "" ULONG RB_RBA_Common_CentralElements_CompuMethods_Identical 1 100 0.0 4294967295 FORMAT "%8.2" ECU_ADDRESS 0xfe418718 /end MEASUREMENT
/begin MEASUREMENT Tlib_EfuseRegRead_GetOVC_THR_O_S_EFUSE23 "" ULONG RB_RBA_Common_CentralElements_CompuMethods_Identical 1 100 0.0 4294967295 FORMAT "%8.2" ECU_ADDRESS 0xfe41871c /end MEASUREMENT
/begin MEASUREMENT Tlib_EfuseRegRead_GetHSHT_THR_O_S_EFUSE23 "" ULONG RB_RBA_Common_CentralElements_CompuMethods_Identical 1 100 0.0 4294967295 FORMAT "%8.2" ECU_ADDRESS 0xfe418720 /end MEASUREMENT
/begin MEASUREMENT Tlib_EfuseRegRead_GetVDS_THR_O_S_EFUSE23 "" ULONG RB_RBA_Common_CentralElements_CompuMethods_Identical 1 100 0.0 4294967295 FORMAT "%8.2" ECU_ADDRESS 0xfe418724 /end MEASUREMENT
/begin MEASUREMENT Tlib_EfuseRegRead_GetNTC_THR_O_S_EFUSE23 "" ULONG RB_RBA_Common_CentralElements_CompuMethods_Identical 1 100 0.0 4294967295 FORMAT "%8.2" ECU_ADDRESS 0xfe418728 /end MEASUREMENT
/begin MEASUREMENT Tlib_EfuseRegRead_R_Shunt_O_S_EFUSE23 "" ULONG RB_RBA_Common_CentralElements_CompuMethods_Identical 1 100 0.0 4294967295 FORMAT "%8.2" ECU_ADDRESS 0xfe41872c /end MEASUREMENT
/begin MEASUREMENT Tlib_EfuseRegRead_GetCr1_O_S_EFUSE24 "" ULONG RB_RBA_Common_CentralElements_CompuMethods_Identical 1 100 0.0 4294967295 FORMAT "%8.2" ECU_ADDRESS 0xfe418730 /end MEASUREMENT
/begin MEASUREMENT Tlib_EfuseRegRead_GetCR3_O_S_EFUSE24 "" ULONG RB_RBA_Common_CentralElements_CompuMethods_Identical 1 100 0.0 4294967295 FORMAT "%8.2" ECU_ADDRESS 0xfe418734 /end MEASUREMENT
/begin MEASUREMENT Tlib_EfuseRegRead_GetSR1_O_S_EFUSE24 "" ULONG RB_RBA_Common_CentralElements_CompuMethods_Identical 1 100 0.0 4294967295 FORMAT "%8.2" ECU_ADDRESS 0xfe418738 /end MEASUREMENT
/begin MEASUREMENT Tlib_EfuseRegRead_GetCurrent_O_S_EFUSE24 "" ULONG RB_RBA_Common_CentralElements_CompuMethods_Identical 1 100 0.0 4294967295 FORMAT "%8.2" ECU_ADDRESS 0xfe41873c /end MEASUREMENT
/begin MEASUREMENT Tlib_EfuseRegRead_GetTJ_O_S_EFUSE24 "" ULONG RB_RBA_Common_CentralElements_CompuMethods_Identical 1 100 0.0 4294967295 FORMAT "%8.2" ECU_ADDRESS 0xfe418740 /end MEASUREMENT
/begin MEASUREMENT Tlib_EfuseRegRead_GetTMOS_O_S_EFUSE24 "" ULONG RB_RBA_Common_CentralElements_CompuMethods_Identical 1 100 0.0 4294967295 FORMAT "%8.2" ECU_ADDRESS 0xfe418744 /end MEASUREMENT
/begin MEASUREMENT Tlib_EfuseRegRead_GetVDS_O_S_EFUSE24 "" ULONG RB_RBA_Common_CentralElements_CompuMethods_Identical 1 100 0.0 4294967295 FORMAT "%8.2" ECU_ADDRESS 0xfe418748 /end MEASUREMENT
/begin MEASUREMENT Tlib_EfuseRegRead_GetVOUT_O_S_EFUSE24 "" ULONG RB_RBA_Common_CentralElements_CompuMethods_Identical 1 100 0.0 4294967295 FORMAT "%8.2" ECU_ADDRESS 0xfe41874c /end MEASUREMENT
/begin MEASUREMENT Tlib_EfuseRegRead_GetT_NOM_O_S_EFUSE24 "" ULONG RB_RBA_Common_CentralElements_CompuMethods_Identical 1 100 0.0 4294967295 FORMAT "%8.2" ECU_ADDRESS 0xfe418750 /end MEASUREMENT
/begin MEASUREMENT Tlib_EfuseRegRead_GetOVC_THR_O_S_EFUSE24 "" ULONG RB_RBA_Common_CentralElements_CompuMethods_Identical 1 100 0.0 4294967295 FORMAT "%8.2" ECU_ADDRESS 0xfe418754 /end MEASUREMENT
/begin MEASUREMENT Tlib_EfuseRegRead_GetHSHT_THR_O_S_EFUSE24 "" ULONG RB_RBA_Common_CentralElements_CompuMethods_Identical 1 100 0.0 4294967295 FORMAT "%8.2" ECU_ADDRESS 0xfe418758 /end MEASUREMENT
/begin MEASUREMENT Tlib_EfuseRegRead_GetVDS_THR_O_S_EFUSE24 "" ULONG RB_RBA_Common_CentralElements_CompuMethods_Identical 1 100 0.0 4294967295 FORMAT "%8.2" ECU_ADDRESS 0xfe41875c /end MEASUREMENT
/begin MEASUREMENT Tlib_EfuseRegRead_GetNTC_THR_O_S_EFUSE24 "" ULONG RB_RBA_Common_CentralElements_CompuMethods_Identical 1 100 0.0 4294967295 FORMAT "%8.2" ECU_ADDRESS 0xfe418760 /end MEASUREMENT
/begin MEASUREMENT Tlib_EfuseRegRead_R_Shunt_O_S_EFUSE24 "" ULONG RB_RBA_Common_CentralElements_CompuMethods_Identical 1 100 0.0 4294967295 FORMAT "%8.2" ECU_ADDRESS 0xfe418764 /end MEASUREMENT
/begin MEASUREMENT Tlib_EfuseRegRead_GetCr1_O_S_ODH53 "" ULONG RB_RBA_Common_CentralElements_CompuMethods_Identical 1 100 0.0 4294967295 FORMAT "%8.2" ECU_ADDRESS 0xfe418768 /end MEASUREMENT
/begin MEASUREMENT Tlib_EfuseRegRead_GetCR3_O_S_ODH53 "" ULONG RB_RBA_Common_CentralElements_CompuMethods_Identical 1 100 0.0 4294967295 FORMAT "%8.2" ECU_ADDRESS 0xfe41876c /end MEASUREMENT
/begin MEASUREMENT Tlib_EfuseRegRead_GetSR1_O_S_ODH53 "" ULONG RB_RBA_Common_CentralElements_CompuMethods_Identical 1 100 0.0 4294967295 FORMAT "%8.2" ECU_ADDRESS 0xfe418770 /end MEASUREMENT
/begin MEASUREMENT Tlib_EfuseRegRead_GetCurrent_O_S_ODH53 "" ULONG RB_RBA_Common_CentralElements_CompuMethods_Identical 1 100 0.0 4294967295 FORMAT "%8.2" ECU_ADDRESS 0xfe418774 /end MEASUREMENT
/begin MEASUREMENT Tlib_EfuseRegRead_GetTJ_O_S_ODH53 "" ULONG RB_RBA_Common_CentralElements_CompuMethods_Identical 1 100 0.0 4294967295 FORMAT "%8.2" ECU_ADDRESS 0xfe418778 /end MEASUREMENT
/begin MEASUREMENT Tlib_EfuseRegRead_GetTMOS_O_S_ODH53 "" ULONG RB_RBA_Common_CentralElements_CompuMethods_Identical 1 100 0.0 4294967295 FORMAT "%8.2" ECU_ADDRESS 0xfe41877c /end MEASUREMENT
/begin MEASUREMENT Tlib_EfuseRegRead_GetVDS_O_S_ODH53 "" ULONG RB_RBA_Common_CentralElements_CompuMethods_Identical 1 100 0.0 4294967295 FORMAT "%8.2" ECU_ADDRESS 0xfe418780 /end MEASUREMENT
/begin MEASUREMENT Tlib_EfuseRegRead_GetVOUT_O_S_ODH53 "" ULONG RB_RBA_Common_CentralElements_CompuMethods_Identical 1 100 0.0 4294967295 FORMAT "%8.2" ECU_ADDRESS 0xfe418784 /end MEASUREMENT
/begin MEASUREMENT Tlib_EfuseRegRead_GetT_NOM_O_S_ODH53 "" ULONG RB_RBA_Common_CentralElements_CompuMethods_Identical 1 100 0.0 4294967295 FORMAT "%8.2" ECU_ADDRESS 0xfe418788 /end MEASUREMENT
/begin MEASUREMENT Tlib_EfuseRegRead_GetOVC_THR_O_S_ODH53 "" ULONG RB_RBA_Common_CentralElements_CompuMethods_Identical 1 100 0.0 4294967295 FORMAT "%8.2" ECU_ADDRESS 0xfe41878c /end MEASUREMENT
/begin MEASUREMENT Tlib_EfuseRegRead_GetHSHT_THR_O_S_ODH53 "" ULONG RB_RBA_Common_CentralElements_CompuMethods_Identical 1 100 0.0 4294967295 FORMAT "%8.2" ECU_ADDRESS 0xfe418790 /end MEASUREMENT
/begin MEASUREMENT Tlib_EfuseRegRead_GetVDS_THR_O_S_ODH53 "" ULONG RB_RBA_Common_CentralElements_CompuMethods_Identical 1 100 0.0 4294967295 FORMAT "%8.2" ECU_ADDRESS 0xfe418794 /end MEASUREMENT
/begin MEASUREMENT Tlib_EfuseRegRead_GetNTC_THR_O_S_ODH53 "" ULONG RB_RBA_Common_CentralElements_CompuMethods_Identical 1 100 0.0 4294967295 FORMAT "%8.2" ECU_ADDRESS 0xfe418798 /end MEASUREMENT
/begin MEASUREMENT Tlib_EfuseRegRead_R_Shunt_O_S_ODH53 "" ULONG RB_RBA_Common_CentralElements_CompuMethods_Identical 1 100 0.0 4294967295 FORMAT "%8.2" ECU_ADDRESS 0xfe41879c /end MEASUREMENT
/begin MEASUREMENT Tlib_EfuseRegRead_GetCr1_O_S_ODH76 "" ULONG RB_RBA_Common_CentralElements_CompuMethods_Identical 1 100 0.0 4294967295 FORMAT "%8.2" ECU_ADDRESS 0xfe4187a0 /end MEASUREMENT
/begin MEASUREMENT Tlib_EfuseRegRead_GetCR3_O_S_ODH76 "" ULONG RB_RBA_Common_CentralElements_CompuMethods_Identical 1 100 0.0 4294967295 FORMAT "%8.2" ECU_ADDRESS 0xfe4187a4 /end MEASUREMENT
/begin MEASUREMENT Tlib_EfuseRegRead_GetSR1_O_S_ODH76 "" ULONG RB_RBA_Common_CentralElements_CompuMethods_Identical 1 100 0.0 4294967295 FORMAT "%8.2" ECU_ADDRESS 0xfe4187a8 /end MEASUREMENT
/begin MEASUREMENT Tlib_EfuseRegRead_GetCurrent_O_S_ODH76 "" ULONG RB_RBA_Common_CentralElements_CompuMethods_Identical 1 100 0.0 4294967295 FORMAT "%8.2" ECU_ADDRESS 0xfe4187ac /end MEASUREMENT
/begin MEASUREMENT Tlib_EfuseRegRead_GetTJ_O_S_ODH76 "" ULONG RB_RBA_Common_CentralElements_CompuMethods_Identical 1 100 0.0 4294967295 FORMAT "%8.2" ECU_ADDRESS 0xfe4187b0 /end MEASUREMENT
/begin MEASUREMENT Tlib_EfuseRegRead_GetTMOS_O_S_ODH76 "" ULONG RB_RBA_Common_CentralElements_CompuMethods_Identical 1 100 0.0 4294967295 FORMAT "%8.2" ECU_ADDRESS 0xfe4187b4 /end MEASUREMENT
/begin MEASUREMENT Tlib_EfuseRegRead_GetVDS_O_S_ODH76 "" ULONG RB_RBA_Common_CentralElements_CompuMethods_Identical 1 100 0.0 4294967295 FORMAT "%8.2" ECU_ADDRESS 0xfe4187b8 /end MEASUREMENT
/begin MEASUREMENT Tlib_EfuseRegRead_GetVOUT_O_S_ODH76 "" ULONG RB_RBA_Common_CentralElements_CompuMethods_Identical 1 100 0.0 4294967295 FORMAT "%8.2" ECU_ADDRESS 0xfe4187bc /end MEASUREMENT
/begin MEASUREMENT Tlib_EfuseRegRead_GetT_NOM_O_S_ODH76 "" ULONG RB_RBA_Common_CentralElements_CompuMethods_Identical 1 100 0.0 4294967295 FORMAT "%8.2" ECU_ADDRESS 0xfe4187c0 /end MEASUREMENT
/begin MEASUREMENT Tlib_EfuseRegRead_GetOVC_THR_O_S_ODH76 "" ULONG RB_RBA_Common_CentralElements_CompuMethods_Identical 1 100 0.0 4294967295 FORMAT "%8.2" ECU_ADDRESS 0xfe4187c4 /end MEASUREMENT
/begin MEASUREMENT Tlib_EfuseRegRead_GetHSHT_THR_O_S_ODH76 "" ULONG RB_RBA_Common_CentralElements_CompuMethods_Identical 1 100 0.0 4294967295 FORMAT "%8.2" ECU_ADDRESS 0xfe4187c8 /end MEASUREMENT
/begin MEASUREMENT Tlib_EfuseRegRead_GetVDS_THR_O_S_ODH76 "" ULONG RB_RBA_Common_CentralElements_CompuMethods_Identical 1 100 0.0 4294967295 FORMAT "%8.2" ECU_ADDRESS 0xfe4187cc /end MEASUREMENT
/begin MEASUREMENT Tlib_EfuseRegRead_GetNTC_THR_O_S_ODH76 "" ULONG RB_RBA_Common_CentralElements_CompuMethods_Identical 1 100 0.0 4294967295 FORMAT "%8.2" ECU_ADDRESS 0xfe4187d0 /end MEASUREMENT
/begin MEASUREMENT Tlib_EfuseRegRead_R_Shunt_O_S_ODH76 "" ULONG RB_RBA_Common_CentralElements_CompuMethods_Identical 1 100 0.0 4294967295 FORMAT "%8.2" ECU_ADDRESS 0xfe4187d4 /end MEASUREMENT
/begin MEASUREMENT Tlib_EfuseRegRead_GetCr1_O_S_ODH65 "" ULONG RB_RBA_Common_CentralElements_CompuMethods_Identical 1 100 0.0 4294967295 FORMAT "%8.2" ECU_ADDRESS 0xfe4187d8 /end MEASUREMENT
/begin MEASUREMENT Tlib_EfuseRegRead_GetCR3_O_S_ODH65 "" ULONG RB_RBA_Common_CentralElements_CompuMethods_Identical 1 100 0.0 4294967295 FORMAT "%8.2" ECU_ADDRESS 0xfe4187dc /end MEASUREMENT
/begin MEASUREMENT Tlib_EfuseRegRead_GetSR1_O_S_ODH65 "" ULONG RB_RBA_Common_CentralElements_CompuMethods_Identical 1 100 0.0 4294967295 FORMAT "%8.2" ECU_ADDRESS 0xfe4187e0 /end MEASUREMENT
/begin MEASUREMENT Tlib_EfuseRegRead_GetCurrent_O_S_ODH65 "" ULONG RB_RBA_Common_CentralElements_CompuMethods_Identical 1 100 0.0 4294967295 FORMAT "%8.2" ECU_ADDRESS 0xfe4187e4 /end MEASUREMENT
/begin MEASUREMENT Tlib_EfuseRegRead_GetTJ_O_S_ODH65 "" ULONG RB_RBA_Common_CentralElements_CompuMethods_Identical 1 100 0.0 4294967295 FORMAT "%8.2" ECU_ADDRESS 0xfe4187e8 /end MEASUREMENT
/begin MEASUREMENT Tlib_EfuseRegRead_GetTMOS_O_S_ODH65 "" ULONG RB_RBA_Common_CentralElements_CompuMethods_Identical 1 100 0.0 4294967295 FORMAT "%8.2" ECU_ADDRESS 0xfe4187ec /end MEASUREMENT
/begin MEASUREMENT Tlib_EfuseRegRead_GetVDS_O_S_ODH65 "" ULONG RB_RBA_Common_CentralElements_CompuMethods_Identical 1 100 0.0 4294967295 FORMAT "%8.2" ECU_ADDRESS 0xfe4187f0 /end MEASUREMENT
/begin MEASUREMENT Tlib_EfuseRegRead_GetVOUT_O_S_ODH65 "" ULONG RB_RBA_Common_CentralElements_CompuMethods_Identical 1 100 0.0 4294967295 FORMAT "%8.2" ECU_ADDRESS 0xfe4187f4 /end MEASUREMENT
/begin MEASUREMENT Tlib_EfuseRegRead_GetT_NOM_O_S_ODH65 "" ULONG RB_RBA_Common_CentralElements_CompuMethods_Identical 1 100 0.0 4294967295 FORMAT "%8.2" ECU_ADDRESS 0xfe4187f8 /end MEASUREMENT
/begin MEASUREMENT Tlib_EfuseRegRead_GetOVC_THR_O_S_ODH65 "" ULONG RB_RBA_Common_CentralElements_CompuMethods_Identical 1 100 0.0 4294967295 FORMAT "%8.2" ECU_ADDRESS 0xfe4187fc /end MEASUREMENT
/begin MEASUREMENT Tlib_EfuseRegRead_GetHSHT_THR_O_S_ODH65 "" ULONG RB_RBA_Common_CentralElements_CompuMethods_Identical 1 100 0.0 4294967295 FORMAT "%8.2" ECU_ADDRESS 0xfe418800 /end MEASUREMENT
/begin MEASUREMENT Tlib_EfuseRegRead_GetVDS_THR_O_S_ODH65 "" ULONG RB_RBA_Common_CentralElements_CompuMethods_Identical 1 100 0.0 4294967295 FORMAT "%8.2" ECU_ADDRESS 0xfe418804 /end MEASUREMENT
/begin MEASUREMENT Tlib_EfuseRegRead_GetNTC_THR_O_S_ODH65 "" ULONG RB_RBA_Common_CentralElements_CompuMethods_Identical 1 100 0.0 4294967295 FORMAT "%8.2" ECU_ADDRESS 0xfe418808 /end MEASUREMENT
/begin MEASUREMENT Tlib_EfuseRegRead_R_Shunt_O_S_ODH65 "" ULONG RB_RBA_Common_CentralElements_CompuMethods_Identical 1 100 0.0 4294967295 FORMAT "%8.2" ECU_ADDRESS 0xfe41880c /end MEASUREMENT
/begin MEASUREMENT Tlib_EfuseRegRead_GetCr1_O_S_ODH83 "" ULONG RB_RBA_Common_CentralElements_CompuMethods_Identical 1 100 0.0 4294967295 FORMAT "%8.2" ECU_ADDRESS 0xfe418810 /end MEASUREMENT
/begin MEASUREMENT Tlib_EfuseRegRead_GetCR3_O_S_ODH83 "" ULONG RB_RBA_Common_CentralElements_CompuMethods_Identical 1 100 0.0 4294967295 FORMAT "%8.2" ECU_ADDRESS 0xfe418814 /end MEASUREMENT
/begin MEASUREMENT Tlib_EfuseRegRead_GetSR1_O_S_ODH83 "" ULONG RB_RBA_Common_CentralElements_CompuMethods_Identical 1 100 0.0 4294967295 FORMAT "%8.2" ECU_ADDRESS 0xfe418818 /end MEASUREMENT
/begin MEASUREMENT Tlib_EfuseRegRead_GetCurrent_O_S_ODH83 "" ULONG RB_RBA_Common_CentralElements_CompuMethods_Identical 1 100 0.0 4294967295 FORMAT "%8.2" ECU_ADDRESS 0xfe41881c /end MEASUREMENT
/begin MEASUREMENT Tlib_EfuseRegRead_GetTJ_O_S_ODH83 "" ULONG RB_RBA_Common_CentralElements_CompuMethods_Identical 1 100 0.0 4294967295 FORMAT "%8.2" ECU_ADDRESS 0xfe418820 /end MEASUREMENT
/begin MEASUREMENT Tlib_EfuseRegRead_GetTMOS_O_S_ODH83 "" ULONG RB_RBA_Common_CentralElements_CompuMethods_Identical 1 100 0.0 4294967295 FORMAT "%8.2" ECU_ADDRESS 0xfe418824 /end MEASUREMENT
/begin MEASUREMENT Tlib_EfuseRegRead_GetVDS_O_S_ODH83 "" ULONG RB_RBA_Common_CentralElements_CompuMethods_Identical 1 100 0.0 4294967295 FORMAT "%8.2" ECU_ADDRESS 0xfe418828 /end MEASUREMENT
/begin MEASUREMENT Tlib_EfuseRegRead_GetVOUT_O_S_ODH83 "" ULONG RB_RBA_Common_CentralElements_CompuMethods_Identical 1 100 0.0 4294967295 FORMAT "%8.2" ECU_ADDRESS 0xfe41882c /end MEASUREMENT
/begin MEASUREMENT Tlib_EfuseRegRead_GetT_NOM_O_S_ODH83 "" ULONG RB_RBA_Common_CentralElements_CompuMethods_Identical 1 100 0.0 4294967295 FORMAT "%8.2" ECU_ADDRESS 0xfe418830 /end MEASUREMENT
/begin MEASUREMENT Tlib_EfuseRegRead_GetOVC_THR_O_S_ODH83 "" ULONG RB_RBA_Common_CentralElements_CompuMethods_Identical 1 100 0.0 4294967295 FORMAT "%8.2" ECU_ADDRESS 0xfe418834 /end MEASUREMENT
/begin MEASUREMENT Tlib_EfuseRegRead_GetHSHT_THR_O_S_ODH83 "" ULONG RB_RBA_Common_CentralElements_CompuMethods_Identical 1 100 0.0 4294967295 FORMAT "%8.2" ECU_ADDRESS 0xfe418838 /end MEASUREMENT
/begin MEASUREMENT Tlib_EfuseRegRead_GetVDS_THR_O_S_ODH83 "" ULONG RB_RBA_Common_CentralElements_CompuMethods_Identical 1 100 0.0 4294967295 FORMAT "%8.2" ECU_ADDRESS 0xfe41883c /end MEASUREMENT
/begin MEASUREMENT Tlib_EfuseRegRead_GetNTC_THR_O_S_ODH83 "" ULONG RB_RBA_Common_CentralElements_CompuMethods_Identical 1 100 0.0 4294967295 FORMAT "%8.2" ECU_ADDRESS 0xfe418840 /end MEASUREMENT
/begin MEASUREMENT Tlib_EfuseRegRead_R_Shunt_O_S_ODH83 "" ULONG RB_RBA_Common_CentralElements_CompuMethods_Identical 1 100 0.0 4294967295 FORMAT "%8.2" ECU_ADDRESS 0xfe418844 /end MEASUREMENT
/begin MEASUREMENT Tlib_EfuseRegRead_GetCr1_O_S_ODH54 "" ULONG RB_RBA_Common_CentralElements_CompuMethods_Identical 1 100 0.0 4294967295 FORMAT "%8.2" ECU_ADDRESS 0xfe418848 /end MEASUREMENT
/begin MEASUREMENT Tlib_EfuseRegRead_GetCR3_O_S_ODH54 "" ULONG RB_RBA_Common_CentralElements_CompuMethods_Identical 1 100 0.0 4294967295 FORMAT "%8.2" ECU_ADDRESS 0xfe41884c /end MEASUREMENT
/begin MEASUREMENT Tlib_EfuseRegRead_GetSR1_O_S_ODH54 "" ULONG RB_RBA_Common_CentralElements_CompuMethods_Identical 1 100 0.0 4294967295 FORMAT "%8.2" ECU_ADDRESS 0xfe418850 /end MEASUREMENT
/begin MEASUREMENT Tlib_EfuseRegRead_GetCurrent_O_S_ODH54 "" ULONG RB_RBA_Common_CentralElements_CompuMethods_Identical 1 100 0.0 4294967295 FORMAT "%8.2" ECU_ADDRESS 0xfe418854 /end MEASUREMENT
/begin MEASUREMENT Tlib_EfuseRegRead_GetTJ_O_S_ODH54 "" ULONG RB_RBA_Common_CentralElements_CompuMethods_Identical 1 100 0.0 4294967295 FORMAT "%8.2" ECU_ADDRESS 0xfe418858 /end MEASUREMENT
/begin MEASUREMENT Tlib_EfuseRegRead_GetTMOS_O_S_ODH54 "" ULONG RB_RBA_Common_CentralElements_CompuMethods_Identical 1 100 0.0 4294967295 FORMAT "%8.2" ECU_ADDRESS 0xfe41885c /end MEASUREMENT
/begin MEASUREMENT Tlib_EfuseRegRead_GetVDS_O_S_ODH54 "" ULONG RB_RBA_Common_CentralElements_CompuMethods_Identical 1 100 0.0 4294967295 FORMAT "%8.2" ECU_ADDRESS 0xfe418860 /end MEASUREMENT
/begin MEASUREMENT Tlib_EfuseRegRead_GetVOUT_O_S_ODH54 "" ULONG RB_RBA_Common_CentralElements_CompuMethods_Identical 1 100 0.0 4294967295 FORMAT "%8.2" ECU_ADDRESS 0xfe418864 /end MEASUREMENT
/begin MEASUREMENT Tlib_EfuseRegRead_GetT_NOM_O_S_ODH54 "" ULONG RB_RBA_Common_CentralElements_CompuMethods_Identical 1 100 0.0 4294967295 FORMAT "%8.2" ECU_ADDRESS 0xfe418868 /end MEASUREMENT
/begin MEASUREMENT Tlib_EfuseRegRead_GetOVC_THR_O_S_ODH54 "" ULONG RB_RBA_Common_CentralElements_CompuMethods_Identical 1 100 0.0 4294967295 FORMAT "%8.2" ECU_ADDRESS 0xfe41886c /end MEASUREMENT
/begin MEASUREMENT Tlib_EfuseRegRead_GetHSHT_THR_O_S_ODH54 "" ULONG RB_RBA_Common_CentralElements_CompuMethods_Identical 1 100 0.0 4294967295 FORMAT "%8.2" ECU_ADDRESS 0xfe418870 /end MEASUREMENT
/begin MEASUREMENT Tlib_EfuseRegRead_GetVDS_THR_O_S_ODH54 "" ULONG RB_RBA_Common_CentralElements_CompuMethods_Identical 1 100 0.0 4294967295 FORMAT "%8.2" ECU_ADDRESS 0xfe418874 /end MEASUREMENT
/begin MEASUREMENT Tlib_EfuseRegRead_GetNTC_THR_O_S_ODH54 "" ULONG RB_RBA_Common_CentralElements_CompuMethods_Identical 1 100 0.0 4294967295 FORMAT "%8.2" ECU_ADDRESS 0xfe418878 /end MEASUREMENT
/begin MEASUREMENT Tlib_EfuseRegRead_R_Shunt_O_S_ODH54 "" ULONG RB_RBA_Common_CentralElements_CompuMethods_Identical 1 100 0.0 4294967295 FORMAT "%8.2" ECU_ADDRESS 0xfe41887c /end MEASUREMENT
/begin MEASUREMENT Tlib_EfuseRegRead_GetCr1_O_S_ODH42 "" ULONG RB_RBA_Common_CentralElements_CompuMethods_Identical 1 100 0.0 4294967295 FORMAT "%8.2" ECU_ADDRESS 0xfe418880 /end MEASUREMENT
/begin MEASUREMENT Tlib_EfuseRegRead_GetCR3_O_S_ODH42 "" ULONG RB_RBA_Common_CentralElements_CompuMethods_Identical 1 100 0.0 4294967295 FORMAT "%8.2" ECU_ADDRESS 0xfe418884 /end MEASUREMENT
/begin MEASUREMENT Tlib_EfuseRegRead_GetSR1_O_S_ODH42 "" ULONG RB_RBA_Common_CentralElements_CompuMethods_Identical 1 100 0.0 4294967295 FORMAT "%8.2" ECU_ADDRESS 0xfe418888 /end MEASUREMENT
/begin MEASUREMENT Tlib_EfuseRegRead_GetCurrent_O_S_ODH42 "" ULONG RB_RBA_Common_CentralElements_CompuMethods_Identical 1 100 0.0 4294967295 FORMAT "%8.2" ECU_ADDRESS 0xfe41888c /end MEASUREMENT
/begin MEASUREMENT Tlib_EfuseRegRead_GetTJ_O_S_ODH42 "" ULONG RB_RBA_Common_CentralElements_CompuMethods_Identical 1 100 0.0 4294967295 FORMAT "%8.2" ECU_ADDRESS 0xfe418890 /end MEASUREMENT
/begin MEASUREMENT Tlib_EfuseRegRead_GetTMOS_O_S_ODH42 "" ULONG RB_RBA_Common_CentralElements_CompuMethods_Identical 1 100 0.0 4294967295 FORMAT "%8.2" ECU_ADDRESS 0xfe418894 /end MEASUREMENT
/begin MEASUREMENT Tlib_EfuseRegRead_GetVDS_O_S_ODH42 "" ULONG RB_RBA_Common_CentralElements_CompuMethods_Identical 1 100 0.0 4294967295 FORMAT "%8.2" ECU_ADDRESS 0xfe418898 /end MEASUREMENT
/begin MEASUREMENT Tlib_EfuseRegRead_GetVOUT_O_S_ODH42 "" ULONG RB_RBA_Common_CentralElements_CompuMethods_Identical 1 100 0.0 4294967295 FORMAT "%8.2" ECU_ADDRESS 0xfe41889c /end MEASUREMENT
/begin MEASUREMENT Tlib_EfuseRegRead_GetT_NOM_O_S_ODH42 "" ULONG RB_RBA_Common_CentralElements_CompuMethods_Identical 1 100 0.0 4294967295 FORMAT "%8.2" ECU_ADDRESS 0xfe4188a0 /end MEASUREMENT
/begin MEASUREMENT Tlib_EfuseRegRead_GetOVC_THR_O_S_ODH42 "" ULONG RB_RBA_Common_CentralElements_CompuMethods_Identical 1 100 0.0 4294967295 FORMAT "%8.2" ECU_ADDRESS 0xfe4188a4 /end MEASUREMENT
/begin MEASUREMENT Tlib_EfuseRegRead_GetHSHT_THR_O_S_ODH42 "" ULONG RB_RBA_Common_CentralElements_CompuMethods_Identical 1 100 0.0 4294967295 FORMAT "%8.2" ECU_ADDRESS 0xfe4188a8 /end MEASUREMENT
/begin MEASUREMENT Tlib_EfuseRegRead_GetVDS_THR_O_S_ODH42 "" ULONG RB_RBA_Common_CentralElements_CompuMethods_Identical 1 100 0.0 4294967295 FORMAT "%8.2" ECU_ADDRESS 0xfe4188ac /end MEASUREMENT
/begin MEASUREMENT Tlib_EfuseRegRead_GetNTC_THR_O_S_ODH42 "" ULONG RB_RBA_Common_CentralElements_CompuMethods_Identical 1 100 0.0 4294967295 FORMAT "%8.2" ECU_ADDRESS 0xfe4188b0 /end MEASUREMENT
/begin MEASUREMENT Tlib_EfuseRegRead_R_Shunt_O_S_ODH42 "" ULONG RB_RBA_Common_CentralElements_CompuMethods_Identical 1 100 0.0 4294967295 FORMAT "%8.2" ECU_ADDRESS 0xfe4188b4 /end MEASUREMENT
/begin MEASUREMENT Tlib_EfuseRegRead_GetCr1_O_S_ODH80 "" ULONG RB_RBA_Common_CentralElements_CompuMethods_Identical 1 100 0.0 4294967295 FORMAT "%8.2" ECU_ADDRESS 0xfe4188b8 /end MEASUREMENT
/begin MEASUREMENT Tlib_EfuseRegRead_GetCR3_O_S_ODH80 "" ULONG RB_RBA_Common_CentralElements_CompuMethods_Identical 1 100 0.0 4294967295 FORMAT "%8.2" ECU_ADDRESS 0xfe4188bc /end MEASUREMENT
/begin MEASUREMENT Tlib_EfuseRegRead_GetSR1_O_S_ODH80 "" ULONG RB_RBA_Common_CentralElements_CompuMethods_Identical 1 100 0.0 4294967295 FORMAT "%8.2" ECU_ADDRESS 0xfe4188c0 /end MEASUREMENT
/begin MEASUREMENT Tlib_EfuseRegRead_GetCurrent_O_S_ODH80 "" ULONG RB_RBA_Common_CentralElements_CompuMethods_Identical 1 100 0.0 4294967295 FORMAT "%8.2" ECU_ADDRESS 0xfe4188c4 /end MEASUREMENT
/begin MEASUREMENT Tlib_EfuseRegRead_GetTJ_O_S_ODH80 "" ULONG RB_RBA_Common_CentralElements_CompuMethods_Identical 1 100 0.0 4294967295 FORMAT "%8.2" ECU_ADDRESS 0xfe4188c8 /end MEASUREMENT
/begin MEASUREMENT Tlib_EfuseRegRead_GetTMOS_O_S_ODH80 "" ULONG RB_RBA_Common_CentralElements_CompuMethods_Identical 1 100 0.0 4294967295 FORMAT "%8.2" ECU_ADDRESS 0xfe4188cc /end MEASUREMENT
/begin MEASUREMENT Tlib_EfuseRegRead_GetVDS_O_S_ODH80 "" ULONG RB_RBA_Common_CentralElements_CompuMethods_Identical 1 100 0.0 4294967295 FORMAT "%8.2" ECU_ADDRESS 0xfe4188d0 /end MEASUREMENT
/begin MEASUREMENT Tlib_EfuseRegRead_GetVOUT_O_S_ODH80 "" ULONG RB_RBA_Common_CentralElements_CompuMethods_Identical 1 100 0.0 4294967295 FORMAT "%8.2" ECU_ADDRESS 0xfe4188d4 /end MEASUREMENT
/begin MEASUREMENT Tlib_EfuseRegRead_GetT_NOM_O_S_ODH80 "" ULONG RB_RBA_Common_CentralElements_CompuMethods_Identical 1 100 0.0 4294967295 FORMAT "%8.2" ECU_ADDRESS 0xfe4188d8 /end MEASUREMENT
/begin MEASUREMENT Tlib_EfuseRegRead_GetOVC_THR_O_S_ODH80 "" ULONG RB_RBA_Common_CentralElements_CompuMethods_Identical 1 100 0.0 4294967295 FORMAT "%8.2" ECU_ADDRESS 0xfe4188dc /end MEASUREMENT
/begin MEASUREMENT Tlib_EfuseRegRead_GetHSHT_THR_O_S_ODH80 "" ULONG RB_RBA_Common_CentralElements_CompuMethods_Identical 1 100 0.0 4294967295 FORMAT "%8.2" ECU_ADDRESS 0xfe4188e0 /end MEASUREMENT
/begin MEASUREMENT Tlib_EfuseRegRead_GetVDS_THR_O_S_ODH80 "" ULONG RB_RBA_Common_CentralElements_CompuMethods_Identical 1 100 0.0 4294967295 FORMAT "%8.2" ECU_ADDRESS 0xfe4188e4 /end MEASUREMENT
/begin MEASUREMENT Tlib_EfuseRegRead_GetNTC_THR_O_S_ODH80 "" ULONG RB_RBA_Common_CentralElements_CompuMethods_Identical 1 100 0.0 4294967295 FORMAT "%8.2" ECU_ADDRESS 0xfe4188e8 /end MEASUREMENT
/begin MEASUREMENT Tlib_EfuseRegRead_R_Shunt_O_S_ODH80 "" ULONG RB_RBA_Common_CentralElements_CompuMethods_Identical 1 100 0.0 4294967295 FORMAT "%8.2" ECU_ADDRESS 0xfe4188ec /end MEASUREMENT
/begin MEASUREMENT Tlib_EfuseRegRead_GetCr1_O_S_ODH81 "" ULONG RB_RBA_Common_CentralElements_CompuMethods_Identical 1 100 0.0 4294967295 FORMAT "%8.2" ECU_ADDRESS 0xfe4188f0 /end MEASUREMENT
/begin MEASUREMENT Tlib_EfuseRegRead_GetCR3_O_S_ODH81 "" ULONG RB_RBA_Common_CentralElements_CompuMethods_Identical 1 100 0.0 4294967295 FORMAT "%8.2" ECU_ADDRESS 0xfe4188f4 /end MEASUREMENT
/begin MEASUREMENT Tlib_EfuseRegRead_GetSR1_O_S_ODH81 "" ULONG RB_RBA_Common_CentralElements_CompuMethods_Identical 1 100 0.0 4294967295 FORMAT "%8.2" ECU_ADDRESS 0xfe4188f8 /end MEASUREMENT
/begin MEASUREMENT Tlib_EfuseRegRead_GetCurrent_O_S_ODH81 "" ULONG RB_RBA_Common_CentralElements_CompuMethods_Identical 1 100 0.0 4294967295 FORMAT "%8.2" ECU_ADDRESS 0xfe4188fc /end MEASUREMENT
/begin MEASUREMENT Tlib_EfuseRegRead_GetTJ_O_S_ODH81 "" ULONG RB_RBA_Common_CentralElements_CompuMethods_Identical 1 100 0.0 4294967295 FORMAT "%8.2" ECU_ADDRESS 0xfe418900 /end MEASUREMENT
/begin MEASUREMENT Tlib_EfuseRegRead_GetTMOS_O_S_ODH81 "" ULONG RB_RBA_Common_CentralElements_CompuMethods_Identical 1 100 0.0 4294967295 FORMAT "%8.2" ECU_ADDRESS 0xfe418904 /end MEASUREMENT
/begin MEASUREMENT Tlib_EfuseRegRead_GetVDS_O_S_ODH81 "" ULONG RB_RBA_Common_CentralElements_CompuMethods_Identical 1 100 0.0 4294967295 FORMAT "%8.2" ECU_ADDRESS 0xfe418908 /end MEASUREMENT
/begin MEASUREMENT Tlib_EfuseRegRead_GetVOUT_O_S_ODH81 "" ULONG RB_RBA_Common_CentralElements_CompuMethods_Identical 1 100 0.0 4294967295 FORMAT "%8.2" ECU_ADDRESS 0xfe41890c /end MEASUREMENT
/begin MEASUREMENT Tlib_EfuseRegRead_GetT_NOM_O_S_ODH81 "" ULONG RB_RBA_Common_CentralElements_CompuMethods_Identical 1 100 0.0 4294967295 FORMAT "%8.2" ECU_ADDRESS 0xfe418910 /end MEASUREMENT
/begin MEASUREMENT Tlib_EfuseRegRead_GetOVC_THR_O_S_ODH81 "" ULONG RB_RBA_Common_CentralElements_CompuMethods_Identical 1 100 0.0 4294967295 FORMAT "%8.2" ECU_ADDRESS 0xfe418914 /end MEASUREMENT
/begin MEASUREMENT Tlib_EfuseRegRead_GetHSHT_THR_O_S_ODH81 "" ULONG RB_RBA_Common_CentralElements_CompuMethods_Identical 1 100 0.0 4294967295 FORMAT "%8.2" ECU_ADDRESS 0xfe418918 /end MEASUREMENT
/begin MEASUREMENT Tlib_EfuseRegRead_GetVDS_THR_O_S_ODH81 "" ULONG RB_RBA_Common_CentralElements_CompuMethods_Identical 1 100 0.0 4294967295 FORMAT "%8.2" ECU_ADDRESS 0xfe41891c /end MEASUREMENT
/begin MEASUREMENT Tlib_EfuseRegRead_GetNTC_THR_O_S_ODH81 "" ULONG RB_RBA_Common_CentralElements_CompuMethods_Identical 1 100 0.0 4294967295 FORMAT "%8.2" ECU_ADDRESS 0xfe418920 /end MEASUREMENT
/begin MEASUREMENT Tlib_EfuseRegRead_R_Shunt_O_S_ODH81 "" ULONG RB_RBA_Common_CentralElements_CompuMethods_Identical 1 100 0.0 4294967295 FORMAT "%8.2" ECU_ADDRESS 0xfe418924 /end MEASUREMENT
/begin MEASUREMENT Tlib_EfuseRegRead_GetCr1_O_S_EFUSE25 "" ULONG RB_RBA_Common_CentralElements_CompuMethods_Identical 1 100 0.0 4294967295 FORMAT "%8.2" ECU_ADDRESS 0xfe418928 /end MEASUREMENT
/begin MEASUREMENT Tlib_EfuseRegRead_GetCR3_O_S_EFUSE25 "" ULONG RB_RBA_Common_CentralElements_CompuMethods_Identical 1 100 0.0 4294967295 FORMAT "%8.2" ECU_ADDRESS 0xfe41892c /end MEASUREMENT
/begin MEASUREMENT Tlib_EfuseRegRead_GetSR1_O_S_EFUSE25 "" ULONG RB_RBA_Common_CentralElements_CompuMethods_Identical 1 100 0.0 4294967295 FORMAT "%8.2" ECU_ADDRESS 0xfe418930 /end MEASUREMENT
/begin MEASUREMENT Tlib_EfuseRegRead_GetCurrent_O_S_EFUSE25 "" ULONG RB_RBA_Common_CentralElements_CompuMethods_Identical 1 100 0.0 4294967295 FORMAT "%8.2" ECU_ADDRESS 0xfe418934 /end MEASUREMENT
/begin MEASUREMENT Tlib_EfuseRegRead_GetTJ_O_S_EFUSE25 "" ULONG RB_RBA_Common_CentralElements_CompuMethods_Identical 1 100 0.0 4294967295 FORMAT "%8.2" ECU_ADDRESS 0xfe418938 /end MEASUREMENT
/begin MEASUREMENT Tlib_EfuseRegRead_GetTMOS_O_S_EFUSE25 "" ULONG RB_RBA_Common_CentralElements_CompuMethods_Identical 1 100 0.0 4294967295 FORMAT "%8.2" ECU_ADDRESS 0xfe41893c /end MEASUREMENT
/begin MEASUREMENT Tlib_EfuseRegRead_GetVDS_O_S_EFUSE25 "" ULONG RB_RBA_Common_CentralElements_CompuMethods_Identical 1 100 0.0 4294967295 FORMAT "%8.2" ECU_ADDRESS 0xfe418940 /end MEASUREMENT
/begin MEASUREMENT Tlib_EfuseRegRead_GetVOUT_O_S_EFUSE25 "" ULONG RB_RBA_Common_CentralElements_CompuMethods_Identical 1 100 0.0 4294967295 FORMAT "%8.2" ECU_ADDRESS 0xfe418944 /end MEASUREMENT
/begin MEASUREMENT Tlib_EfuseRegRead_GetT_NOM_O_S_EFUSE25 "" ULONG RB_RBA_Common_CentralElements_CompuMethods_Identical 1 100 0.0 4294967295 FORMAT "%8.2" ECU_ADDRESS 0xfe418948 /end MEASUREMENT
/begin MEASUREMENT Tlib_EfuseRegRead_GetOVC_THR_O_S_EFUSE25 "" ULONG RB_RBA_Common_CentralElements_CompuMethods_Identical 1 100 0.0 4294967295 FORMAT "%8.2" ECU_ADDRESS 0xfe41894c /end MEASUREMENT
/begin MEASUREMENT Tlib_EfuseRegRead_GetHSHT_THR_O_S_EFUSE25 "" ULONG RB_RBA_Common_CentralElements_CompuMethods_Identical 1 100 0.0 4294967295 FORMAT "%8.2" ECU_ADDRESS 0xfe418950 /end MEASUREMENT
/begin MEASUREMENT Tlib_EfuseRegRead_GetVDS_THR_O_S_EFUSE25 "" ULONG RB_RBA_Common_CentralElements_CompuMethods_Identical 1 100 0.0 4294967295 FORMAT "%8.2" ECU_ADDRESS 0xfe418954 /end MEASUREMENT
/begin MEASUREMENT Tlib_EfuseRegRead_GetNTC_THR_O_S_EFUSE25 "" ULONG RB_RBA_Common_CentralElements_CompuMethods_Identical 1 100 0.0 4294967295 FORMAT "%8.2" ECU_ADDRESS 0xfe418958 /end MEASUREMENT
/begin MEASUREMENT Tlib_EfuseRegRead_R_Shunt_O_S_EFUSE25 "" ULONG RB_RBA_Common_CentralElements_CompuMethods_Identical 1 100 0.0 4294967295 FORMAT "%8.2" ECU_ADDRESS 0xfe41895c /end MEASUREMENT
/begin MEASUREMENT Tlib_EfuseRegRead_GetCr1_O_S_ODH79 "" ULONG RB_RBA_Common_CentralElements_CompuMethods_Identical 1 100 0.0 4294967295 FORMAT "%8.2" ECU_ADDRESS 0xfe418960 /end MEASUREMENT
/begin MEASUREMENT Tlib_EfuseRegRead_GetCR3_O_S_ODH79 "" ULONG RB_RBA_Common_CentralElements_CompuMethods_Identical 1 100 0.0 4294967295 FORMAT "%8.2" ECU_ADDRESS 0xfe418964 /end MEASUREMENT
/begin MEASUREMENT Tlib_EfuseRegRead_GetSR1_O_S_ODH79 "" ULONG RB_RBA_Common_CentralElements_CompuMethods_Identical 1 100 0.0 4294967295 FORMAT "%8.2" ECU_ADDRESS 0xfe418968 /end MEASUREMENT
/begin MEASUREMENT Tlib_EfuseRegRead_GetCurrent_O_S_ODH79 "" ULONG RB_RBA_Common_CentralElements_CompuMethods_Identical 1 100 0.0 4294967295 FORMAT "%8.2" ECU_ADDRESS 0xfe41896c /end MEASUREMENT
/begin MEASUREMENT Tlib_EfuseRegRead_GetTJ_O_S_ODH79 "" ULONG RB_RBA_Common_CentralElements_CompuMethods_Identical 1 100 0.0 4294967295 FORMAT "%8.2" ECU_ADDRESS 0xfe418970 /end MEASUREMENT
/begin MEASUREMENT Tlib_EfuseRegRead_GetTMOS_O_S_ODH79 "" ULONG RB_RBA_Common_CentralElements_CompuMethods_Identical 1 100 0.0 4294967295 FORMAT "%8.2" ECU_ADDRESS 0xfe418974 /end MEASUREMENT
/begin MEASUREMENT Tlib_EfuseRegRead_GetVDS_O_S_ODH79 "" ULONG RB_RBA_Common_CentralElements_CompuMethods_Identical 1 100 0.0 4294967295 FORMAT "%8.2" ECU_ADDRESS 0xfe418978 /end MEASUREMENT
/begin MEASUREMENT Tlib_EfuseRegRead_GetVOUT_O_S_ODH79 "" ULONG RB_RBA_Common_CentralElements_CompuMethods_Identical 1 100 0.0 4294967295 FORMAT "%8.2" ECU_ADDRESS 0xfe41897c /end MEASUREMENT
/begin MEASUREMENT Tlib_EfuseRegRead_GetT_NOM_O_S_ODH79 "" ULONG RB_RBA_Common_CentralElements_CompuMethods_Identical 1 100 0.0 4294967295 FORMAT "%8.2" ECU_ADDRESS 0xfe418980 /end MEASUREMENT
/begin MEASUREMENT Tlib_EfuseRegRead_GetOVC_THR_O_S_ODH79 "" ULONG RB_RBA_Common_CentralElements_CompuMethods_Identical 1 100 0.0 4294967295 FORMAT "%8.2" ECU_ADDRESS 0xfe418984 /end MEASUREMENT
/begin MEASUREMENT Tlib_EfuseRegRead_GetHSHT_THR_O_S_ODH79 "" ULONG RB_RBA_Common_CentralElements_CompuMethods_Identical 1 100 0.0 4294967295 FORMAT "%8.2" ECU_ADDRESS 0xfe418988 /end MEASUREMENT
/begin MEASUREMENT Tlib_EfuseRegRead_GetVDS_THR_O_S_ODH79 "" ULONG RB_RBA_Common_CentralElements_CompuMethods_Identical 1 100 0.0 4294967295 FORMAT "%8.2" ECU_ADDRESS 0xfe41898c /end MEASUREMENT
/begin MEASUREMENT Tlib_EfuseRegRead_GetNTC_THR_O_S_ODH79 "" ULONG RB_RBA_Common_CentralElements_CompuMethods_Identical 1 100 0.0 4294967295 FORMAT "%8.2" ECU_ADDRESS 0xfe418990 /end MEASUREMENT
/begin MEASUREMENT Tlib_EfuseRegRead_R_Shunt_O_S_ODH79 "" ULONG RB_RBA_Common_CentralElements_CompuMethods_Identical 1 100 0.0 4294967295 FORMAT "%8.2" ECU_ADDRESS 0xfe418994 /end MEASUREMENT
/begin MEASUREMENT Tlib_EfuseRegRead_GetCr1_O_S_ODH78 "" ULONG RB_RBA_Common_CentralElements_CompuMethods_Identical 1 100 0.0 4294967295 FORMAT "%8.2" ECU_ADDRESS 0xfe418998 /end MEASUREMENT
/begin MEASUREMENT Tlib_EfuseRegRead_GetCR3_O_S_ODH78 "" ULONG RB_RBA_Common_CentralElements_CompuMethods_Identical 1 100 0.0 4294967295 FORMAT "%8.2" ECU_ADDRESS 0xfe41899c /end MEASUREMENT
/*********** End of merged FUNCTION blocks ***********/ /*********** Start of merged COMPU_METHOD blocks ***********/
/begin COMPU_METHOD RB_RBA_Common_CentralElements_CompuMethods_Identical "The internal value and the physical one are identical. No physical unit available" RAT_FUNC "%10.5" "noUnit" COEFFS 0.0 1.0 0.0 0.0 0.0 1.0 REF_UNIT RB_RBA_Common_CentralElements_Units_NoUnit /end COMPU_METHOD
/*********** Start of merged UNIT blocks ***********/
/begin UNIT RB_RBA_Common_CentralElements_Units_NoUnit "No Unit" "noUnit" EXTENDED_SI SI_EXPONENTS 0 0 0 0 0 0 0 /end UNIT
/begin UNIT RB_RBA_rba_MRly_Units_NoUnit "No Unit" "nounit" EXTENDED_SI SI_EXPONENTS 0 0 0 0 0 0 0 /end UNIT
/begin UNIT RB_RBA_rba_MRly_Units_ms "Millisecond" "ms" EXTENDED_SI SI_EXPONENTS 0 0 1 0 0 0 0 /end UNIT
/begin UNIT RB_RBA_rba_OsMeasmt_Units_Perc "Percent" "%" EXTENDED_SI /end UNIT
/begin UNIT RB_RBA_rba_OsMeasmt_Units_MicroSec "Micro Second" "us" EXTENDED_SI /end UNIT
/begin UNIT RB_RBA_rba_OsShell_Units_MicroSec "Micro Second" "us" EXTENDED_SI /end UNIT
/begin UNIT RB_RBA_rba_OsMeasmt_Units_NoUnit "No Unit" "noUnit" EXTENDED_SI SI_EXPONENTS 0 0 0 0 0 0 0 /end UNIT
/end MODULE
/end PROJECT
