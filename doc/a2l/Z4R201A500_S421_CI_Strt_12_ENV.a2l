ASAP2_VERSION 1 61
/begin PROJECT ZCU "ZCU"
/begin HEADER "" VERSION "ZCU" PROJECT_NO ZCU /end HEADER
/begin MODULE DIM ""
/begin MOD_COMMON "" BYTE_ORDER MSB_LAST ALIGNMENT_BYTE 1 ALIGNMENT_WORD 2 ALIGNMENT_LONG 4 ALIGNMENT_INT64 4 ALIGNMENT_FLOAT32_IEEE 4 ALIGNMENT_FLOAT64_IEEE 4 DATA_SIZE 32 /end MOD_COMMON
/begin MEASUREMENT Tlib_HfaActr15ResetSts_ZCR_LIN6 "" UBYTE RB_RBA_Common_CentralElements_CompuMethods_Identical 1 100 0.0 255.00 FORMAT "%8.2" ECU_ADDRESS 0xfe4030e1 /end MEASUREMENT
/begin MEASUREMENT Tlib_HfaActr15BusAdr_ZCR_LIN6 "" UBYTE RB_RBA_Common_CentralElements_CompuMethods_Identical 1 100 0.0 255.00 FORMAT "%8.2" ECU_ADDRESS 0xfe4030e2 /end MEASUREMENT
/begin MEASUREMENT Tlib_HfaActr15ElecErr_ZCR_LIN6 "" UBYTE RB_RBA_Common_CentralElements_CompuMethods_Identical 1 100 0.0 255.00 FORMAT "%8.2" ECU_ADDRESS 0xfe4030e3 /end MEASUREMENT
/begin MEASUREMENT Tlib_HfaActr15VoltErr_ZCR_LIN6 "" UBYTE RB_RBA_Common_CentralElements_CompuMethods_Identical 1 100 0.0 255.00 FORMAT "%8.2" ECU_ADDRESS 0xfe4030e4 /end MEASUREMENT
/begin MEASUREMENT Tlib_HfaActr15UrgcSts_ZCR_LIN6 "" UBYTE RB_RBA_Common_CentralElements_CompuMethods_Identical 1 100 0.0 255.00 FORMAT "%8.2" ECU_ADDRESS 0xfe4030e5 /end MEASUREMENT
/begin MEASUREMENT Tlib_HfaActr15CoilSts_ZCR_LIN6 "" UBYTE RB_RBA_Common_CentralElements_CompuMethods_Identical 1 100 0.0 255.00 FORMAT "%8.2" ECU_ADDRESS 0xfe4030e6 /end MEASUREMENT
/begin MEASUREMENT Tlib_HfaActr15BlckInd_ZCR_LIN6 "" UBYTE RB_RBA_Common_CentralElements_CompuMethods_Identical 1 100 0.0 255.00 FORMAT "%8.2" ECU_ADDRESS 0xfe4030e7 /end MEASUREMENT
/begin MEASUREMENT Tlib_HfaActr15ActPson_ZCR_LIN6 "" UWORD RB_RBA_Common_CentralElements_CompuMethods_Identical 1 100 0.0 65535 FORMAT "%8.2" ECU_ADDRESS 0xfe4028b4 /end MEASUREMENT
/begin MEASUREMENT Tlib_HfaActr15SpdSts_ZCR_LIN6 "" UBYTE RB_RBA_Common_CentralElements_CompuMethods_Identical 1 100 0.0 255.00 FORMAT "%8.2" ECU_ADDRESS 0xfe4030e8 /end MEASUREMENT
/begin MEASUREMENT Tlib_HfaActr15OvrTempErr_ZCR_LIN6 "" UBYTE RB_RBA_Common_CentralElements_CompuMethods_Identical 1 100 0.0 255.00 FORMAT "%8.2" ECU_ADDRESS 0xfe4030e9 /end MEASUREMENT
/begin MEASUREMENT Tlib_HfaActr15SpclFct_ZCR_LIN6 "" UBYTE RB_RBA_Common_CentralElements_CompuMethods_Identical 1 100 0.0 255.00 FORMAT "%8.2" ECU_ADDRESS 0xfe4030ea /end MEASUREMENT
/begin MEASUREMENT Tlib_HfaActr15UrgcExist_ZCR_LIN6 "" UBYTE RB_RBA_Common_CentralElements_CompuMethods_Identical 1 100 0.0 255.00 FORMAT "%8.2" ECU_ADDRESS 0xfe4030eb /end MEASUREMENT
/begin MEASUREMENT Tlib_HfaActr15PsonSts_ZCR_LIN6 "" UBYTE RB_RBA_Common_CentralElements_CompuMethods_Identical 1 100 0.0 255.00 FORMAT "%8.2" ECU_ADDRESS 0xfe4030ec /end MEASUREMENT
/begin MEASUREMENT Tlib_HfaActr15TrqSts_ZCR_LIN6 "" UBYTE RB_RBA_Common_CentralElements_CompuMethods_Identical 1 100 0.0 255.00 FORMAT "%8.2" ECU_ADDRESS 0xfe4030ed /end MEASUREMENT
/begin MEASUREMENT Tlib_StsOfWelGbyFrntRi_ZCR_CANFD1 "" UBYTE RB_RBA_Common_CentralElements_CompuMethods_Identical 1 100 0.0 255.00 FORMAT "%8.2" ECU_ADDRESS 0xfe4030ee /end MEASUREMENT
/begin MEASUREMENT Tlib_StsOfLedFrntTurnIndcrRiChks8_ZCR_CANFD1 "" UBYTE RB_RBA_Common_CentralElements_CompuMethods_Identical 1 100 0.0 255.00 FORMAT "%8.2" ECU_ADDRESS 0xfe4030ef /end MEASUREMENT
/begin MEASUREMENT Tlib_StsOfLedFrntTurnIndcrRiDevSts4_ZCR_CANFD1 "" UBYTE RB_RBA_Common_CentralElements_CompuMethods_Identical 1 100 0.0 255.00 FORMAT "%8.2" ECU_ADDRESS 0xfe4030f0 /end MEASUREMENT
/begin MEASUREMENT Tlib_StsOfLedFrntTurnIndcrRiCntr4_ZCR_CANFD1 "" UBYTE RB_RBA_Common_CentralElements_CompuMethods_Identical 1 100 0.0 255.00 FORMAT "%8.2" ECU_ADDRESS 0xfe4030f1 /end MEASUREMENT
/begin MEASUREMENT Tlib_StsOfLedFrntTurnIndcrRiDataID4_ZCR_CANFD1 "" UBYTE RB_RBA_Common_CentralElements_CompuMethods_Identical 1 100 0.0 255.00 FORMAT "%8.2" ECU_ADDRESS 0xfe4030f2 /end MEASUREMENT
/begin MEASUREMENT Tlib_StsOfLedDaytiRunngLampRi_ZCR_CANFD1 "" UBYTE RB_RBA_Common_CentralElements_CompuMethods_Identical 1 100 0.0 255.00 FORMAT "%8.2" ECU_ADDRESS 0xfe4030f3 /end MEASUREMENT
/begin MEASUREMENT Tlib_StsOfFrntSideMkrLampRi2_ZCR_CANFD1 "" UBYTE RB_RBA_Common_CentralElements_CompuMethods_Identical 1 100 0.0 255.00 FORMAT "%8.2" ECU_ADDRESS 0xfe4030f4 /end MEASUREMENT
/begin MEASUREMENT Tlib_StsOfLedCornrgLampRi_ZCR_CANFD1 "" UBYTE RB_RBA_Common_CentralElements_CompuMethods_Identical 1 100 0.0 255.00 FORMAT "%8.2" ECU_ADDRESS 0xfe4030f5 /end MEASUREMENT
/begin MEASUREMENT Tlib_StsOfLedLoBeamRi_ZCR_CANFD1 "" UBYTE RB_RBA_Common_CentralElements_CompuMethods_Identical 1 100 0.0 255.00 FORMAT "%8.2" ECU_ADDRESS 0xfe4030f6 /end MEASUREMENT
/begin MEASUREMENT Tlib_StsOfLedFrntPosnLampRi_ZCR_CANFD1 "" UBYTE RB_RBA_Common_CentralElements_CompuMethods_Identical 1 100 0.0 255.00 FORMAT "%8.2" ECU_ADDRESS 0xfe4030f7 /end MEASUREMENT
/begin MEASUREMENT Tlib_StsOfLedFrntFogLampRi_ZCR_CANFD1 "" UBYTE RB_RBA_Common_CentralElements_CompuMethods_Identical 1 100 0.0 255.00 FORMAT "%8.2" ECU_ADDRESS 0xfe4030f8 /end MEASUREMENT
/begin MEASUREMENT Tlib_StsOfLedHiBeamRi_ZCR_CANFD1 "" UBYTE RB_RBA_Common_CentralElements_CompuMethods_Identical 1 100 0.0 255.00 FORMAT "%8.2" ECU_ADDRESS 0xfe4030f9 /end MEASUREMENT
/begin MEASUREMENT Tlib_ReHvacUDetdLo_ZCR_LIN3 "" UBYTE RB_RBA_Common_CentralElements_CompuMethods_Identical 1 100 0.0 255.00 FORMAT "%8.2" ECU_ADDRESS 0xfe4030fa /end MEASUREMENT
/begin MEASUREMENT Tlib_ReHvacOverCurrErr_ZCR_LIN3 "" UBYTE RB_RBA_Common_CentralElements_CompuMethods_Identical 1 100 0.0 255.00 FORMAT "%8.2" ECU_ADDRESS 0xfe4030fb /end MEASUREMENT
/begin MEASUREMENT Tlib_ReHvacFanSpdFd_ZCR_LIN3 "" UBYTE RB_RBA_Common_CentralElements_CompuMethods_Identical 1 100 0.0 255.00 FORMAT "%8.2" ECU_ADDRESS 0xfe4030fc /end MEASUREMENT
/begin MEASUREMENT Tlib_ReHvacSpDetd_ZCR_LIN3 "" UBYTE RB_RBA_Common_CentralElements_CompuMethods_Identical 1 100 0.0 255.00 FORMAT "%8.2" ECU_ADDRESS 0xfe4030fd /end MEASUREMENT
/begin MEASUREMENT Tlib_ReHvacFanBattU_ZCR_LIN3 "" UWORD RB_RBA_Common_CentralElements_CompuMethods_Identical 1 100 0.0 65535 FORMAT "%8.2" ECU_ADDRESS 0xfe4028b6 /end MEASUREMENT
/begin MEASUREMENT Tlib_ReHvacFanTErr_ZCR_LIN3 "" UBYTE RB_RBA_Common_CentralElements_CompuMethods_Identical 1 100 0.0 255.00 FORMAT "%8.2" ECU_ADDRESS 0xfe4030fe /end MEASUREMENT
/begin MEASUREMENT Tlib_ReHvacFanSupplier_ZCR_LIN3 "" UBYTE RB_RBA_Common_CentralElements_CompuMethods_Identical 1 100 0.0 255.00 FORMAT "%8.2" ECU_ADDRESS 0xfe4030ff /end MEASUREMENT
/begin MEASUREMENT Tlib_ReHvacFanCircShoOrMotBlkd_ZCR_LIN3 "" UBYTE RB_RBA_Common_CentralElements_CompuMethods_Identical 1 100 0.0 255.00 FORMAT "%8.2" ECU_ADDRESS 0xfe403100 /end MEASUREMENT
/begin MEASUREMENT Tlib_ReHvacFanDiagFlag1_ZCR_LIN3 "" UBYTE RB_RBA_Common_CentralElements_CompuMethods_Identical 1 100 0.0 255.00 FORMAT "%8.2" ECU_ADDRESS 0xfe403101 /end MEASUREMENT
/begin MEASUREMENT Tlib_ReHvacSftyModEnad_ZCR_LIN3 "" UBYTE RB_RBA_Common_CentralElements_CompuMethods_Identical 1 100 0.0 255.00 FORMAT "%8.2" ECU_ADDRESS 0xfe403102 /end MEASUREMENT
/begin MEASUREMENT Tlib_ReHvacFanT_ZCR_LIN3 "" UBYTE RB_RBA_Common_CentralElements_CompuMethods_Identical 1 100 0.0 255.00 FORMAT "%8.2" ECU_ADDRESS 0xfe403103 /end MEASUREMENT
/begin MEASUREMENT Tlib_ReHvacSpdSts_ZCR_LIN3 "" UBYTE RB_RBA_Common_CentralElements_CompuMethods_Identical 1 100 0.0 255.00 FORMAT "%8.2" ECU_ADDRESS 0xfe403104 /end MEASUREMENT
/begin MEASUREMENT Tlib_ReHvacFanIntErr_ZCR_LIN3 "" UBYTE RB_RBA_Common_CentralElements_CompuMethods_Identical 1 100 0.0 255.00 FORMAT "%8.2" ECU_ADDRESS 0xfe403105 /end MEASUREMENT
/begin MEASUREMENT Tlib_ReHvacHvDetd_ZCR_LIN3 "" UBYTE RB_RBA_Common_CentralElements_CompuMethods_Identical 1 100 0.0 255.00 FORMAT "%8.2" ECU_ADDRESS 0xfe403106 /end MEASUREMENT
/begin MEASUREMENT Tlib_ReHvacFanDirFd_ZCR_LIN3 "" UBYTE RB_RBA_Common_CentralElements_CompuMethods_Identical 1 100 0.0 255.00 FORMAT "%8.2" ECU_ADDRESS 0xfe403107 /end MEASUREMENT
/begin MEASUREMENT Tlib_ReHvacFanBattI_ZCR_LIN3 "" UBYTE RB_RBA_Common_CentralElements_CompuMethods_Identical 1 100 0.0 255.00 FORMAT "%8.2" ECU_ADDRESS 0xfe403108 /end MEASUREMENT
/begin MEASUREMENT Tlib_ReHvacFanVersion_ZCR_LIN3 "" UBYTE RB_RBA_Common_CentralElements_CompuMethods_Identical 1 100 0.0 255.00 FORMAT "%8.2" ECU_ADDRESS 0xfe403109 /end MEASUREMENT
/begin MEASUREMENT Tlib_ReHvacFanILimn_ZCR_LIN3 "" UBYTE RB_RBA_Common_CentralElements_CompuMethods_Identical 1 100 0.0 255.00 FORMAT "%8.2" ECU_ADDRESS 0xfe40310a /end MEASUREMENT
/begin MEASUREMENT Tlib_HfarActr1BlckSts_ZCR_LIN3 "" UBYTE RB_RBA_Common_CentralElements_CompuMethods_Identical 1 100 0.0 255.00 FORMAT "%8.2" ECU_ADDRESS 0xfe40310b /end MEASUREMENT
/begin MEASUREMENT Tlib_HfarActr1ResetSts_ZCR_LIN3 "" UBYTE RB_RBA_Common_CentralElements_CompuMethods_Identical 1 100 0.0 255.00 FORMAT "%8.2" ECU_ADDRESS 0xfe40310c /end MEASUREMENT
/begin MEASUREMENT Tlib_HfarActr1OvrTempErr_ZCR_LIN3 "" UBYTE RB_RBA_Common_CentralElements_CompuMethods_Identical 1 100 0.0 255.00 FORMAT "%8.2" ECU_ADDRESS 0xfe40310d /end MEASUREMENT
/begin MEASUREMENT Tlib_HfarActr1Mode_ZCR_LIN3 "" UBYTE RB_RBA_Common_CentralElements_CompuMethods_Identical 1 100 0.0 255.00 FORMAT "%8.2" ECU_ADDRESS 0xfe40310e /end MEASUREMENT
/begin MEASUREMENT Tlib_HfarActr1PsonSts_ZCR_LIN3 "" UBYTE RB_RBA_Common_CentralElements_CompuMethods_Identical 1 100 0.0 255.00 FORMAT "%8.2" ECU_ADDRESS 0xfe40310f /end MEASUREMENT
/begin MEASUREMENT Tlib_HfarActr1ActPson_ZCR_LIN3 "" UWORD RB_RBA_Common_CentralElements_CompuMethods_Identical 1 100 0.0 65535 FORMAT "%8.2" ECU_ADDRESS 0xfe4028b8 /end MEASUREMENT
/begin MEASUREMENT Tlib_HfarActr1BusAdr_ZCR_LIN3 "" UBYTE RB_RBA_Common_CentralElements_CompuMethods_Identical 1 100 0.0 255.00 FORMAT "%8.2" ECU_ADDRESS 0xfe403110 /end MEASUREMENT
/begin MEASUREMENT Tlib_HfarActr1BlckInd_ZCR_LIN3 "" UBYTE RB_RBA_Common_CentralElements_CompuMethods_Identical 1 100 0.0 255.00 FORMAT "%8.2" ECU_ADDRESS 0xfe403111 /end MEASUREMENT
/begin MEASUREMENT Tlib_HfarActr1DrvDir_ZCR_LIN3 "" UBYTE RB_RBA_Common_CentralElements_CompuMethods_Identical 1 100 0.0 255.00 FORMAT "%8.2" ECU_ADDRESS 0xfe403112 /end MEASUREMENT
/begin MEASUREMENT Tlib_HfarActr1ElecErr_ZCR_LIN3 "" UBYTE RB_RBA_Common_CentralElements_CompuMethods_Identical 1 100 0.0 255.00 FORMAT "%8.2" ECU_ADDRESS 0xfe403113 /end MEASUREMENT
/begin MEASUREMENT Tlib_HfarActr1MovDir_ZCR_LIN3 "" UBYTE RB_RBA_Common_CentralElements_CompuMethods_Identical 1 100 0.0 255.00 FORMAT "%8.2" ECU_ADDRESS 0xfe403114 /end MEASUREMENT
/begin MEASUREMENT Tlib_HfarActr1UrgcPson_ZCR_LIN3 "" UBYTE RB_RBA_Common_CentralElements_CompuMethods_Identical 1 100 0.0 255.00 FORMAT "%8.2" ECU_ADDRESS 0xfe403115 /end MEASUREMENT
/begin MEASUREMENT Tlib_HfarActr1UrgcSts_ZCR_LIN3 "" UBYTE RB_RBA_Common_CentralElements_CompuMethods_Identical 1 100 0.0 255.00 FORMAT "%8.2" ECU_ADDRESS 0xfe403116 /end MEASUREMENT
/begin MEASUREMENT Tlib_HfarActr1UrgcExist_ZCR_LIN3 "" UBYTE RB_RBA_Common_CentralElements_CompuMethods_Identical 1 100 0.0 255.00 FORMAT "%8.2" ECU_ADDRESS 0xfe403117 /end MEASUREMENT
/begin MEASUREMENT Tlib_HfarActr1CoilSts_ZCR_LIN3 "" UBYTE RB_RBA_Common_CentralElements_CompuMethods_Identical 1 100 0.0 255.00 FORMAT "%8.2" ECU_ADDRESS 0xfe403118 /end MEASUREMENT
/begin MEASUREMENT Tlib_HfarActr1SpdSts_ZCR_LIN3 "" UBYTE RB_RBA_Common_CentralElements_CompuMethods_Identical 1 100 0.0 255.00 FORMAT "%8.2" ECU_ADDRESS 0xfe403119 /end MEASUREMENT
/begin MEASUREMENT Tlib_HfarActr1VoltErr_ZCR_LIN3 "" UBYTE RB_RBA_Common_CentralElements_CompuMethods_Identical 1 100 0.0 255.00 FORMAT "%8.2" ECU_ADDRESS 0xfe40311a /end MEASUREMENT
/begin MEASUREMENT Tlib_HfarActr1SpclFct_ZCR_LIN3 "" UBYTE RB_RBA_Common_CentralElements_CompuMethods_Identical 1 100 0.0 255.00 FORMAT "%8.2" ECU_ADDRESS 0xfe40311b /end MEASUREMENT
/begin MEASUREMENT Tlib_HfarActr1TrqSts_ZCR_LIN3 "" UBYTE RB_RBA_Common_CentralElements_CompuMethods_Identical 1 100 0.0 255.00 FORMAT "%8.2" ECU_ADDRESS 0xfe40311c /end MEASUREMENT
/begin MEASUREMENT Tlib_InPm25SensrIntErr_ZCR_LIN3 "" UBYTE RB_RBA_Common_CentralElements_CompuMethods_Identical 1 100 0.0 255.00 FORMAT "%8.2" ECU_ADDRESS 0xfe40311d /end MEASUREMENT
/begin MEASUREMENT Tlib_InPm25FanErr_ZCR_LIN3 "" UBYTE RB_RBA_Common_CentralElements_CompuMethods_Identical 1 100 0.0 255.00 FORMAT "%8.2" ECU_ADDRESS 0xfe40311e /end MEASUREMENT
/begin MEASUREMENT Tlib_InPm25SnsrSts_ZCR_LIN3 "" UBYTE RB_RBA_Common_CentralElements_CompuMethods_Identical 1 100 0.0 255.00 FORMAT "%8.2" ECU_ADDRESS 0xfe40311f /end MEASUREMENT
/begin MEASUREMENT Tlib_InPm25SnsrElecErr_ZCR_LIN3 "" UBYTE RB_RBA_Common_CentralElements_CompuMethods_Identical 1 100 0.0 255.00 FORMAT "%8.2" ECU_ADDRESS 0xfe403120 /end MEASUREMENT
/begin MEASUREMENT Tlib_InPm25SnrTempErr_ZCR_LIN3 "" UBYTE RB_RBA_Common_CentralElements_CompuMethods_Identical 1 100 0.0 255.00 FORMAT "%8.2" ECU_ADDRESS 0xfe403121 /end MEASUREMENT
/begin MEASUREMENT Tlib_CmpmtInAirPmDnsty_ZCR_LIN3 "" UWORD RB_RBA_Common_CentralElements_CompuMethods_Identical 1 100 0.0 65535 FORMAT "%8.2" ECU_ADDRESS 0xfe4028ba /end MEASUREMENT
/begin MEASUREMENT Tlib_InPm25SnrVoltgRangErr_ZCR_LIN3 "" UBYTE RB_RBA_Common_CentralElements_CompuMethods_Identical 1 100 0.0 255.00 FORMAT "%8.2" ECU_ADDRESS 0xfe403122 /end MEASUREMENT
/begin MEASUREMENT Tlib_DfalActrMovDir_ZCR_LIN3 "" UBYTE RB_RBA_Common_CentralElements_CompuMethods_Identical 1 100 0.0 255.00 FORMAT "%8.2" ECU_ADDRESS 0xfe403123 /end MEASUREMENT
/begin MEASUREMENT Tlib_DfalActrSpdSts_ZCR_LIN3 "" UBYTE RB_RBA_Common_CentralElements_CompuMethods_Identical 1 100 0.0 255.00 FORMAT "%8.2" ECU_ADDRESS 0xfe403124 /end MEASUREMENT
/begin MEASUREMENT Tlib_DfalActrUrgcSts_ZCR_LIN3 "" UBYTE RB_RBA_Common_CentralElements_CompuMethods_Identical 1 100 0.0 255.00 FORMAT "%8.2" ECU_ADDRESS 0xfe403125 /end MEASUREMENT
/begin MEASUREMENT Tlib_DfalActrResetSts_ZCR_LIN3 "" UBYTE RB_RBA_Common_CentralElements_CompuMethods_Identical 1 100 0.0 255.00 FORMAT "%8.2" ECU_ADDRESS 0xfe403126 /end MEASUREMENT
/begin MEASUREMENT Tlib_DfalActrDrvDir_ZCR_LIN3 "" UBYTE RB_RBA_Common_CentralElements_CompuMethods_Identical 1 100 0.0 255.00 FORMAT "%8.2" ECU_ADDRESS 0xfe403127 /end MEASUREMENT
/begin MEASUREMENT Tlib_DfalActrBusAdr_ZCR_LIN3 "" UBYTE RB_RBA_Common_CentralElements_CompuMethods_Identical 1 100 0.0 255.00 FORMAT "%8.2" ECU_ADDRESS 0xfe403128 /end MEASUREMENT
/begin MEASUREMENT Tlib_DfalActrMode_ZCR_LIN3 "" UBYTE RB_RBA_Common_CentralElements_CompuMethods_Identical 1 100 0.0 255.00 FORMAT "%8.2" ECU_ADDRESS 0xfe403129 /end MEASUREMENT
/begin MEASUREMENT Tlib_DfalActrTrqSts_ZCR_LIN3 "" UBYTE RB_RBA_Common_CentralElements_CompuMethods_Identical 1 100 0.0 255.00 FORMAT "%8.2" ECU_ADDRESS 0xfe40312a /end MEASUREMENT
/begin MEASUREMENT Tlib_DfalActrSpclFct_ZCR_LIN3 "" UBYTE RB_RBA_Common_CentralElements_CompuMethods_Identical 1 100 0.0 255.00 FORMAT "%8.2" ECU_ADDRESS 0xfe40312b /end MEASUREMENT
/begin MEASUREMENT Tlib_DfalActrActPson_ZCR_LIN3 "" UWORD RB_RBA_Common_CentralElements_CompuMethods_Identical 1 100 0.0 65535 FORMAT "%8.2" ECU_ADDRESS 0xfe4028bc /end MEASUREMENT
/begin MEASUREMENT Tlib_DfalActrUrgcExist_ZCR_LIN3 "" UBYTE RB_RBA_Common_CentralElements_CompuMethods_Identical 1 100 0.0 255.00 FORMAT "%8.2" ECU_ADDRESS 0xfe40312c /end MEASUREMENT
/begin MEASUREMENT Tlib_DfalActrBlckInd_ZCR_LIN3 "" UBYTE RB_RBA_Common_CentralElements_CompuMethods_Identical 1 100 0.0 255.00 FORMAT "%8.2" ECU_ADDRESS 0xfe40312d /end MEASUREMENT
/begin MEASUREMENT Tlib_DfalActrUrgcPson_ZCR_LIN3 "" UBYTE RB_RBA_Common_CentralElements_CompuMethods_Identical 1 100 0.0 255.00 FORMAT "%8.2" ECU_ADDRESS 0xfe40312e /end MEASUREMENT
/begin MEASUREMENT Tlib_DfalActrElecErr_ZCR_LIN3 "" UBYTE RB_RBA_Common_CentralElements_CompuMethods_Identical 1 100 0.0 255.00 FORMAT "%8.2" ECU_ADDRESS 0xfe40312f /end MEASUREMENT
/begin MEASUREMENT Tlib_DfalActrBlckSts_ZCR_LIN3 "" UBYTE RB_RBA_Common_CentralElements_CompuMethods_Identical 1 100 0.0 255.00 FORMAT "%8.2" ECU_ADDRESS 0xfe403130 /end MEASUREMENT
/begin MEASUREMENT Tlib_DfalActrVoltErr_ZCR_LIN3 "" UBYTE RB_RBA_Common_CentralElements_CompuMethods_Identical 1 100 0.0 255.00 FORMAT "%8.2" ECU_ADDRESS 0xfe403131 /end MEASUREMENT
/begin MEASUREMENT Tlib_DfalActrOvrTempErr_ZCR_LIN3 "" UBYTE RB_RBA_Common_CentralElements_CompuMethods_Identical 1 100 0.0 255.00 FORMAT "%8.2" ECU_ADDRESS 0xfe403132 /end MEASUREMENT
/begin MEASUREMENT Tlib_DfalActrCoilSts_ZCR_LIN3 "" UBYTE RB_RBA_Common_CentralElements_CompuMethods_Identical 1 100 0.0 255.00 FORMAT "%8.2" ECU_ADDRESS 0xfe403133 /end MEASUREMENT
/begin MEASUREMENT Tlib_DfalActrPsonSts_ZCR_LIN3 "" UBYTE RB_RBA_Common_CentralElements_CompuMethods_Identical 1 100 0.0 255.00 FORMAT "%8.2" ECU_ADDRESS 0xfe403134 /end MEASUREMENT
/begin MEASUREMENT Tlib_DfarActrCoilSts_ZCR_LIN3 "" UBYTE RB_RBA_Common_CentralElements_CompuMethods_Identical 1 100 0.0 255.00 FORMAT "%8.2" ECU_ADDRESS 0xfe403135 /end MEASUREMENT
/begin MEASUREMENT Tlib_DfarActrBlckInd_ZCR_LIN3 "" UBYTE RB_RBA_Common_CentralElements_CompuMethods_Identical 1 100 0.0 255.00 FORMAT "%8.2" ECU_ADDRESS 0xfe403136 /end MEASUREMENT
/begin MEASUREMENT Tlib_DfarActrActPson_ZCR_LIN3 "" UWORD RB_RBA_Common_CentralElements_CompuMethods_Identical 1 100 0.0 65535 FORMAT "%8.2" ECU_ADDRESS 0xfe4028be /end MEASUREMENT
/begin MEASUREMENT Tlib_DfarActrUrgcExist_ZCR_LIN3 "" UBYTE RB_RBA_Common_CentralElements_CompuMethods_Identical 1 100 0.0 255.00 FORMAT "%8.2" ECU_ADDRESS 0xfe403137 /end MEASUREMENT
/begin MEASUREMENT Tlib_DfarActrDrvDir_ZCR_LIN3 "" UBYTE RB_RBA_Common_CentralElements_CompuMethods_Identical 1 100 0.0 255.00 FORMAT "%8.2" ECU_ADDRESS 0xfe403138 /end MEASUREMENT
/begin MEASUREMENT Tlib_DfarActrMovDir_ZCR_LIN3 "" UBYTE RB_RBA_Common_CentralElements_CompuMethods_Identical 1 100 0.0 255.00 FORMAT "%8.2" ECU_ADDRESS 0xfe403139 /end MEASUREMENT
/begin MEASUREMENT Tlib_DfarActrVoltErr_ZCR_LIN3 "" UBYTE RB_RBA_Common_CentralElements_CompuMethods_Identical 1 100 0.0 255.00 FORMAT "%8.2" ECU_ADDRESS 0xfe40313a /end MEASUREMENT
/begin MEASUREMENT Tlib_DfarActrMode_ZCR_LIN3 "" UBYTE RB_RBA_Common_CentralElements_CompuMethods_Identical 1 100 0.0 255.00 FORMAT "%8.2" ECU_ADDRESS 0xfe40313b /end MEASUREMENT
/begin MEASUREMENT Tlib_DfarActrPsonSts_ZCR_LIN3 "" UBYTE RB_RBA_Common_CentralElements_CompuMethods_Identical 1 100 0.0 255.00 FORMAT "%8.2" ECU_ADDRESS 0xfe40313c /end MEASUREMENT
/begin MEASUREMENT Tlib_DfarActrElecErr_ZCR_LIN3 "" UBYTE RB_RBA_Common_CentralElements_CompuMethods_Identical 1 100 0.0 255.00 FORMAT "%8.2" ECU_ADDRESS 0xfe40313d /end MEASUREMENT
/begin MEASUREMENT Tlib_DfarActrUrgcSts_ZCR_LIN3 "" UBYTE RB_RBA_Common_CentralElements_CompuMethods_Identical 1 100 0.0 255.00 FORMAT "%8.2" ECU_ADDRESS 0xfe40313e /end MEASUREMENT
/begin MEASUREMENT Tlib_DfarActrOvrTempErr_ZCR_LIN3 "" UBYTE RB_RBA_Common_CentralElements_CompuMethods_Identical 1 100 0.0 255.00 FORMAT "%8.2" ECU_ADDRESS 0xfe40313f /end MEASUREMENT
/begin MEASUREMENT Tlib_DfarActrBusAdr_ZCR_LIN3 "" UBYTE RB_RBA_Common_CentralElements_CompuMethods_Identical 1 100 0.0 255.00 FORMAT "%8.2" ECU_ADDRESS 0xfe403140 /end MEASUREMENT
/begin MEASUREMENT Tlib_DfarActrSpdSts_ZCR_LIN3 "" UBYTE RB_RBA_Common_CentralElements_CompuMethods_Identical 1 100 0.0 255.00 FORMAT "%8.2" ECU_ADDRESS 0xfe403141 /end MEASUREMENT
/begin MEASUREMENT Tlib_DfarActrSpclFct_ZCR_LIN3 "" UBYTE RB_RBA_Common_CentralElements_CompuMethods_Identical 1 100 0.0 255.00 FORMAT "%8.2" ECU_ADDRESS 0xfe403142 /end MEASUREMENT
/begin MEASUREMENT Tlib_DfarActrUrgcPson_ZCR_LIN3 "" UBYTE RB_RBA_Common_CentralElements_CompuMethods_Identical 1 100 0.0 255.00 FORMAT "%8.2" ECU_ADDRESS 0xfe403143 /end MEASUREMENT
/begin MEASUREMENT Tlib_DfarActrBlckSts_ZCR_LIN3 "" UBYTE RB_RBA_Common_CentralElements_CompuMethods_Identical 1 100 0.0 255.00 FORMAT "%8.2" ECU_ADDRESS 0xfe403144 /end MEASUREMENT
/begin MEASUREMENT Tlib_DfarActrResetSts_ZCR_LIN3 "" UBYTE RB_RBA_Common_CentralElements_CompuMethods_Identical 1 100 0.0 255.00 FORMAT "%8.2" ECU_ADDRESS 0xfe403145 /end MEASUREMENT
/begin MEASUREMENT Tlib_DfarActrTrqSts_ZCR_LIN3 "" UBYTE RB_RBA_Common_CentralElements_CompuMethods_Identical 1 100 0.0 255.00 FORMAT "%8.2" ECU_ADDRESS 0xfe403146 /end MEASUREMENT
/begin MEASUREMENT Tlib_AFUInitSts_ZCR_LIN3 "" UBYTE RB_RBA_Common_CentralElements_CompuMethods_Identical 1 100 0.0 255.00 FORMAT "%8.2" ECU_ADDRESS 0xfe403147 /end MEASUREMENT
/begin MEASUREMENT Tlib_AIUSts_ZCR_LIN3 "" UBYTE RB_RBA_Common_CentralElements_CompuMethods_Identical 1 100 0.0 255.00 FORMAT "%8.2" ECU_ADDRESS 0xfe403148 /end MEASUREMENT
/begin MEASUREMENT Tlib_AIUErrSts_ZCR_LIN3 "" UBYTE RB_RBA_Common_CentralElements_CompuMethods_Identical 1 100 0.0 255.00 FORMAT "%8.2" ECU_ADDRESS 0xfe403149 /end MEASUREMENT
/begin MEASUREMENT Tlib_AFUTypeFragTypeCh1_ZCR_LIN3 "" UBYTE RB_RBA_Common_CentralElements_CompuMethods_Identical 1 100 0.0 255.00 FORMAT "%8.2" ECU_ADDRESS 0xfe40314a /end MEASUREMENT
/begin MEASUREMENT Tlib_AFUTypeFragTypeCh5_ZCR_LIN3 "" UBYTE RB_RBA_Common_CentralElements_CompuMethods_Identical 1 100 0.0 255.00 FORMAT "%8.2" ECU_ADDRESS 0xfe40314b /end MEASUREMENT
/begin MEASUREMENT Tlib_AFUTypeFragTypeCh4_ZCR_LIN3 "" UBYTE RB_RBA_Common_CentralElements_CompuMethods_Identical 1 100 0.0 255.00 FORMAT "%8.2" ECU_ADDRESS 0xfe40314c /end MEASUREMENT
/begin MEASUREMENT Tlib_AFUTypeFragTypeCh2_ZCR_LIN3 "" UBYTE RB_RBA_Common_CentralElements_CompuMethods_Identical 1 100 0.0 255.00 FORMAT "%8.2" ECU_ADDRESS 0xfe40314d /end MEASUREMENT
/begin MEASUREMENT Tlib_AFUTypeFragTypeCh3_ZCR_LIN3 "" UBYTE RB_RBA_Common_CentralElements_CompuMethods_Identical 1 100 0.0 255.00 FORMAT "%8.2" ECU_ADDRESS 0xfe40314e /end MEASUREMENT
/begin MEASUREMENT Tlib_AFUChRunngStsFragRunngStsCh1_ZCR_LIN3 "" UBYTE RB_RBA_Common_CentralElements_CompuMethods_Identical 1 100 0.0 255.00 FORMAT "%8.2" ECU_ADDRESS 0xfe40314f /end MEASUREMENT
/begin MEASUREMENT Tlib_AFUChRunngStsFragRunngStsCh2_ZCR_LIN3 "" UBYTE RB_RBA_Common_CentralElements_CompuMethods_Identical 1 100 0.0 255.00 FORMAT "%8.2" ECU_ADDRESS 0xfe403150 /end MEASUREMENT
/begin MEASUREMENT Tlib_AFUChRunngStsFragRunngStsCh3_ZCR_LIN3 "" UBYTE RB_RBA_Common_CentralElements_CompuMethods_Identical 1 100 0.0 255.00 FORMAT "%8.2" ECU_ADDRESS 0xfe403151 /end MEASUREMENT
/begin MEASUREMENT Tlib_AFUChRunngStsFragRunngStsCh4_ZCR_LIN3 "" UBYTE RB_RBA_Common_CentralElements_CompuMethods_Identical 1 100 0.0 255.00 FORMAT "%8.2" ECU_ADDRESS 0xfe403152 /end MEASUREMENT
/begin MEASUREMENT Tlib_AFUChRunngStsFragRunngStsCh5_ZCR_LIN3 "" UBYTE RB_RBA_Common_CentralElements_CompuMethods_Identical 1 100 0.0 255.00 FORMAT "%8.2" ECU_ADDRESS 0xfe403153 /end MEASUREMENT
/begin MEASUREMENT Tlib_AFUErrStsFragMotErrCh4_ZCR_LIN3 "" UBYTE RB_RBA_Common_CentralElements_CompuMethods_Identical 1 100 0.0 255.00 FORMAT "%8.2" ECU_ADDRESS 0xfe403154 /end MEASUREMENT
/begin MEASUREMENT Tlib_AFUErrStsFragMotErrCh5_ZCR_LIN3 "" UBYTE RB_RBA_Common_CentralElements_CompuMethods_Identical 1 100 0.0 255.00 FORMAT "%8.2" ECU_ADDRESS 0xfe403155 /end MEASUREMENT
/begin MEASUREMENT Tlib_AFUErrStsFragMotErrCh1_ZCR_LIN3 "" UBYTE RB_RBA_Common_CentralElements_CompuMethods_Identical 1 100 0.0 255.00 FORMAT "%8.2" ECU_ADDRESS 0xfe403156 /end MEASUREMENT
/begin MEASUREMENT Tlib_AFUErrStsFragFanErr_ZCR_LIN3 "" UBYTE RB_RBA_Common_CentralElements_CompuMethods_Identical 1 100 0.0 255.00 FORMAT "%8.2" ECU_ADDRESS 0xfe403157 /end MEASUREMENT
/begin MEASUREMENT Tlib_AFUErrStsFragTErr_ZCR_LIN3 "" UBYTE RB_RBA_Common_CentralElements_CompuMethods_Identical 1 100 0.0 255.00 FORMAT "%8.2" ECU_ADDRESS 0xfe403158 /end MEASUREMENT
/begin MEASUREMENT Tlib_AFUErrStsFragUndVoltErr_ZCR_LIN3 "" UBYTE RB_RBA_Common_CentralElements_CompuMethods_Identical 1 100 0.0 255.00 FORMAT "%8.2" ECU_ADDRESS 0xfe403159 /end MEASUREMENT
/begin MEASUREMENT Tlib_AFUErrStsFragMotErrCh2_ZCR_LIN3 "" UBYTE RB_RBA_Common_CentralElements_CompuMethods_Identical 1 100 0.0 255.00 FORMAT "%8.2" ECU_ADDRESS 0xfe40315a /end MEASUREMENT
/begin MEASUREMENT Tlib_AFUErrStsFragOvrVoltErr_ZCR_LIN3 "" UBYTE RB_RBA_Common_CentralElements_CompuMethods_Identical 1 100 0.0 255.00 FORMAT "%8.2" ECU_ADDRESS 0xfe40315b /end MEASUREMENT
/begin MEASUREMENT Tlib_AFUErrStsFragMotErrCh3_ZCR_LIN3 "" UBYTE RB_RBA_Common_CentralElements_CompuMethods_Identical 1 100 0.0 255.00 FORMAT "%8.2" ECU_ADDRESS 0xfe40315c /end MEASUREMENT
/begin MEASUREMENT Tlib_AFUConcLvlSts_ZCR_LIN3 "" UBYTE RB_RBA_Common_CentralElements_CompuMethods_Identical 1 100 0.0 255.00 FORMAT "%8.2" ECU_ADDRESS 0xfe40315d /end MEASUREMENT
/begin MEASUREMENT Tlib_AFUAvlTiStsFragCh3AvlTi_ZCR_LIN3 "" UWORD RB_RBA_Common_CentralElements_CompuMethods_Identical 1 100 0.0 65535 FORMAT "%8.2" ECU_ADDRESS 0xfe4028c0 /end MEASUREMENT
/begin MEASUREMENT Tlib_AFUAvlTiStsFragCh1AvlTi_ZCR_LIN3 "" UWORD RB_RBA_Common_CentralElements_CompuMethods_Identical 1 100 0.0 65535 FORMAT "%8.2" ECU_ADDRESS 0xfe4028c2 /end MEASUREMENT
/begin MEASUREMENT Tlib_AFUAvlTiStsFragCh4AvlTi_ZCR_LIN3 "" UWORD RB_RBA_Common_CentralElements_CompuMethods_Identical 1 100 0.0 65535 FORMAT "%8.2" ECU_ADDRESS 0xfe4028c4 /end MEASUREMENT
/begin MEASUREMENT Tlib_AFUAvlTiStsFragCh2AvlTi_ZCR_LIN3 "" UWORD RB_RBA_Common_CentralElements_CompuMethods_Identical 1 100 0.0 65535 FORMAT "%8.2" ECU_ADDRESS 0xfe4028c6 /end MEASUREMENT
/begin MEASUREMENT Tlib_AFUAvlTiStsFragCh5AvlTi_ZCR_LIN3 "" UWORD RB_RBA_Common_CentralElements_CompuMethods_Identical 1 100 0.0 65535 FORMAT "%8.2" ECU_ADDRESS 0xfe4028c8 /end MEASUREMENT
/begin MEASUREMENT Tlib_isYawRateReqdByDrvr_0_VLAN204ControLow "" SWORD RB_RBA_Common_CentralElements_CompuMethods_Identical 1 100 -32768 32767 FORMAT "%8.2" ECU_ADDRESS 0xfe4028ca /end MEASUREMENT
/begin MEASUREMENT Tlib_isActnOfLoBeamRi_VLAN204ControLow "" UBYTE RB_RBA_Common_CentralElements_CompuMethods_Identical 1 100 0.0 255.00 FORMAT "%8.2" ECU_ADDRESS 0xfe40315e /end MEASUREMENT
/begin MEASUREMENT Tlib_isLitArea_0_VLAN204ControLow "" UBYTE RB_RBA_Common_CentralElements_CompuMethods_Identical 1 100 0.0 255.00 FORMAT "%8.2" ECU_ADDRESS 0xfe40315f /end MEASUREMENT
/begin MEASUREMENT Tlib_isActnOfHiBeamRi_VLAN204ControLow "" UBYTE RB_RBA_Common_CentralElements_CompuMethods_Identical 1 100 0.0 255.00 FORMAT "%8.2" ECU_ADDRESS 0xfe403160 /end MEASUREMENT
/begin MEASUREMENT Tlib_isActnOfLedRiLogoLamp_0_VLAN204ControLow "" UBYTE RB_RBA_Common_CentralElements_CompuMethods_Identical 1 100 0.0 255.00 FORMAT "%8.2" ECU_ADDRESS 0xfe403161 /end MEASUREMENT
/begin MEASUREMENT Tlib_isTooManyCars_0_VLAN204ControLow "" UBYTE RB_RBA_Common_CentralElements_CompuMethods_Identical 1 100 0.0 255.00 FORMAT "%8.2" ECU_ADDRESS 0xfe403162 /end MEASUREMENT
/begin MEASUREMENT Tlib_isVehObjforAHBAdbDetdQly_0_VLAN204ControLow "" UBYTE RB_RBA_Common_CentralElements_CompuMethods_Identical 1 100 0.0 255.00 FORMAT "%8.2" ECU_ADDRESS 0xfe403163 /end MEASUREMENT
/begin MEASUREMENT Tlib_isVehObjforAHBAdbTrkInfo_0_VLAN204ControLow "" UBYTE RB_RBA_Common_CentralElements_CompuMethods_Identical 1 100 0.0 255.00 FORMAT "%8.2" ECU_ADDRESS 0xfe403164 /end MEASUREMENT
/begin MEASUREMENT Tlib_isVehObjforAHBAdbVertAg_0_VLAN204ControLow "" UBYTE RB_RBA_Common_CentralElements_CompuMethods_Identical 1 100 0.0 255.00 FORMAT "%8.2" ECU_ADDRESS 0xfe403165 /end MEASUREMENT
/begin MEASUREMENT Tlib_isVehObjforAHBAdbObjVertAgSpd_0_VLAN204ControLow "" UWORD RB_RBA_Common_CentralElements_CompuMethods_Identical 1 100 0.0 65535 FORMAT "%8.2" ECU_ADDRESS 0xfe4028cc /end MEASUREMENT
/begin MEASUREMENT Tlib_isVehObjforAHBAdbAbsDist_0_VLAN204ControLow "" UWORD RB_RBA_Common_CentralElements_CompuMethods_Identical 1 100 0.0 65535 FORMAT "%8.2" ECU_ADDRESS 0xfe4028ce /end MEASUREMENT
/begin MEASUREMENT Tlib_isVehObjforAHBAdbClassnQly_0_VLAN204ControLow "" UBYTE RB_RBA_Common_CentralElements_CompuMethods_Identical 1 100 0.0 255.00 FORMAT "%8.2" ECU_ADDRESS 0xfe403166 /end MEASUREMENT
/begin MEASUREMENT Tlib_isVehObjforAHBAdbObjDir_0_VLAN204ControLow "" UBYTE RB_RBA_Common_CentralElements_CompuMethods_Identical 1 100 0.0 255.00 FORMAT "%8.2" ECU_ADDRESS 0xfe403167 /end MEASUREMENT
/begin MEASUREMENT Tlib_isVehObjforAHBAdbClassn_0_VLAN204ControLow "" UBYTE RB_RBA_Common_CentralElements_CompuMethods_Identical 1 100 0.0 255.00 FORMAT "%8.2" ECU_ADDRESS 0xfe403168 /end MEASUREMENT
/begin MEASUREMENT Tlib_isVehObjforAHBAdbHozlAg_0_VLAN204ControLow "" UWORD RB_RBA_Common_CentralElements_CompuMethods_Identical 1 100 0.0 65535 FORMAT "%8.2" ECU_ADDRESS 0xfe4028d0 /end MEASUREMENT
/begin MEASUREMENT Tlib_isVehObjforAHBAdbObjHozlAgSpd_0_VLAN204ControLow "" UWORD RB_RBA_Common_CentralElements_CompuMethods_Identical 1 100 0.0 65535 FORMAT "%8.2" ECU_ADDRESS 0xfe4028d2 /end MEASUREMENT
/begin MEASUREMENT Tlib_isActnOfLedRiLogoLampDyn_0_VLAN204ControLow "" UBYTE RB_RBA_Common_CentralElements_CompuMethods_Identical 1 100 0.0 255.00 FORMAT "%8.2" ECU_ADDRESS 0xfe403169 /end MEASUREMENT
/begin MEASUREMENT Tlib_isCameraStsforAHBC_0_VLAN204ControLow "" UBYTE RB_RBA_Common_CentralElements_CompuMethods_Identical 1 100 0.0 255.00 FORMAT "%8.2" ECU_ADDRESS 0xfe40316a /end MEASUREMENT
/begin MEASUREMENT Tlib_isActnOfLoBeamLe_VLAN204ControLow "" UBYTE RB_RBA_Common_CentralElements_CompuMethods_Identical 1 100 0.0 255.00 FORMAT "%8.2" ECU_ADDRESS 0xfe40316b /end MEASUREMENT
/begin MEASUREMENT Tlib_isActnOfHiBeamLe_VLAN204ControLow "" UBYTE RB_RBA_Common_CentralElements_CompuMethods_Identical 1 100 0.0 255.00 FORMAT "%8.2" ECU_ADDRESS 0xfe40316c /end MEASUREMENT
/begin MEASUREMENT Tlib_isLvlgSwtSetReq_0_VLAN204ControLow "" UBYTE RB_RBA_Common_CentralElements_CompuMethods_Identical 1 100 0.0 255.00 FORMAT "%8.2" ECU_ADDRESS 0xfe40316d /end MEASUREMENT
/begin MEASUREMENT Tlib_isActnBatChargingPCM_0_VLAN204ControLow "" UBYTE RB_RBA_Common_CentralElements_CompuMethods_Identical 1 100 0.0 255.00 FORMAT "%8.2" ECU_ADDRESS 0xfe40316e /end MEASUREMENT
/begin MEASUREMENT Tlib_isHvacCoolgEnaRe_VLAN204ControLow "" UBYTE RB_RBA_Common_CentralElements_CompuMethods_Identical 1 100 0.0 255.00 FORMAT "%8.2" ECU_ADDRESS 0xfe40316f /end MEASUREMENT
/begin MEASUREMENT Tlib_isClimaCoolgReqLvlRe_VLAN204ControLow "" UBYTE RB_RBA_Common_CentralElements_CompuMethods_Identical 1 100 0.0 255.00 FORMAT "%8.2" ECU_ADDRESS 0xfe403170 /end MEASUREMENT
/begin MEASUREMENT Tlib_isHvacHeatgEnaRe_VLAN204ControLow "" UBYTE RB_RBA_Common_CentralElements_CompuMethods_Identical 1 100 0.0 255.00 FORMAT "%8.2" ECU_ADDRESS 0xfe403171 /end MEASUREMENT
/begin MEASUREMENT Tlib_isHvacEvaprTSpFrnt_VLAN204ControLow "" UWORD RB_RBA_Common_CentralElements_CompuMethods_Identical 1 100 0.0 65535 FORMAT "%8.2" ECU_ADDRESS 0xfe4028d4 /end MEASUREMENT
/begin MEASUREMENT Tlib_isHvacHeatgEnaFrnt_VLAN204ControLow "" UBYTE RB_RBA_Common_CentralElements_CompuMethods_Identical 1 100 0.0 255.00 FORMAT "%8.2" ECU_ADDRESS 0xfe403172 /end MEASUREMENT
/begin MEASUREMENT Tlib_isClimaHeatgReqLvlRe_VLAN204ControLow "" UBYTE RB_RBA_Common_CentralElements_CompuMethods_Identical 1 100 0.0 255.00 FORMAT "%8.2" ECU_ADDRESS 0xfe403173 /end MEASUREMENT
/begin MEASUREMENT Tlib_isHeatrAirTSpFrnt_VLAN204ControLow "" UWORD RB_RBA_Common_CentralElements_CompuMethods_Identical 1 100 0.0 65535 FORMAT "%8.2" ECU_ADDRESS 0xfe4028d6 /end MEASUREMENT
/begin MEASUREMENT Tlib_isClimaHeatgReqLvlFrnt_VLAN204ControLow "" UBYTE RB_RBA_Common_CentralElements_CompuMethods_Identical 1 100 0.0 255.00 FORMAT "%8.2" ECU_ADDRESS 0xfe403174 /end MEASUREMENT
/begin MEASUREMENT Tlib_isHeatrAirTSpRe_VLAN204ControLow "" UWORD RB_RBA_Common_CentralElements_CompuMethods_Identical 1 100 0.0 65535 FORMAT "%8.2" ECU_ADDRESS 0xfe4028d8 /end MEASUREMENT
/begin MEASUREMENT Tlib_isHvacEvaprTSpRe_VLAN204ControLow "" UWORD RB_RBA_Common_CentralElements_CompuMethods_Identical 1 100 0.0 65535 FORMAT "%8.2" ECU_ADDRESS 0xfe4028da /end MEASUREMENT
/begin MEASUREMENT Tlib_isHvacCoolgEnaFrnt_VLAN204ControLow "" UBYTE RB_RBA_Common_CentralElements_CompuMethods_Identical 1 100 0.0 255.00 FORMAT "%8.2" ECU_ADDRESS 0xfe403175 /end MEASUREMENT
/begin MEASUREMENT Tlib_isClimaCoolgReqLvlFrnt_VLAN204ControLow "" UBYTE RB_RBA_Common_CentralElements_CompuMethods_Identical 1 100 0.0 255.00 FORMAT "%8.2" ECU_ADDRESS 0xfe403176 /end MEASUREMENT
/begin MEASUREMENT Tlib_isCscAdCoolgReq_VLAN204ControLow "" UBYTE RB_RBA_Common_CentralElements_CompuMethods_Identical 1 100 0.0 255.00 FORMAT "%8.2" ECU_ADDRESS 0xfe403177 /end MEASUREMENT
/begin MEASUREMENT Tlib_isCscAdMinCooltFlow_VLAN204ControLow "" UWORD RB_RBA_Common_CentralElements_CompuMethods_Identical 1 100 0.0 65535 FORMAT "%8.2" ECU_ADDRESS 0xfe4028dc /end MEASUREMENT
/begin MEASUREMENT Tlib_isCscCockCoolgReq_VLAN204ControLow "" UBYTE RB_RBA_Common_CentralElements_CompuMethods_Identical 1 100 0.0 255.00 FORMAT "%8.2" ECU_ADDRESS 0xfe403178 /end MEASUREMENT
/begin MEASUREMENT Tlib_isCscCockMinCooltFlow_VLAN204ControLow "" UWORD RB_RBA_Common_CentralElements_CompuMethods_Identical 1 100 0.0 65535 FORMAT "%8.2" ECU_ADDRESS 0xfe4028de /end MEASUREMENT
/begin MEASUREMENT Tlib_isAmbDewPointTDewTQf_VLAN204ControLow "" UBYTE RB_RBA_Common_CentralElements_CompuMethods_Identical 1 100 0.0 255.00 FORMAT "%8.2" ECU_ADDRESS 0xfe403179 /end MEASUREMENT
/begin MEASUREMENT Tlib_isAmbDewPointTDewT_VLAN204ControLow "" UWORD RB_RBA_Common_CentralElements_CompuMethods_Identical 1 100 0.0 65535 FORMAT "%8.2" ECU_ADDRESS 0xfe4028e0 /end MEASUREMENT
/begin MEASUREMENT Tlib_isActvnOfAfs_0_VLAN204ControLow "" UBYTE RB_RBA_Common_CentralElements_CompuMethods_Identical 1 100 0.0 255.00 FORMAT "%8.2" ECU_ADDRESS 0xfe40317a /end MEASUREMENT
/begin MEASUREMENT Tlib_isActvnOfDbl_0_VLAN204ControLow "" UBYTE RB_RBA_Common_CentralElements_CompuMethods_Identical 1 100 0.0 255.00 FORMAT "%8.2" ECU_ADDRESS 0xfe40317b /end MEASUREMENT
/begin MEASUREMENT Tlib_isActvnOfADB_0_VLAN204ControLow "" UBYTE RB_RBA_Common_CentralElements_CompuMethods_Identical 1 100 0.0 255.00 FORMAT "%8.2" ECU_ADDRESS 0xfe40317c /end MEASUREMENT
/begin MEASUREMENT Tlib_isActvnOfAhl_0_VLAN204ControLow "" UBYTE RB_RBA_Common_CentralElements_CompuMethods_Identical 1 100 0.0 255.00 FORMAT "%8.2" ECU_ADDRESS 0xfe40317d /end MEASUREMENT
/begin MEASUREMENT Tlib_isActvnOfAhbc_0_VLAN204ControLow "" UBYTE RB_RBA_Common_CentralElements_CompuMethods_Identical 1 100 0.0 255.00 FORMAT "%8.2" ECU_ADDRESS 0xfe40317e /end MEASUREMENT
/begin MEASUREMENT Tlib_isActvnOfTouristMod_0_VLAN204ControLow "" UBYTE RB_RBA_Common_CentralElements_CompuMethods_Identical 1 100 0.0 255.00 FORMAT "%8.2" ECU_ADDRESS 0xfe40317f /end MEASUREMENT
/begin MEASUREMENT Tlib_isAlrmAcoustReq01_VLAN204ControLow "" UBYTE RB_RBA_Common_CentralElements_CompuMethods_Identical 1 100 0.0 255.00 FORMAT "%8.2" ECU_ADDRESS 0xfe403180 /end MEASUREMENT
/begin MEASUREMENT Tlib_isGrlActTrqBoost_VLAN204ControLow "" UBYTE RB_RBA_Common_CentralElements_CompuMethods_Identical 1 100 0.0 255.00 FORMAT "%8.2" ECU_ADDRESS 0xfe403181 /end MEASUREMENT
/begin MEASUREMENT Tlib_isGrlShttrMoveActive_VLAN204ControLow "" UBYTE RB_RBA_Common_CentralElements_CompuMethods_Identical 1 100 0.0 255.00 FORMAT "%8.2" ECU_ADDRESS 0xfe403182 /end MEASUREMENT
/begin MEASUREMENT Tlib_isGrlShttrStsShttrPosnRaw_VLAN204ControLow "" UBYTE RB_RBA_Common_CentralElements_CompuMethods_Identical 1 100 0.0 255.00 FORMAT "%8.2" ECU_ADDRESS 0xfe403183 /end MEASUREMENT
/begin MEASUREMENT Tlib_isGrlShttrStsShttrULoErr_VLAN204ControLow "" UBYTE RB_RBA_Common_CentralElements_CompuMethods_Identical 1 100 0.0 255.00 FORMAT "%8.2" ECU_ADDRESS 0xfe403184 /end MEASUREMENT
/begin MEASUREMENT Tlib_isGrlShttrStsShttrActrFlt_VLAN204ControLow "" UBYTE RB_RBA_Common_CentralElements_CompuMethods_Identical 1 100 0.0 255.00 FORMAT "%8.2" ECU_ADDRESS 0xfe403185 /end MEASUREMENT
/begin MEASUREMENT Tlib_isGrlShttrStsShttrElecErr_VLAN204ControLow "" UBYTE RB_RBA_Common_CentralElements_CompuMethods_Identical 1 100 0.0 255.00 FORMAT "%8.2" ECU_ADDRESS 0xfe403186 /end MEASUREMENT
/begin MEASUREMENT Tlib_isGrlShttrStsShttrCalActv_VLAN204ControLow "" UBYTE RB_RBA_Common_CentralElements_CompuMethods_Identical 1 100 0.0 255.00 FORMAT "%8.2" ECU_ADDRESS 0xfe403187 /end MEASUREMENT
/begin MEASUREMENT Tlib_isGrlShttrStsShttrSnsrFlt_VLAN204ControLow "" UBYTE RB_RBA_Common_CentralElements_CompuMethods_Identical 1 100 0.0 255.00 FORMAT "%8.2" ECU_ADDRESS 0xfe403188 /end MEASUREMENT
/begin MEASUREMENT Tlib_isGrlShttrStsShttrTErr_VLAN204ControLow "" UBYTE RB_RBA_Common_CentralElements_CompuMethods_Identical 1 100 0.0 255.00 FORMAT "%8.2" ECU_ADDRESS 0xfe403189 /end MEASUREMENT
/begin MEASUREMENT Tlib_isGrlShttrStsShttrCalIndcd_VLAN204ControLow "" UBYTE RB_RBA_Common_CentralElements_CompuMethods_Identical 1 100 0.0 255.00 FORMAT "%8.2" ECU_ADDRESS 0xfe40318a /end MEASUREMENT
/begin MEASUREMENT Tlib_isGrlShttrStsShttrBlkd_VLAN204ControLow "" UBYTE RB_RBA_Common_CentralElements_CompuMethods_Identical 1 100 0.0 255.00 FORMAT "%8.2" ECU_ADDRESS 0xfe40318b /end MEASUREMENT
/begin MEASUREMENT Tlib_isGrlHldTrqActive_VLAN204ControLow "" UBYTE RB_RBA_Common_CentralElements_CompuMethods_Identical 1 100 0.0 255.00 FORMAT "%8.2" ECU_ADDRESS 0xfe40318c /end MEASUREMENT
/begin MEASUREMENT Tlib_isGrlShttrOvertravelErr_VLAN204ControLow "" UBYTE RB_RBA_Common_CentralElements_CompuMethods_Identical 1 100 0.0 255.00 FORMAT "%8.2" ECU_ADDRESS 0xfe40318d /end MEASUREMENT
/begin MEASUREMENT Tlib_isGrlShttrOverVolt_VLAN204ControLow "" UBYTE RB_RBA_Common_CentralElements_CompuMethods_Identical 1 100 0.0 255.00 FORMAT "%8.2" ECU_ADDRESS 0xfe40318e /end MEASUREMENT
/begin MEASUREMENT Tlib_isAGMNVMFlt_VLAN204ControLow "" UBYTE RB_RBA_Common_CentralElements_CompuMethods_Identical 1 100 0.0 255.00 FORMAT "%8.2" ECU_ADDRESS 0xfe40318f /end MEASUREMENT
/begin MEASUREMENT Tlib_isResrvdSig1ForZCL_VLAN204ControLow "" ULONG RB_RBA_Common_CentralElements_CompuMethods_Identical 1 100 0.0 4294967295 FORMAT "%8.2" ECU_ADDRESS 0xfe40276c /end MEASUREMENT
/begin MEASUREMENT Tlib_isResrvdSig2ForZCL_VLAN204ControLow "" ULONG RB_RBA_Common_CentralElements_CompuMethods_Identical 1 100 0.0 4294967295 FORMAT "%8.2" ECU_ADDRESS 0xfe402770 /end MEASUREMENT
/begin MEASUREMENT Tlib_isResrvdSig3ForZCL_VLAN204ControLow "" ULONG RB_RBA_Common_CentralElements_CompuMethods_Identical 1 100 0.0 4294967295 FORMAT "%8.2" ECU_ADDRESS 0xfe402774 /end MEASUREMENT
/begin MEASUREMENT Tlib_isFanFltSts_VLAN204ControLow "" UBYTE RB_RBA_Common_CentralElements_CompuMethods_Identical 1 100 0.0 255.00 FORMAT "%8.2" ECU_ADDRESS 0xfe403190 /end MEASUREMENT
/begin MEASUREMENT Tlib_isLvFuSaFltSecDcDc_VLAN204ControLow "" UBYTE RB_RBA_Common_CentralElements_CompuMethods_Identical 1 100 0.0 255.00 FORMAT "%8.2" ECU_ADDRESS 0xfe403191 /end MEASUREMENT
/begin MEASUREMENT Tlib_isLimpHomeSecDcDc_VLAN204ControLow "" UBYTE RB_RBA_Common_CentralElements_CompuMethods_Identical 1 100 0.0 255.00 FORMAT "%8.2" ECU_ADDRESS 0xfe403192 /end MEASUREMENT
/begin MEASUREMENT Tlib_isLatentFltSecDcDc_VLAN204ControLow "" UBYTE RB_RBA_Common_CentralElements_CompuMethods_Identical 1 100 0.0 255.00 FORMAT "%8.2" ECU_ADDRESS 0xfe403193 /end MEASUREMENT
/begin MEASUREMENT Tlib_isFanPwmFb_VLAN204ControLow "" UWORD RB_RBA_Common_CentralElements_CompuMethods_Identical 1 100 0.0 65535 FORMAT "%8.2" ECU_ADDRESS 0xfe4028e2 /end MEASUREMENT
/begin MEASUREMENT Tlib_isFanFlt_VLAN204ControLow "" UBYTE RB_RBA_Common_CentralElements_CompuMethods_Identical 1 100 0.0 255.00 FORMAT "%8.2" ECU_ADDRESS 0xfe403194 /end MEASUREMENT
/begin MEASUREMENT Tlib_isHvBattOnRouteAndPresetThermSts_VLAN204ControLow "" UBYTE RB_RBA_Common_CentralElements_CompuMethods_Identical 1 100 0.0 255.00 FORMAT "%8.2" ECU_ADDRESS 0xfe403195 /end MEASUREMENT
/begin MEASUREMENT Tlib_isIsgCoolgReq_VLAN204ControLow "" UBYTE RB_RBA_Common_CentralElements_CompuMethods_Identical 1 100 0.0 255.00 FORMAT "%8.2" ECU_ADDRESS 0xfe403196 /end MEASUREMENT
/begin MEASUREMENT Tlib_isIsgInvrT_VLAN204ControLow "" UBYTE RB_RBA_Common_CentralElements_CompuMethods_Identical 1 100 0.0 255.00 FORMAT "%8.2" ECU_ADDRESS 0xfe403197 /end MEASUREMENT
/begin MEASUREMENT Tlib_isIsgRiMotT_VLAN204ControLow "" UBYTE RB_RBA_Common_CentralElements_CompuMethods_Identical 1 100 0.0 255.00 FORMAT "%8.2" ECU_ADDRESS 0xfe403198 /end MEASUREMENT
/begin MEASUREMENT Tlib_isIsgMotT_VLAN204ControLow "" UBYTE RB_RBA_Common_CentralElements_CompuMethods_Identical 1 100 0.0 255.00 FORMAT "%8.2" ECU_ADDRESS 0xfe403199 /end MEASUREMENT
/begin MEASUREMENT Tlib_isIsgRiCoolgReq_VLAN204ControLow "" UBYTE RB_RBA_Common_CentralElements_CompuMethods_Identical 1 100 0.0 255.00 FORMAT "%8.2" ECU_ADDRESS 0xfe40319a /end MEASUREMENT
/begin MEASUREMENT Tlib_isIsgRiInvrT_VLAN204ControLow "" UBYTE RB_RBA_Common_CentralElements_CompuMethods_Identical 1 100 0.0 255.00 FORMAT "%8.2" ECU_ADDRESS 0xfe40319b /end MEASUREMENT
/begin MEASUREMENT Tlib_isInletCooltTDcDc_VLAN204ControLow "" UBYTE RB_RBA_Common_CentralElements_CompuMethods_Identical 1 100 0.0 255.00 FORMAT "%8.2" ECU_ADDRESS 0xfe40319c /end MEASUREMENT
/begin MEASUREMENT Tlib_isInletCooltTSecDcDc_VLAN204ControLow "" UBYTE RB_RBA_Common_CentralElements_CompuMethods_Identical 1 100 0.0 255.00 FORMAT "%8.2" ECU_ADDRESS 0xfe40319d /end MEASUREMENT
/begin MEASUREMENT Tlib_isCooltLvl_VLAN204ControLow "" UBYTE RB_RBA_Common_CentralElements_CompuMethods_Identical 1 100 0.0 255.00 FORMAT "%8.2" ECU_ADDRESS 0xfe40319e /end MEASUREMENT
/begin MEASUREMENT Tlib_isCmptmtRelHumFild_VLAN204ControLow "" UBYTE RB_RBA_Common_CentralElements_CompuMethods_Identical 1 100 0.0 255.00 FORMAT "%8.2" ECU_ADDRESS 0xfe40319f /end MEASUREMENT
/begin MEASUREMENT Tlib_isCooltLvlSnsrFltSts_VLAN204ControLow "" UBYTE RB_RBA_Common_CentralElements_CompuMethods_Identical 1 100 0.0 255.00 FORMAT "%8.2" ECU_ADDRESS 0xfe4031a0 /end MEASUREMENT
/begin MEASUREMENT Tlib_isMessMissZCL_VLAN204ControLow "" UWORD RB_RBA_Common_CentralElements_CompuMethods_Identical 1 100 0.0 65535 FORMAT "%8.2" ECU_ADDRESS 0xfe4028e4 /end MEASUREMENT
/begin MEASUREMENT Tlib_isCmptmtFrntWindTFild_VLAN204ControLow "" UWORD RB_RBA_Common_CentralElements_CompuMethods_Identical 1 100 0.0 65535 FORMAT "%8.2" ECU_ADDRESS 0xfe4028e6 /end MEASUREMENT
/begin MEASUREMENT Tlib_isCmptmtFrntWindDewTFild_VLAN204ControLow "" UWORD RB_RBA_Common_CentralElements_CompuMethods_Identical 1 100 0.0 65535 FORMAT "%8.2" ECU_ADDRESS 0xfe4028e8 /end MEASUREMENT
/begin MEASUREMENT Tlib_isOnBdChrgrInletCooltT_VLAN204ControLow "" UBYTE RB_RBA_Common_CentralElements_CompuMethods_Identical 1 100 0.0 255.00 FORMAT "%8.2" ECU_ADDRESS 0xfe4031a1 /end MEASUREMENT
/begin MEASUREMENT Tlib_isMinCooltFlowDcDc_VLAN204ControLow "" UBYTE RB_RBA_Common_CentralElements_CompuMethods_Identical 1 100 0.0 255.00 FORMAT "%8.2" ECU_ADDRESS 0xfe4031a2 /end MEASUREMENT
/begin MEASUREMENT Tlib_isOnBdChrgrCoolgReq_VLAN204ControLow "" UBYTE RB_RBA_Common_CentralElements_CompuMethods_Identical 1 100 0.0 255.00 FORMAT "%8.2" ECU_ADDRESS 0xfe4031a3 /end MEASUREMENT
/begin MEASUREMENT Tlib_isOnBdChrgrMinCooltFlow_VLAN204ControLow "" UBYTE RB_RBA_Common_CentralElements_CompuMethods_Identical 1 100 0.0 255.00 FORMAT "%8.2" ECU_ADDRESS 0xfe4031a4 /end MEASUREMENT
/begin MEASUREMENT Tlib_isOnBdChrgrT_VLAN204ControLow "" UBYTE RB_RBA_Common_CentralElements_CompuMethods_Identical 1 100 0.0 255.00 FORMAT "%8.2" ECU_ADDRESS 0xfe4031a5 /end MEASUREMENT
/begin MEASUREMENT Tlib_isEmActivHeatAllwd_VLAN204ControLow "" UBYTE RB_RBA_Common_CentralElements_CompuMethods_Identical 1 100 0.0 255.00 FORMAT "%8.2" ECU_ADDRESS 0xfe4031a6 /end MEASUREMENT
/begin MEASUREMENT Tlib_isCoolgReqSecDcDc_VLAN204ControLow "" UBYTE RB_RBA_Common_CentralElements_CompuMethods_Identical 1 100 0.0 255.00 FORMAT "%8.2" ECU_ADDRESS 0xfe4031a7 /end MEASUREMENT
/begin MEASUREMENT Tlib_isTHvBoosterCoolInp_VLAN204ControLow "" UBYTE RB_RBA_Common_CentralElements_CompuMethods_Identical 1 100 0.0 255.00 FORMAT "%8.2" ECU_ADDRESS 0xfe4031a8 /end MEASUREMENT
/begin MEASUREMENT Tlib_isHvHeatgPwrAllwd_VLAN204ControLow "" UWORD RB_RBA_Common_CentralElements_CompuMethods_Identical 1 100 0.0 65535 FORMAT "%8.2" ECU_ADDRESS 0xfe4028ea /end MEASUREMENT
/begin MEASUREMENT Tlib_isHvThermEnad_VLAN204ControLow "" UBYTE RB_RBA_Common_CentralElements_CompuMethods_Identical 1 100 0.0 255.00 FORMAT "%8.2" ECU_ADDRESS 0xfe4031a9 /end MEASUREMENT
/begin MEASUREMENT Tlib_isHvBoosterMinCooltFlowReq_VLAN204ControLow "" UBYTE RB_RBA_Common_CentralElements_CompuMethods_Identical 1 100 0.0 255.00 FORMAT "%8.2" ECU_ADDRESS 0xfe4031aa /end MEASUREMENT
/begin MEASUREMENT Tlib_isTSecDcDc_VLAN204ControLow "" UBYTE RB_RBA_Common_CentralElements_CompuMethods_Identical 1 100 0.0 255.00 FORMAT "%8.2" ECU_ADDRESS 0xfe4031ab /end MEASUREMENT
/begin MEASUREMENT Tlib_isHvCoolgPwrAllwd_VLAN204ControLow "" UWORD RB_RBA_Common_CentralElements_CompuMethods_Identical 1 100 0.0 65535 FORMAT "%8.2" ECU_ADDRESS 0xfe4028ec /end MEASUREMENT
/begin MEASUREMENT Tlib_isHvBattCooltOutletT_VLAN204ControLow "" UWORD RB_RBA_Common_CentralElements_CompuMethods_Identical 1 100 0.0 65535 FORMAT "%8.2" ECU_ADDRESS 0xfe4028ee /end MEASUREMENT
/begin MEASUREMENT Tlib_isHvBattCooltInletT_VLAN204ControLow "" UWORD RB_RBA_Common_CentralElements_CompuMethods_Identical 1 100 0.0 65535 FORMAT "%8.2" ECU_ADDRESS 0xfe4028f0 /end MEASUREMENT
/begin MEASUREMENT Tlib_isWhlMotSysCoolgReq_VLAN204ControLow "" UBYTE RB_RBA_Common_CentralElements_CompuMethods_Identical 1 100 0.0 255.00 FORMAT "%8.2" ECU_ADDRESS 0xfe4031ac /end MEASUREMENT
/begin MEASUREMENT Tlib_isResrvdSig2ToZCR_VLAN204ControLow "" ULONG RB_RBA_Common_CentralElements_CompuMethods_Identical 1 100 0.0 4294967295 FORMAT "%8.2" ECU_ADDRESS 0xfe402778 /end MEASUREMENT
/begin MEASUREMENT Tlib_isResrvdSig1ToZCR_VLAN204ControLow "" ULONG RB_RBA_Common_CentralElements_CompuMethods_Identical 1 100 0.0 4294967295 FORMAT "%8.2" ECU_ADDRESS 0xfe40277c /end MEASUREMENT
/begin MEASUREMENT Tlib_isResrvdSig3ToZCR_VLAN204ControLow "" ULONG RB_RBA_Common_CentralElements_CompuMethods_Identical 1 100 0.0 4294967295 FORMAT "%8.2" ECU_ADDRESS 0xfe402780 /end MEASUREMENT
/begin MEASUREMENT Tlib_isHmiCmptmtTSpSecLeHmiCmptmtT_VLAN204ControLow "" UBYTE RB_RBA_Common_CentralElements_CompuMethods_Identical 1 100 0.0 255.00 FORMAT "%8.2" ECU_ADDRESS 0xfe4031ad /end MEASUREMENT
/begin MEASUREMENT Tlib_isHmiCmptmtTSpSecLeHmiCmptmtTSpSpcl_VLAN204ControLow "" UBYTE RB_RBA_Common_CentralElements_CompuMethods_Identical 1 100 0.0 255.00 FORMAT "%8.2" ECU_ADDRESS 0xfe4031ae /end MEASUREMENT
/begin MEASUREMENT Tlib_isHmiCmptmtTSpThirdLeHmiCmptmtTSpSpcl_VLAN204ControLow "" UBYTE RB_RBA_Common_CentralElements_CompuMethods_Identical 1 100 0.0 255.00 FORMAT "%8.2" ECU_ADDRESS 0xfe4031af /end MEASUREMENT
/begin MEASUREMENT Tlib_isHmiCmptmtTSpThirdLeHmiCmptmtT_VLAN204ControLow "" UBYTE RB_RBA_Common_CentralElements_CompuMethods_Identical 1 100 0.0 255.00 FORMAT "%8.2" ECU_ADDRESS 0xfe4031b0 /end MEASUREMENT
/begin MEASUREMENT Tlib_isHmiCmptmtTSpFirstRiHmiCmptmtT_VLAN204ControLow "" UBYTE RB_RBA_Common_CentralElements_CompuMethods_Identical 1 100 0.0 255.00 FORMAT "%8.2" ECU_ADDRESS 0xfe4031b1 /end MEASUREMENT
/begin MEASUREMENT Tlib_isHmiCmptmtTSpFirstRiHmiCmptmtTSpSpcl_VLAN204ControLow "" UBYTE RB_RBA_Common_CentralElements_CompuMethods_Identical 1 100 0.0 255.00 FORMAT "%8.2" ECU_ADDRESS 0xfe4031b2 /end MEASUREMENT
/begin MEASUREMENT Tlib_isHmiCmptmtTSpFirstLeHmiCmptmtT_VLAN204ControLow "" UBYTE RB_RBA_Common_CentralElements_CompuMethods_Identical 1 100 0.0 255.00 FORMAT "%8.2" ECU_ADDRESS 0xfe4031b3 /end MEASUREMENT
/begin MEASUREMENT Tlib_isHmiCmptmtTSpFirstLeHmiCmptmtTSpSpcl_VLAN204ControLow "" UBYTE RB_RBA_Common_CentralElements_CompuMethods_Identical 1 100 0.0 255.00 FORMAT "%8.2" ECU_ADDRESS 0xfe4031b4 /end MEASUREMENT
/begin MEASUREMENT Tlib_isHmiCmptmtTSpSecRiHmiCmptmtTSpSpcl_VLAN204ControLow "" UBYTE RB_RBA_Common_CentralElements_CompuMethods_Identical 1 100 0.0 255.00 FORMAT "%8.2" ECU_ADDRESS 0xfe4031b5 /end MEASUREMENT
/begin MEASUREMENT Tlib_isHmiCmptmtTSpSecRiHmiCmptmtT_VLAN204ControLow "" UBYTE RB_RBA_Common_CentralElements_CompuMethods_Identical 1 100 0.0 255.00 FORMAT "%8.2" ECU_ADDRESS 0xfe4031b6 /end MEASUREMENT
/begin MEASUREMENT Tlib_isHmiCmptmtTSpThirdRiHmiCmptmtTSpSpcl_VLAN204ControLow "" UBYTE RB_RBA_Common_CentralElements_CompuMethods_Identical 1 100 0.0 255.00 FORMAT "%8.2" ECU_ADDRESS 0xfe4031b7 /end MEASUREMENT
/begin MEASUREMENT Tlib_isHmiCmptmtTSpThirdRiHmiCmptmtT_VLAN204ControLow "" UBYTE RB_RBA_Common_CentralElements_CompuMethods_Identical 1 100 0.0 255.00 FORMAT "%8.2" ECU_ADDRESS 0xfe4031b8 /end MEASUREMENT
/begin MEASUREMENT Tlib_isElEgyLvlLvlElecSubtyp_VLAN204ControLow "" UBYTE RB_RBA_Common_CentralElements_CompuMethods_Identical 1 100 0.0 255.00 FORMAT "%8.2" ECU_ADDRESS 0xfe4031b9 /end MEASUREMENT
/begin MEASUREMENT Tlib_isElEgyLvlLvlElecMai_VLAN204ControLow "" UBYTE RB_RBA_Common_CentralElements_CompuMethods_Identical 1 100 0.0 255.00 FORMAT "%8.2" ECU_ADDRESS 0xfe4031ba /end MEASUREMENT
/begin MEASUREMENT Tlib_isWhlMotSysRiMotT_VLAN204ControLow "" UBYTE RB_RBA_Common_CentralElements_CompuMethods_Identical 1 100 0.0 255.00 FORMAT "%8.2" ECU_ADDRESS 0xfe4031bb /end MEASUREMENT
/begin MEASUREMENT Tlib_isWhlMotSysMotT_VLAN204ControLow "" UBYTE RB_RBA_Common_CentralElements_CompuMethods_Identical 1 100 0.0 255.00 FORMAT "%8.2" ECU_ADDRESS 0xfe4031bc /end MEASUREMENT
/begin MEASUREMENT Tlib_isWhlMotSysInvrT_VLAN204ControLow "" UBYTE RB_RBA_Common_CentralElements_CompuMethods_Identical 1 100 0.0 255.00 FORMAT "%8.2" ECU_ADDRESS 0xfe4031bd /end MEASUREMENT
/begin MEASUREMENT Tlib_isWhlMotSysRiCoolgReq_VLAN204ControLow "" UBYTE RB_RBA_Common_CentralElements_CompuMethods_Identical 1 100 0.0 255.00 FORMAT "%8.2" ECU_ADDRESS 0xfe4031be /end MEASUREMENT
/begin MEASUREMENT Tlib_isHvBattPmpStatCooltPmpI_VLAN204ControLow "" UBYTE RB_RBA_Common_CentralElements_CompuMethods_Identical 1 100 0.0 255.00 FORMAT "%8.2" ECU_ADDRESS 0xfe4031bf /end MEASUREMENT
/begin MEASUREMENT Tlib_isHvBattPmpStatCooltPmpDryErr_VLAN204ControLow "" UBYTE RB_RBA_Common_CentralElements_CompuMethods_Identical 1 100 0.0 255.00 FORMAT "%8.2" ECU_ADDRESS 0xfe4031c0 /end MEASUREMENT
/begin MEASUREMENT Tlib_isHvBattPmpStatCooltPmpTErr_VLAN204ControLow "" UBYTE RB_RBA_Common_CentralElements_CompuMethods_Identical 1 100 0.0 255.00 FORMAT "%8.2" ECU_ADDRESS 0xfe4031c1 /end MEASUREMENT
/begin MEASUREMENT Tlib_isHvBattPmpStatCooltPmpU_VLAN204ControLow "" UBYTE RB_RBA_Common_CentralElements_CompuMethods_Identical 1 100 0.0 255.00 FORMAT "%8.2" ECU_ADDRESS 0xfe4031c2 /end MEASUREMENT
/begin MEASUREMENT Tlib_isHvBattPmpStatCooltPmpIErr_VLAN204ControLow "" UBYTE RB_RBA_Common_CentralElements_CompuMethods_Identical 1 100 0.0 255.00 FORMAT "%8.2" ECU_ADDRESS 0xfe4031c3 /end MEASUREMENT
/begin MEASUREMENT Tlib_isHvBattPmpStatCooltPmpSpd_VLAN204ControLow "" UBYTE RB_RBA_Common_CentralElements_CompuMethods_Identical 1 100 0.0 255.00 FORMAT "%8.2" ECU_ADDRESS 0xfe4031c4 /end MEASUREMENT
/begin MEASUREMENT Tlib_isHvBattPmpStatCooltPmpSetPostRunReq_VLAN204ControLow "" UBYTE RB_RBA_Common_CentralElements_CompuMethods_Identical 1 100 0.0 255.00 FORMAT "%8.2" ECU_ADDRESS 0xfe4031c5 /end MEASUREMENT
/begin MEASUREMENT Tlib_isHvBattPmpStatCooltPmpPostRunSts_VLAN204ControLow "" UBYTE RB_RBA_Common_CentralElements_CompuMethods_Identical 1 100 0.0 255.00 FORMAT "%8.2" ECU_ADDRESS 0xfe4031c6 /end MEASUREMENT
/begin MEASUREMENT Tlib_isHvBattPmpStatCooltPmpEmgyModSts_VLAN204ControLow "" UBYTE RB_RBA_Common_CentralElements_CompuMethods_Identical 1 100 0.0 255.00 FORMAT "%8.2" ECU_ADDRESS 0xfe4031c7 /end MEASUREMENT
/begin MEASUREMENT Tlib_isHvBattPmpStatCooltPmpMonrSpd_VLAN204ControLow "" UBYTE RB_RBA_Common_CentralElements_CompuMethods_Identical 1 100 0.0 255.00 FORMAT "%8.2" ECU_ADDRESS 0xfe4031c8 /end MEASUREMENT
/begin MEASUREMENT Tlib_isHvBattPmpStatCooltPmpT_VLAN204ControLow "" UBYTE RB_RBA_Common_CentralElements_CompuMethods_Identical 1 100 0.0 255.00 FORMAT "%8.2" ECU_ADDRESS 0xfe4031c9 /end MEASUREMENT
/begin MEASUREMENT Tlib_isHvBattPmpStatCooltPmpUErr_VLAN204ControLow "" UBYTE RB_RBA_Common_CentralElements_CompuMethods_Identical 1 100 0.0 255.00 FORMAT "%8.2" ECU_ADDRESS 0xfe4031ca /end MEASUREMENT
/begin MEASUREMENT Tlib_isHvBattPmpStatCooltPmpSetSpdReq_VLAN204ControLow "" UBYTE RB_RBA_Common_CentralElements_CompuMethods_Identical 1 100 0.0 255.00 FORMAT "%8.2" ECU_ADDRESS 0xfe4031cb /end MEASUREMENT
/begin MEASUREMENT Tlib_isHvBattPmpStatCooltPmpErrSts_VLAN204ControLow "" UBYTE RB_RBA_Common_CentralElements_CompuMethods_Identical 1 100 0.0 255.00 FORMAT "%8.2" ECU_ADDRESS 0xfe4031cc /end MEASUREMENT
/begin MEASUREMENT Tlib_isHvBattPmpStatCooltPmpUnstallSts_VLAN204ControLow "" UBYTE RB_RBA_Common_CentralElements_CompuMethods_Identical 1 100 0.0 255.00 FORMAT "%8.2" ECU_ADDRESS 0xfe4031cd /end MEASUREMENT
/begin MEASUREMENT Tlib_isRefriRT2SnsrTQf_VLAN204ControLow "" UBYTE RB_RBA_Common_CentralElements_CompuMethods_Identical 1 100 0.0 255.00 FORMAT "%8.2" ECU_ADDRESS 0xfe4031ce /end MEASUREMENT
/begin MEASUREMENT Tlib_isRefriRT2SnsrT_VLAN204ControLow "" UWORD RB_RBA_Common_CentralElements_CompuMethods_Identical 1 100 0.0 65535 FORMAT "%8.2" ECU_ADDRESS 0xfe4028f2 /end MEASUREMENT
/begin MEASUREMENT Tlib_isRainfallAmnt_0_VLAN204ControLow "" UBYTE RB_RBA_Common_CentralElements_CompuMethods_Identical 1 100 0.0 255.00 FORMAT "%8.2" ECU_ADDRESS 0xfe4031cf /end MEASUREMENT
/begin MEASUREMENT Tlib_isSecGrlHldTrqActive_VLAN204ControLow "" UBYTE RB_RBA_Common_CentralElements_CompuMethods_Identical 1 100 0.0 255.00 FORMAT "%8.2" ECU_ADDRESS 0xfe4031d0 /end MEASUREMENT
/begin MEASUREMENT Tlib_isSecGrlShttrOvertravelErr_VLAN204ControLow "" UBYTE RB_RBA_Common_CentralElements_CompuMethods_Identical 1 100 0.0 255.00 FORMAT "%8.2" ECU_ADDRESS 0xfe4031d1 /end MEASUREMENT
/begin MEASUREMENT Tlib_isSecGrlShttrStsShttrTErr_VLAN204ControLow "" UBYTE RB_RBA_Common_CentralElements_CompuMethods_Identical 1 100 0.0 255.00 FORMAT "%8.2" ECU_ADDRESS 0xfe4031d2 /end MEASUREMENT
/begin MEASUREMENT Tlib_isSecGrlShttrStsShttrBlkd_VLAN204ControLow "" UBYTE RB_RBA_Common_CentralElements_CompuMethods_Identical 1 100 0.0 255.00 FORMAT "%8.2" ECU_ADDRESS 0xfe4031d3 /end MEASUREMENT
/begin MEASUREMENT Tlib_isSecGrlShttrStsShttrCalIndcd_VLAN204ControLow "" UBYTE RB_RBA_Common_CentralElements_CompuMethods_Identical 1 100 0.0 255.00 FORMAT "%8.2" ECU_ADDRESS 0xfe4031d4 /end MEASUREMENT
/begin MEASUREMENT Tlib_isSecGrlShttrStsShttrCalActv_VLAN204ControLow "" UBYTE RB_RBA_Common_CentralElements_CompuMethods_Identical 1 100 0.0 255.00 FORMAT "%8.2" ECU_ADDRESS 0xfe4031d5 /end MEASUREMENT
/begin MEASUREMENT Tlib_isSecGrlShttrStsShttrSnsrFlt_VLAN204ControLow "" UBYTE RB_RBA_Common_CentralElements_CompuMethods_Identical 1 100 0.0 255.00 FORMAT "%8.2" ECU_ADDRESS 0xfe4031d6 /end MEASUREMENT
/begin MEASUREMENT Tlib_isSecGrlShttrStsShttrPosnRaw_VLAN204ControLow "" UBYTE RB_RBA_Common_CentralElements_CompuMethods_Identical 1 100 0.0 255.00 FORMAT "%8.2" ECU_ADDRESS 0xfe4031d7 /end MEASUREMENT
/begin MEASUREMENT Tlib_isSecGrlShttrStsShttrULoErr_VLAN204ControLow "" UBYTE RB_RBA_Common_CentralElements_CompuMethods_Identical 1 100 0.0 255.00 FORMAT "%8.2" ECU_ADDRESS 0xfe4031d8 /end MEASUREMENT
/begin MEASUREMENT Tlib_isSecGrlShttrStsShttrActrFlt_VLAN204ControLow "" UBYTE RB_RBA_Common_CentralElements_CompuMethods_Identical 1 100 0.0 255.00 FORMAT "%8.2" ECU_ADDRESS 0xfe4031d9 /end MEASUREMENT
/begin MEASUREMENT Tlib_isSecGrlShttrStsShttrElecErr_VLAN204ControLow "" UBYTE RB_RBA_Common_CentralElements_CompuMethods_Identical 1 100 0.0 255.00 FORMAT "%8.2" ECU_ADDRESS 0xfe4031da /end MEASUREMENT
/begin MEASUREMENT Tlib_isSecGrlShttrOverVolt_VLAN204ControLow "" UBYTE RB_RBA_Common_CentralElements_CompuMethods_Identical 1 100 0.0 255.00 FORMAT "%8.2" ECU_ADDRESS 0xfe4031db /end MEASUREMENT
/begin MEASUREMENT Tlib_isSecGrlShttrMoveActive_VLAN204ControLow "" UBYTE RB_RBA_Common_CentralElements_CompuMethods_Identical 1 100 0.0 255.00 FORMAT "%8.2" ECU_ADDRESS 0xfe4031dc /end MEASUREMENT
/begin MEASUREMENT Tlib_isSecGrlActTrqBoost_VLAN204ControLow "" UBYTE RB_RBA_Common_CentralElements_CompuMethods_Identical 1 100 0.0 255.00 FORMAT "%8.2" ECU_ADDRESS 0xfe4031dd /end MEASUREMENT
/begin MEASUREMENT Tlib_isSecGrlShttrNVMFlt_VLAN204ControLow "" UBYTE RB_RBA_Common_CentralElements_CompuMethods_Identical 1 100 0.0 255.00 FORMAT "%8.2" ECU_ADDRESS 0xfe4031de /end MEASUREMENT
/begin MEASUREMENT Tlib_SecBattCpEstimd_ZCR_LIN9 "" UBYTE RB_RBA_Common_CentralElements_CompuMethods_Identical 1 100 0.0 255.00 FORMAT "%8.2" ECU_ADDRESS 0xfe4031df /end MEASUREMENT
/begin MEASUREMENT Tlib_SecBattCircOpenU_ZCR_LIN9 "" UBYTE RB_RBA_Common_CentralElements_CompuMethods_Identical 1 100 0.0 255.00 FORMAT "%8.2" ECU_ADDRESS 0xfe4031e0 /end MEASUREMENT
/begin MEASUREMENT Tlib_SecBattSnsrCalcnNotVld_ZCR_LIN9 "" UBYTE RB_RBA_Common_CentralElements_CompuMethods_Identical 1 100 0.0 255.00 FORMAT "%8.2" ECU_ADDRESS 0xfe4031e1 /end MEASUREMENT
/begin MEASUREMENT Tlib_SecBattChrgnAndDisChrgnBal_ZCR_LIN9 "" UWORD RB_RBA_Common_CentralElements_CompuMethods_Identical 1 100 0.0 65535 FORMAT "%8.2" ECU_ADDRESS 0xfe4028f4 /end MEASUREMENT
/begin MEASUREMENT Tlib_SecBattSOH_ZCR_LIN9 "" UWORD RB_RBA_Common_CentralElements_CompuMethods_Identical 1 100 0.0 65535 FORMAT "%8.2" ECU_ADDRESS 0xfe4028f6 /end MEASUREMENT
/begin MEASUREMENT Tlib_SecBattRAtTNom_ZCR_LIN9 "" UWORD RB_RBA_Common_CentralElements_CompuMethods_Identical 1 100 0.0 65535 FORMAT "%8.2" ECU_ADDRESS 0xfe4028f8 /end MEASUREMENT
/begin MEASUREMENT Tlib_SecBattCpEstimdAtTNom_ZCR_LIN9 "" UBYTE RB_RBA_Common_CentralElements_CompuMethods_Identical 1 100 0.0 255.00 FORMAT "%8.2" ECU_ADDRESS 0xfe4031e2 /end MEASUREMENT
/begin MEASUREMENT Tlib_SecBattR_ZCR_LIN9 "" UWORD RB_RBA_Common_CentralElements_CompuMethods_Identical 1 100 0.0 65535 FORMAT "%8.2" ECU_ADDRESS 0xfe4028fa /end MEASUREMENT
/begin MEASUREMENT Tlib_SecBattSOC_ZCR_LIN9 "" UWORD RB_RBA_Common_CentralElements_CompuMethods_Identical 1 100 0.0 65535 FORMAT "%8.2" ECU_ADDRESS 0xfe4028fc /end MEASUREMENT
/begin MEASUREMENT Tlib_SecBattTiInSrv_ZCR_LIN9 "" UWORD RB_RBA_Common_CentralElements_CompuMethods_Identical 1 100 0.0 65535 FORMAT "%8.2" ECU_ADDRESS 0xfe4028fe /end MEASUREMENT
/begin MEASUREMENT Tlib_SprCapTCellBattTCell1_ZCR_LIN9 "" UWORD RB_RBA_Common_CentralElements_CompuMethods_Identical 1 100 0.0 65535 FORMAT "%8.2" ECU_ADDRESS 0xfe402900 /end MEASUREMENT
/begin MEASUREMENT Tlib_SprCapTCellBattTCell3_ZCR_LIN9 "" UWORD RB_RBA_Common_CentralElements_CompuMethods_Identical 1 100 0.0 65535 FORMAT "%8.2" ECU_ADDRESS 0xfe402902 /end MEASUREMENT
/begin MEASUREMENT Tlib_SprCapTCellBattTCell2_ZCR_LIN9 "" UWORD RB_RBA_Common_CentralElements_CompuMethods_Identical 1 100 0.0 65535 FORMAT "%8.2" ECU_ADDRESS 0xfe402904 /end MEASUREMENT
/begin MEASUREMENT Tlib_SecBattT_ZCR_LIN9 "" UWORD RB_RBA_Common_CentralElements_CompuMethods_Identical 1 100 0.0 65535 FORMAT "%8.2" ECU_ADDRESS 0xfe402906 /end MEASUREMENT
/begin MEASUREMENT Tlib_WakeUpReasonSec_ZCR_LIN9 "" UBYTE RB_RBA_Common_CentralElements_CompuMethods_Identical 1 100 0.0 255.00 FORMAT "%8.2" ECU_ADDRESS 0xfe4031e3 /end MEASUREMENT
/begin MEASUREMENT Tlib_SecBattMosStsChks8_ZCR_LIN9 "" UBYTE RB_RBA_Common_CentralElements_CompuMethods_Identical 1 100 0.0 255.00 FORMAT "%8.2" ECU_ADDRESS 0xfe4031e4 /end MEASUREMENT
/begin MEASUREMENT Tlib_SecBattMosStsCntr4_ZCR_LIN9 "" UBYTE RB_RBA_Common_CentralElements_CompuMethods_Identical 1 100 0.0 255.00 FORMAT "%8.2" ECU_ADDRESS 0xfe4031e5 /end MEASUREMENT
/begin MEASUREMENT Tlib_SecBattMosStsDataID4_ZCR_LIN9 "" UBYTE RB_RBA_Common_CentralElements_CompuMethods_Identical 1 100 0.0 255.00 FORMAT "%8.2" ECU_ADDRESS 0xfe4031e6 /end MEASUREMENT
/begin MEASUREMENT Tlib_SecBattMosStsSwtSts_ZCR_LIN9 "" UBYTE RB_RBA_Common_CentralElements_CompuMethods_Identical 1 100 0.0 255.00 FORMAT "%8.2" ECU_ADDRESS 0xfe4031e7 /end MEASUREMENT
/begin MEASUREMENT Tlib_SecBattIDataID4_ZCR_LIN9 "" UBYTE RB_RBA_Common_CentralElements_CompuMethods_Identical 1 100 0.0 255.00 FORMAT "%8.2" ECU_ADDRESS 0xfe4031e8 /end MEASUREMENT
/begin MEASUREMENT Tlib_SecBattIBattI_ZCR_LIN9 "" UWORD RB_RBA_Common_CentralElements_CompuMethods_Identical 1 100 0.0 65535 FORMAT "%8.2" ECU_ADDRESS 0xfe402908 /end MEASUREMENT
/begin MEASUREMENT Tlib_SecBattICntr4_ZCR_LIN9 "" UBYTE RB_RBA_Common_CentralElements_CompuMethods_Identical 1 100 0.0 255.00 FORMAT "%8.2" ECU_ADDRESS 0xfe4031e9 /end MEASUREMENT
/begin MEASUREMENT Tlib_SecBattIChks8_ZCR_LIN9 "" UBYTE RB_RBA_Common_CentralElements_CompuMethods_Identical 1 100 0.0 255.00 FORMAT "%8.2" ECU_ADDRESS 0xfe4031ea /end MEASUREMENT
/begin MEASUREMENT Tlib_SecBattUCntr4_ZCR_LIN9 "" UBYTE RB_RBA_Common_CentralElements_CompuMethods_Identical 1 100 0.0 255.00 FORMAT "%8.2" ECU_ADDRESS 0xfe4031eb /end MEASUREMENT
/begin MEASUREMENT Tlib_SecBattUDataID4_ZCR_LIN9 "" UBYTE RB_RBA_Common_CentralElements_CompuMethods_Identical 1 100 0.0 255.00 FORMAT "%8.2" ECU_ADDRESS 0xfe4031ec /end MEASUREMENT
/begin MEASUREMENT Tlib_SecBattUBattU_ZCR_LIN9 "" UWORD RB_RBA_Common_CentralElements_CompuMethods_Identical 1 100 0.0 65535 FORMAT "%8.2" ECU_ADDRESS 0xfe40290a /end MEASUREMENT
/begin MEASUREMENT Tlib_SecBattUChks8_ZCR_LIN9 "" UBYTE RB_RBA_Common_CentralElements_CompuMethods_Identical 1 100 0.0 255.00 FORMAT "%8.2" ECU_ADDRESS 0xfe4031ed /end MEASUREMENT
/begin MEASUREMENT Tlib_SecBattFltStsCntr4_ZCR_LIN9 "" UBYTE RB_RBA_Common_CentralElements_CompuMethods_Identical 1 100 0.0 255.00 FORMAT "%8.2" ECU_ADDRESS 0xfe4031ee /end MEASUREMENT
/begin MEASUREMENT Tlib_SecBattFltStsChks8_ZCR_LIN9 "" UBYTE RB_RBA_Common_CentralElements_CompuMethods_Identical 1 100 0.0 255.00 FORMAT "%8.2" ECU_ADDRESS 0xfe4031ef /end MEASUREMENT
/begin MEASUREMENT Tlib_SecBattFltStsDataID4_ZCR_LIN9 "" UBYTE RB_RBA_Common_CentralElements_CompuMethods_Identical 1 100 0.0 255.00 FORMAT "%8.2" ECU_ADDRESS 0xfe4031f0 /end MEASUREMENT
/begin MEASUREMENT Tlib_SecBattFltStsSts_ZCR_LIN9 "" UWORD RB_RBA_Common_CentralElements_CompuMethods_Identical 1 100 0.0 65535 FORMAT "%8.2" ECU_ADDRESS 0xfe40290c /end MEASUREMENT
/begin MEASUREMENT Tlib_BMSBFltStsSts_ZCR_LIN9 "" UWORD RB_RBA_Common_CentralElements_CompuMethods_Identical 1 100 0.0 65535 FORMAT "%8.2" ECU_ADDRESS 0xfe40290e /end MEASUREMENT
/begin MEASUREMENT Tlib_BMSBFltStsDataID4_ZCR_LIN9 "" UBYTE RB_RBA_Common_CentralElements_CompuMethods_Identical 1 100 0.0 255.00 FORMAT "%8.2" ECU_ADDRESS 0xfe4031f1 /end MEASUREMENT
/begin MEASUREMENT Tlib_BMSBFltStsChks8_ZCR_LIN9 "" UBYTE RB_RBA_Common_CentralElements_CompuMethods_Identical 1 100 0.0 255.00 FORMAT "%8.2" ECU_ADDRESS 0xfe4031f2 /end MEASUREMENT
/begin MEASUREMENT Tlib_BMSBFltStsCntr4_ZCR_LIN9 "" UBYTE RB_RBA_Common_CentralElements_CompuMethods_Identical 1 100 0.0 255.00 FORMAT "%8.2" ECU_ADDRESS 0xfe4031f3 /end MEASUREMENT
/begin MEASUREMENT Tlib_SprCapUCell1To3SprCapUCell5_ZCR_LIN9 "" UWORD RB_RBA_Common_CentralElements_CompuMethods_Identical 1 100 0.0 65535 FORMAT "%8.2" ECU_ADDRESS 0xfe402910 /end MEASUREMENT
/begin MEASUREMENT Tlib_SprCapUCell1To3SprCapUCell4_ZCR_LIN9 "" UWORD RB_RBA_Common_CentralElements_CompuMethods_Identical 1 100 0.0 65535 FORMAT "%8.2" ECU_ADDRESS 0xfe402912 /end MEASUREMENT
/begin MEASUREMENT Tlib_SprCapUCell1To3SprCapUCell6_ZCR_LIN9 "" UWORD RB_RBA_Common_CentralElements_CompuMethods_Identical 1 100 0.0 65535 FORMAT "%8.2" ECU_ADDRESS 0xfe402914 /end MEASUREMENT
/begin MEASUREMENT Tlib_SprCapUCell4To6SprCapUCell4_ZCR_LIN9 "" UWORD RB_RBA_Common_CentralElements_CompuMethods_Identical 1 100 0.0 65535 FORMAT "%8.2" ECU_ADDRESS 0xfe402916 /end MEASUREMENT
/begin MEASUREMENT Tlib_SprCapUCell4To6SprCapUCell5_ZCR_LIN9 "" UWORD RB_RBA_Common_CentralElements_CompuMethods_Identical 1 100 0.0 65535 FORMAT "%8.2" ECU_ADDRESS 0xfe402918 /end MEASUREMENT
/begin MEASUREMENT Tlib_SprCapUCell4To6SprCapUCell6_ZCR_LIN9 "" UWORD RB_RBA_Common_CentralElements_CompuMethods_Identical 1 100 0.0 65535 FORMAT "%8.2" ECU_ADDRESS 0xfe40291a /end MEASUREMENT
/begin MEASUREMENT Tlib_isAccrPedlRatAccrPedlRat_0_VLAN206ControlHigh "" UWORD RB_RBA_Common_CentralElements_CompuMethods_Identical 1 100 0.0 65535 FORMAT "%8.2" ECU_ADDRESS 0xfe40291c /end MEASUREMENT
/begin MEASUREMENT Tlib_isAccrPedlRatDataID4_0_VLAN206ControlHigh "" UBYTE RB_RBA_Common_CentralElements_CompuMethods_Identical 1 100 0.0 255.00 FORMAT "%8.2" ECU_ADDRESS 0xfe4031f4 /end MEASUREMENT
/begin MEASUREMENT Tlib_isAccrPedlRatChks8_0_VLAN206ControlHigh "" UBYTE RB_RBA_Common_CentralElements_CompuMethods_Identical 1 100 0.0 255.00 FORMAT "%8.2" ECU_ADDRESS 0xfe4031f5 /end MEASUREMENT
/begin MEASUREMENT Tlib_isAccrPedlRatCntr4_0_VLAN206ControlHigh "" UBYTE RB_RBA_Common_CentralElements_CompuMethods_Identical 1 100 0.0 255.00 FORMAT "%8.2" ECU_ADDRESS 0xfe4031f6 /end MEASUREMENT
/begin MEASUREMENT Tlib_isHvBattSoc_VLAN206ControlHigh "" UWORD RB_RBA_Common_CentralElements_CompuMethods_Identical 1 100 0.0 65535 FORMAT "%8.2" ECU_ADDRESS 0xfe40291e /end MEASUREMENT
/begin MEASUREMENT Tlib_isHvBattUDc_VLAN206ControlHigh "" UWORD RB_RBA_Common_CentralElements_CompuMethods_Identical 1 100 0.0 65535 FORMAT "%8.2" ECU_ADDRESS 0xfe402920 /end MEASUREMENT
/begin MEASUREMENT Tlib_isHvSysRlyStsDataID4_0_VLAN206ControlHigh "" UBYTE RB_RBA_Common_CentralElements_CompuMethods_Identical 1 100 0.0 255.00 FORMAT "%8.2" ECU_ADDRESS 0xfe4031f7 /end MEASUREMENT
/begin MEASUREMENT Tlib_isHvSysRlyStsChks8_0_VLAN206ControlHigh "" UBYTE RB_RBA_Common_CentralElements_CompuMethods_Identical 1 100 0.0 255.00 FORMAT "%8.2" ECU_ADDRESS 0xfe4031f8 /end MEASUREMENT
/begin MEASUREMENT Tlib_isHvSysRlyStsCntr4_0_VLAN206ControlHigh "" UBYTE RB_RBA_Common_CentralElements_CompuMethods_Identical 1 100 0.0 255.00 FORMAT "%8.2" ECU_ADDRESS 0xfe4031f9 /end MEASUREMENT
/begin MEASUREMENT Tlib_isHvSysRlyStsRly_0_VLAN206ControlHigh "" UBYTE RB_RBA_Common_CentralElements_CompuMethods_Identical 1 100 0.0 255.00 FORMAT "%8.2" ECU_ADDRESS 0xfe4031fa /end MEASUREMENT
/begin MEASUREMENT Tlib_isUtcTiGlbUtcTiVal_0_VLAN206ControlHigh "" ULONG RB_RBA_Common_CentralElements_CompuMethods_Identical 1 100 0.0 4294967295 FORMAT "%8.2" ECU_ADDRESS 0xfe402784 /end MEASUREMENT
/begin MEASUREMENT Tlib_isUtcTiGlbDataValid_0_VLAN206ControlHigh "" UBYTE RB_RBA_Common_CentralElements_CompuMethods_Identical 1 100 0.0 255.00 FORMAT "%8.2" ECU_ADDRESS 0xfe4031fb /end MEASUREMENT
/begin MEASUREMENT Tlib_isVehLVSysUZCLVehLVSysUBkp_0_VLAN206ControlHigh "" UBYTE RB_RBA_Common_CentralElements_CompuMethods_Identical 1 100 0.0 255.00 FORMAT "%8.2" ECU_ADDRESS 0xfe4031fc /end MEASUREMENT
/begin MEASUREMENT Tlib_isVehLVSysUZCLVehLVSysUMai_0_VLAN206ControlHigh "" UBYTE RB_RBA_Common_CentralElements_CompuMethods_Identical 1 100 0.0 255.00 FORMAT "%8.2" ECU_ADDRESS 0xfe4031fd /end MEASUREMENT
/begin MEASUREMENT Tlib_isOdoMeter_0_VLAN206ControlHigh "" ULONG RB_RBA_Common_CentralElements_CompuMethods_Identical 1 100 0.0 4294967295 FORMAT "%8.2" ECU_ADDRESS 0xfe402788 /end MEASUREMENT
/begin MEASUREMENT Tlib_isHvBattCooltTReq_VLAN201BE "" UBYTE RB_RBA_Common_CentralElements_CompuMethods_Identical 1 100 0.0 255.00 FORMAT "%8.2" ECU_ADDRESS 0xfe4031fe /end MEASUREMENT
/begin MEASUREMENT Tlib_isHvBattTAvg_VLAN201BE "" SWORD RB_RBA_Common_CentralElements_CompuMethods_Identical 1 100 -32768 32767 FORMAT "%8.2" ECU_ADDRESS 0xfe402922 /end MEASUREMENT
/begin MEASUREMENT Tlib_isHvBattTMin_VLAN201BE "" SWORD RB_RBA_Common_CentralElements_CompuMethods_Identical 1 100 -32768 32767 FORMAT "%8.2" ECU_ADDRESS 0xfe402924 /end MEASUREMENT
/begin MEASUREMENT Tlib_isHvBattTMax_VLAN201BE "" SWORD RB_RBA_Common_CentralElements_CompuMethods_Identical 1 100 -32768 32767 FORMAT "%8.2" ECU_ADDRESS 0xfe402926 /end MEASUREMENT
/begin MEASUREMENT Tlib_isHctvStsVlvPreHeatgSts_VLAN201BE "" UBYTE RB_RBA_Common_CentralElements_CompuMethods_Identical 1 100 0.0 255.00 FORMAT "%8.2" ECU_ADDRESS 0xfe4031ff /end MEASUREMENT
/begin MEASUREMENT Tlib_isHctvStsVlvOverTWarn_VLAN201BE "" UBYTE RB_RBA_Common_CentralElements_CompuMethods_Identical 1 100 0.0 255.00 FORMAT "%8.2" ECU_ADDRESS 0xfe403200 /end MEASUREMENT
/begin MEASUREMENT Tlib_isHctvStsVlvOverUErr_VLAN201BE "" UBYTE RB_RBA_Common_CentralElements_CompuMethods_Identical 1 100 0.0 255.00 FORMAT "%8.2" ECU_ADDRESS 0xfe403201 /end MEASUREMENT
/begin MEASUREMENT Tlib_isHctvStsVlvSelfLearnFlt_VLAN201BE "" UBYTE RB_RBA_Common_CentralElements_CompuMethods_Identical 1 100 0.0 255.00 FORMAT "%8.2" ECU_ADDRESS 0xfe403202 /end MEASUREMENT
/begin MEASUREMENT Tlib_isHctvStsVlvMoveSts_VLAN201BE "" UBYTE RB_RBA_Common_CentralElements_CompuMethods_Identical 1 100 0.0 255.00 FORMAT "%8.2" ECU_ADDRESS 0xfe403203 /end MEASUREMENT
/begin MEASUREMENT Tlib_isHctvStsVlvPosn_VLAN201BE "" UWORD RB_RBA_Common_CentralElements_CompuMethods_Identical 1 100 0.0 65535 FORMAT "%8.2" ECU_ADDRESS 0xfe402928 /end MEASUREMENT
/begin MEASUREMENT Tlib_isHctvStsVlvSpdLvlSts_VLAN201BE "" UBYTE RB_RBA_Common_CentralElements_CompuMethods_Identical 1 100 0.0 255.00 FORMAT "%8.2" ECU_ADDRESS 0xfe403204 /end MEASUREMENT
/begin MEASUREMENT Tlib_isHctvStsVlvShoCircFlt_VLAN201BE "" UBYTE RB_RBA_Common_CentralElements_CompuMethods_Identical 1 100 0.0 255.00 FORMAT "%8.2" ECU_ADDRESS 0xfe403205 /end MEASUREMENT
/begin MEASUREMENT Tlib_isHctvStsVlvCalibSts_VLAN201BE "" UBYTE RB_RBA_Common_CentralElements_CompuMethods_Identical 1 100 0.0 255.00 FORMAT "%8.2" ECU_ADDRESS 0xfe403206 /end MEASUREMENT
/begin MEASUREMENT Tlib_isHctvStsVlvCmdPosnErr_VLAN201BE "" UBYTE RB_RBA_Common_CentralElements_CompuMethods_Identical 1 100 0.0 255.00 FORMAT "%8.2" ECU_ADDRESS 0xfe403207 /end MEASUREMENT
/begin MEASUREMENT Tlib_isHctvStsVlvOpenCircFlt_VLAN201BE "" UBYTE RB_RBA_Common_CentralElements_CompuMethods_Identical 1 100 0.0 255.00 FORMAT "%8.2" ECU_ADDRESS 0xfe403208 /end MEASUREMENT
/begin MEASUREMENT Tlib_isHctvStsVlvNVMFlt_VLAN201BE "" UBYTE RB_RBA_Common_CentralElements_CompuMethods_Identical 1 100 0.0 255.00 FORMAT "%8.2" ECU_ADDRESS 0xfe403209 /end MEASUREMENT
/begin MEASUREMENT Tlib_isHctvStsVlvBlkFlt_VLAN201BE "" UBYTE RB_RBA_Common_CentralElements_CompuMethods_Identical 1 100 0.0 255.00 FORMAT "%8.2" ECU_ADDRESS 0xfe40320a /end MEASUREMENT
/begin MEASUREMENT Tlib_isHctvStsVlvUnderUErr_VLAN201BE "" UBYTE RB_RBA_Common_CentralElements_CompuMethods_Identical 1 100 0.0 255.00 FORMAT "%8.2" ECU_ADDRESS 0xfe40320b /end MEASUREMENT
/begin MEASUREMENT Tlib_isHctvStsVlvOverTErr_VLAN201BE "" UBYTE RB_RBA_Common_CentralElements_CompuMethods_Identical 1 100 0.0 255.00 FORMAT "%8.2" ECU_ADDRESS 0xfe40320c /end MEASUREMENT
/begin MEASUREMENT Tlib_isHctvStsVlvOverTrvlFlt_VLAN201BE "" UBYTE RB_RBA_Common_CentralElements_CompuMethods_Identical 1 100 0.0 255.00 FORMAT "%8.2" ECU_ADDRESS 0xfe40320d /end MEASUREMENT
/begin MEASUREMENT Tlib_isHctvStsVlvLoTErr_VLAN201BE "" UBYTE RB_RBA_Common_CentralElements_CompuMethods_Identical 1 100 0.0 255.00 FORMAT "%8.2" ECU_ADDRESS 0xfe40320e /end MEASUREMENT
/begin MEASUREMENT Tlib_isHctvStsVlvPosnCtrlTimeOutFlt_VLAN201BE "" UBYTE RB_RBA_Common_CentralElements_CompuMethods_Identical 1 100 0.0 255.00 FORMAT "%8.2" ECU_ADDRESS 0xfe40320f /end MEASUREMENT
/begin MEASUREMENT Tlib_isHctvStsVlvPosnUkwnFlt_VLAN201BE "" UBYTE RB_RBA_Common_CentralElements_CompuMethods_Identical 1 100 0.0 255.00 FORMAT "%8.2" ECU_ADDRESS 0xfe403210 /end MEASUREMENT
/begin MEASUREMENT Tlib_isHvBattThermMod_VLAN201BE "" UBYTE RB_RBA_Common_CentralElements_CompuMethods_Identical 1 100 0.0 255.00 FORMAT "%8.2" ECU_ADDRESS 0xfe403211 /end MEASUREMENT
/begin MEASUREMENT Tlib_isHvBattCooltFlowReq_VLAN201BE "" UWORD RB_RBA_Common_CentralElements_CompuMethods_Identical 1 100 0.0 65535 FORMAT "%8.2" ECU_ADDRESS 0xfe40292a /end MEASUREMENT
/begin MEASUREMENT Tlib_isHvBattThermReqLvl_VLAN201BE "" UBYTE RB_RBA_Common_CentralElements_CompuMethods_Identical 1 100 0.0 255.00 FORMAT "%8.2" ECU_ADDRESS 0xfe403212 /end MEASUREMENT
/begin MEASUREMENT Tlib_isTDcDc_VLAN201BE "" UBYTE RB_RBA_Common_CentralElements_CompuMethods_Identical 1 100 0.0 255.00 FORMAT "%8.2" ECU_ADDRESS 0xfe403213 /end MEASUREMENT
/begin MEASUREMENT Tlib_isCoolgReqDcDc_VLAN201BE "" UBYTE RB_RBA_Common_CentralElements_CompuMethods_Identical 1 100 0.0 255.00 FORMAT "%8.2" ECU_ADDRESS 0xfe403214 /end MEASUREMENT
/begin MEASUREMENT Tlib_isMinCooltFlowSecDcDc_VLAN201BE "" UBYTE RB_RBA_Common_CentralElements_CompuMethods_Identical 1 100 0.0 255.00 FORMAT "%8.2" ECU_ADDRESS 0xfe403215 /end MEASUREMENT
/begin MEASUREMENT Tlib_isHvBattThermForcedReqLvl_VLAN201BE "" UBYTE RB_RBA_Common_CentralElements_CompuMethods_Identical 1 100 0.0 255.00 FORMAT "%8.2" ECU_ADDRESS 0xfe403216 /end MEASUREMENT
/begin MEASUREMENT Tlib_isHvBoosterCoolgReq_VLAN201BE "" UBYTE RB_RBA_Common_CentralElements_CompuMethods_Identical 1 100 0.0 255.00 FORMAT "%8.2" ECU_ADDRESS 0xfe403217 /end MEASUREMENT
/begin MEASUREMENT Tlib_isHeatrPmpStatCooltPmpEmgyModSts_VLAN201BE "" UBYTE RB_RBA_Common_CentralElements_CompuMethods_Identical 1 100 0.0 255.00 FORMAT "%8.2" ECU_ADDRESS 0xfe403218 /end MEASUREMENT
/begin MEASUREMENT Tlib_isHeatrPmpStatCooltPmpSpd_VLAN201BE "" UBYTE RB_RBA_Common_CentralElements_CompuMethods_Identical 1 100 0.0 255.00 FORMAT "%8.2" ECU_ADDRESS 0xfe403219 /end MEASUREMENT
/begin MEASUREMENT Tlib_isHeatrPmpStatCooltPmpErrSts_VLAN201BE "" UBYTE RB_RBA_Common_CentralElements_CompuMethods_Identical 1 100 0.0 255.00 FORMAT "%8.2" ECU_ADDRESS 0xfe40321a /end MEASUREMENT
/begin MEASUREMENT Tlib_isHeatrPmpStatCooltPmpDryErr_VLAN201BE "" UBYTE RB_RBA_Common_CentralElements_CompuMethods_Identical 1 100 0.0 255.00 FORMAT "%8.2" ECU_ADDRESS 0xfe40321b /end MEASUREMENT
/begin MEASUREMENT Tlib_isHeatrPmpStatCooltPmpT_VLAN201BE "" UBYTE RB_RBA_Common_CentralElements_CompuMethods_Identical 1 100 0.0 255.00 FORMAT "%8.2" ECU_ADDRESS 0xfe40321c /end MEASUREMENT
/begin MEASUREMENT Tlib_isHeatrPmpStatCooltPmpMonrSpd_VLAN201BE "" UBYTE RB_RBA_Common_CentralElements_CompuMethods_Identical 1 100 0.0 255.00 FORMAT "%8.2" ECU_ADDRESS 0xfe40321d /end MEASUREMENT
/begin MEASUREMENT Tlib_isHeatrPmpStatCooltPmpTErr_VLAN201BE "" UBYTE RB_RBA_Common_CentralElements_CompuMethods_Identical 1 100 0.0 255.00 FORMAT "%8.2" ECU_ADDRESS 0xfe40321e /end MEASUREMENT
/begin MEASUREMENT Tlib_isHeatrPmpStatCooltPmpSetPostRunReq_VLAN201BE "" UBYTE RB_RBA_Common_CentralElements_CompuMethods_Identical 1 100 0.0 255.00 FORMAT "%8.2" ECU_ADDRESS 0xfe40321f /end MEASUREMENT
/begin MEASUREMENT Tlib_isHeatrPmpStatCooltPmpPostRunSts_VLAN201BE "" UBYTE RB_RBA_Common_CentralElements_CompuMethods_Identical 1 100 0.0 255.00 FORMAT "%8.2" ECU_ADDRESS 0xfe403220 /end MEASUREMENT
/begin MEASUREMENT Tlib_isHeatrPmpStatCooltPmpUErr_VLAN201BE "" UBYTE RB_RBA_Common_CentralElements_CompuMethods_Identical 1 100 0.0 255.00 FORMAT "%8.2" ECU_ADDRESS 0xfe403221 /end MEASUREMENT
/begin MEASUREMENT Tlib_isHeatrPmpStatCooltPmpI_VLAN201BE "" UBYTE RB_RBA_Common_CentralElements_CompuMethods_Identical 1 100 0.0 255.00 FORMAT "%8.2" ECU_ADDRESS 0xfe403222 /end MEASUREMENT
/begin MEASUREMENT Tlib_isHeatrPmpStatCooltPmpSetSpdReq_VLAN201BE "" UBYTE RB_RBA_Common_CentralElements_CompuMethods_Identical 1 100 0.0 255.00 FORMAT "%8.2" ECU_ADDRESS 0xfe403223 /end MEASUREMENT
/begin MEASUREMENT Tlib_isHeatrPmpStatCooltPmpU_VLAN201BE "" UBYTE RB_RBA_Common_CentralElements_CompuMethods_Identical 1 100 0.0 255.00 FORMAT "%8.2" ECU_ADDRESS 0xfe403224 /end MEASUREMENT
/begin MEASUREMENT Tlib_isHeatrPmpStatCooltPmpUnstallSts_VLAN201BE "" UBYTE RB_RBA_Common_CentralElements_CompuMethods_Identical 1 100 0.0 255.00 FORMAT "%8.2" ECU_ADDRESS 0xfe403225 /end MEASUREMENT
/begin MEASUREMENT Tlib_isHeatrPmpStatCooltPmpIErr_VLAN201BE "" UBYTE RB_RBA_Common_CentralElements_CompuMethods_Identical 1 100 0.0 255.00 FORMAT "%8.2" ECU_ADDRESS 0xfe403226 /end MEASUREMENT
/begin MEASUREMENT Tlib_DtcInfDoorPass2Boolean4_ZCR_CANFD5 "" UBYTE RB_RBA_Common_CentralElements_CompuMethods_Identical 1 100 0.0 255.00 FORMAT "%8.2" ECU_ADDRESS 0xfe403227 /end MEASUREMENT
/begin MEASUREMENT Tlib_DtcInfDoorPass2Boolean13_ZCR_CANFD5 "" UBYTE RB_RBA_Common_CentralElements_CompuMethods_Identical 1 100 0.0 255.00 FORMAT "%8.2" ECU_ADDRESS 0xfe403228 /end MEASUREMENT
/begin MEASUREMENT Tlib_DtcInfDoorPass2Boolean3_ZCR_CANFD5 "" UBYTE RB_RBA_Common_CentralElements_CompuMethods_Identical 1 100 0.0 255.00 FORMAT "%8.2" ECU_ADDRESS 0xfe403229 /end MEASUREMENT
/begin MEASUREMENT Tlib_DtcInfDoorPass2Boolean1_ZCR_CANFD5 "" UBYTE RB_RBA_Common_CentralElements_CompuMethods_Identical 1 100 0.0 255.00 FORMAT "%8.2" ECU_ADDRESS 0xfe40322a /end MEASUREMENT
/begin MEASUREMENT Tlib_DtcInfDoorPass2Boolean2_ZCR_CANFD5 "" UBYTE RB_RBA_Common_CentralElements_CompuMethods_Identical 1 100 0.0 255.00 FORMAT "%8.2" ECU_ADDRESS 0xfe40322b /end MEASUREMENT
/begin MEASUREMENT Tlib_DtcInfDoorPass2Boolean6_ZCR_CANFD5 "" UBYTE RB_RBA_Common_CentralElements_CompuMethods_Identical 1 100 0.0 255.00 FORMAT "%8.2" ECU_ADDRESS 0xfe40322c /end MEASUREMENT
/begin MEASUREMENT Tlib_DtcInfDoorPass2Boolean5_ZCR_CANFD5 "" UBYTE RB_RBA_Common_CentralElements_CompuMethods_Identical 1 100 0.0 255.00 FORMAT "%8.2" ECU_ADDRESS 0xfe40322d /end MEASUREMENT
/begin MEASUREMENT Tlib_DtcInfDoorPass2Boolean14_ZCR_CANFD5 "" UBYTE RB_RBA_Common_CentralElements_CompuMethods_Identical 1 100 0.0 255.00 FORMAT "%8.2" ECU_ADDRESS 0xfe40322e /end MEASUREMENT
/begin MEASUREMENT Tlib_DtcInfDoorPass2Boolean9_ZCR_CANFD5 "" UBYTE RB_RBA_Common_CentralElements_CompuMethods_Identical 1 100 0.0 255.00 FORMAT "%8.2" ECU_ADDRESS 0xfe40322f /end MEASUREMENT
/begin MEASUREMENT Tlib_DtcInfDoorPass2Boolean10_ZCR_CANFD5 "" UBYTE RB_RBA_Common_CentralElements_CompuMethods_Identical 1 100 0.0 255.00 FORMAT "%8.2" ECU_ADDRESS 0xfe403230 /end MEASUREMENT
/begin MEASUREMENT Tlib_DtcInfDoorPass2Boolean7_ZCR_CANFD5 "" UBYTE RB_RBA_Common_CentralElements_CompuMethods_Identical 1 100 0.0 255.00 FORMAT "%8.2" ECU_ADDRESS 0xfe403231 /end MEASUREMENT
/begin MEASUREMENT Tlib_DtcInfDoorPass2Boolean12_ZCR_CANFD5 "" UBYTE RB_RBA_Common_CentralElements_CompuMethods_Identical 1 100 0.0 255.00 FORMAT "%8.2" ECU_ADDRESS 0xfe403232 /end MEASUREMENT
/begin MEASUREMENT Tlib_DtcInfDoorPass2Boolean11_ZCR_CANFD5 "" UBYTE RB_RBA_Common_CentralElements_CompuMethods_Identical 1 100 0.0 255.00 FORMAT "%8.2" ECU_ADDRESS 0xfe403233 /end MEASUREMENT
/begin MEASUREMENT Tlib_DtcInfDoorPass2Boolean8_ZCR_CANFD5 "" UBYTE RB_RBA_Common_CentralElements_CompuMethods_Identical 1 100 0.0 255.00 FORMAT "%8.2" ECU_ADDRESS 0xfe403234 /end MEASUREMENT
/begin MEASUREMENT Tlib_DoorPassModSts2_ZCR_CANFD5 "" UBYTE RB_RBA_Common_CentralElements_CompuMethods_Identical 1 100 0.0 255.00 FORMAT "%8.2" ECU_ADDRESS 0xfe403235 /end MEASUREMENT
/begin MEASUREMENT Tlib_DoorPassLatPosnHi_ZCR_CANFD5 "" UBYTE RB_RBA_Common_CentralElements_CompuMethods_Identical 1 100 0.0 255.00 FORMAT "%8.2" ECU_ADDRESS 0xfe403236 /end MEASUREMENT
/begin MEASUREMENT Tlib_DoorPassOpenReqInsdSwtHi2_ZCR_CANFD5 "" UBYTE RB_RBA_Common_CentralElements_CompuMethods_Identical 1 100 0.0 255.00 FORMAT "%8.2" ECU_ADDRESS 0xfe403237 /end MEASUREMENT
/begin MEASUREMENT Tlib_DoorPassOpenReqOutdSwtHi2_ZCR_CANFD5 "" UBYTE RB_RBA_Common_CentralElements_CompuMethods_Identical 1 100 0.0 255.00 FORMAT "%8.2" ECU_ADDRESS 0xfe403238 /end MEASUREMENT
/begin MEASUREMENT Tlib_DoorOpenerPassSts2_ZCR_CANFD5 "" UBYTE RB_RBA_Common_CentralElements_CompuMethods_Identical 1 100 0.0 255.00 FORMAT "%8.2" ECU_ADDRESS 0xfe403239 /end MEASUREMENT
/begin MEASUREMENT Tlib_DoorPassOpenReqInsdSwtHi1_ZCR_CANFD5 "" UBYTE RB_RBA_Common_CentralElements_CompuMethods_Identical 1 100 0.0 255.00 FORMAT "%8.2" ECU_ADDRESS 0xfe40323a /end MEASUREMENT
/begin MEASUREMENT Tlib_SecOpenWaitPass_ZCR_CANFD5 "" UBYTE RB_RBA_Common_CentralElements_CompuMethods_Identical 1 100 0.0 255.00 FORMAT "%8.2" ECU_ADDRESS 0xfe40323b /end MEASUREMENT
/begin MEASUREMENT Tlib_DtcInfDoorRiRe2Boolean11_ZCR_CANFD5 "" UBYTE RB_RBA_Common_CentralElements_CompuMethods_Identical 1 100 0.0 255.00 FORMAT "%8.2" ECU_ADDRESS 0xfe40323c /end MEASUREMENT
/begin MEASUREMENT Tlib_DtcInfDoorRiRe2Boolean12_ZCR_CANFD5 "" UBYTE RB_RBA_Common_CentralElements_CompuMethods_Identical 1 100 0.0 255.00 FORMAT "%8.2" ECU_ADDRESS 0xfe40323d /end MEASUREMENT
/begin MEASUREMENT Tlib_DtcInfDoorRiRe2Boolean7_ZCR_CANFD5 "" UBYTE RB_RBA_Common_CentralElements_CompuMethods_Identical 1 100 0.0 255.00 FORMAT "%8.2" ECU_ADDRESS 0xfe40323e /end MEASUREMENT
/begin MEASUREMENT Tlib_DtcInfDoorRiRe2Boolean2_ZCR_CANFD5 "" UBYTE RB_RBA_Common_CentralElements_CompuMethods_Identical 1 100 0.0 255.00 FORMAT "%8.2" ECU_ADDRESS 0xfe40323f /end MEASUREMENT
/begin MEASUREMENT Tlib_DtcInfDoorRiRe2Boolean9_ZCR_CANFD5 "" UBYTE RB_RBA_Common_CentralElements_CompuMethods_Identical 1 100 0.0 255.00 FORMAT "%8.2" ECU_ADDRESS 0xfe403240 /end MEASUREMENT
/begin MEASUREMENT Tlib_DtcInfDoorRiRe2Boolean5_ZCR_CANFD5 "" UBYTE RB_RBA_Common_CentralElements_CompuMethods_Identical 1 100 0.0 255.00 FORMAT "%8.2" ECU_ADDRESS 0xfe403241 /end MEASUREMENT
/begin MEASUREMENT Tlib_DtcInfDoorRiRe2Boolean13_ZCR_CANFD5 "" UBYTE RB_RBA_Common_CentralElements_CompuMethods_Identical 1 100 0.0 255.00 FORMAT "%8.2" ECU_ADDRESS 0xfe403242 /end MEASUREMENT
/begin MEASUREMENT Tlib_DtcInfDoorRiRe2Boolean8_ZCR_CANFD5 "" UBYTE RB_RBA_Common_CentralElements_CompuMethods_Identical 1 100 0.0 255.00 FORMAT "%8.2" ECU_ADDRESS 0xfe403243 /end MEASUREMENT
/begin MEASUREMENT Tlib_DtcInfDoorRiRe2Boolean4_ZCR_CANFD5 "" UBYTE RB_RBA_Common_CentralElements_CompuMethods_Identical 1 100 0.0 255.00 FORMAT "%8.2" ECU_ADDRESS 0xfe403244 /end MEASUREMENT
/begin MEASUREMENT Tlib_DtcInfDoorRiRe2Boolean1_ZCR_CANFD5 "" UBYTE RB_RBA_Common_CentralElements_CompuMethods_Identical 1 100 0.0 255.00 FORMAT "%8.2" ECU_ADDRESS 0xfe403245 /end MEASUREMENT
/begin MEASUREMENT Tlib_DtcInfDoorRiRe2Boolean14_ZCR_CANFD5 "" UBYTE RB_RBA_Common_CentralElements_CompuMethods_Identical 1 100 0.0 255.00 FORMAT "%8.2" ECU_ADDRESS 0xfe403246 /end MEASUREMENT
/begin MEASUREMENT Tlib_DtcInfDoorRiRe2Boolean3_ZCR_CANFD5 "" UBYTE RB_RBA_Common_CentralElements_CompuMethods_Identical 1 100 0.0 255.00 FORMAT "%8.2" ECU_ADDRESS 0xfe403247 /end MEASUREMENT
/begin MEASUREMENT Tlib_DtcInfDoorRiRe2Boolean10_ZCR_CANFD5 "" UBYTE RB_RBA_Common_CentralElements_CompuMethods_Identical 1 100 0.0 255.00 FORMAT "%8.2" ECU_ADDRESS 0xfe403248 /end MEASUREMENT
/begin MEASUREMENT Tlib_DtcInfDoorRiRe2Boolean6_ZCR_CANFD5 "" UBYTE RB_RBA_Common_CentralElements_CompuMethods_Identical 1 100 0.0 255.00 FORMAT "%8.2" ECU_ADDRESS 0xfe403249 /end MEASUREMENT
/begin MEASUREMENT Tlib_DoorRiReModSts2_ZCR_CANFD5 "" UBYTE RB_RBA_Common_CentralElements_CompuMethods_Identical 1 100 0.0 255.00 FORMAT "%8.2" ECU_ADDRESS 0xfe40324a /end MEASUREMENT
/begin MEASUREMENT Tlib_DoorRiReLatPosnHi_ZCR_CANFD5 "" UBYTE RB_RBA_Common_CentralElements_CompuMethods_Identical 1 100 0.0 255.00 FORMAT "%8.2" ECU_ADDRESS 0xfe40324b /end MEASUREMENT
/begin MEASUREMENT Tlib_ShortDropWinReRiStsHi_ZCR_CANFD5 "" UBYTE RB_RBA_Common_CentralElements_CompuMethods_Identical 1 100 0.0 255.00 FORMAT "%8.2" ECU_ADDRESS 0xfe40324c /end MEASUREMENT
/begin MEASUREMENT Tlib_DoorRiReOpenReqInsdSwtHi1_ZCR_CANFD5 "" UBYTE RB_RBA_Common_CentralElements_CompuMethods_Identical 1 100 0.0 255.00 FORMAT "%8.2" ECU_ADDRESS 0xfe40324d /end MEASUREMENT
/begin MEASUREMENT Tlib_DoorRiReOpenReqOutdSwtHi2_ZCR_CANFD5 "" UBYTE RB_RBA_Common_CentralElements_CompuMethods_Identical 1 100 0.0 255.00 FORMAT "%8.2" ECU_ADDRESS 0xfe40324e /end MEASUREMENT
/begin MEASUREMENT Tlib_CinhRiReStsHi_ZCR_CANFD5 "" UBYTE RB_RBA_Common_CentralElements_CompuMethods_Identical 1 100 0.0 255.00 FORMAT "%8.2" ECU_ADDRESS 0xfe40324f /end MEASUREMENT
/begin MEASUREMENT Tlib_CinhRiReSwtHi_ZCR_CANFD5 "" UBYTE RB_RBA_Common_CentralElements_CompuMethods_Identical 1 100 0.0 255.00 FORMAT "%8.2" ECU_ADDRESS 0xfe403250 /end MEASUREMENT
/begin MEASUREMENT Tlib_DoorOpenerRiReSts2_ZCR_CANFD5 "" UBYTE RB_RBA_Common_CentralElements_CompuMethods_Identical 1 100 0.0 255.00 FORMAT "%8.2" ECU_ADDRESS 0xfe403251 /end MEASUREMENT
/begin MEASUREMENT Tlib_DoorRiReOpenReqInsdSwtHi2_ZCR_CANFD5 "" UBYTE RB_RBA_Common_CentralElements_CompuMethods_Identical 1 100 0.0 255.00 FORMAT "%8.2" ECU_ADDRESS 0xfe403252 /end MEASUREMENT
/begin MEASUREMENT Tlib_PawlRiReSwtHi_ZCR_CANFD5 "" UBYTE RB_RBA_Common_CentralElements_CompuMethods_Identical 1 100 0.0 255.00 FORMAT "%8.2" ECU_ADDRESS 0xfe403253 /end MEASUREMENT
/begin MEASUREMENT Tlib_SecOpenWaitRiRe_ZCR_CANFD5 "" UBYTE RB_RBA_Common_CentralElements_CompuMethods_Identical 1 100 0.0 255.00 FORMAT "%8.2" ECU_ADDRESS 0xfe403254 /end MEASUREMENT
/begin MEASUREMENT Tlib_DoorPassPosn2_ZCR_CANFD5 "" UBYTE RB_RBA_Common_CentralElements_CompuMethods_Identical 1 100 0.0 255.00 FORMAT "%8.2" ECU_ADDRESS 0xfe403255 /end MEASUREMENT
/begin MEASUREMENT Tlib_FRDoorStopReazon_ZCR_CANFD5 "" UBYTE RB_RBA_Common_CentralElements_CompuMethods_Identical 1 100 0.0 255.00 FORMAT "%8.2" ECU_ADDRESS 0xfe403256 /end MEASUREMENT
/begin MEASUREMENT Tlib_PassWinSwtReqHi_ZCR_CANFD5 "" UBYTE RB_RBA_Common_CentralElements_CompuMethods_Identical 1 100 0.0 255.00 FORMAT "%8.2" ECU_ADDRESS 0xfe403257 /end MEASUREMENT
/begin MEASUREMENT Tlib_ShortDropWinPassStsHi_ZCR_CANFD5 "" UBYTE RB_RBA_Common_CentralElements_CompuMethods_Identical 1 100 0.0 255.00 FORMAT "%8.2" ECU_ADDRESS 0xfe403258 /end MEASUREMENT
/begin MEASUREMENT Tlib_DoorPassAntiPnch2_ZCR_CANFD5 "" UBYTE RB_RBA_Common_CentralElements_CompuMethods_Identical 1 100 0.0 255.00 FORMAT "%8.2" ECU_ADDRESS 0xfe403259 /end MEASUREMENT
/begin MEASUREMENT Tlib_ObstStrDetcnRiRe2_ZCR_CANFD5 "" UBYTE RB_RBA_Common_CentralElements_CompuMethods_Identical 1 100 0.0 255.00 FORMAT "%8.2" ECU_ADDRESS 0xfe40325a /end MEASUREMENT
/begin MEASUREMENT Tlib_DoorRiRePosn2_ZCR_CANFD5 "" UBYTE RB_RBA_Common_CentralElements_CompuMethods_Identical 1 100 0.0 255.00 FORMAT "%8.2" ECU_ADDRESS 0xfe40325b /end MEASUREMENT
/begin MEASUREMENT Tlib_WinFailrStsAtReRiHi_ZCR_CANFD5 "" UBYTE RB_RBA_Common_CentralElements_CompuMethods_Identical 1 100 0.0 255.00 FORMAT "%8.2" ECU_ADDRESS 0xfe40325c /end MEASUREMENT
/begin MEASUREMENT Tlib_AntiPinchDsblStsReRiHi_ZCR_CANFD5 "" UBYTE RB_RBA_Common_CentralElements_CompuMethods_Identical 1 100 0.0 255.00 FORMAT "%8.2" ECU_ADDRESS 0xfe40325d /end MEASUREMENT
/begin MEASUREMENT Tlib_WinPosnStsAtReRiHi_ZCR_CANFD5 "" UBYTE RB_RBA_Common_CentralElements_CompuMethods_Identical 1 100 0.0 255.00 FORMAT "%8.2" ECU_ADDRESS 0xfe40325e /end MEASUREMENT
/begin MEASUREMENT Tlib_WindowLearnStAtReRiHi_ZCR_CANFD5 "" UBYTE RB_RBA_Common_CentralElements_CompuMethods_Identical 1 100 0.0 255.00 FORMAT "%8.2" ECU_ADDRESS 0xfe40325f /end MEASUREMENT
/begin MEASUREMENT Tlib_WinCurtPosnStsAtReRiHi_ZCR_CANFD5 "" UBYTE RB_RBA_Common_CentralElements_CompuMethods_Identical 1 100 0.0 255.00 FORMAT "%8.2" ECU_ADDRESS 0xfe403260 /end MEASUREMENT
/begin MEASUREMENT Tlib_WinMovStsAtReRiHi_ZCR_CANFD5 "" UBYTE RB_RBA_Common_CentralElements_CompuMethods_Identical 1 100 0.0 255.00 FORMAT "%8.2" ECU_ADDRESS 0xfe403261 /end MEASUREMENT
/begin MEASUREMENT Tlib_DoorRiRe2Swt2DplyHndlHi_ZCR_CANFD5 "" UBYTE RB_RBA_Common_CentralElements_CompuMethods_Identical 1 100 0.0 255.00 FORMAT "%8.2" ECU_ADDRESS 0xfe403262 /end MEASUREMENT
/begin MEASUREMENT Tlib_WinCurtMovStsAtReRiHi_ZCR_CANFD5 "" UBYTE RB_RBA_Common_CentralElements_CompuMethods_Identical 1 100 0.0 255.00 FORMAT "%8.2" ECU_ADDRESS 0xfe403263 /end MEASUREMENT
/begin MEASUREMENT Tlib_WinCurtAntiPinchStsAtReRiHi_ZCR_CANFD5 "" UBYTE RB_RBA_Common_CentralElements_CompuMethods_Identical 1 100 0.0 255.00 FORMAT "%8.2" ECU_ADDRESS 0xfe403264 /end MEASUREMENT
/begin MEASUREMENT Tlib_RRDoorStopReazon_ZCR_CANFD5 "" UBYTE RB_RBA_Common_CentralElements_CompuMethods_Identical 1 100 0.0 255.00 FORMAT "%8.2" ECU_ADDRESS 0xfe403265 /end MEASUREMENT
/begin MEASUREMENT Tlib_OpenRiReSwtHi_ZCR_CANFD5 "" UBYTE RB_RBA_Common_CentralElements_CompuMethods_Identical 1 100 0.0 255.00 FORMAT "%8.2" ECU_ADDRESS 0xfe403266 /end MEASUREMENT
/begin MEASUREMENT Tlib_AntiPinchStsAtReRiHi_ZCR_CANFD5 "" UBYTE RB_RBA_Common_CentralElements_CompuMethods_Identical 1 100 0.0 255.00 FORMAT "%8.2" ECU_ADDRESS 0xfe403267 /end MEASUREMENT
/begin MEASUREMENT Tlib_DoorRiRe2Swt1DplyHndlHi_ZCR_CANFD5 "" UBYTE RB_RBA_Common_CentralElements_CompuMethods_Identical 1 100 0.0 255.00 FORMAT "%8.2" ECU_ADDRESS 0xfe403268 /end MEASUREMENT
/begin MEASUREMENT Tlib_WinCurtFailrStsAtReRiHi_ZCR_CANFD5 "" UBYTE RB_RBA_Common_CentralElements_CompuMethods_Identical 1 100 0.0 255.00 FORMAT "%8.2" ECU_ADDRESS 0xfe403269 /end MEASUREMENT
/begin MEASUREMENT Tlib_WinDiagcAtReRiHiMissCal_ZCR_CANFD5 "" UBYTE RB_RBA_Common_CentralElements_CompuMethods_Identical 1 100 0.0 255.00 FORMAT "%8.2" ECU_ADDRESS 0xfe40326a /end MEASUREMENT
/begin MEASUREMENT Tlib_WinDiagcAtReRiHiOverTemperature_ZCR_CANFD5 "" UBYTE RB_RBA_Common_CentralElements_CompuMethods_Identical 1 100 0.0 255.00 FORMAT "%8.2" ECU_ADDRESS 0xfe40326b /end MEASUREMENT
/begin MEASUREMENT Tlib_WinDiagcAtReRiHiMeclFailr_ZCR_CANFD5 "" UBYTE RB_RBA_Common_CentralElements_CompuMethods_Identical 1 100 0.0 255.00 FORMAT "%8.2" ECU_ADDRESS 0xfe40326c /end MEASUREMENT
/begin MEASUREMENT Tlib_WinDiagcAtReRiHiOpenCirc_ZCR_CANFD5 "" UBYTE RB_RBA_Common_CentralElements_CompuMethods_Identical 1 100 0.0 255.00 FORMAT "%8.2" ECU_ADDRESS 0xfe40326d /end MEASUREMENT
/begin MEASUREMENT Tlib_WinDiagcAtReRiHiOverCurrent_ZCR_CANFD5 "" UBYTE RB_RBA_Common_CentralElements_CompuMethods_Identical 1 100 0.0 255.00 FORMAT "%8.2" ECU_ADDRESS 0xfe40326e /end MEASUREMENT
/begin MEASUREMENT Tlib_WinDiagcAtReRiHiIntElecFailr_ZCR_CANFD5 "" UBYTE RB_RBA_Common_CentralElements_CompuMethods_Identical 1 100 0.0 255.00 FORMAT "%8.2" ECU_ADDRESS 0xfe40326f /end MEASUREMENT
/begin MEASUREMENT Tlib_WinDiagcAtReRiHiRipplefault_ZCR_CANFD5 "" UBYTE RB_RBA_Common_CentralElements_CompuMethods_Identical 1 100 0.0 255.00 FORMAT "%8.2" ECU_ADDRESS 0xfe403270 /end MEASUREMENT
/begin MEASUREMENT Tlib_WinDiagcAtReRiHivoltageoutofrange_ZCR_CANFD5 "" UBYTE RB_RBA_Common_CentralElements_CompuMethods_Identical 1 100 0.0 255.00 FORMAT "%8.2" ECU_ADDRESS 0xfe403271 /end MEASUREMENT
/begin MEASUREMENT Tlib_ActrStopReazonAtReRiWinHi_ZCR_CANFD5 "" UBYTE RB_RBA_Common_CentralElements_CompuMethods_Identical 1 100 0.0 255.00 FORMAT "%8.2" ECU_ADDRESS 0xfe403272 /end MEASUREMENT
/begin MEASUREMENT Tlib_IceBreakDoorRiReActvHi_ZCR_CANFD5 "" UBYTE RB_RBA_Common_CentralElements_CompuMethods_Identical 1 100 0.0 255.00 FORMAT "%8.2" ECU_ADDRESS 0xfe403273 /end MEASUREMENT
/begin MEASUREMENT Tlib_DoorRiReLatPawlStHi_ZCR_CANFD5 "" UBYTE RB_RBA_Common_CentralElements_CompuMethods_Identical 1 100 0.0 255.00 FORMAT "%8.2" ECU_ADDRESS 0xfe403274 /end MEASUREMENT
/begin MEASUREMENT Tlib_PwrDoorManStrengthLvlStsRiRe_ZCR_CANFD5 "" UBYTE RB_RBA_Common_CentralElements_CompuMethods_Identical 1 100 0.0 255.00 FORMAT "%8.2" ECU_ADDRESS 0xfe403275 /end MEASUREMENT
/begin MEASUREMENT Tlib_WinReRiAutoUpDiStsHi_ZCR_CANFD5 "" UBYTE RB_RBA_Common_CentralElements_CompuMethods_Identical 1 100 0.0 255.00 FORMAT "%8.2" ECU_ADDRESS 0xfe403276 /end MEASUREMENT
/begin MEASUREMENT Tlib_ObstStrDetcnPass2_ZCR_CANFD5 "" UBYTE RB_RBA_Common_CentralElements_CompuMethods_Identical 1 100 0.0 255.00 FORMAT "%8.2" ECU_ADDRESS 0xfe403277 /end MEASUREMENT
/begin MEASUREMENT Tlib_AmbTRawAmbTEstimdQf_ZCR_CANFD5 "" UBYTE RB_RBA_Common_CentralElements_CompuMethods_Identical 1 100 0.0 255.00 FORMAT "%8.2" ECU_ADDRESS 0xfe403278 /end MEASUREMENT
/begin MEASUREMENT Tlib_AmbTRawAmbTEstimd_ZCR_CANFD5 "" UWORD RB_RBA_Common_CentralElements_CompuMethods_Identical 1 100 0.0 65535 FORMAT "%8.2" ECU_ADDRESS 0xfe40292c /end MEASUREMENT
/begin MEASUREMENT Tlib_NRRDoorPassOpenInsdSwtIfHi2OfLocking_ZCR_CANFD5 "" UBYTE RB_RBA_Common_CentralElements_CompuMethods_Identical 1 100 0.0 255.00 FORMAT "%8.2" ECU_ADDRESS 0xfe403279 /end MEASUREMENT
/begin MEASUREMENT Tlib_NRRDoorPassOpenInsdSwtIfHi1OfLocking_ZCR_CANFD5 "" UBYTE RB_RBA_Common_CentralElements_CompuMethods_Identical 1 100 0.0 255.00 FORMAT "%8.2" ECU_ADDRESS 0xfe40327a /end MEASUREMENT
/begin MEASUREMENT Tlib_NRRDoorPassOpenOutdSwtIfHi2OfLocking_ZCR_CANFD5 "" UBYTE RB_RBA_Common_CentralElements_CompuMethods_Identical 1 100 0.0 255.00 FORMAT "%8.2" ECU_ADDRESS 0xfe40327b /end MEASUREMENT
/begin MEASUREMENT Tlib_NRRDoorPassSnsrIfHiOfLocking_ZCR_CANFD5 "" UBYTE RB_RBA_Common_CentralElements_CompuMethods_Identical 1 100 0.0 255.00 FORMAT "%8.2" ECU_ADDRESS 0xfe40327c /end MEASUREMENT
/begin MEASUREMENT Tlib_DoorRiReAntiPnch2_ZCR_CANFD5 "" UBYTE RB_RBA_Common_CentralElements_CompuMethods_Identical 1 100 0.0 255.00 FORMAT "%8.2" ECU_ADDRESS 0xfe40327d /end MEASUREMENT
/begin MEASUREMENT Tlib_NRRDoorRiReSnsrIfHiOfLocking_ZCR_CANFD5 "" UBYTE RB_RBA_Common_CentralElements_CompuMethods_Identical 1 100 0.0 255.00 FORMAT "%8.2" ECU_ADDRESS 0xfe40327e /end MEASUREMENT
/begin MEASUREMENT Tlib_NRRDoorRiReOpenInsdSwtIfHi1OfLocking_ZCR_CANFD5 "" UBYTE RB_RBA_Common_CentralElements_CompuMethods_Identical 1 100 0.0 255.00 FORMAT "%8.2" ECU_ADDRESS 0xfe40327f /end MEASUREMENT
/begin MEASUREMENT Tlib_NRRDoorRiReOpenInsdSwtIfHi2OfLocking_ZCR_CANFD5 "" UBYTE RB_RBA_Common_CentralElements_CompuMethods_Identical 1 100 0.0 255.00 FORMAT "%8.2" ECU_ADDRESS 0xfe403280 /end MEASUREMENT
/begin MEASUREMENT Tlib_NRRDoorRiReOpenOutdSwtIfHi2OfLocking_ZCR_CANFD5 "" UBYTE RB_RBA_Common_CentralElements_CompuMethods_Identical 1 100 0.0 255.00 FORMAT "%8.2" ECU_ADDRESS 0xfe403281 /end MEASUREMENT
/begin MEASUREMENT Tlib_PassDoorRdrObj1RdrObjConfidLvl_ZCR_CANFD5 "" UBYTE RB_RBA_Common_CentralElements_CompuMethods_Identical 1 100 0.0 255.00 FORMAT "%8.2" ECU_ADDRESS 0xfe403282 /end MEASUREMENT
/begin MEASUREMENT Tlib_PassDoorRdrObj1RdrObjDataMode_ZCR_CANFD5 "" UBYTE RB_RBA_Common_CentralElements_CompuMethods_Identical 1 100 0.0 255.00 FORMAT "%8.2" ECU_ADDRESS 0xfe403283 /end MEASUREMENT
/begin MEASUREMENT Tlib_PassDoorRdrObj1RdrObjMotionPattern_ZCR_CANFD5 "" UBYTE RB_RBA_Common_CentralElements_CompuMethods_Identical 1 100 0.0 255.00 FORMAT "%8.2" ECU_ADDRESS 0xfe403284 /end MEASUREMENT
/begin MEASUREMENT Tlib_PassDoorRdrObj1RdrObjAccStdX_ZCR_CANFD5 "" UBYTE RB_RBA_Common_CentralElements_CompuMethods_Identical 1 100 0.0 255.00 FORMAT "%8.2" ECU_ADDRESS 0xfe403285 /end MEASUREMENT
/begin MEASUREMENT Tlib_PassDoorRdrObj1RdrObjTrackClass_ZCR_CANFD5 "" UBYTE RB_RBA_Common_CentralElements_CompuMethods_Identical 1 100 0.0 255.00 FORMAT "%8.2" ECU_ADDRESS 0xfe403286 /end MEASUREMENT
/begin MEASUREMENT Tlib_PassDoorRdrObj1RdrObjAccX_ZCR_CANFD5 "" UWORD RB_RBA_Common_CentralElements_CompuMethods_Identical 1 100 0.0 65535 FORMAT "%8.2" ECU_ADDRESS 0xfe40292e /end MEASUREMENT
/begin MEASUREMENT Tlib_PassDoorRdrObj1RdrObjRangeX_ZCR_CANFD5 "" UWORD RB_RBA_Common_CentralElements_CompuMethods_Identical 1 100 0.0 65535 FORMAT "%8.2" ECU_ADDRESS 0xfe402930 /end MEASUREMENT
/begin MEASUREMENT Tlib_PassDoorRdrObj1RdrObjSpeedStdX_ZCR_CANFD5 "" UBYTE RB_RBA_Common_CentralElements_CompuMethods_Identical 1 100 0.0 255.00 FORMAT "%8.2" ECU_ADDRESS 0xfe403287 /end MEASUREMENT
/begin MEASUREMENT Tlib_PassDoorRdrObj1RdrObjRangeY_ZCR_CANFD5 "" UWORD RB_RBA_Common_CentralElements_CompuMethods_Identical 1 100 0.0 65535 FORMAT "%8.2" ECU_ADDRESS 0xfe402932 /end MEASUREMENT
/begin MEASUREMENT Tlib_PassDoorRdrObj1RdrObjRangeStdZ_ZCR_CANFD5 "" UBYTE RB_RBA_Common_CentralElements_CompuMethods_Identical 1 100 0.0 255.00 FORMAT "%8.2" ECU_ADDRESS 0xfe403288 /end MEASUREMENT
/begin MEASUREMENT Tlib_PassDoorRdrObj1RdrObjSpeedStdY_ZCR_CANFD5 "" UBYTE RB_RBA_Common_CentralElements_CompuMethods_Identical 1 100 0.0 255.00 FORMAT "%8.2" ECU_ADDRESS 0xfe403289 /end MEASUREMENT
/begin MEASUREMENT Tlib_PassDoorRdrObj1RdrObjAccY_ZCR_CANFD5 "" UWORD RB_RBA_Common_CentralElements_CompuMethods_Identical 1 100 0.0 65535 FORMAT "%8.2" ECU_ADDRESS 0xfe402934 /end MEASUREMENT
/begin MEASUREMENT Tlib_PassDoorRdrObj1RdrObjRangeStdX_ZCR_CANFD5 "" UBYTE RB_RBA_Common_CentralElements_CompuMethods_Identical 1 100 0.0 255.00 FORMAT "%8.2" ECU_ADDRESS 0xfe40328a /end MEASUREMENT
/begin MEASUREMENT Tlib_PassDoorRdrObj1RdrObjIdx_ZCR_CANFD5 "" UBYTE RB_RBA_Common_CentralElements_CompuMethods_Identical 1 100 0.0 255.00 FORMAT "%8.2" ECU_ADDRESS 0xfe40328b /end MEASUREMENT
/begin MEASUREMENT Tlib_PassDoorRdrObj1RdrObjSpeedY_ZCR_CANFD5 "" UWORD RB_RBA_Common_CentralElements_CompuMethods_Identical 1 100 0.0 65535 FORMAT "%8.2" ECU_ADDRESS 0xfe402936 /end MEASUREMENT
/begin MEASUREMENT Tlib_PassDoorRdrObj1RdrObjTrackAge_ZCR_CANFD5 "" UBYTE RB_RBA_Common_CentralElements_CompuMethods_Identical 1 100 0.0 255.00 FORMAT "%8.2" ECU_ADDRESS 0xfe40328c /end MEASUREMENT
/begin MEASUREMENT Tlib_PassDoorRdrObj1RdrObjRangeStdY_ZCR_CANFD5 "" UBYTE RB_RBA_Common_CentralElements_CompuMethods_Identical 1 100 0.0 255.00 FORMAT "%8.2" ECU_ADDRESS 0xfe40328d /end MEASUREMENT
/begin MEASUREMENT Tlib_PassDoorRdrObj1RdrObjSpeedX_ZCR_CANFD5 "" UWORD RB_RBA_Common_CentralElements_CompuMethods_Identical 1 100 0.0 65535 FORMAT "%8.2" ECU_ADDRESS 0xfe402938 /end MEASUREMENT
/begin MEASUREMENT Tlib_PassDoorRdrObj1RdrObjAccStdY_ZCR_CANFD5 "" UBYTE RB_RBA_Common_CentralElements_CompuMethods_Identical 1 100 0.0 255.00 FORMAT "%8.2" ECU_ADDRESS 0xfe40328e /end MEASUREMENT
/begin MEASUREMENT Tlib_PassDoorRdrObj1RdrObjRangeZ_ZCR_CANFD5 "" UWORD RB_RBA_Common_CentralElements_CompuMethods_Identical 1 100 0.0 65535 FORMAT "%8.2" ECU_ADDRESS 0xfe40293a /end MEASUREMENT
/begin MEASUREMENT Tlib_PassDoorRdrObj10RdrObjConfidLvl_ZCR_CANFD5 "" UBYTE RB_RBA_Common_CentralElements_CompuMethods_Identical 1 100 0.0 255.00 FORMAT "%8.2" ECU_ADDRESS 0xfe40328f /end MEASUREMENT
/begin MEASUREMENT Tlib_PassDoorRdrObj10RdrObjIdx_ZCR_CANFD5 "" UBYTE RB_RBA_Common_CentralElements_CompuMethods_Identical 1 100 0.0 255.00 FORMAT "%8.2" ECU_ADDRESS 0xfe403290 /end MEASUREMENT
/begin MEASUREMENT Tlib_PassDoorRdrObj10RdrObjRangeX_ZCR_CANFD5 "" UWORD RB_RBA_Common_CentralElements_CompuMethods_Identical 1 100 0.0 65535 FORMAT "%8.2" ECU_ADDRESS 0xfe40293c /end MEASUREMENT
/begin MEASUREMENT Tlib_PassDoorRdrObj10RdrObjSpeedX_ZCR_CANFD5 "" UWORD RB_RBA_Common_CentralElements_CompuMethods_Identical 1 100 0.0 65535 FORMAT "%8.2" ECU_ADDRESS 0xfe40293e /end MEASUREMENT
/begin MEASUREMENT Tlib_PassDoorRdrObj10RdrObjRangeStdX_ZCR_CANFD5 "" UBYTE RB_RBA_Common_CentralElements_CompuMethods_Identical 1 100 0.0 255.00 FORMAT "%8.2" ECU_ADDRESS 0xfe403291 /end MEASUREMENT
/begin MEASUREMENT Tlib_PassDoorRdrObj10RdrObjSpeedY_ZCR_CANFD5 "" UWORD RB_RBA_Common_CentralElements_CompuMethods_Identical 1 100 0.0 65535 FORMAT "%8.2" ECU_ADDRESS 0xfe402940 /end MEASUREMENT
/begin MEASUREMENT Tlib_PassDoorRdrObj10RdrObjSpeedStdY_ZCR_CANFD5 "" UBYTE RB_RBA_Common_CentralElements_CompuMethods_Identical 1 100 0.0 255.00 FORMAT "%8.2" ECU_ADDRESS 0xfe403292 /end MEASUREMENT
/begin MEASUREMENT Tlib_PassDoorRdrObj10RdrObjDataMode_ZCR_CANFD5 "" UBYTE RB_RBA_Common_CentralElements_CompuMethods_Identical 1 100 0.0 255.00 FORMAT "%8.2" ECU_ADDRESS 0xfe403293 /end MEASUREMENT
/begin MEASUREMENT Tlib_PassDoorRdrObj10RdrObjTrackClass_ZCR_CANFD5 "" UBYTE RB_RBA_Common_CentralElements_CompuMethods_Identical 1 100 0.0 255.00 FORMAT "%8.2" ECU_ADDRESS 0xfe403294 /end MEASUREMENT
/begin MEASUREMENT Tlib_PassDoorRdrObj10RdrObjAccX_ZCR_CANFD5 "" UWORD RB_RBA_Common_CentralElements_CompuMethods_Identical 1 100 0.0 65535 FORMAT "%8.2" ECU_ADDRESS 0xfe402942 /end MEASUREMENT
/begin MEASUREMENT Tlib_PassDoorRdrObj10RdrObjAccStdX_ZCR_CANFD5 "" UBYTE RB_RBA_Common_CentralElements_CompuMethods_Identical 1 100 0.0 255.00 FORMAT "%8.2" ECU_ADDRESS 0xfe403295 /end MEASUREMENT
/begin MEASUREMENT Tlib_PassDoorRdrObj10RdrObjTrackAge_ZCR_CANFD5 "" UBYTE RB_RBA_Common_CentralElements_CompuMethods_Identical 1 100 0.0 255.00 FORMAT "%8.2" ECU_ADDRESS 0xfe403296 /end MEASUREMENT
/begin MEASUREMENT Tlib_PassDoorRdrObj10RdrObjRangeStdZ_ZCR_CANFD5 "" UBYTE RB_RBA_Common_CentralElements_CompuMethods_Identical 1 100 0.0 255.00 FORMAT "%8.2" ECU_ADDRESS 0xfe403297 /end MEASUREMENT
/begin MEASUREMENT Tlib_PassDoorRdrObj10RdrObjRangeY_ZCR_CANFD5 "" UWORD RB_RBA_Common_CentralElements_CompuMethods_Identical 1 100 0.0 65535 FORMAT "%8.2" ECU_ADDRESS 0xfe402944 /end MEASUREMENT
/begin MEASUREMENT Tlib_PassDoorRdrObj10RdrObjSpeedStdX_ZCR_CANFD5 "" UBYTE RB_RBA_Common_CentralElements_CompuMethods_Identical 1 100 0.0 255.00 FORMAT "%8.2" ECU_ADDRESS 0xfe403298 /end MEASUREMENT
/begin MEASUREMENT Tlib_PassDoorRdrObj10RdrObjMotionPattern_ZCR_CANFD5 "" UBYTE RB_RBA_Common_CentralElements_CompuMethods_Identical 1 100 0.0 255.00 FORMAT "%8.2" ECU_ADDRESS 0xfe403299 /end MEASUREMENT
/begin MEASUREMENT Tlib_PassDoorRdrObj10RdrObjRangeStdY_ZCR_CANFD5 "" UBYTE RB_RBA_Common_CentralElements_CompuMethods_Identical 1 100 0.0 255.00 FORMAT "%8.2" ECU_ADDRESS 0xfe40329a /end MEASUREMENT
/begin MEASUREMENT Tlib_PassDoorRdrObj10RdrObjAccStdY_ZCR_CANFD5 "" UBYTE RB_RBA_Common_CentralElements_CompuMethods_Identical 1 100 0.0 255.00 FORMAT "%8.2" ECU_ADDRESS 0xfe40329b /end MEASUREMENT
/begin MEASUREMENT Tlib_PassDoorRdrObj10RdrObjAccY_ZCR_CANFD5 "" UWORD RB_RBA_Common_CentralElements_CompuMethods_Identical 1 100 0.0 65535 FORMAT "%8.2" ECU_ADDRESS 0xfe402946 /end MEASUREMENT
/begin MEASUREMENT Tlib_PassDoorRdrObj10RdrObjRangeZ_ZCR_CANFD5 "" UWORD RB_RBA_Common_CentralElements_CompuMethods_Identical 1 100 0.0 65535 FORMAT "%8.2" ECU_ADDRESS 0xfe402948 /end MEASUREMENT
/begin MEASUREMENT Tlib_PassDoorRdrObj11RdrObjRangeStdX_ZCR_CANFD5 "" UBYTE RB_RBA_Common_CentralElements_CompuMethods_Identical 1 100 0.0 255.00 FORMAT "%8.2" ECU_ADDRESS 0xfe40329c /end MEASUREMENT
/begin MEASUREMENT Tlib_PassDoorRdrObj11RdrObjSpeedX_ZCR_CANFD5 "" UWORD RB_RBA_Common_CentralElements_CompuMethods_Identical 1 100 0.0 65535 FORMAT "%8.2" ECU_ADDRESS 0xfe40294a /end MEASUREMENT
/begin MEASUREMENT Tlib_PassDoorRdrObj11RdrObjTrackAge_ZCR_CANFD5 "" UBYTE RB_RBA_Common_CentralElements_CompuMethods_Identical 1 100 0.0 255.00 FORMAT "%8.2" ECU_ADDRESS 0xfe40329d /end MEASUREMENT
/begin MEASUREMENT Tlib_PassDoorRdrObj11RdrObjAccStdY_ZCR_CANFD5 "" UBYTE RB_RBA_Common_CentralElements_CompuMethods_Identical 1 100 0.0 255.00 FORMAT "%8.2" ECU_ADDRESS 0xfe40329e /end MEASUREMENT
/begin MEASUREMENT Tlib_PassDoorRdrObj11RdrObjDataMode_ZCR_CANFD5 "" UBYTE RB_RBA_Common_CentralElements_CompuMethods_Identical 1 100 0.0 255.00 FORMAT "%8.2" ECU_ADDRESS 0xfe40329f /end MEASUREMENT
/begin MEASUREMENT Tlib_PassDoorRdrObj11RdrObjAccStdX_ZCR_CANFD5 "" UBYTE RB_RBA_Common_CentralElements_CompuMethods_Identical 1 100 0.0 255.00 FORMAT "%8.2" ECU_ADDRESS 0xfe4032a0 /end MEASUREMENT
/begin MEASUREMENT Tlib_PassDoorRdrObj11RdrObjSpeedStdY_ZCR_CANFD5 "" UBYTE RB_RBA_Common_CentralElements_CompuMethods_Identical 1 100 0.0 255.00 FORMAT "%8.2" ECU_ADDRESS 0xfe4032a1 /end MEASUREMENT
/begin MEASUREMENT Tlib_PassDoorRdrObj11RdrObjMotionPattern_ZCR_CANFD5 "" UBYTE RB_RBA_Common_CentralElements_CompuMethods_Identical 1 100 0.0 255.00 FORMAT "%8.2" ECU_ADDRESS 0xfe4032a2 /end MEASUREMENT
/begin MEASUREMENT Tlib_PassDoorRdrObj11RdrObjAccY_ZCR_CANFD5 "" UWORD RB_RBA_Common_CentralElements_CompuMethods_Identical 1 100 0.0 65535 FORMAT "%8.2" ECU_ADDRESS 0xfe40294c /end MEASUREMENT
/begin MEASUREMENT Tlib_PassDoorRdrObj11RdrObjTrackClass_ZCR_CANFD5 "" UBYTE RB_RBA_Common_CentralElements_CompuMethods_Identical 1 100 0.0 255.00 FORMAT "%8.2" ECU_ADDRESS 0xfe4032a3 /end MEASUREMENT
/begin MEASUREMENT Tlib_PassDoorRdrObj11RdrObjConfidLvl_ZCR_CANFD5 "" UBYTE RB_RBA_Common_CentralElements_CompuMethods_Identical 1 100 0.0 255.00 FORMAT "%8.2" ECU_ADDRESS 0xfe4032a4 /end MEASUREMENT
/begin MEASUREMENT Tlib_PassDoorRdrObj11RdrObjRangeZ_ZCR_CANFD5 "" UWORD RB_RBA_Common_CentralElements_CompuMethods_Identical 1 100 0.0 65535 FORMAT "%8.2" ECU_ADDRESS 0xfe40294e /end MEASUREMENT
/begin MEASUREMENT Tlib_PassDoorRdrObj11RdrObjAccX_ZCR_CANFD5 "" UWORD RB_RBA_Common_CentralElements_CompuMethods_Identical 1 100 0.0 65535 FORMAT "%8.2" ECU_ADDRESS 0xfe402950 /end MEASUREMENT
/begin MEASUREMENT Tlib_PassDoorRdrObj11RdrObjRangeX_ZCR_CANFD5 "" UWORD RB_RBA_Common_CentralElements_CompuMethods_Identical 1 100 0.0 65535 FORMAT "%8.2" ECU_ADDRESS 0xfe402952 /end MEASUREMENT
/begin MEASUREMENT Tlib_PassDoorRdrObj11RdrObjRangeStdZ_ZCR_CANFD5 "" UBYTE RB_RBA_Common_CentralElements_CompuMethods_Identical 1 100 0.0 255.00 FORMAT "%8.2" ECU_ADDRESS 0xfe4032a5 /end MEASUREMENT
/begin MEASUREMENT Tlib_PassDoorRdrObj11RdrObjSpeedY_ZCR_CANFD5 "" UWORD RB_RBA_Common_CentralElements_CompuMethods_Identical 1 100 0.0 65535 FORMAT "%8.2" ECU_ADDRESS 0xfe402954 /end MEASUREMENT
/begin MEASUREMENT Tlib_PassDoorRdrObj11RdrObjSpeedStdX_ZCR_CANFD5 "" UBYTE RB_RBA_Common_CentralElements_CompuMethods_Identical 1 100 0.0 255.00 FORMAT "%8.2" ECU_ADDRESS 0xfe4032a6 /end MEASUREMENT
/begin MEASUREMENT Tlib_PassDoorRdrObj11RdrObjRangeStdY_ZCR_CANFD5 "" UBYTE RB_RBA_Common_CentralElements_CompuMethods_Identical 1 100 0.0 255.00 FORMAT "%8.2" ECU_ADDRESS 0xfe4032a7 /end MEASUREMENT
/begin MEASUREMENT Tlib_PassDoorRdrObj11RdrObjRangeY_ZCR_CANFD5 "" UWORD RB_RBA_Common_CentralElements_CompuMethods_Identical 1 100 0.0 65535 FORMAT "%8.2" ECU_ADDRESS 0xfe402956 /end MEASUREMENT
/begin MEASUREMENT Tlib_PassDoorRdrObj11RdrObjIdx_ZCR_CANFD5 "" UBYTE RB_RBA_Common_CentralElements_CompuMethods_Identical 1 100 0.0 255.00 FORMAT "%8.2" ECU_ADDRESS 0xfe4032a8 /end MEASUREMENT
/begin MEASUREMENT Tlib_RiReDoorRdrObj26RdrObjIdx_ZCR_CANFD5 "" UBYTE RB_RBA_Common_CentralElements_CompuMethods_Identical 1 100 0.0 255.00 FORMAT "%8.2" ECU_ADDRESS 0xfe4032a9 /end MEASUREMENT
/begin MEASUREMENT Tlib_RiReDoorRdrObj26RdrObjSpeedStdX_ZCR_CANFD5 "" UBYTE RB_RBA_Common_CentralElements_CompuMethods_Identical 1 100 0.0 255.00 FORMAT "%8.2" ECU_ADDRESS 0xfe4032aa /end MEASUREMENT
/begin MEASUREMENT Tlib_RiReDoorRdrObj26RdrObjTrackAge_ZCR_CANFD5 "" UBYTE RB_RBA_Common_CentralElements_CompuMethods_Identical 1 100 0.0 255.00 FORMAT "%8.2" ECU_ADDRESS 0xfe4032ab /end MEASUREMENT
/begin MEASUREMENT Tlib_RiReDoorRdrObj26RdrObjRangeX_ZCR_CANFD5 "" UWORD RB_RBA_Common_CentralElements_CompuMethods_Identical 1 100 0.0 65535 FORMAT "%8.2" ECU_ADDRESS 0xfe402958 /end MEASUREMENT
/begin MEASUREMENT Tlib_RiReDoorRdrObj26RdrObjRangeZ_ZCR_CANFD5 "" UWORD RB_RBA_Common_CentralElements_CompuMethods_Identical 1 100 0.0 65535 FORMAT "%8.2" ECU_ADDRESS 0xfe40295a /end MEASUREMENT
/begin MEASUREMENT Tlib_RiReDoorRdrObj26RdrObjAccX_ZCR_CANFD5 "" UWORD RB_RBA_Common_CentralElements_CompuMethods_Identical 1 100 0.0 65535 FORMAT "%8.2" ECU_ADDRESS 0xfe40295c /end MEASUREMENT
/begin MEASUREMENT Tlib_RiReDoorRdrObj26RdrObjSpeedX_ZCR_CANFD5 "" UWORD RB_RBA_Common_CentralElements_CompuMethods_Identical 1 100 0.0 65535 FORMAT "%8.2" ECU_ADDRESS 0xfe40295e /end MEASUREMENT
/begin MEASUREMENT Tlib_RiReDoorRdrObj26RdrObjRangeStdY_ZCR_CANFD5 "" UBYTE RB_RBA_Common_CentralElements_CompuMethods_Identical 1 100 0.0 255.00 FORMAT "%8.2" ECU_ADDRESS 0xfe4032ac /end MEASUREMENT
/begin MEASUREMENT Tlib_RiReDoorRdrObj26RdrObjAccStdY_ZCR_CANFD5 "" UBYTE RB_RBA_Common_CentralElements_CompuMethods_Identical 1 100 0.0 255.00 FORMAT "%8.2" ECU_ADDRESS 0xfe4032ad /end MEASUREMENT
/begin MEASUREMENT Tlib_RiReDoorRdrObj26RdrObjConfidLvl_ZCR_CANFD5 "" UBYTE RB_RBA_Common_CentralElements_CompuMethods_Identical 1 100 0.0 255.00 FORMAT "%8.2" ECU_ADDRESS 0xfe4032ae /end MEASUREMENT
/begin MEASUREMENT Tlib_RiReDoorRdrObj26RdrObjRangeStdZ_ZCR_CANFD5 "" UBYTE RB_RBA_Common_CentralElements_CompuMethods_Identical 1 100 0.0 255.00 FORMAT "%8.2" ECU_ADDRESS 0xfe4032af /end MEASUREMENT
/begin MEASUREMENT Tlib_RiReDoorRdrObj26RdrObjRangeStdX_ZCR_CANFD5 "" UBYTE RB_RBA_Common_CentralElements_CompuMethods_Identical 1 100 0.0 255.00 FORMAT "%8.2" ECU_ADDRESS 0xfe4032b0 /end MEASUREMENT
/begin MEASUREMENT Tlib_RiReDoorRdrObj26RdrObjSpeedStdY_ZCR_CANFD5 "" UBYTE RB_RBA_Common_CentralElements_CompuMethods_Identical 1 100 0.0 255.00 FORMAT "%8.2" ECU_ADDRESS 0xfe4032b1 /end MEASUREMENT
/begin MEASUREMENT Tlib_RiReDoorRdrObj26RdrObjTrackClass_ZCR_CANFD5 "" UBYTE RB_RBA_Common_CentralElements_CompuMethods_Identical 1 100 0.0 255.00 FORMAT "%8.2" ECU_ADDRESS 0xfe4032b2 /end MEASUREMENT
/begin MEASUREMENT Tlib_RiReDoorRdrObj26RdrObjAccStdX_ZCR_CANFD5 "" UBYTE RB_RBA_Common_CentralElements_CompuMethods_Identical 1 100 0.0 255.00 FORMAT "%8.2" ECU_ADDRESS 0xfe4032b3 /end MEASUREMENT
/begin MEASUREMENT Tlib_RiReDoorRdrObj26RdrObjDataMode_ZCR_CANFD5 "" UBYTE RB_RBA_Common_CentralElements_CompuMethods_Identical 1 100 0.0 255.00 FORMAT "%8.2" ECU_ADDRESS 0xfe4032b4 /end MEASUREMENT
/begin MEASUREMENT Tlib_RiReDoorRdrObj26RdrObjAccY_ZCR_CANFD5 "" UWORD RB_RBA_Common_CentralElements_CompuMethods_Identical 1 100 0.0 65535 FORMAT "%8.2" ECU_ADDRESS 0xfe402960 /end MEASUREMENT
/begin MEASUREMENT Tlib_RiReDoorRdrObj26RdrObjMotionPattern_ZCR_CANFD5 "" UBYTE RB_RBA_Common_CentralElements_CompuMethods_Identical 1 100 0.0 255.00 FORMAT "%8.2" ECU_ADDRESS 0xfe4032b5 /end MEASUREMENT
/begin MEASUREMENT Tlib_RiReDoorRdrObj26RdrObjRangeY_ZCR_CANFD5 "" UWORD RB_RBA_Common_CentralElements_CompuMethods_Identical 1 100 0.0 65535 FORMAT "%8.2" ECU_ADDRESS 0xfe402962 /end MEASUREMENT
/begin MEASUREMENT Tlib_RiReDoorRdrObj26RdrObjSpeedY_ZCR_CANFD5 "" UWORD RB_RBA_Common_CentralElements_CompuMethods_Identical 1 100 0.0 65535 FORMAT "%8.2" ECU_ADDRESS 0xfe402964 /end MEASUREMENT
/begin MEASUREMENT Tlib_RiReDoorRdrObj28RdrObjRangeStdZ_ZCR_CANFD5 "" UBYTE RB_RBA_Common_CentralElements_CompuMethods_Identical 1 100 0.0 255.00 FORMAT "%8.2" ECU_ADDRESS 0xfe4032b6 /end MEASUREMENT
/begin MEASUREMENT Tlib_RiReDoorRdrObj28RdrObjAccX_ZCR_CANFD5 "" UWORD RB_RBA_Common_CentralElements_CompuMethods_Identical 1 100 0.0 65535 FORMAT "%8.2" ECU_ADDRESS 0xfe402966 /end MEASUREMENT
/begin MEASUREMENT Tlib_RiReDoorRdrObj28RdrObjTrackAge_ZCR_CANFD5 "" UBYTE RB_RBA_Common_CentralElements_CompuMethods_Identical 1 100 0.0 255.00 FORMAT "%8.2" ECU_ADDRESS 0xfe4032b7 /end MEASUREMENT
/begin MEASUREMENT Tlib_RiReDoorRdrObj28RdrObjAccStdX_ZCR_CANFD5 "" UBYTE RB_RBA_Common_CentralElements_CompuMethods_Identical 1 100 0.0 255.00 FORMAT "%8.2" ECU_ADDRESS 0xfe4032b8 /end MEASUREMENT
/begin MEASUREMENT Tlib_RiReDoorRdrObj28RdrObjSpeedX_ZCR_CANFD5 "" UWORD RB_RBA_Common_CentralElements_CompuMethods_Identical 1 100 0.0 65535 FORMAT "%8.2" ECU_ADDRESS 0xfe402968 /end MEASUREMENT
/begin MEASUREMENT Tlib_RiReDoorRdrObj28RdrObjMotionPattern_ZCR_CANFD5 "" UBYTE RB_RBA_Common_CentralElements_CompuMethods_Identical 1 100 0.0 255.00 FORMAT "%8.2" ECU_ADDRESS 0xfe4032b9 /end MEASUREMENT
/begin MEASUREMENT Tlib_RiReDoorRdrObj28RdrObjDataMode_ZCR_CANFD5 "" UBYTE RB_RBA_Common_CentralElements_CompuMethods_Identical 1 100 0.0 255.00 FORMAT "%8.2" ECU_ADDRESS 0xfe4032ba /end MEASUREMENT
/begin MEASUREMENT Tlib_RiReDoorRdrObj28RdrObjRangeY_ZCR_CANFD5 "" UWORD RB_RBA_Common_CentralElements_CompuMethods_Identical 1 100 0.0 65535 FORMAT "%8.2" ECU_ADDRESS 0xfe40296a /end MEASUREMENT
/begin MEASUREMENT Tlib_RiReDoorRdrObj28RdrObjRangeZ_ZCR_CANFD5 "" UWORD RB_RBA_Common_CentralElements_CompuMethods_Identical 1 100 0.0 65535 FORMAT "%8.2" ECU_ADDRESS 0xfe40296c /end MEASUREMENT
/begin MEASUREMENT Tlib_RiReDoorRdrObj28RdrObjTrackClass_ZCR_CANFD5 "" UBYTE RB_RBA_Common_CentralElements_CompuMethods_Identical 1 100 0.0 255.00 FORMAT "%8.2" ECU_ADDRESS 0xfe4032bb /end MEASUREMENT
/begin MEASUREMENT Tlib_RiReDoorRdrObj28RdrObjIdx_ZCR_CANFD5 "" UBYTE RB_RBA_Common_CentralElements_CompuMethods_Identical 1 100 0.0 255.00 FORMAT "%8.2" ECU_ADDRESS 0xfe4032bc /end MEASUREMENT
/begin MEASUREMENT Tlib_RiReDoorRdrObj28RdrObjSpeedStdX_ZCR_CANFD5 "" UBYTE RB_RBA_Common_CentralElements_CompuMethods_Identical 1 100 0.0 255.00 FORMAT "%8.2" ECU_ADDRESS 0xfe4032bd /end MEASUREMENT
/begin MEASUREMENT Tlib_RiReDoorRdrObj28RdrObjAccStdY_ZCR_CANFD5 "" UBYTE RB_RBA_Common_CentralElements_CompuMethods_Identical 1 100 0.0 255.00 FORMAT "%8.2" ECU_ADDRESS 0xfe4032be /end MEASUREMENT
/begin MEASUREMENT Tlib_RiReDoorRdrObj28RdrObjSpeedY_ZCR_CANFD5 "" UWORD RB_RBA_Common_CentralElements_CompuMethods_Identical 1 100 0.0 65535 FORMAT "%8.2" ECU_ADDRESS 0xfe40296e /end MEASUREMENT
/begin MEASUREMENT Tlib_RiReDoorRdrObj28RdrObjConfidLvl_ZCR_CANFD5 "" UBYTE RB_RBA_Common_CentralElements_CompuMethods_Identical 1 100 0.0 255.00 FORMAT "%8.2" ECU_ADDRESS 0xfe4032bf /end MEASUREMENT
/begin MEASUREMENT Tlib_RiReDoorRdrObj28RdrObjSpeedStdY_ZCR_CANFD5 "" UBYTE RB_RBA_Common_CentralElements_CompuMethods_Identical 1 100 0.0 255.00 FORMAT "%8.2" ECU_ADDRESS 0xfe4032c0 /end MEASUREMENT
/begin MEASUREMENT Tlib_RiReDoorRdrObj28RdrObjRangeStdY_ZCR_CANFD5 "" UBYTE RB_RBA_Common_CentralElements_CompuMethods_Identical 1 100 0.0 255.00 FORMAT "%8.2" ECU_ADDRESS 0xfe4032c1 /end MEASUREMENT
/begin MEASUREMENT Tlib_RiReDoorRdrObj28RdrObjAccY_ZCR_CANFD5 "" UWORD RB_RBA_Common_CentralElements_CompuMethods_Identical 1 100 0.0 65535 FORMAT "%8.2" ECU_ADDRESS 0xfe402970 /end MEASUREMENT
/begin MEASUREMENT Tlib_RiReDoorRdrObj28RdrObjRangeStdX_ZCR_CANFD5 "" UBYTE RB_RBA_Common_CentralElements_CompuMethods_Identical 1 100 0.0 255.00 FORMAT "%8.2" ECU_ADDRESS 0xfe4032c2 /end MEASUREMENT
/begin MEASUREMENT Tlib_RiReDoorRdrObj28RdrObjRangeX_ZCR_CANFD5 "" UWORD RB_RBA_Common_CentralElements_CompuMethods_Identical 1 100 0.0 65535 FORMAT "%8.2" ECU_ADDRESS 0xfe402972 /end MEASUREMENT
/begin MEASUREMENT Tlib_RiReDoorRdrObj27RdrObjSpeedStdY_ZCR_CANFD5 "" UBYTE RB_RBA_Common_CentralElements_CompuMethods_Identical 1 100 0.0 255.00 FORMAT "%8.2" ECU_ADDRESS 0xfe4032c3 /end MEASUREMENT
/begin MEASUREMENT Tlib_RiReDoorRdrObj27RdrObjRangeZ_ZCR_CANFD5 "" UWORD RB_RBA_Common_CentralElements_CompuMethods_Identical 1 100 0.0 65535 FORMAT "%8.2" ECU_ADDRESS 0xfe402974 /end MEASUREMENT
/begin MEASUREMENT Tlib_RiReDoorRdrObj27RdrObjSpeedX_ZCR_CANFD5 "" UWORD RB_RBA_Common_CentralElements_CompuMethods_Identical 1 100 0.0 65535 FORMAT "%8.2" ECU_ADDRESS 0xfe402976 /end MEASUREMENT
/begin MEASUREMENT Tlib_RiReDoorRdrObj27RdrObjSpeedY_ZCR_CANFD5 "" UWORD RB_RBA_Common_CentralElements_CompuMethods_Identical 1 100 0.0 65535 FORMAT "%8.2" ECU_ADDRESS 0xfe402978 /end MEASUREMENT
/begin MEASUREMENT Tlib_RiReDoorRdrObj27RdrObjTrackAge_ZCR_CANFD5 "" UBYTE RB_RBA_Common_CentralElements_CompuMethods_Identical 1 100 0.0 255.00 FORMAT "%8.2" ECU_ADDRESS 0xfe4032c4 /end MEASUREMENT
/begin MEASUREMENT Tlib_RiReDoorRdrObj27RdrObjAccStdY_ZCR_CANFD5 "" UBYTE RB_RBA_Common_CentralElements_CompuMethods_Identical 1 100 0.0 255.00 FORMAT "%8.2" ECU_ADDRESS 0xfe4032c5 /end MEASUREMENT
/begin MEASUREMENT Tlib_RiReDoorRdrObj27RdrObjIdx_ZCR_CANFD5 "" UBYTE RB_RBA_Common_CentralElements_CompuMethods_Identical 1 100 0.0 255.00 FORMAT "%8.2" ECU_ADDRESS 0xfe4032c6 /end MEASUREMENT
/begin MEASUREMENT Tlib_RiReDoorRdrObj27RdrObjAccX_ZCR_CANFD5 "" UWORD RB_RBA_Common_CentralElements_CompuMethods_Identical 1 100 0.0 65535 FORMAT "%8.2" ECU_ADDRESS 0xfe40297a /end MEASUREMENT
/begin MEASUREMENT Tlib_RiReDoorRdrObj27RdrObjRangeStdX_ZCR_CANFD5 "" UBYTE RB_RBA_Common_CentralElements_CompuMethods_Identical 1 100 0.0 255.00 FORMAT "%8.2" ECU_ADDRESS 0xfe4032c7 /end MEASUREMENT
/begin MEASUREMENT Tlib_RiReDoorRdrObj27RdrObjTrackClass_ZCR_CANFD5 "" UBYTE RB_RBA_Common_CentralElements_CompuMethods_Identical 1 100 0.0 255.00 FORMAT "%8.2" ECU_ADDRESS 0xfe4032c8 /end MEASUREMENT
/begin MEASUREMENT Tlib_RiReDoorRdrObj27RdrObjSpeedStdX_ZCR_CANFD5 "" UBYTE RB_RBA_Common_CentralElements_CompuMethods_Identical 1 100 0.0 255.00 FORMAT "%8.2" ECU_ADDRESS 0xfe4032c9 /end MEASUREMENT
/begin MEASUREMENT Tlib_RiReDoorRdrObj27RdrObjAccY_ZCR_CANFD5 "" UWORD RB_RBA_Common_CentralElements_CompuMethods_Identical 1 100 0.0 65535 FORMAT "%8.2" ECU_ADDRESS 0xfe40297c /end MEASUREMENT
/begin MEASUREMENT Tlib_RiReDoorRdrObj27RdrObjDataMode_ZCR_CANFD5 "" UBYTE RB_RBA_Common_CentralElements_CompuMethods_Identical 1 100 0.0 255.00 FORMAT "%8.2" ECU_ADDRESS 0xfe4032ca /end MEASUREMENT
/begin MEASUREMENT Tlib_RiReDoorRdrObj27RdrObjRangeX_ZCR_CANFD5 "" UWORD RB_RBA_Common_CentralElements_CompuMethods_Identical 1 100 0.0 65535 FORMAT "%8.2" ECU_ADDRESS 0xfe40297e /end MEASUREMENT
/begin MEASUREMENT Tlib_RiReDoorRdrObj27RdrObjRangeStdZ_ZCR_CANFD5 "" UBYTE RB_RBA_Common_CentralElements_CompuMethods_Identical 1 100 0.0 255.00 FORMAT "%8.2" ECU_ADDRESS 0xfe4032cb /end MEASUREMENT
/begin MEASUREMENT Tlib_RiReDoorRdrObj27RdrObjRangeY_ZCR_CANFD5 "" UWORD RB_RBA_Common_CentralElements_CompuMethods_Identical 1 100 0.0 65535 FORMAT "%8.2" ECU_ADDRESS 0xfe402980 /end MEASUREMENT
/begin MEASUREMENT Tlib_RiReDoorRdrObj27RdrObjConfidLvl_ZCR_CANFD5 "" UBYTE RB_RBA_Common_CentralElements_CompuMethods_Identical 1 100 0.0 255.00 FORMAT "%8.2" ECU_ADDRESS 0xfe4032cc /end MEASUREMENT
/begin MEASUREMENT Tlib_RiReDoorRdrObj27RdrObjRangeStdY_ZCR_CANFD5 "" UBYTE RB_RBA_Common_CentralElements_CompuMethods_Identical 1 100 0.0 255.00 FORMAT "%8.2" ECU_ADDRESS 0xfe4032cd /end MEASUREMENT
/begin MEASUREMENT Tlib_RiReDoorRdrObj27RdrObjAccStdX_ZCR_CANFD5 "" UBYTE RB_RBA_Common_CentralElements_CompuMethods_Identical 1 100 0.0 255.00 FORMAT "%8.2" ECU_ADDRESS 0xfe4032ce /end MEASUREMENT
/begin MEASUREMENT Tlib_RiReDoorRdrObj27RdrObjMotionPattern_ZCR_CANFD5 "" UBYTE RB_RBA_Common_CentralElements_CompuMethods_Identical 1 100 0.0 255.00 FORMAT "%8.2" ECU_ADDRESS 0xfe4032cf /end MEASUREMENT
/begin MEASUREMENT Tlib_CinhPassSwtHi_ZCR_CANFD5 "" UBYTE RB_RBA_Common_CentralElements_CompuMethods_Identical 1 100 0.0 255.00 FORMAT "%8.2" ECU_ADDRESS 0xfe4032d0 /end MEASUREMENT
/begin MEASUREMENT Tlib_DoorPass2Swt1DplyHndlHi_ZCR_CANFD5 "" UBYTE RB_RBA_Common_CentralElements_CompuMethods_Identical 1 100 0.0 255.00 FORMAT "%8.2" ECU_ADDRESS 0xfe4032d1 /end MEASUREMENT
/begin MEASUREMENT Tlib_DoorPassLatPawlStHi_ZCR_CANFD5 "" UBYTE RB_RBA_Common_CentralElements_CompuMethods_Identical 1 100 0.0 255.00 FORMAT "%8.2" ECU_ADDRESS 0xfe4032d2 /end MEASUREMENT
/begin MEASUREMENT Tlib_PawlPassSwtHi_ZCR_CANFD5 "" UBYTE RB_RBA_Common_CentralElements_CompuMethods_Identical 1 100 0.0 255.00 FORMAT "%8.2" ECU_ADDRESS 0xfe4032d3 /end MEASUREMENT
/begin MEASUREMENT Tlib_DoorPassCinFailHiFailure1_ZCR_CANFD5 "" UBYTE RB_RBA_Common_CentralElements_CompuMethods_Identical 1 100 0.0 255.00 FORMAT "%8.2" ECU_ADDRESS 0xfe4032d4 /end MEASUREMENT
/begin MEASUREMENT Tlib_DoorPassCinFailHiMechRels_ZCR_CANFD5 "" UBYTE RB_RBA_Common_CentralElements_CompuMethods_Identical 1 100 0.0 255.00 FORMAT "%8.2" ECU_ADDRESS 0xfe4032d5 /end MEASUREMENT
/begin MEASUREMENT Tlib_DoorPassCinFailHiCinchOverTimed_ZCR_CANFD5 "" UBYTE RB_RBA_Common_CentralElements_CompuMethods_Identical 1 100 0.0 255.00 FORMAT "%8.2" ECU_ADDRESS 0xfe4032d6 /end MEASUREMENT
/begin MEASUREMENT Tlib_DoorPassHndlStsHi_ZCR_CANFD5 "" UBYTE RB_RBA_Common_CentralElements_CompuMethods_Identical 1 100 0.0 255.00 FORMAT "%8.2" ECU_ADDRESS 0xfe4032d7 /end MEASUREMENT
/begin MEASUREMENT Tlib_OpenPassSwtHi_ZCR_CANFD5 "" UBYTE RB_RBA_Common_CentralElements_CompuMethods_Identical 1 100 0.0 255.00 FORMAT "%8.2" ECU_ADDRESS 0xfe4032d8 /end MEASUREMENT
/begin MEASUREMENT Tlib_DoorPassSwtIntrLockgReqHi_ZCR_CANFD5 "" UBYTE RB_RBA_Common_CentralElements_CompuMethods_Identical 1 100 0.0 255.00 FORMAT "%8.2" ECU_ADDRESS 0xfe4032d9 /end MEASUREMENT
/begin MEASUREMENT Tlib_DoorPass2Swt2DplyHndlHi_ZCR_CANFD5 "" UBYTE RB_RBA_Common_CentralElements_CompuMethods_Identical 1 100 0.0 255.00 FORMAT "%8.2" ECU_ADDRESS 0xfe4032da /end MEASUREMENT
/begin MEASUREMENT Tlib_DoorPassRelsFailHiFailure1_ZCR_CANFD5 "" UBYTE RB_RBA_Common_CentralElements_CompuMethods_Identical 1 100 0.0 255.00 FORMAT "%8.2" ECU_ADDRESS 0xfe4032db /end MEASUREMENT
/begin MEASUREMENT Tlib_DoorPassRelsFailHiMechRels_ZCR_CANFD5 "" UBYTE RB_RBA_Common_CentralElements_CompuMethods_Identical 1 100 0.0 255.00 FORMAT "%8.2" ECU_ADDRESS 0xfe4032dc /end MEASUREMENT
/begin MEASUREMENT Tlib_DoorPassRelsFailHiCinchOverTimed_ZCR_CANFD5 "" UBYTE RB_RBA_Common_CentralElements_CompuMethods_Identical 1 100 0.0 255.00 FORMAT "%8.2" ECU_ADDRESS 0xfe4032dd /end MEASUREMENT
/begin MEASUREMENT Tlib_DoorPassCinhIntFailInfHiCinchRestFlt_ZCR_CANFD5 "" UBYTE RB_RBA_Common_CentralElements_CompuMethods_Identical 1 100 0.0 255.00 FORMAT "%8.2" ECU_ADDRESS 0xfe4032de /end MEASUREMENT
/begin MEASUREMENT Tlib_DoorPassCinhIntFailInfHiCinchFlt1_ZCR_CANFD5 "" UBYTE RB_RBA_Common_CentralElements_CompuMethods_Identical 1 100 0.0 255.00 FORMAT "%8.2" ECU_ADDRESS 0xfe4032df /end MEASUREMENT
/begin MEASUREMENT Tlib_IceBreakDoorPassActvHi_ZCR_CANFD5 "" UBYTE RB_RBA_Common_CentralElements_CompuMethods_Identical 1 100 0.0 255.00 FORMAT "%8.2" ECU_ADDRESS 0xfe4032e0 /end MEASUREMENT
/begin MEASUREMENT Tlib_CinhPassStsHi_ZCR_CANFD5 "" UBYTE RB_RBA_Common_CentralElements_CompuMethods_Identical 1 100 0.0 255.00 FORMAT "%8.2" ECU_ADDRESS 0xfe4032e1 /end MEASUREMENT
/begin MEASUREMENT Tlib_AntiPinchStsAtPassHi_ZCR_CANFD5 "" UBYTE RB_RBA_Common_CentralElements_CompuMethods_Identical 1 100 0.0 255.00 FORMAT "%8.2" ECU_ADDRESS 0xfe4032e2 /end MEASUREMENT
/begin MEASUREMENT Tlib_PassDoorRdrObj4RdrObjIdx_ZCR_CANFD5 "" UBYTE RB_RBA_Common_CentralElements_CompuMethods_Identical 1 100 0.0 255.00 FORMAT "%8.2" ECU_ADDRESS 0xfe4032e3 /end MEASUREMENT
/begin MEASUREMENT Tlib_PassDoorRdrObj4RdrObjRangeY_ZCR_CANFD5 "" UWORD RB_RBA_Common_CentralElements_CompuMethods_Identical 1 100 0.0 65535 FORMAT "%8.2" ECU_ADDRESS 0xfe402982 /end MEASUREMENT
/begin MEASUREMENT Tlib_PassDoorRdrObj4RdrObjSpeedY_ZCR_CANFD5 "" UWORD RB_RBA_Common_CentralElements_CompuMethods_Identical 1 100 0.0 65535 FORMAT "%8.2" ECU_ADDRESS 0xfe402984 /end MEASUREMENT
/begin MEASUREMENT Tlib_PassDoorRdrObj4RdrObjTrackClass_ZCR_CANFD5 "" UBYTE RB_RBA_Common_CentralElements_CompuMethods_Identical 1 100 0.0 255.00 FORMAT "%8.2" ECU_ADDRESS 0xfe4032e4 /end MEASUREMENT
/begin MEASUREMENT Tlib_PassDoorRdrObj4RdrObjTrackAge_ZCR_CANFD5 "" UBYTE RB_RBA_Common_CentralElements_CompuMethods_Identical 1 100 0.0 255.00 FORMAT "%8.2" ECU_ADDRESS 0xfe4032e5 /end MEASUREMENT
/begin MEASUREMENT Tlib_PassDoorRdrObj4RdrObjAccY_ZCR_CANFD5 "" UWORD RB_RBA_Common_CentralElements_CompuMethods_Identical 1 100 0.0 65535 FORMAT "%8.2" ECU_ADDRESS 0xfe402986 /end MEASUREMENT
/begin MEASUREMENT Tlib_PassDoorRdrObj4RdrObjAccStdY_ZCR_CANFD5 "" UBYTE RB_RBA_Common_CentralElements_CompuMethods_Identical 1 100 0.0 255.00 FORMAT "%8.2" ECU_ADDRESS 0xfe4032e6 /end MEASUREMENT
/begin MEASUREMENT Tlib_PassDoorRdrObj4RdrObjConfidLvl_ZCR_CANFD5 "" UBYTE RB_RBA_Common_CentralElements_CompuMethods_Identical 1 100 0.0 255.00 FORMAT "%8.2" ECU_ADDRESS 0xfe4032e7 /end MEASUREMENT
/begin MEASUREMENT Tlib_PassDoorRdrObj4RdrObjRangeX_ZCR_CANFD5 "" UWORD RB_RBA_Common_CentralElements_CompuMethods_Identical 1 100 0.0 65535 FORMAT "%8.2" ECU_ADDRESS 0xfe402988 /end MEASUREMENT
/begin MEASUREMENT Tlib_PassDoorRdrObj4RdrObjRangeStdY_ZCR_CANFD5 "" UBYTE RB_RBA_Common_CentralElements_CompuMethods_Identical 1 100 0.0 255.00 FORMAT "%8.2" ECU_ADDRESS 0xfe4032e8 /end MEASUREMENT
/begin MEASUREMENT Tlib_PassDoorRdrObj4RdrObjAccStdX_ZCR_CANFD5 "" UBYTE RB_RBA_Common_CentralElements_CompuMethods_Identical 1 100 0.0 255.00 FORMAT "%8.2" ECU_ADDRESS 0xfe4032e9 /end MEASUREMENT
/begin MEASUREMENT Tlib_PassDoorRdrObj4RdrObjRangeZ_ZCR_CANFD5 "" UWORD RB_RBA_Common_CentralElements_CompuMethods_Identical 1 100 0.0 65535 FORMAT "%8.2" ECU_ADDRESS 0xfe40298a /end MEASUREMENT
/begin MEASUREMENT Tlib_PassDoorRdrObj4RdrObjMotionPattern_ZCR_CANFD5 "" UBYTE RB_RBA_Common_CentralElements_CompuMethods_Identical 1 100 0.0 255.00 FORMAT "%8.2" ECU_ADDRESS 0xfe4032ea /end MEASUREMENT
/begin MEASUREMENT Tlib_PassDoorRdrObj4RdrObjSpeedStdX_ZCR_CANFD5 "" UBYTE RB_RBA_Common_CentralElements_CompuMethods_Identical 1 100 0.0 255.00 FORMAT "%8.2" ECU_ADDRESS 0xfe4032eb /end MEASUREMENT
/begin MEASUREMENT Tlib_PassDoorRdrObj4RdrObjSpeedX_ZCR_CANFD5 "" UWORD RB_RBA_Common_CentralElements_CompuMethods_Identical 1 100 0.0 65535 FORMAT "%8.2" ECU_ADDRESS 0xfe40298c /end MEASUREMENT
/begin MEASUREMENT Tlib_PassDoorRdrObj4RdrObjRangeStdX_ZCR_CANFD5 "" UBYTE RB_RBA_Common_CentralElements_CompuMethods_Identical 1 100 0.0 255.00 FORMAT "%8.2" ECU_ADDRESS 0xfe4032ec /end MEASUREMENT
/begin MEASUREMENT Tlib_PassDoorRdrObj4RdrObjDataMode_ZCR_CANFD5 "" UBYTE RB_RBA_Common_CentralElements_CompuMethods_Identical 1 100 0.0 255.00 FORMAT "%8.2" ECU_ADDRESS 0xfe4032ed /end MEASUREMENT
/begin MEASUREMENT Tlib_PassDoorRdrObj4RdrObjRangeStdZ_ZCR_CANFD5 "" UBYTE RB_RBA_Common_CentralElements_CompuMethods_Identical 1 100 0.0 255.00 FORMAT "%8.2" ECU_ADDRESS 0xfe4032ee /end MEASUREMENT
/begin MEASUREMENT Tlib_PassDoorRdrObj4RdrObjSpeedStdY_ZCR_CANFD5 "" UBYTE RB_RBA_Common_CentralElements_CompuMethods_Identical 1 100 0.0 255.00 FORMAT "%8.2" ECU_ADDRESS 0xfe4032ef /end MEASUREMENT
/begin MEASUREMENT Tlib_PassDoorRdrObj4RdrObjAccX_ZCR_CANFD5 "" UWORD RB_RBA_Common_CentralElements_CompuMethods_Identical 1 100 0.0 65535 FORMAT "%8.2" ECU_ADDRESS 0xfe40298e /end MEASUREMENT
/begin MEASUREMENT Tlib_PassDoorRdrObj31RdrObjRangeStdY_ZCR_CANFD5 "" UBYTE RB_RBA_Common_CentralElements_CompuMethods_Identical 1 100 0.0 255.00 FORMAT "%8.2" ECU_ADDRESS 0xfe4032f0 /end MEASUREMENT
/begin MEASUREMENT Tlib_PassDoorRdrObj31RdrObjSpeedX_ZCR_CANFD5 "" UWORD RB_RBA_Common_CentralElements_CompuMethods_Identical 1 100 0.0 65535 FORMAT "%8.2" ECU_ADDRESS 0xfe402990 /end MEASUREMENT
/begin MEASUREMENT Tlib_PassDoorRdrObj31RdrObjTrackAge_ZCR_CANFD5 "" UBYTE RB_RBA_Common_CentralElements_CompuMethods_Identical 1 100 0.0 255.00 FORMAT "%8.2" ECU_ADDRESS 0xfe4032f1 /end MEASUREMENT
/begin MEASUREMENT Tlib_PassDoorRdrObj31RdrObjAccStdX_ZCR_CANFD5 "" UBYTE RB_RBA_Common_CentralElements_CompuMethods_Identical 1 100 0.0 255.00 FORMAT "%8.2" ECU_ADDRESS 0xfe4032f2 /end MEASUREMENT
/begin MEASUREMENT Tlib_PassDoorRdrObj31RdrObjAccY_ZCR_CANFD5 "" UWORD RB_RBA_Common_CentralElements_CompuMethods_Identical 1 100 0.0 65535 FORMAT "%8.2" ECU_ADDRESS 0xfe402992 /end MEASUREMENT
/begin MEASUREMENT Tlib_PassDoorRdrObj31RdrObjTrackClass_ZCR_CANFD5 "" UBYTE RB_RBA_Common_CentralElements_CompuMethods_Identical 1 100 0.0 255.00 FORMAT "%8.2" ECU_ADDRESS 0xfe4032f3 /end MEASUREMENT
/begin MEASUREMENT Tlib_PassDoorRdrObj31RdrObjDataMode_ZCR_CANFD5 "" UBYTE RB_RBA_Common_CentralElements_CompuMethods_Identical 1 100 0.0 255.00 FORMAT "%8.2" ECU_ADDRESS 0xfe4032f4 /end MEASUREMENT
/begin MEASUREMENT Tlib_PassDoorRdrObj31RdrObjIdx_ZCR_CANFD5 "" UBYTE RB_RBA_Common_CentralElements_CompuMethods_Identical 1 100 0.0 255.00 FORMAT "%8.2" ECU_ADDRESS 0xfe4032f5 /end MEASUREMENT
/begin MEASUREMENT Tlib_PassDoorRdrObj31RdrObjSpeedStdX_ZCR_CANFD5 "" UBYTE RB_RBA_Common_CentralElements_CompuMethods_Identical 1 100 0.0 255.00 FORMAT "%8.2" ECU_ADDRESS 0xfe4032f6 /end MEASUREMENT
/begin MEASUREMENT Tlib_PassDoorRdrObj31RdrObjAccX_ZCR_CANFD5 "" UWORD RB_RBA_Common_CentralElements_CompuMethods_Identical 1 100 0.0 65535 FORMAT "%8.2" ECU_ADDRESS 0xfe402994 /end MEASUREMENT
/begin MEASUREMENT Tlib_PassDoorRdrObj31RdrObjRangeStdZ_ZCR_CANFD5 "" UBYTE RB_RBA_Common_CentralElements_CompuMethods_Identical 1 100 0.0 255.00 FORMAT "%8.2" ECU_ADDRESS 0xfe4032f7 /end MEASUREMENT
/begin MEASUREMENT Tlib_PassDoorRdrObj31RdrObjRangeX_ZCR_CANFD5 "" UWORD RB_RBA_Common_CentralElements_CompuMethods_Identical 1 100 0.0 65535 FORMAT "%8.2" ECU_ADDRESS 0xfe402996 /end MEASUREMENT
/begin MEASUREMENT Tlib_PassDoorRdrObj31RdrObjRangeY_ZCR_CANFD5 "" UWORD RB_RBA_Common_CentralElements_CompuMethods_Identical 1 100 0.0 65535 FORMAT "%8.2" ECU_ADDRESS 0xfe402998 /end MEASUREMENT
/begin MEASUREMENT Tlib_PassDoorRdrObj31RdrObjRangeZ_ZCR_CANFD5 "" UWORD RB_RBA_Common_CentralElements_CompuMethods_Identical 1 100 0.0 65535 FORMAT "%8.2" ECU_ADDRESS 0xfe40299a /end MEASUREMENT
/begin MEASUREMENT Tlib_PassDoorRdrObj31RdrObjSpeedY_ZCR_CANFD5 "" UWORD RB_RBA_Common_CentralElements_CompuMethods_Identical 1 100 0.0 65535 FORMAT "%8.2" ECU_ADDRESS 0xfe40299c /end MEASUREMENT
/begin MEASUREMENT Tlib_PassDoorRdrObj31RdrObjAccStdY_ZCR_CANFD5 "" UBYTE RB_RBA_Common_CentralElements_CompuMethods_Identical 1 100 0.0 255.00 FORMAT "%8.2" ECU_ADDRESS 0xfe4032f8 /end MEASUREMENT
/begin MEASUREMENT Tlib_PassDoorRdrObj31RdrObjSpeedStdY_ZCR_CANFD5 "" UBYTE RB_RBA_Common_CentralElements_CompuMethods_Identical 1 100 0.0 255.00 FORMAT "%8.2" ECU_ADDRESS 0xfe4032f9 /end MEASUREMENT
/begin MEASUREMENT Tlib_PassDoorRdrObj31RdrObjConfidLvl_ZCR_CANFD5 "" UBYTE RB_RBA_Common_CentralElements_CompuMethods_Identical 1 100 0.0 255.00 FORMAT "%8.2" ECU_ADDRESS 0xfe4032fa /end MEASUREMENT
/begin MEASUREMENT Tlib_PassDoorRdrObj31RdrObjMotionPattern_ZCR_CANFD5 "" UBYTE RB_RBA_Common_CentralElements_CompuMethods_Identical 1 100 0.0 255.00 FORMAT "%8.2" ECU_ADDRESS 0xfe4032fb /end MEASUREMENT
/begin MEASUREMENT Tlib_PassDoorRdrObj31RdrObjRangeStdX_ZCR_CANFD5 "" UBYTE RB_RBA_Common_CentralElements_CompuMethods_Identical 1 100 0.0 255.00 FORMAT "%8.2" ECU_ADDRESS 0xfe4032fc /end MEASUREMENT
/begin MEASUREMENT Tlib_PassDoorRdrObj32RdrObjRangeY_ZCR_CANFD5 "" UWORD RB_RBA_Common_CentralElements_CompuMethods_Identical 1 100 0.0 65535 FORMAT "%8.2" ECU_ADDRESS 0xfe40299e /end MEASUREMENT
/begin MEASUREMENT Tlib_PassDoorRdrObj32RdrObjAccX_ZCR_CANFD5 "" UWORD RB_RBA_Common_CentralElements_CompuMethods_Identical 1 100 0.0 65535 FORMAT "%8.2" ECU_ADDRESS 0xfe4029a0 /end MEASUREMENT
/begin MEASUREMENT Tlib_PassDoorRdrObj32RdrObjDataMode_ZCR_CANFD5 "" UBYTE RB_RBA_Common_CentralElements_CompuMethods_Identical 1 100 0.0 255.00 FORMAT "%8.2" ECU_ADDRESS 0xfe4032fd /end MEASUREMENT
/begin MEASUREMENT Tlib_PassDoorRdrObj32RdrObjSpeedStdX_ZCR_CANFD5 "" UBYTE RB_RBA_Common_CentralElements_CompuMethods_Identical 1 100 0.0 255.00 FORMAT "%8.2" ECU_ADDRESS 0xfe4032fe /end MEASUREMENT
/begin MEASUREMENT Tlib_PassDoorRdrObj32RdrObjTrackClass_ZCR_CANFD5 "" UBYTE RB_RBA_Common_CentralElements_CompuMethods_Identical 1 100 0.0 255.00 FORMAT "%8.2" ECU_ADDRESS 0xfe4032ff /end MEASUREMENT
/begin MEASUREMENT Tlib_PassDoorRdrObj32RdrObjRangeZ_ZCR_CANFD5 "" UWORD RB_RBA_Common_CentralElements_CompuMethods_Identical 1 100 0.0 65535 FORMAT "%8.2" ECU_ADDRESS 0xfe4029a2 /end MEASUREMENT
/begin MEASUREMENT Tlib_PassDoorRdrObj32RdrObjRangeStdY_ZCR_CANFD5 "" UBYTE RB_RBA_Common_CentralElements_CompuMethods_Identical 1 100 0.0 255.00 FORMAT "%8.2" ECU_ADDRESS 0xfe403300 /end MEASUREMENT
/begin MEASUREMENT Tlib_PassDoorRdrObj32RdrObjMotionPattern_ZCR_CANFD5 "" UBYTE RB_RBA_Common_CentralElements_CompuMethods_Identical 1 100 0.0 255.00 FORMAT "%8.2" ECU_ADDRESS 0xfe403301 /end MEASUREMENT
/begin MEASUREMENT Tlib_PassDoorRdrObj32RdrObjAccStdX_ZCR_CANFD5 "" UBYTE RB_RBA_Common_CentralElements_CompuMethods_Identical 1 100 0.0 255.00 FORMAT "%8.2" ECU_ADDRESS 0xfe403302 /end MEASUREMENT
/begin MEASUREMENT Tlib_PassDoorRdrObj32RdrObjTrackAge_ZCR_CANFD5 "" UBYTE RB_RBA_Common_CentralElements_CompuMethods_Identical 1 100 0.0 255.00 FORMAT "%8.2" ECU_ADDRESS 0xfe403303 /end MEASUREMENT
/begin MEASUREMENT Tlib_PassDoorRdrObj32RdrObjIdx_ZCR_CANFD5 "" UBYTE RB_RBA_Common_CentralElements_CompuMethods_Identical 1 100 0.0 255.00 FORMAT "%8.2" ECU_ADDRESS 0xfe403304 /end MEASUREMENT
/begin MEASUREMENT Tlib_PassDoorRdrObj32RdrObjRangeStdZ_ZCR_CANFD5 "" UBYTE RB_RBA_Common_CentralElements_CompuMethods_Identical 1 100 0.0 255.00 FORMAT "%8.2" ECU_ADDRESS 0xfe403305 /end MEASUREMENT
/begin MEASUREMENT Tlib_PassDoorRdrObj32RdrObjRangeStdX_ZCR_CANFD5 "" UBYTE RB_RBA_Common_CentralElements_CompuMethods_Identical 1 100 0.0 255.00 FORMAT "%8.2" ECU_ADDRESS 0xfe403306 /end MEASUREMENT
/begin MEASUREMENT Tlib_PassDoorRdrObj32RdrObjSpeedX_ZCR_CANFD5 "" UWORD RB_RBA_Common_CentralElements_CompuMethods_Identical 1 100 0.0 65535 FORMAT "%8.2" ECU_ADDRESS 0xfe4029a4 /end MEASUREMENT
/begin MEASUREMENT Tlib_PassDoorRdrObj32RdrObjAccY_ZCR_CANFD5 "" UWORD RB_RBA_Common_CentralElements_CompuMethods_Identical 1 100 0.0 65535 FORMAT "%8.2" ECU_ADDRESS 0xfe4029a6 /end MEASUREMENT
/begin MEASUREMENT Tlib_PassDoorRdrObj32RdrObjAccStdY_ZCR_CANFD5 "" UBYTE RB_RBA_Common_CentralElements_CompuMethods_Identical 1 100 0.0 255.00 FORMAT "%8.2" ECU_ADDRESS 0xfe403307 /end MEASUREMENT
/begin MEASUREMENT Tlib_PassDoorRdrObj32RdrObjSpeedStdY_ZCR_CANFD5 "" UBYTE RB_RBA_Common_CentralElements_CompuMethods_Identical 1 100 0.0 255.00 FORMAT "%8.2" ECU_ADDRESS 0xfe403308 /end MEASUREMENT
/begin MEASUREMENT Tlib_PassDoorRdrObj32RdrObjRangeX_ZCR_CANFD5 "" UWORD RB_RBA_Common_CentralElements_CompuMethods_Identical 1 100 0.0 65535 FORMAT "%8.2" ECU_ADDRESS 0xfe4029a8 /end MEASUREMENT
/begin MEASUREMENT Tlib_PassDoorRdrObj32RdrObjConfidLvl_ZCR_CANFD5 "" UBYTE RB_RBA_Common_CentralElements_CompuMethods_Identical 1 100 0.0 255.00 FORMAT "%8.2" ECU_ADDRESS 0xfe403309 /end MEASUREMENT
/begin MEASUREMENT Tlib_PassDoorRdrObj32RdrObjSpeedY_ZCR_CANFD5 "" UWORD RB_RBA_Common_CentralElements_CompuMethods_Identical 1 100 0.0 65535 FORMAT "%8.2" ECU_ADDRESS 0xfe4029aa /end MEASUREMENT
/begin MEASUREMENT Tlib_PassDoorRdrObj12RdrObjRangeStdY_ZCR_CANFD5 "" UBYTE RB_RBA_Common_CentralElements_CompuMethods_Identical 1 100 0.0 255.00 FORMAT "%8.2" ECU_ADDRESS 0xfe40330a /end MEASUREMENT
/begin MEASUREMENT Tlib_PassDoorRdrObj12RdrObjRangeX_ZCR_CANFD5 "" UWORD RB_RBA_Common_CentralElements_CompuMethods_Identical 1 100 0.0 65535 FORMAT "%8.2" ECU_ADDRESS 0xfe4029ac /end MEASUREMENT
/begin MEASUREMENT Tlib_PassDoorRdrObj12RdrObjTrackClass_ZCR_CANFD5 "" UBYTE RB_RBA_Common_CentralElements_CompuMethods_Identical 1 100 0.0 255.00 FORMAT "%8.2" ECU_ADDRESS 0xfe40330b /end MEASUREMENT
/begin MEASUREMENT Tlib_PassDoorRdrObj12RdrObjMotionPattern_ZCR_CANFD5 "" UBYTE RB_RBA_Common_CentralElements_CompuMethods_Identical 1 100 0.0 255.00 FORMAT "%8.2" ECU_ADDRESS 0xfe40330c /end MEASUREMENT
/begin MEASUREMENT Tlib_PassDoorRdrObj12RdrObjRangeZ_ZCR_CANFD5 "" UWORD RB_RBA_Common_CentralElements_CompuMethods_Identical 1 100 0.0 65535 FORMAT "%8.2" ECU_ADDRESS 0xfe4029ae /end MEASUREMENT
/begin MEASUREMENT Tlib_PassDoorRdrObj12RdrObjAccStdX_ZCR_CANFD5 "" UBYTE RB_RBA_Common_CentralElements_CompuMethods_Identical 1 100 0.0 255.00 FORMAT "%8.2" ECU_ADDRESS 0xfe40330d /end MEASUREMENT
/begin MEASUREMENT Tlib_PassDoorRdrObj12RdrObjTrackAge_ZCR_CANFD5 "" UBYTE RB_RBA_Common_CentralElements_CompuMethods_Identical 1 100 0.0 255.00 FORMAT "%8.2" ECU_ADDRESS 0xfe40330e /end MEASUREMENT
/begin MEASUREMENT Tlib_PassDoorRdrObj12RdrObjAccX_ZCR_CANFD5 "" UWORD RB_RBA_Common_CentralElements_CompuMethods_Identical 1 100 0.0 65535 FORMAT "%8.2" ECU_ADDRESS 0xfe4029b0 /end MEASUREMENT
/begin MEASUREMENT Tlib_PassDoorRdrObj12RdrObjAccStdY_ZCR_CANFD5 "" UBYTE RB_RBA_Common_CentralElements_CompuMethods_Identical 1 100 0.0 255.00 FORMAT "%8.2" ECU_ADDRESS 0xfe40330f /end MEASUREMENT
/begin MEASUREMENT Tlib_PassDoorRdrObj12RdrObjSpeedStdX_ZCR_CANFD5 "" UBYTE RB_RBA_Common_CentralElements_CompuMethods_Identical 1 100 0.0 255.00 FORMAT "%8.2" ECU_ADDRESS 0xfe403310 /end MEASUREMENT
/begin MEASUREMENT Tlib_PassDoorRdrObj12RdrObjIdx_ZCR_CANFD5 "" UBYTE RB_RBA_Common_CentralElements_CompuMethods_Identical 1 100 0.0 255.00 FORMAT "%8.2" ECU_ADDRESS 0xfe403311 /end MEASUREMENT
/begin MEASUREMENT Tlib_PassDoorRdrObj12RdrObjSpeedStdY_ZCR_CANFD5 "" UBYTE RB_RBA_Common_CentralElements_CompuMethods_Identical 1 100 0.0 255.00 FORMAT "%8.2" ECU_ADDRESS 0xfe403312 /end MEASUREMENT
/begin MEASUREMENT Tlib_PassDoorRdrObj12RdrObjRangeStdZ_ZCR_CANFD5 "" UBYTE RB_RBA_Common_CentralElements_CompuMethods_Identical 1 100 0.0 255.00 FORMAT "%8.2" ECU_ADDRESS 0xfe403313 /end MEASUREMENT
/begin MEASUREMENT Tlib_PassDoorRdrObj12RdrObjSpeedX_ZCR_CANFD5 "" UWORD RB_RBA_Common_CentralElements_CompuMethods_Identical 1 100 0.0 65535 FORMAT "%8.2" ECU_ADDRESS 0xfe4029b2 /end MEASUREMENT
/begin MEASUREMENT Tlib_PassDoorRdrObj12RdrObjDataMode_ZCR_CANFD5 "" UBYTE RB_RBA_Common_CentralElements_CompuMethods_Identical 1 100 0.0 255.00 FORMAT "%8.2" ECU_ADDRESS 0xfe403314 /end MEASUREMENT
/begin MEASUREMENT Tlib_PassDoorRdrObj12RdrObjConfidLvl_ZCR_CANFD5 "" UBYTE RB_RBA_Common_CentralElements_CompuMethods_Identical 1 100 0.0 255.00 FORMAT "%8.2" ECU_ADDRESS 0xfe403315 /end MEASUREMENT
/begin MEASUREMENT Tlib_PassDoorRdrObj12RdrObjRangeStdX_ZCR_CANFD5 "" UBYTE RB_RBA_Common_CentralElements_CompuMethods_Identical 1 100 0.0 255.00 FORMAT "%8.2" ECU_ADDRESS 0xfe403316 /end MEASUREMENT
/begin MEASUREMENT Tlib_PassDoorRdrObj12RdrObjAccY_ZCR_CANFD5 "" UWORD RB_RBA_Common_CentralElements_CompuMethods_Identical 1 100 0.0 65535 FORMAT "%8.2" ECU_ADDRESS 0xfe4029b4 /end MEASUREMENT
/begin MEASUREMENT Tlib_PassDoorRdrObj12RdrObjRangeY_ZCR_CANFD5 "" UWORD RB_RBA_Common_CentralElements_CompuMethods_Identical 1 100 0.0 65535 FORMAT "%8.2" ECU_ADDRESS 0xfe4029b6 /end MEASUREMENT
/begin MEASUREMENT Tlib_PassDoorRdrObj12RdrObjSpeedY_ZCR_CANFD5 "" UWORD RB_RBA_Common_CentralElements_CompuMethods_Identical 1 100 0.0 65535 FORMAT "%8.2" ECU_ADDRESS 0xfe4029b8 /end MEASUREMENT
/begin MEASUREMENT Tlib_PassDoorRdrObj14RdrObjConfidLvl_ZCR_CANFD5 "" UBYTE RB_RBA_Common_CentralElements_CompuMethods_Identical 1 100 0.0 255.00 FORMAT "%8.2" ECU_ADDRESS 0xfe403317 /end MEASUREMENT
/begin MEASUREMENT Tlib_PassDoorRdrObj14RdrObjMotionPattern_ZCR_CANFD5 "" UBYTE RB_RBA_Common_CentralElements_CompuMethods_Identical 1 100 0.0 255.00 FORMAT "%8.2" ECU_ADDRESS 0xfe403318 /end MEASUREMENT
/begin MEASUREMENT Tlib_PassDoorRdrObj14RdrObjRangeStdX_ZCR_CANFD5 "" UBYTE RB_RBA_Common_CentralElements_CompuMethods_Identical 1 100 0.0 255.00 FORMAT "%8.2" ECU_ADDRESS 0xfe403319 /end MEASUREMENT
/begin MEASUREMENT Tlib_PassDoorRdrObj14RdrObjRangeStdY_ZCR_CANFD5 "" UBYTE RB_RBA_Common_CentralElements_CompuMethods_Identical 1 100 0.0 255.00 FORMAT "%8.2" ECU_ADDRESS 0xfe40331a /end MEASUREMENT
/begin MEASUREMENT Tlib_PassDoorRdrObj14RdrObjTrackClass_ZCR_CANFD5 "" UBYTE RB_RBA_Common_CentralElements_CompuMethods_Identical 1 100 0.0 255.00 FORMAT "%8.2" ECU_ADDRESS 0xfe40331b /end MEASUREMENT
/begin MEASUREMENT Tlib_PassDoorRdrObj14RdrObjRangeX_ZCR_CANFD5 "" UWORD RB_RBA_Common_CentralElements_CompuMethods_Identical 1 100 0.0 65535 FORMAT "%8.2" ECU_ADDRESS 0xfe4029ba /end MEASUREMENT
/begin MEASUREMENT Tlib_PassDoorRdrObj14RdrObjSpeedX_ZCR_CANFD5 "" UWORD RB_RBA_Common_CentralElements_CompuMethods_Identical 1 100 0.0 65535 FORMAT "%8.2" ECU_ADDRESS 0xfe4029bc /end MEASUREMENT
/begin MEASUREMENT Tlib_PassDoorRdrObj14RdrObjRangeY_ZCR_CANFD5 "" UWORD RB_RBA_Common_CentralElements_CompuMethods_Identical 1 100 0.0 65535 FORMAT "%8.2" ECU_ADDRESS 0xfe4029be /end MEASUREMENT
/begin MEASUREMENT Tlib_PassDoorRdrObj14RdrObjDataMode_ZCR_CANFD5 "" UBYTE RB_RBA_Common_CentralElements_CompuMethods_Identical 1 100 0.0 255.00 FORMAT "%8.2" ECU_ADDRESS 0xfe40331c /end MEASUREMENT
/begin MEASUREMENT Tlib_PassDoorRdrObj14RdrObjSpeedY_ZCR_CANFD5 "" UWORD RB_RBA_Common_CentralElements_CompuMethods_Identical 1 100 0.0 65535 FORMAT "%8.2" ECU_ADDRESS 0xfe4029c0 /end MEASUREMENT
/begin MEASUREMENT Tlib_PassDoorRdrObj14RdrObjRangeZ_ZCR_CANFD5 "" UWORD RB_RBA_Common_CentralElements_CompuMethods_Identical 1 100 0.0 65535 FORMAT "%8.2" ECU_ADDRESS 0xfe4029c2 /end MEASUREMENT
/begin MEASUREMENT Tlib_PassDoorRdrObj14RdrObjRangeStdZ_ZCR_CANFD5 "" UBYTE RB_RBA_Common_CentralElements_CompuMethods_Identical 1 100 0.0 255.00 FORMAT "%8.2" ECU_ADDRESS 0xfe40331d /end MEASUREMENT
/begin MEASUREMENT Tlib_PassDoorRdrObj14RdrObjAccY_ZCR_CANFD5 "" UWORD RB_RBA_Common_CentralElements_CompuMethods_Identical 1 100 0.0 65535 FORMAT "%8.2" ECU_ADDRESS 0xfe4029c4 /end MEASUREMENT
/begin MEASUREMENT Tlib_PassDoorRdrObj14RdrObjTrackAge_ZCR_CANFD5 "" UBYTE RB_RBA_Common_CentralElements_CompuMethods_Identical 1 100 0.0 255.00 FORMAT "%8.2" ECU_ADDRESS 0xfe40331e /end MEASUREMENT
/begin MEASUREMENT Tlib_PassDoorRdrObj14RdrObjSpeedStdX_ZCR_CANFD5 "" UBYTE RB_RBA_Common_CentralElements_CompuMethods_Identical 1 100 0.0 255.00 FORMAT "%8.2" ECU_ADDRESS 0xfe40331f /end MEASUREMENT
/begin MEASUREMENT Tlib_PassDoorRdrObj14RdrObjAccStdY_ZCR_CANFD5 "" UBYTE RB_RBA_Common_CentralElements_CompuMethods_Identical 1 100 0.0 255.00 FORMAT "%8.2" ECU_ADDRESS 0xfe403320 /end MEASUREMENT
/begin MEASUREMENT Tlib_PassDoorRdrObj14RdrObjSpeedStdY_ZCR_CANFD5 "" UBYTE RB_RBA_Common_CentralElements_CompuMethods_Identical 1 100 0.0 255.00 FORMAT "%8.2" ECU_ADDRESS 0xfe403321 /end MEASUREMENT
/begin MEASUREMENT Tlib_PassDoorRdrObj14RdrObjAccStdX_ZCR_CANFD5 "" UBYTE RB_RBA_Common_CentralElements_CompuMethods_Identical 1 100 0.0 255.00 FORMAT "%8.2" ECU_ADDRESS 0xfe403322 /end MEASUREMENT
/begin MEASUREMENT Tlib_PassDoorRdrObj14RdrObjAccX_ZCR_CANFD5 "" UWORD RB_RBA_Common_CentralElements_CompuMethods_Identical 1 100 0.0 65535 FORMAT "%8.2" ECU_ADDRESS 0xfe4029c6 /end MEASUREMENT
/begin MEASUREMENT Tlib_PassDoorRdrObj14RdrObjIdx_ZCR_CANFD5 "" UBYTE RB_RBA_Common_CentralElements_CompuMethods_Identical 1 100 0.0 255.00 FORMAT "%8.2" ECU_ADDRESS 0xfe403323 /end MEASUREMENT
/begin MEASUREMENT Tlib_PassDoorRdrObj13RdrObjSpeedStdX_ZCR_CANFD5 "" UBYTE RB_RBA_Common_CentralElements_CompuMethods_Identical 1 100 0.0 255.00 FORMAT "%8.2" ECU_ADDRESS 0xfe403324 /end MEASUREMENT
/begin MEASUREMENT Tlib_PassDoorRdrObj13RdrObjSpeedStdY_ZCR_CANFD5 "" UBYTE RB_RBA_Common_CentralElements_CompuMethods_Identical 1 100 0.0 255.00 FORMAT "%8.2" ECU_ADDRESS 0xfe403325 /end MEASUREMENT
/begin MEASUREMENT Tlib_PassDoorRdrObj13RdrObjConfidLvl_ZCR_CANFD5 "" UBYTE RB_RBA_Common_CentralElements_CompuMethods_Identical 1 100 0.0 255.00 FORMAT "%8.2" ECU_ADDRESS 0xfe403326 /end MEASUREMENT
/begin MEASUREMENT Tlib_PassDoorRdrObj13RdrObjRangeStdZ_ZCR_CANFD5 "" UBYTE RB_RBA_Common_CentralElements_CompuMethods_Identical 1 100 0.0 255.00 FORMAT "%8.2" ECU_ADDRESS 0xfe403327 /end MEASUREMENT
/begin MEASUREMENT Tlib_PassDoorRdrObj13RdrObjRangeStdY_ZCR_CANFD5 "" UBYTE RB_RBA_Common_CentralElements_CompuMethods_Identical 1 100 0.0 255.00 FORMAT "%8.2" ECU_ADDRESS 0xfe403328 /end MEASUREMENT
/begin MEASUREMENT Tlib_PassDoorRdrObj13RdrObjAccY_ZCR_CANFD5 "" UWORD RB_RBA_Common_CentralElements_CompuMethods_Identical 1 100 0.0 65535 FORMAT "%8.2" ECU_ADDRESS 0xfe4029c8 /end MEASUREMENT
/begin MEASUREMENT Tlib_PassDoorRdrObj13RdrObjAccX_ZCR_CANFD5 "" UWORD RB_RBA_Common_CentralElements_CompuMethods_Identical 1 100 0.0 65535 FORMAT "%8.2" ECU_ADDRESS 0xfe4029ca /end MEASUREMENT
/begin MEASUREMENT Tlib_PassDoorRdrObj13RdrObjIdx_ZCR_CANFD5 "" UBYTE RB_RBA_Common_CentralElements_CompuMethods_Identical 1 100 0.0 255.00 FORMAT "%8.2" ECU_ADDRESS 0xfe403329 /end MEASUREMENT
/begin MEASUREMENT Tlib_PassDoorRdrObj13RdrObjTrackClass_ZCR_CANFD5 "" UBYTE RB_RBA_Common_CentralElements_CompuMethods_Identical 1 100 0.0 255.00 FORMAT "%8.2" ECU_ADDRESS 0xfe40332a /end MEASUREMENT
/begin MEASUREMENT Tlib_PassDoorRdrObj13RdrObjRangeY_ZCR_CANFD5 "" UWORD RB_RBA_Common_CentralElements_CompuMethods_Identical 1 100 0.0 65535 FORMAT "%8.2" ECU_ADDRESS 0xfe4029cc /end MEASUREMENT
/begin MEASUREMENT Tlib_PassDoorRdrObj13RdrObjSpeedX_ZCR_CANFD5 "" UWORD RB_RBA_Common_CentralElements_CompuMethods_Identical 1 100 0.0 65535 FORMAT "%8.2" ECU_ADDRESS 0xfe4029ce /end MEASUREMENT
/begin MEASUREMENT Tlib_PassDoorRdrObj13RdrObjTrackAge_ZCR_CANFD5 "" UBYTE RB_RBA_Common_CentralElements_CompuMethods_Identical 1 100 0.0 255.00 FORMAT "%8.2" ECU_ADDRESS 0xfe40332b /end MEASUREMENT
/begin MEASUREMENT Tlib_PassDoorRdrObj13RdrObjMotionPattern_ZCR_CANFD5 "" UBYTE RB_RBA_Common_CentralElements_CompuMethods_Identical 1 100 0.0 255.00 FORMAT "%8.2" ECU_ADDRESS 0xfe40332c /end MEASUREMENT
/begin MEASUREMENT Tlib_PassDoorRdrObj13RdrObjRangeX_ZCR_CANFD5 "" UWORD RB_RBA_Common_CentralElements_CompuMethods_Identical 1 100 0.0 65535 FORMAT "%8.2" ECU_ADDRESS 0xfe4029d0 /end MEASUREMENT
/begin MEASUREMENT Tlib_PassDoorRdrObj13RdrObjRangeStdX_ZCR_CANFD5 "" UBYTE RB_RBA_Common_CentralElements_CompuMethods_Identical 1 100 0.0 255.00 FORMAT "%8.2" ECU_ADDRESS 0xfe40332d /end MEASUREMENT
/begin MEASUREMENT Tlib_PassDoorRdrObj13RdrObjRangeZ_ZCR_CANFD5 "" UWORD RB_RBA_Common_CentralElements_CompuMethods_Identical 1 100 0.0 65535 FORMAT "%8.2" ECU_ADDRESS 0xfe4029d2 /end MEASUREMENT
/begin MEASUREMENT Tlib_PassDoorRdrObj13RdrObjAccStdX_ZCR_CANFD5 "" UBYTE RB_RBA_Common_CentralElements_CompuMethods_Identical 1 100 0.0 255.00 FORMAT "%8.2" ECU_ADDRESS 0xfe40332e /end MEASUREMENT
/begin MEASUREMENT Tlib_PassDoorRdrObj13RdrObjDataMode_ZCR_CANFD5 "" UBYTE RB_RBA_Common_CentralElements_CompuMethods_Identical 1 100 0.0 255.00 FORMAT "%8.2" ECU_ADDRESS 0xfe40332f /end MEASUREMENT
/begin MEASUREMENT Tlib_PassDoorRdrObj13RdrObjSpeedY_ZCR_CANFD5 "" UWORD RB_RBA_Common_CentralElements_CompuMethods_Identical 1 100 0.0 65535 FORMAT "%8.2" ECU_ADDRESS 0xfe4029d4 /end MEASUREMENT
/begin MEASUREMENT Tlib_PassDoorRdrObj13RdrObjAccStdY_ZCR_CANFD5 "" UBYTE RB_RBA_Common_CentralElements_CompuMethods_Identical 1 100 0.0 255.00 FORMAT "%8.2" ECU_ADDRESS 0xfe403330 /end MEASUREMENT
/begin MEASUREMENT Tlib_PassDoorRdrObj9RdrObjSpeedX_ZCR_CANFD5 "" UWORD RB_RBA_Common_CentralElements_CompuMethods_Identical 1 100 0.0 65535 FORMAT "%8.2" ECU_ADDRESS 0xfe4029d6 /end MEASUREMENT
/begin MEASUREMENT Tlib_PassDoorRdrObj9RdrObjRangeStdX_ZCR_CANFD5 "" UBYTE RB_RBA_Common_CentralElements_CompuMethods_Identical 1 100 0.0 255.00 FORMAT "%8.2" ECU_ADDRESS 0xfe403331 /end MEASUREMENT
/begin MEASUREMENT Tlib_PassDoorRdrObj9RdrObjRangeZ_ZCR_CANFD5 "" UWORD RB_RBA_Common_CentralElements_CompuMethods_Identical 1 100 0.0 65535 FORMAT "%8.2" ECU_ADDRESS 0xfe4029d8 /end MEASUREMENT
/begin MEASUREMENT Tlib_PassDoorRdrObj9RdrObjSpeedStdX_ZCR_CANFD5 "" UBYTE RB_RBA_Common_CentralElements_CompuMethods_Identical 1 100 0.0 255.00 FORMAT "%8.2" ECU_ADDRESS 0xfe403332 /end MEASUREMENT
/begin MEASUREMENT Tlib_PassDoorRdrObj9RdrObjTrackAge_ZCR_CANFD5 "" UBYTE RB_RBA_Common_CentralElements_CompuMethods_Identical 1 100 0.0 255.00 FORMAT "%8.2" ECU_ADDRESS 0xfe403333 /end MEASUREMENT
/begin MEASUREMENT Tlib_PassDoorRdrObj9RdrObjTrackClass_ZCR_CANFD5 "" UBYTE RB_RBA_Common_CentralElements_CompuMethods_Identical 1 100 0.0 255.00 FORMAT "%8.2" ECU_ADDRESS 0xfe403334 /end MEASUREMENT
/begin MEASUREMENT Tlib_PassDoorRdrObj9RdrObjSpeedY_ZCR_CANFD5 "" UWORD RB_RBA_Common_CentralElements_CompuMethods_Identical 1 100 0.0 65535 FORMAT "%8.2" ECU_ADDRESS 0xfe4029da /end MEASUREMENT
/begin MEASUREMENT Tlib_PassDoorRdrObj9RdrObjRangeStdZ_ZCR_CANFD5 "" UBYTE RB_RBA_Common_CentralElements_CompuMethods_Identical 1 100 0.0 255.00 FORMAT "%8.2" ECU_ADDRESS 0xfe403335 /end MEASUREMENT
/begin MEASUREMENT Tlib_PassDoorRdrObj9RdrObjMotionPattern_ZCR_CANFD5 "" UBYTE RB_RBA_Common_CentralElements_CompuMethods_Identical 1 100 0.0 255.00 FORMAT "%8.2" ECU_ADDRESS 0xfe403336 /end MEASUREMENT
/begin MEASUREMENT Tlib_PassDoorRdrObj9RdrObjAccStdY_ZCR_CANFD5 "" UBYTE RB_RBA_Common_CentralElements_CompuMethods_Identical 1 100 0.0 255.00 FORMAT "%8.2" ECU_ADDRESS 0xfe403337 /end MEASUREMENT
/begin MEASUREMENT Tlib_PassDoorRdrObj9RdrObjConfidLvl_ZCR_CANFD5 "" UBYTE RB_RBA_Common_CentralElements_CompuMethods_Identical 1 100 0.0 255.00 FORMAT "%8.2" ECU_ADDRESS 0xfe403338 /end MEASUREMENT
/begin MEASUREMENT Tlib_PassDoorRdrObj9RdrObjDataMode_ZCR_CANFD5 "" UBYTE RB_RBA_Common_CentralElements_CompuMethods_Identical 1 100 0.0 255.00 FORMAT "%8.2" ECU_ADDRESS 0xfe403339 /end MEASUREMENT
/begin MEASUREMENT Tlib_PassDoorRdrObj9RdrObjRangeY_ZCR_CANFD5 "" UWORD RB_RBA_Common_CentralElements_CompuMethods_Identical 1 100 0.0 65535 FORMAT "%8.2" ECU_ADDRESS 0xfe4029dc /end MEASUREMENT
/begin MEASUREMENT Tlib_PassDoorRdrObj9RdrObjAccX_ZCR_CANFD5 "" UWORD RB_RBA_Common_CentralElements_CompuMethods_Identical 1 100 0.0 65535 FORMAT "%8.2" ECU_ADDRESS 0xfe4029de /end MEASUREMENT
/begin MEASUREMENT Tlib_PassDoorRdrObj9RdrObjAccStdX_ZCR_CANFD5 "" UBYTE RB_RBA_Common_CentralElements_CompuMethods_Identical 1 100 0.0 255.00 FORMAT "%8.2" ECU_ADDRESS 0xfe40333a /end MEASUREMENT
/begin MEASUREMENT Tlib_PassDoorRdrObj9RdrObjIdx_ZCR_CANFD5 "" UBYTE RB_RBA_Common_CentralElements_CompuMethods_Identical 1 100 0.0 255.00 FORMAT "%8.2" ECU_ADDRESS 0xfe40333b /end MEASUREMENT
/begin MEASUREMENT Tlib_PassDoorRdrObj9RdrObjRangeStdY_ZCR_CANFD5 "" UBYTE RB_RBA_Common_CentralElements_CompuMethods_Identical 1 100 0.0 255.00 FORMAT "%8.2" ECU_ADDRESS 0xfe40333c /end MEASUREMENT
/begin MEASUREMENT Tlib_PassDoorRdrObj9RdrObjSpeedStdY_ZCR_CANFD5 "" UBYTE RB_RBA_Common_CentralElements_CompuMethods_Identical 1 100 0.0 255.00 FORMAT "%8.2" ECU_ADDRESS 0xfe40333d /end MEASUREMENT
/begin MEASUREMENT Tlib_PassDoorRdrObj9RdrObjAccY_ZCR_CANFD5 "" UWORD RB_RBA_Common_CentralElements_CompuMethods_Identical 1 100 0.0 65535 FORMAT "%8.2" ECU_ADDRESS 0xfe4029e0 /end MEASUREMENT
/begin MEASUREMENT Tlib_PassDoorRdrObj9RdrObjRangeX_ZCR_CANFD5 "" UWORD RB_RBA_Common_CentralElements_CompuMethods_Identical 1 100 0.0 65535 FORMAT "%8.2" ECU_ADDRESS 0xfe4029e2 /end MEASUREMENT
/begin MEASUREMENT Tlib_PassDoorSensorYzOrient_ZCR_CANFD5 "" UBYTE RB_RBA_Common_CentralElements_CompuMethods_Identical 1 100 0.0 255.00 FORMAT "%8.2" ECU_ADDRESS 0xfe40333e /end MEASUREMENT
/begin MEASUREMENT Tlib_PassDoorRdrFrameID_ZCR_CANFD5 "" UBYTE RB_RBA_Common_CentralElements_CompuMethods_Identical 1 100 0.0 255.00 FORMAT "%8.2" ECU_ADDRESS 0xfe40333f /end MEASUREMENT
/begin MEASUREMENT Tlib_PassDoorSensorXyOrient_ZCR_CANFD5 "" UBYTE RB_RBA_Common_CentralElements_CompuMethods_Identical 1 100 0.0 255.00 FORMAT "%8.2" ECU_ADDRESS 0xfe403340 /end MEASUREMENT
/begin MEASUREMENT Tlib_PassDoorRdrSts_ZCR_CANFD5 "" UBYTE RB_RBA_Common_CentralElements_CompuMethods_Identical 1 100 0.0 255.00 FORMAT "%8.2" ECU_ADDRESS 0xfe403341 /end MEASUREMENT
/begin MEASUREMENT Tlib_PassDoorRdrDTCInfoInterference1_ZCR_CANFD5 "" UBYTE RB_RBA_Common_CentralElements_CompuMethods_Identical 1 100 0.0 255.00 FORMAT "%8.2" ECU_ADDRESS 0xfe403342 /end MEASUREMENT
/begin MEASUREMENT Tlib_PassDoorRdrDTCInfoBlocked_ZCR_CANFD5 "" UBYTE RB_RBA_Common_CentralElements_CompuMethods_Identical 1 100 0.0 255.00 FORMAT "%8.2" ECU_ADDRESS 0xfe403343 /end MEASUREMENT
/begin MEASUREMENT Tlib_PassDoorRdrDTCInfoCalFailure_ZCR_CANFD5 "" UBYTE RB_RBA_Common_CentralElements_CompuMethods_Identical 1 100 0.0 255.00 FORMAT "%8.2" ECU_ADDRESS 0xfe403344 /end MEASUREMENT
/begin MEASUREMENT Tlib_PassDoorRdrDTCInfoInternalErr_ZCR_CANFD5 "" UBYTE RB_RBA_Common_CentralElements_CompuMethods_Identical 1 100 0.0 255.00 FORMAT "%8.2" ECU_ADDRESS 0xfe403345 /end MEASUREMENT
/begin MEASUREMENT Tlib_PassDoorRdrDTCInfoLowVol_ZCR_CANFD5 "" UBYTE RB_RBA_Common_CentralElements_CompuMethods_Identical 1 100 0.0 255.00 FORMAT "%8.2" ECU_ADDRESS 0xfe403346 /end MEASUREMENT
/begin MEASUREMENT Tlib_PassDoorRdrDTCInfoNvmErr_ZCR_CANFD5 "" UBYTE RB_RBA_Common_CentralElements_CompuMethods_Identical 1 100 0.0 255.00 FORMAT "%8.2" ECU_ADDRESS 0xfe403347 /end MEASUREMENT
/begin MEASUREMENT Tlib_PassDoorRdrDTCInfoInterference2_ZCR_CANFD5 "" UBYTE RB_RBA_Common_CentralElements_CompuMethods_Identical 1 100 0.0 255.00 FORMAT "%8.2" ECU_ADDRESS 0xfe403348 /end MEASUREMENT
/begin MEASUREMENT Tlib_PassDoorRdrDTCInfoHighVol_ZCR_CANFD5 "" UBYTE RB_RBA_Common_CentralElements_CompuMethods_Identical 1 100 0.0 255.00 FORMAT "%8.2" ECU_ADDRESS 0xfe403349 /end MEASUREMENT
/begin MEASUREMENT Tlib_PassDoorRdrObj8RdrObjRangeStdY_ZCR_CANFD5 "" UBYTE RB_RBA_Common_CentralElements_CompuMethods_Identical 1 100 0.0 255.00 FORMAT "%8.2" ECU_ADDRESS 0xfe40334a /end MEASUREMENT
/begin MEASUREMENT Tlib_PassDoorRdrObj8RdrObjAccStdY_ZCR_CANFD5 "" UBYTE RB_RBA_Common_CentralElements_CompuMethods_Identical 1 100 0.0 255.00 FORMAT "%8.2" ECU_ADDRESS 0xfe40334b /end MEASUREMENT
/begin MEASUREMENT Tlib_PassDoorRdrObj8RdrObjSpeedX_ZCR_CANFD5 "" UWORD RB_RBA_Common_CentralElements_CompuMethods_Identical 1 100 0.0 65535 FORMAT "%8.2" ECU_ADDRESS 0xfe4029e4 /end MEASUREMENT
/begin MEASUREMENT Tlib_PassDoorRdrObj8RdrObjSpeedStdY_ZCR_CANFD5 "" UBYTE RB_RBA_Common_CentralElements_CompuMethods_Identical 1 100 0.0 255.00 FORMAT "%8.2" ECU_ADDRESS 0xfe40334c /end MEASUREMENT
/begin MEASUREMENT Tlib_PassDoorRdrObj8RdrObjRangeStdZ_ZCR_CANFD5 "" UBYTE RB_RBA_Common_CentralElements_CompuMethods_Identical 1 100 0.0 255.00 FORMAT "%8.2" ECU_ADDRESS 0xfe40334d /end MEASUREMENT
/begin MEASUREMENT Tlib_PassDoorRdrObj8RdrObjRangeStdX_ZCR_CANFD5 "" UBYTE RB_RBA_Common_CentralElements_CompuMethods_Identical 1 100 0.0 255.00 FORMAT "%8.2" ECU_ADDRESS 0xfe40334e /end MEASUREMENT
/begin MEASUREMENT Tlib_PassDoorRdrObj8RdrObjRangeY_ZCR_CANFD5 "" UWORD RB_RBA_Common_CentralElements_CompuMethods_Identical 1 100 0.0 65535 FORMAT "%8.2" ECU_ADDRESS 0xfe4029e6 /end MEASUREMENT
/begin MEASUREMENT Tlib_PassDoorRdrObj8RdrObjSpeedStdX_ZCR_CANFD5 "" UBYTE RB_RBA_Common_CentralElements_CompuMethods_Identical 1 100 0.0 255.00 FORMAT "%8.2" ECU_ADDRESS 0xfe40334f /end MEASUREMENT
/begin MEASUREMENT Tlib_PassDoorRdrObj8RdrObjTrackClass_ZCR_CANFD5 "" UBYTE RB_RBA_Common_CentralElements_CompuMethods_Identical 1 100 0.0 255.00 FORMAT "%8.2" ECU_ADDRESS 0xfe403350 /end MEASUREMENT
/begin MEASUREMENT Tlib_PassDoorRdrObj8RdrObjAccY_ZCR_CANFD5 "" UWORD RB_RBA_Common_CentralElements_CompuMethods_Identical 1 100 0.0 65535 FORMAT "%8.2" ECU_ADDRESS 0xfe4029e8 /end MEASUREMENT
/begin MEASUREMENT Tlib_PassDoorRdrObj8RdrObjMotionPattern_ZCR_CANFD5 "" UBYTE RB_RBA_Common_CentralElements_CompuMethods_Identical 1 100 0.0 255.00 FORMAT "%8.2" ECU_ADDRESS 0xfe403351 /end MEASUREMENT
/begin MEASUREMENT Tlib_PassDoorRdrObj8RdrObjSpeedY_ZCR_CANFD5 "" UWORD RB_RBA_Common_CentralElements_CompuMethods_Identical 1 100 0.0 65535 FORMAT "%8.2" ECU_ADDRESS 0xfe4029ea /end MEASUREMENT
/begin MEASUREMENT Tlib_PassDoorRdrObj8RdrObjIdx_ZCR_CANFD5 "" UBYTE RB_RBA_Common_CentralElements_CompuMethods_Identical 1 100 0.0 255.00 FORMAT "%8.2" ECU_ADDRESS 0xfe403352 /end MEASUREMENT
/begin MEASUREMENT Tlib_PassDoorRdrObj8RdrObjRangeX_ZCR_CANFD5 "" UWORD RB_RBA_Common_CentralElements_CompuMethods_Identical 1 100 0.0 65535 FORMAT "%8.2" ECU_ADDRESS 0xfe4029ec /end MEASUREMENT
/begin MEASUREMENT Tlib_PassDoorRdrObj8RdrObjTrackAge_ZCR_CANFD5 "" UBYTE RB_RBA_Common_CentralElements_CompuMethods_Identical 1 100 0.0 255.00 FORMAT "%8.2" ECU_ADDRESS 0xfe403353 /end MEASUREMENT
/begin MEASUREMENT Tlib_PassDoorRdrObj8RdrObjAccStdX_ZCR_CANFD5 "" UBYTE RB_RBA_Common_CentralElements_CompuMethods_Identical 1 100 0.0 255.00 FORMAT "%8.2" ECU_ADDRESS 0xfe403354 /end MEASUREMENT
/begin MEASUREMENT Tlib_PassDoorRdrObj8RdrObjAccX_ZCR_CANFD5 "" UWORD RB_RBA_Common_CentralElements_CompuMethods_Identical 1 100 0.0 65535 FORMAT "%8.2" ECU_ADDRESS 0xfe4029ee /end MEASUREMENT
/begin MEASUREMENT Tlib_PassDoorRdrObj8RdrObjConfidLvl_ZCR_CANFD5 "" UBYTE RB_RBA_Common_CentralElements_CompuMethods_Identical 1 100 0.0 255.00 FORMAT "%8.2" ECU_ADDRESS 0xfe403355 /end MEASUREMENT
/begin MEASUREMENT Tlib_PassDoorRdrObj8RdrObjDataMode_ZCR_CANFD5 "" UBYTE RB_RBA_Common_CentralElements_CompuMethods_Identical 1 100 0.0 255.00 FORMAT "%8.2" ECU_ADDRESS 0xfe403356 /end MEASUREMENT
/begin MEASUREMENT Tlib_PassDoorRdrObj8RdrObjRangeZ_ZCR_CANFD5 "" UWORD RB_RBA_Common_CentralElements_CompuMethods_Identical 1 100 0.0 65535 FORMAT "%8.2" ECU_ADDRESS 0xfe4029f0 /end MEASUREMENT
/begin MEASUREMENT Tlib_PassDoorSensorXzOrient_ZCR_CANFD5 "" UBYTE RB_RBA_Common_CentralElements_CompuMethods_Identical 1 100 0.0 255.00 FORMAT "%8.2" ECU_ADDRESS 0xfe403357 /end MEASUREMENT
/begin MEASUREMENT Tlib_RiReDoorRdrObj30RdrObjSpeedStdY_ZCR_CANFD5 "" UBYTE RB_RBA_Common_CentralElements_CompuMethods_Identical 1 100 0.0 255.00 FORMAT "%8.2" ECU_ADDRESS 0xfe403358 /end MEASUREMENT
/begin MEASUREMENT Tlib_RiReDoorRdrObj30RdrObjDataMode_ZCR_CANFD5 "" UBYTE RB_RBA_Common_CentralElements_CompuMethods_Identical 1 100 0.0 255.00 FORMAT "%8.2" ECU_ADDRESS 0xfe403359 /end MEASUREMENT
/begin MEASUREMENT Tlib_RiReDoorRdrObj30RdrObjRangeZ_ZCR_CANFD5 "" UWORD RB_RBA_Common_CentralElements_CompuMethods_Identical 1 100 0.0 65535 FORMAT "%8.2" ECU_ADDRESS 0xfe4029f2 /end MEASUREMENT
/begin MEASUREMENT Tlib_RiReDoorRdrObj30RdrObjRangeX_ZCR_CANFD5 "" UWORD RB_RBA_Common_CentralElements_CompuMethods_Identical 1 100 0.0 65535 FORMAT "%8.2" ECU_ADDRESS 0xfe4029f4 /end MEASUREMENT
/begin MEASUREMENT Tlib_RiReDoorRdrObj30RdrObjTrackClass_ZCR_CANFD5 "" UBYTE RB_RBA_Common_CentralElements_CompuMethods_Identical 1 100 0.0 255.00 FORMAT "%8.2" ECU_ADDRESS 0xfe40335a /end MEASUREMENT
/begin MEASUREMENT Tlib_RiReDoorRdrObj30RdrObjMotionPattern_ZCR_CANFD5 "" UBYTE RB_RBA_Common_CentralElements_CompuMethods_Identical 1 100 0.0 255.00 FORMAT "%8.2" ECU_ADDRESS 0xfe40335b /end MEASUREMENT
/begin MEASUREMENT Tlib_RiReDoorRdrObj30RdrObjRangeStdZ_ZCR_CANFD5 "" UBYTE RB_RBA_Common_CentralElements_CompuMethods_Identical 1 100 0.0 255.00 FORMAT "%8.2" ECU_ADDRESS 0xfe40335c /end MEASUREMENT
/begin MEASUREMENT Tlib_RiReDoorRdrObj30RdrObjAccY_ZCR_CANFD5 "" UWORD RB_RBA_Common_CentralElements_CompuMethods_Identical 1 100 0.0 65535 FORMAT "%8.2" ECU_ADDRESS 0xfe4029f6 /end MEASUREMENT
/begin MEASUREMENT Tlib_RiReDoorRdrObj30RdrObjAccStdX_ZCR_CANFD5 "" UBYTE RB_RBA_Common_CentralElements_CompuMethods_Identical 1 100 0.0 255.00 FORMAT "%8.2" ECU_ADDRESS 0xfe40335d /end MEASUREMENT
/begin MEASUREMENT Tlib_RiReDoorRdrObj30RdrObjConfidLvl_ZCR_CANFD5 "" UBYTE RB_RBA_Common_CentralElements_CompuMethods_Identical 1 100 0.0 255.00 FORMAT "%8.2" ECU_ADDRESS 0xfe40335e /end MEASUREMENT
/begin MEASUREMENT Tlib_RiReDoorRdrObj30RdrObjIdx_ZCR_CANFD5 "" UBYTE RB_RBA_Common_CentralElements_CompuMethods_Identical 1 100 0.0 255.00 FORMAT "%8.2" ECU_ADDRESS 0xfe40335f /end MEASUREMENT
/begin MEASUREMENT Tlib_RiReDoorRdrObj30RdrObjTrackAge_ZCR_CANFD5 "" UBYTE RB_RBA_Common_CentralElements_CompuMethods_Identical 1 100 0.0 255.00 FORMAT "%8.2" ECU_ADDRESS 0xfe403360 /end MEASUREMENT
/begin MEASUREMENT Tlib_RiReDoorRdrObj30RdrObjSpeedY_ZCR_CANFD5 "" UWORD RB_RBA_Common_CentralElements_CompuMethods_Identical 1 100 0.0 65535 FORMAT "%8.2" ECU_ADDRESS 0xfe4029f8 /end MEASUREMENT
/begin MEASUREMENT Tlib_RiReDoorRdrObj30RdrObjRangeStdY_ZCR_CANFD5 "" UBYTE RB_RBA_Common_CentralElements_CompuMethods_Identical 1 100 0.0 255.00 FORMAT "%8.2" ECU_ADDRESS 0xfe403361 /end MEASUREMENT
/begin MEASUREMENT Tlib_RiReDoorRdrObj30RdrObjSpeedStdX_ZCR_CANFD5 "" UBYTE RB_RBA_Common_CentralElements_CompuMethods_Identical 1 100 0.0 255.00 FORMAT "%8.2" ECU_ADDRESS 0xfe403362 /end MEASUREMENT
/begin MEASUREMENT Tlib_RiReDoorRdrObj30RdrObjAccStdY_ZCR_CANFD5 "" UBYTE RB_RBA_Common_CentralElements_CompuMethods_Identical 1 100 0.0 255.00 FORMAT "%8.2" ECU_ADDRESS 0xfe403363 /end MEASUREMENT
/begin MEASUREMENT Tlib_RiReDoorRdrObj30RdrObjAccX_ZCR_CANFD5 "" UWORD RB_RBA_Common_CentralElements_CompuMethods_Identical 1 100 0.0 65535 FORMAT "%8.2" ECU_ADDRESS 0xfe4029fa /end MEASUREMENT
/begin MEASUREMENT Tlib_RiReDoorRdrObj30RdrObjRangeStdX_ZCR_CANFD5 "" UBYTE RB_RBA_Common_CentralElements_CompuMethods_Identical 1 100 0.0 255.00 FORMAT "%8.2" ECU_ADDRESS 0xfe403364 /end MEASUREMENT
/begin MEASUREMENT Tlib_RiReDoorRdrObj30RdrObjSpeedX_ZCR_CANFD5 "" UWORD RB_RBA_Common_CentralElements_CompuMethods_Identical 1 100 0.0 65535 FORMAT "%8.2" ECU_ADDRESS 0xfe4029fc /end MEASUREMENT
/begin MEASUREMENT Tlib_RiReDoorRdrObj30RdrObjRangeY_ZCR_CANFD5 "" UWORD RB_RBA_Common_CentralElements_CompuMethods_Identical 1 100 0.0 65535 FORMAT "%8.2" ECU_ADDRESS 0xfe4029fe /end MEASUREMENT
/begin MEASUREMENT Tlib_RiReDoorRdrObj29RdrObjRangeZ_ZCR_CANFD5 "" UWORD RB_RBA_Common_CentralElements_CompuMethods_Identical 1 100 0.0 65535 FORMAT "%8.2" ECU_ADDRESS 0xfe402a00 /end MEASUREMENT
/begin MEASUREMENT Tlib_RiReDoorRdrObj29RdrObjDataMode_ZCR_CANFD5 "" UBYTE RB_RBA_Common_CentralElements_CompuMethods_Identical 1 100 0.0 255.00 FORMAT "%8.2" ECU_ADDRESS 0xfe403365 /end MEASUREMENT
/begin MEASUREMENT Tlib_RiReDoorRdrObj29RdrObjSpeedX_ZCR_CANFD5 "" UWORD RB_RBA_Common_CentralElements_CompuMethods_Identical 1 100 0.0 65535 FORMAT "%8.2" ECU_ADDRESS 0xfe402a02 /end MEASUREMENT
/begin MEASUREMENT Tlib_RiReDoorRdrObj29RdrObjAccY_ZCR_CANFD5 "" UWORD RB_RBA_Common_CentralElements_CompuMethods_Identical 1 100 0.0 65535 FORMAT "%8.2" ECU_ADDRESS 0xfe402a04 /end MEASUREMENT
/begin MEASUREMENT Tlib_RiReDoorRdrObj29RdrObjSpeedStdX_ZCR_CANFD5 "" UBYTE RB_RBA_Common_CentralElements_CompuMethods_Identical 1 100 0.0 255.00 FORMAT "%8.2" ECU_ADDRESS 0xfe403366 /end MEASUREMENT
/begin MEASUREMENT Tlib_RiReDoorRdrObj29RdrObjConfidLvl_ZCR_CANFD5 "" UBYTE RB_RBA_Common_CentralElements_CompuMethods_Identical 1 100 0.0 255.00 FORMAT "%8.2" ECU_ADDRESS 0xfe403367 /end MEASUREMENT
/begin MEASUREMENT Tlib_RiReDoorRdrObj29RdrObjRangeStdZ_ZCR_CANFD5 "" UBYTE RB_RBA_Common_CentralElements_CompuMethods_Identical 1 100 0.0 255.00 FORMAT "%8.2" ECU_ADDRESS 0xfe403368 /end MEASUREMENT
/begin MEASUREMENT Tlib_RiReDoorRdrObj29RdrObjTrackAge_ZCR_CANFD5 "" UBYTE RB_RBA_Common_CentralElements_CompuMethods_Identical 1 100 0.0 255.00 FORMAT "%8.2" ECU_ADDRESS 0xfe403369 /end MEASUREMENT
/begin MEASUREMENT Tlib_RiReDoorRdrObj29RdrObjAccStdY_ZCR_CANFD5 "" UBYTE RB_RBA_Common_CentralElements_CompuMethods_Identical 1 100 0.0 255.00 FORMAT "%8.2" ECU_ADDRESS 0xfe40336a /end MEASUREMENT
/begin MEASUREMENT Tlib_RiReDoorRdrObj29RdrObjSpeedStdY_ZCR_CANFD5 "" UBYTE RB_RBA_Common_CentralElements_CompuMethods_Identical 1 100 0.0 255.00 FORMAT "%8.2" ECU_ADDRESS 0xfe40336b /end MEASUREMENT
/begin MEASUREMENT Tlib_RiReDoorRdrObj29RdrObjMotionPattern_ZCR_CANFD5 "" UBYTE RB_RBA_Common_CentralElements_CompuMethods_Identical 1 100 0.0 255.00 FORMAT "%8.2" ECU_ADDRESS 0xfe40336c /end MEASUREMENT
/begin MEASUREMENT Tlib_RiReDoorRdrObj29RdrObjTrackClass_ZCR_CANFD5 "" UBYTE RB_RBA_Common_CentralElements_CompuMethods_Identical 1 100 0.0 255.00 FORMAT "%8.2" ECU_ADDRESS 0xfe40336d /end MEASUREMENT
/begin MEASUREMENT Tlib_RiReDoorRdrObj29RdrObjSpeedY_ZCR_CANFD5 "" UWORD RB_RBA_Common_CentralElements_CompuMethods_Identical 1 100 0.0 65535 FORMAT "%8.2" ECU_ADDRESS 0xfe402a06 /end MEASUREMENT
/begin MEASUREMENT Tlib_RiReDoorRdrObj29RdrObjRangeY_ZCR_CANFD5 "" UWORD RB_RBA_Common_CentralElements_CompuMethods_Identical 1 100 0.0 65535 FORMAT "%8.2" ECU_ADDRESS 0xfe402a08 /end MEASUREMENT
/begin MEASUREMENT Tlib_RiReDoorRdrObj29RdrObjAccX_ZCR_CANFD5 "" UWORD RB_RBA_Common_CentralElements_CompuMethods_Identical 1 100 0.0 65535 FORMAT "%8.2" ECU_ADDRESS 0xfe402a0a /end MEASUREMENT
/begin MEASUREMENT Tlib_RiReDoorRdrObj29RdrObjIdx_ZCR_CANFD5 "" UBYTE RB_RBA_Common_CentralElements_CompuMethods_Identical 1 100 0.0 255.00 FORMAT "%8.2" ECU_ADDRESS 0xfe40336e /end MEASUREMENT
/begin MEASUREMENT Tlib_RiReDoorRdrObj29RdrObjRangeX_ZCR_CANFD5 "" UWORD RB_RBA_Common_CentralElements_CompuMethods_Identical 1 100 0.0 65535 FORMAT "%8.2" ECU_ADDRESS 0xfe402a0c /end MEASUREMENT
/begin MEASUREMENT Tlib_RiReDoorRdrObj29RdrObjAccStdX_ZCR_CANFD5 "" UBYTE RB_RBA_Common_CentralElements_CompuMethods_Identical 1 100 0.0 255.00 FORMAT "%8.2" ECU_ADDRESS 0xfe40336f /end MEASUREMENT
/begin MEASUREMENT Tlib_RiReDoorRdrObj29RdrObjRangeStdX_ZCR_CANFD5 "" UBYTE RB_RBA_Common_CentralElements_CompuMethods_Identical 1 100 0.0 255.00 FORMAT "%8.2" ECU_ADDRESS 0xfe403370 /end MEASUREMENT
/begin MEASUREMENT Tlib_RiReDoorRdrObj29RdrObjRangeStdY_ZCR_CANFD5 "" UBYTE RB_RBA_Common_CentralElements_CompuMethods_Identical 1 100 0.0 255.00 FORMAT "%8.2" ECU_ADDRESS 0xfe403371 /end MEASUREMENT
/begin MEASUREMENT Tlib_RiReDoorRdrObj3RdrObjRangeStdX_ZCR_CANFD5 "" UBYTE RB_RBA_Common_CentralElements_CompuMethods_Identical 1 100 0.0 255.00 FORMAT "%8.2" ECU_ADDRESS 0xfe403372 /end MEASUREMENT
/begin MEASUREMENT Tlib_RiReDoorRdrObj3RdrObjTrackClass_ZCR_CANFD5 "" UBYTE RB_RBA_Common_CentralElements_CompuMethods_Identical 1 100 0.0 255.00 FORMAT "%8.2" ECU_ADDRESS 0xfe403373 /end MEASUREMENT
/begin MEASUREMENT Tlib_RiReDoorRdrObj3RdrObjAccY_ZCR_CANFD5 "" UWORD RB_RBA_Common_CentralElements_CompuMethods_Identical 1 100 0.0 65535 FORMAT "%8.2" ECU_ADDRESS 0xfe402a0e /end MEASUREMENT
/begin MEASUREMENT Tlib_RiReDoorRdrObj3RdrObjDataMode_ZCR_CANFD5 "" UBYTE RB_RBA_Common_CentralElements_CompuMethods_Identical 1 100 0.0 255.00 FORMAT "%8.2" ECU_ADDRESS 0xfe403374 /end MEASUREMENT
/begin MEASUREMENT Tlib_RiReDoorRdrObj3RdrObjAccStdY_ZCR_CANFD5 "" UBYTE RB_RBA_Common_CentralElements_CompuMethods_Identical 1 100 0.0 255.00 FORMAT "%8.2" ECU_ADDRESS 0xfe403375 /end MEASUREMENT
/begin MEASUREMENT Tlib_RiReDoorRdrObj3RdrObjAccX_ZCR_CANFD5 "" UWORD RB_RBA_Common_CentralElements_CompuMethods_Identical 1 100 0.0 65535 FORMAT "%8.2" ECU_ADDRESS 0xfe402a10 /end MEASUREMENT
/begin MEASUREMENT Tlib_RiReDoorRdrObj3RdrObjConfidLvl_ZCR_CANFD5 "" UBYTE RB_RBA_Common_CentralElements_CompuMethods_Identical 1 100 0.0 255.00 FORMAT "%8.2" ECU_ADDRESS 0xfe403376 /end MEASUREMENT
/begin MEASUREMENT Tlib_RiReDoorRdrObj3RdrObjIdx_ZCR_CANFD5 "" UBYTE RB_RBA_Common_CentralElements_CompuMethods_Identical 1 100 0.0 255.00 FORMAT "%8.2" ECU_ADDRESS 0xfe403377 /end MEASUREMENT
/begin MEASUREMENT Tlib_RiReDoorRdrObj3RdrObjMotionPattern_ZCR_CANFD5 "" UBYTE RB_RBA_Common_CentralElements_CompuMethods_Identical 1 100 0.0 255.00 FORMAT "%8.2" ECU_ADDRESS 0xfe403378 /end MEASUREMENT
/begin MEASUREMENT Tlib_RiReDoorRdrObj3RdrObjAccStdX_ZCR_CANFD5 "" UBYTE RB_RBA_Common_CentralElements_CompuMethods_Identical 1 100 0.0 255.00 FORMAT "%8.2" ECU_ADDRESS 0xfe403379 /end MEASUREMENT
/begin MEASUREMENT Tlib_RiReDoorRdrObj3RdrObjRangeZ_ZCR_CANFD5 "" UWORD RB_RBA_Common_CentralElements_CompuMethods_Identical 1 100 0.0 65535 FORMAT "%8.2" ECU_ADDRESS 0xfe402a12 /end MEASUREMENT
/begin MEASUREMENT Tlib_RiReDoorRdrObj3RdrObjSpeedStdY_ZCR_CANFD5 "" UBYTE RB_RBA_Common_CentralElements_CompuMethods_Identical 1 100 0.0 255.00 FORMAT "%8.2" ECU_ADDRESS 0xfe40337a /end MEASUREMENT
/begin MEASUREMENT Tlib_RiReDoorRdrObj3RdrObjRangeStdY_ZCR_CANFD5 "" UBYTE RB_RBA_Common_CentralElements_CompuMethods_Identical 1 100 0.0 255.00 FORMAT "%8.2" ECU_ADDRESS 0xfe40337b /end MEASUREMENT
/begin MEASUREMENT Tlib_RiReDoorRdrObj3RdrObjSpeedX_ZCR_CANFD5 "" UWORD RB_RBA_Common_CentralElements_CompuMethods_Identical 1 100 0.0 65535 FORMAT "%8.2" ECU_ADDRESS 0xfe402a14 /end MEASUREMENT
/begin MEASUREMENT Tlib_RiReDoorRdrObj3RdrObjTrackAge_ZCR_CANFD5 "" UBYTE RB_RBA_Common_CentralElements_CompuMethods_Identical 1 100 0.0 255.00 FORMAT "%8.2" ECU_ADDRESS 0xfe40337c /end MEASUREMENT
/begin MEASUREMENT Tlib_RiReDoorRdrObj3RdrObjSpeedStdX_ZCR_CANFD5 "" UBYTE RB_RBA_Common_CentralElements_CompuMethods_Identical 1 100 0.0 255.00 FORMAT "%8.2" ECU_ADDRESS 0xfe40337d /end MEASUREMENT
/begin MEASUREMENT Tlib_RiReDoorRdrObj3RdrObjRangeX_ZCR_CANFD5 "" UWORD RB_RBA_Common_CentralElements_CompuMethods_Identical 1 100 0.0 65535 FORMAT "%8.2" ECU_ADDRESS 0xfe402a16 /end MEASUREMENT
/begin MEASUREMENT Tlib_RiReDoorRdrObj3RdrObjRangeY_ZCR_CANFD5 "" UWORD RB_RBA_Common_CentralElements_CompuMethods_Identical 1 100 0.0 65535 FORMAT "%8.2" ECU_ADDRESS 0xfe402a18 /end MEASUREMENT
/begin MEASUREMENT Tlib_RiReDoorRdrObj3RdrObjRangeStdZ_ZCR_CANFD5 "" UBYTE RB_RBA_Common_CentralElements_CompuMethods_Identical 1 100 0.0 255.00 FORMAT "%8.2" ECU_ADDRESS 0xfe40337e /end MEASUREMENT
/begin MEASUREMENT Tlib_RiReDoorRdrObj3RdrObjSpeedY_ZCR_CANFD5 "" UWORD RB_RBA_Common_CentralElements_CompuMethods_Identical 1 100 0.0 65535 FORMAT "%8.2" ECU_ADDRESS 0xfe402a1a /end MEASUREMENT
/begin MEASUREMENT Tlib_RiReDoorRdrObj8RdrObjTrackClass_ZCR_CANFD5 "" UBYTE RB_RBA_Common_CentralElements_CompuMethods_Identical 1 100 0.0 255.00 FORMAT "%8.2" ECU_ADDRESS 0xfe40337f /end MEASUREMENT
/begin MEASUREMENT Tlib_RiReDoorRdrObj8RdrObjRangeY_ZCR_CANFD5 "" UWORD RB_RBA_Common_CentralElements_CompuMethods_Identical 1 100 0.0 65535 FORMAT "%8.2" ECU_ADDRESS 0xfe402a1c /end MEASUREMENT
/begin MEASUREMENT Tlib_RiReDoorRdrObj8RdrObjRangeStdY_ZCR_CANFD5 "" UBYTE RB_RBA_Common_CentralElements_CompuMethods_Identical 1 100 0.0 255.00 FORMAT "%8.2" ECU_ADDRESS 0xfe403380 /end MEASUREMENT
/begin MEASUREMENT Tlib_RiReDoorRdrObj8RdrObjAccX_ZCR_CANFD5 "" UWORD RB_RBA_Common_CentralElements_CompuMethods_Identical 1 100 0.0 65535 FORMAT "%8.2" ECU_ADDRESS 0xfe402a1e /end MEASUREMENT
/begin MEASUREMENT Tlib_RiReDoorRdrObj8RdrObjRangeStdX_ZCR_CANFD5 "" UBYTE RB_RBA_Common_CentralElements_CompuMethods_Identical 1 100 0.0 255.00 FORMAT "%8.2" ECU_ADDRESS 0xfe403381 /end MEASUREMENT
/begin MEASUREMENT Tlib_RiReDoorRdrObj8RdrObjConfidLvl_ZCR_CANFD5 "" UBYTE RB_RBA_Common_CentralElements_CompuMethods_Identical 1 100 0.0 255.00 FORMAT "%8.2" ECU_ADDRESS 0xfe403382 /end MEASUREMENT
/begin MEASUREMENT Tlib_RiReDoorRdrObj8RdrObjDataMode_ZCR_CANFD5 "" UBYTE RB_RBA_Common_CentralElements_CompuMethods_Identical 1 100 0.0 255.00 FORMAT "%8.2" ECU_ADDRESS 0xfe403383 /end MEASUREMENT
/begin MEASUREMENT Tlib_RiReDoorRdrObj8RdrObjSpeedStdY_ZCR_CANFD5 "" UBYTE RB_RBA_Common_CentralElements_CompuMethods_Identical 1 100 0.0 255.00 FORMAT "%8.2" ECU_ADDRESS 0xfe403384 /end MEASUREMENT
/begin MEASUREMENT Tlib_RiReDoorRdrObj8RdrObjRangeX_ZCR_CANFD5 "" UWORD RB_RBA_Common_CentralElements_CompuMethods_Identical 1 100 0.0 65535 FORMAT "%8.2" ECU_ADDRESS 0xfe402a20 /end MEASUREMENT
/begin MEASUREMENT Tlib_RiReDoorRdrObj8RdrObjAccStdX_ZCR_CANFD5 "" UBYTE RB_RBA_Common_CentralElements_CompuMethods_Identical 1 100 0.0 255.00 FORMAT "%8.2" ECU_ADDRESS 0xfe403385 /end MEASUREMENT
/begin MEASUREMENT Tlib_RiReDoorRdrObj8RdrObjRangeZ_ZCR_CANFD5 "" UWORD RB_RBA_Common_CentralElements_CompuMethods_Identical 1 100 0.0 65535 FORMAT "%8.2" ECU_ADDRESS 0xfe402a22 /end MEASUREMENT
/begin MEASUREMENT Tlib_RiReDoorRdrObj8RdrObjMotionPattern_ZCR_CANFD5 "" UBYTE RB_RBA_Common_CentralElements_CompuMethods_Identical 1 100 0.0 255.00 FORMAT "%8.2" ECU_ADDRESS 0xfe403386 /end MEASUREMENT
/begin MEASUREMENT Tlib_RiReDoorRdrObj8RdrObjRangeStdZ_ZCR_CANFD5 "" UBYTE RB_RBA_Common_CentralElements_CompuMethods_Identical 1 100 0.0 255.00 FORMAT "%8.2" ECU_ADDRESS 0xfe403387 /end MEASUREMENT
/begin MEASUREMENT Tlib_RiReDoorRdrObj8RdrObjSpeedStdX_ZCR_CANFD5 "" UBYTE RB_RBA_Common_CentralElements_CompuMethods_Identical 1 100 0.0 255.00 FORMAT "%8.2" ECU_ADDRESS 0xfe403388 /end MEASUREMENT
/begin MEASUREMENT Tlib_RiReDoorRdrObj8RdrObjSpeedY_ZCR_CANFD5 "" UWORD RB_RBA_Common_CentralElements_CompuMethods_Identical 1 100 0.0 65535 FORMAT "%8.2" ECU_ADDRESS 0xfe402a24 /end MEASUREMENT
/begin MEASUREMENT Tlib_RiReDoorRdrObj8RdrObjTrackAge_ZCR_CANFD5 "" UBYTE RB_RBA_Common_CentralElements_CompuMethods_Identical 1 100 0.0 255.00 FORMAT "%8.2" ECU_ADDRESS 0xfe403389 /end MEASUREMENT
/begin MEASUREMENT Tlib_RiReDoorRdrObj8RdrObjIdx_ZCR_CANFD5 "" UBYTE RB_RBA_Common_CentralElements_CompuMethods_Identical 1 100 0.0 255.00 FORMAT "%8.2" ECU_ADDRESS 0xfe40338a /end MEASUREMENT
/begin MEASUREMENT Tlib_RiReDoorRdrObj8RdrObjAccStdY_ZCR_CANFD5 "" UBYTE RB_RBA_Common_CentralElements_CompuMethods_Identical 1 100 0.0 255.00 FORMAT "%8.2" ECU_ADDRESS 0xfe40338b /end MEASUREMENT
/begin MEASUREMENT Tlib_RiReDoorRdrObj8RdrObjAccY_ZCR_CANFD5 "" UWORD RB_RBA_Common_CentralElements_CompuMethods_Identical 1 100 0.0 65535 FORMAT "%8.2" ECU_ADDRESS 0xfe402a26 /end MEASUREMENT
/begin MEASUREMENT Tlib_RiReDoorRdrObj8RdrObjSpeedX_ZCR_CANFD5 "" UWORD RB_RBA_Common_CentralElements_CompuMethods_Identical 1 100 0.0 65535 FORMAT "%8.2" ECU_ADDRESS 0xfe402a28 /end MEASUREMENT
/begin MEASUREMENT Tlib_RiReDoorRdrFrameID_ZCR_CANFD5 "" UBYTE RB_RBA_Common_CentralElements_CompuMethods_Identical 1 100 0.0 255.00 FORMAT "%8.2" ECU_ADDRESS 0xfe40338c /end MEASUREMENT
/begin MEASUREMENT Tlib_RiReDoorSensorXzOrient_ZCR_CANFD5 "" UBYTE RB_RBA_Common_CentralElements_CompuMethods_Identical 1 100 0.0 255.00 FORMAT "%8.2" ECU_ADDRESS 0xfe40338d /end MEASUREMENT
/begin MEASUREMENT Tlib_RiReDoorRdrDTCInfoInternalErr_ZCR_CANFD5 "" UBYTE RB_RBA_Common_CentralElements_CompuMethods_Identical 1 100 0.0 255.00 FORMAT "%8.2" ECU_ADDRESS 0xfe40338e /end MEASUREMENT
/begin MEASUREMENT Tlib_RiReDoorRdrDTCInfoCalFailure_ZCR_CANFD5 "" UBYTE RB_RBA_Common_CentralElements_CompuMethods_Identical 1 100 0.0 255.00 FORMAT "%8.2" ECU_ADDRESS 0xfe40338f /end MEASUREMENT
/begin MEASUREMENT Tlib_RiReDoorRdrDTCInfoHighVol_ZCR_CANFD5 "" UBYTE RB_RBA_Common_CentralElements_CompuMethods_Identical 1 100 0.0 255.00 FORMAT "%8.2" ECU_ADDRESS 0xfe403390 /end MEASUREMENT
/begin MEASUREMENT Tlib_RiReDoorRdrDTCInfoInterference2_ZCR_CANFD5 "" UBYTE RB_RBA_Common_CentralElements_CompuMethods_Identical 1 100 0.0 255.00 FORMAT "%8.2" ECU_ADDRESS 0xfe403391 /end MEASUREMENT
/begin MEASUREMENT Tlib_RiReDoorRdrDTCInfoNvmErr_ZCR_CANFD5 "" UBYTE RB_RBA_Common_CentralElements_CompuMethods_Identical 1 100 0.0 255.00 FORMAT "%8.2" ECU_ADDRESS 0xfe403392 /end MEASUREMENT
/begin MEASUREMENT Tlib_RiReDoorRdrDTCInfoBlocked_ZCR_CANFD5 "" UBYTE RB_RBA_Common_CentralElements_CompuMethods_Identical 1 100 0.0 255.00 FORMAT "%8.2" ECU_ADDRESS 0xfe403393 /end MEASUREMENT
/begin MEASUREMENT Tlib_RiReDoorRdrDTCInfoLowVol_ZCR_CANFD5 "" UBYTE RB_RBA_Common_CentralElements_CompuMethods_Identical 1 100 0.0 255.00 FORMAT "%8.2" ECU_ADDRESS 0xfe403394 /end MEASUREMENT
/begin MEASUREMENT Tlib_RiReDoorRdrDTCInfoInterference1_ZCR_CANFD5 "" UBYTE RB_RBA_Common_CentralElements_CompuMethods_Identical 1 100 0.0 255.00 FORMAT "%8.2" ECU_ADDRESS 0xfe403395 /end MEASUREMENT
/begin MEASUREMENT Tlib_RiReDoorSensorYzOrient_ZCR_CANFD5 "" UBYTE RB_RBA_Common_CentralElements_CompuMethods_Identical 1 100 0.0 255.00 FORMAT "%8.2" ECU_ADDRESS 0xfe403396 /end MEASUREMENT
/begin MEASUREMENT Tlib_RiReDoorSensorXyOrient_ZCR_CANFD5 "" UBYTE RB_RBA_Common_CentralElements_CompuMethods_Identical 1 100 0.0 255.00 FORMAT "%8.2" ECU_ADDRESS 0xfe403397 /end MEASUREMENT
/begin MEASUREMENT Tlib_RiReDoorRdrSts_ZCR_CANFD5 "" UBYTE RB_RBA_Common_CentralElements_CompuMethods_Identical 1 100 0.0 255.00 FORMAT "%8.2" ECU_ADDRESS 0xfe403398 /end MEASUREMENT
/begin MEASUREMENT Tlib_RiReDoorRdrObj9RdrObjAccStdX_ZCR_CANFD5 "" UBYTE RB_RBA_Common_CentralElements_CompuMethods_Identical 1 100 0.0 255.00 FORMAT "%8.2" ECU_ADDRESS 0xfe403399 /end MEASUREMENT
/begin MEASUREMENT Tlib_RiReDoorRdrObj9RdrObjAccStdY_ZCR_CANFD5 "" UBYTE RB_RBA_Common_CentralElements_CompuMethods_Identical 1 100 0.0 255.00 FORMAT "%8.2" ECU_ADDRESS 0xfe40339a /end MEASUREMENT
/begin MEASUREMENT Tlib_RiReDoorRdrObj9RdrObjRangeStdX_ZCR_CANFD5 "" UBYTE RB_RBA_Common_CentralElements_CompuMethods_Identical 1 100 0.0 255.00 FORMAT "%8.2" ECU_ADDRESS 0xfe40339b /end MEASUREMENT
/begin MEASUREMENT Tlib_RiReDoorRdrObj9RdrObjRangeY_ZCR_CANFD5 "" UWORD RB_RBA_Common_CentralElements_CompuMethods_Identical 1 100 0.0 65535 FORMAT "%8.2" ECU_ADDRESS 0xfe402a2a /end MEASUREMENT
/begin MEASUREMENT Tlib_RiReDoorRdrObj9RdrObjTrackClass_ZCR_CANFD5 "" UBYTE RB_RBA_Common_CentralElements_CompuMethods_Identical 1 100 0.0 255.00 FORMAT "%8.2" ECU_ADDRESS 0xfe40339c /end MEASUREMENT
/begin MEASUREMENT Tlib_RiReDoorRdrObj9RdrObjAccY_ZCR_CANFD5 "" UWORD RB_RBA_Common_CentralElements_CompuMethods_Identical 1 100 0.0 65535 FORMAT "%8.2" ECU_ADDRESS 0xfe402a2c /end MEASUREMENT
/begin MEASUREMENT Tlib_RiReDoorRdrObj9RdrObjIdx_ZCR_CANFD5 "" UBYTE RB_RBA_Common_CentralElements_CompuMethods_Identical 1 100 0.0 255.00 FORMAT "%8.2" ECU_ADDRESS 0xfe40339d /end MEASUREMENT
/begin MEASUREMENT Tlib_RiReDoorRdrObj9RdrObjRangeZ_ZCR_CANFD5 "" UWORD RB_RBA_Common_CentralElements_CompuMethods_Identical 1 100 0.0 65535 FORMAT "%8.2" ECU_ADDRESS 0xfe402a2e /end MEASUREMENT
/begin MEASUREMENT Tlib_RiReDoorRdrObj9RdrObjMotionPattern_ZCR_CANFD5 "" UBYTE RB_RBA_Common_CentralElements_CompuMethods_Identical 1 100 0.0 255.00 FORMAT "%8.2" ECU_ADDRESS 0xfe40339e /end MEASUREMENT
/begin MEASUREMENT Tlib_RiReDoorRdrObj9RdrObjConfidLvl_ZCR_CANFD5 "" UBYTE RB_RBA_Common_CentralElements_CompuMethods_Identical 1 100 0.0 255.00 FORMAT "%8.2" ECU_ADDRESS 0xfe40339f /end MEASUREMENT
/begin MEASUREMENT Tlib_RiReDoorRdrObj9RdrObjSpeedY_ZCR_CANFD5 "" UWORD RB_RBA_Common_CentralElements_CompuMethods_Identical 1 100 0.0 65535 FORMAT "%8.2" ECU_ADDRESS 0xfe402a30 /end MEASUREMENT
/begin MEASUREMENT Tlib_RiReDoorRdrObj9RdrObjRangeStdY_ZCR_CANFD5 "" UBYTE RB_RBA_Common_CentralElements_CompuMethods_Identical 1 100 0.0 255.00 FORMAT "%8.2" ECU_ADDRESS 0xfe4033a0 /end MEASUREMENT
/begin MEASUREMENT Tlib_RiReDoorRdrObj9RdrObjRangeX_ZCR_CANFD5 "" UWORD RB_RBA_Common_CentralElements_CompuMethods_Identical 1 100 0.0 65535 FORMAT "%8.2" ECU_ADDRESS 0xfe402a32 /end MEASUREMENT
/begin MEASUREMENT Tlib_RiReDoorRdrObj9RdrObjSpeedX_ZCR_CANFD5 "" UWORD RB_RBA_Common_CentralElements_CompuMethods_Identical 1 100 0.0 65535 FORMAT "%8.2" ECU_ADDRESS 0xfe402a34 /end MEASUREMENT
/begin MEASUREMENT Tlib_RiReDoorRdrObj9RdrObjDataMode_ZCR_CANFD5 "" UBYTE RB_RBA_Common_CentralElements_CompuMethods_Identical 1 100 0.0 255.00 FORMAT "%8.2" ECU_ADDRESS 0xfe4033a1 /end MEASUREMENT
/begin MEASUREMENT Tlib_RiReDoorRdrObj9RdrObjSpeedStdY_ZCR_CANFD5 "" UBYTE RB_RBA_Common_CentralElements_CompuMethods_Identical 1 100 0.0 255.00 FORMAT "%8.2" ECU_ADDRESS 0xfe4033a2 /end MEASUREMENT
/begin MEASUREMENT Tlib_RiReDoorRdrObj9RdrObjTrackAge_ZCR_CANFD5 "" UBYTE RB_RBA_Common_CentralElements_CompuMethods_Identical 1 100 0.0 255.00 FORMAT "%8.2" ECU_ADDRESS 0xfe4033a3 /end MEASUREMENT
/begin MEASUREMENT Tlib_RiReDoorRdrObj9RdrObjAccX_ZCR_CANFD5 "" UWORD RB_RBA_Common_CentralElements_CompuMethods_Identical 1 100 0.0 65535 FORMAT "%8.2" ECU_ADDRESS 0xfe402a36 /end MEASUREMENT
/begin MEASUREMENT Tlib_RiReDoorRdrObj9RdrObjRangeStdZ_ZCR_CANFD5 "" UBYTE RB_RBA_Common_CentralElements_CompuMethods_Identical 1 100 0.0 255.00 FORMAT "%8.2" ECU_ADDRESS 0xfe4033a4 /end MEASUREMENT
/begin MEASUREMENT Tlib_RiReDoorRdrObj9RdrObjSpeedStdX_ZCR_CANFD5 "" UBYTE RB_RBA_Common_CentralElements_CompuMethods_Identical 1 100 0.0 255.00 FORMAT "%8.2" ECU_ADDRESS 0xfe4033a5 /end MEASUREMENT
/begin MEASUREMENT Tlib_RiReDoorRdrObj22RdrObjSpeedY_ZCR_CANFD5 "" UWORD RB_RBA_Common_CentralElements_CompuMethods_Identical 1 100 0.0 65535 FORMAT "%8.2" ECU_ADDRESS 0xfe402a38 /end MEASUREMENT
/begin MEASUREMENT Tlib_RiReDoorRdrObj22RdrObjRangeX_ZCR_CANFD5 "" UWORD RB_RBA_Common_CentralElements_CompuMethods_Identical 1 100 0.0 65535 FORMAT "%8.2" ECU_ADDRESS 0xfe402a3a /end MEASUREMENT
/begin MEASUREMENT Tlib_RiReDoorRdrObj22RdrObjAccStdX_ZCR_CANFD5 "" UBYTE RB_RBA_Common_CentralElements_CompuMethods_Identical 1 100 0.0 255.00 FORMAT "%8.2" ECU_ADDRESS 0xfe4033a6 /end MEASUREMENT
/begin MEASUREMENT Tlib_RiReDoorRdrObj22RdrObjRangeY_ZCR_CANFD5 "" UWORD RB_RBA_Common_CentralElements_CompuMethods_Identical 1 100 0.0 65535 FORMAT "%8.2" ECU_ADDRESS 0xfe402a3c /end MEASUREMENT
/begin MEASUREMENT Tlib_RiReDoorRdrObj22RdrObjSpeedX_ZCR_CANFD5 "" UWORD RB_RBA_Common_CentralElements_CompuMethods_Identical 1 100 0.0 65535 FORMAT "%8.2" ECU_ADDRESS 0xfe402a3e /end MEASUREMENT
/begin MEASUREMENT Tlib_RiReDoorRdrObj22RdrObjSpeedStdY_ZCR_CANFD5 "" UBYTE RB_RBA_Common_CentralElements_CompuMethods_Identical 1 100 0.0 255.00 FORMAT "%8.2" ECU_ADDRESS 0xfe4033a7 /end MEASUREMENT
/begin MEASUREMENT Tlib_RiReDoorRdrObj22RdrObjTrackClass_ZCR_CANFD5 "" UBYTE RB_RBA_Common_CentralElements_CompuMethods_Identical 1 100 0.0 255.00 FORMAT "%8.2" ECU_ADDRESS 0xfe4033a8 /end MEASUREMENT
/begin MEASUREMENT Tlib_RiReDoorRdrObj22RdrObjAccX_ZCR_CANFD5 "" UWORD RB_RBA_Common_CentralElements_CompuMethods_Identical 1 100 0.0 65535 FORMAT "%8.2" ECU_ADDRESS 0xfe402a40 /end MEASUREMENT
/begin MEASUREMENT Tlib_RiReDoorRdrObj22RdrObjRangeStdX_ZCR_CANFD5 "" UBYTE RB_RBA_Common_CentralElements_CompuMethods_Identical 1 100 0.0 255.00 FORMAT "%8.2" ECU_ADDRESS 0xfe4033a9 /end MEASUREMENT
/begin MEASUREMENT Tlib_RiReDoorRdrObj22RdrObjIdx_ZCR_CANFD5 "" UBYTE RB_RBA_Common_CentralElements_CompuMethods_Identical 1 100 0.0 255.00 FORMAT "%8.2" ECU_ADDRESS 0xfe4033aa /end MEASUREMENT
/begin MEASUREMENT Tlib_RiReDoorRdrObj22RdrObjRangeZ_ZCR_CANFD5 "" UWORD RB_RBA_Common_CentralElements_CompuMethods_Identical 1 100 0.0 65535 FORMAT "%8.2" ECU_ADDRESS 0xfe402a42 /end MEASUREMENT
/begin MEASUREMENT Tlib_RiReDoorRdrObj22RdrObjTrackAge_ZCR_CANFD5 "" UBYTE RB_RBA_Common_CentralElements_CompuMethods_Identical 1 100 0.0 255.00 FORMAT "%8.2" ECU_ADDRESS 0xfe4033ab /end MEASUREMENT
/begin MEASUREMENT Tlib_RiReDoorRdrObj22RdrObjDataMode_ZCR_CANFD5 "" UBYTE RB_RBA_Common_CentralElements_CompuMethods_Identical 1 100 0.0 255.00 FORMAT "%8.2" ECU_ADDRESS 0xfe4033ac /end MEASUREMENT
/begin MEASUREMENT Tlib_RiReDoorRdrObj22RdrObjMotionPattern_ZCR_CANFD5 "" UBYTE RB_RBA_Common_CentralElements_CompuMethods_Identical 1 100 0.0 255.00 FORMAT "%8.2" ECU_ADDRESS 0xfe4033ad /end MEASUREMENT
/begin MEASUREMENT Tlib_RiReDoorRdrObj22RdrObjAccY_ZCR_CANFD5 "" UWORD RB_RBA_Common_CentralElements_CompuMethods_Identical 1 100 0.0 65535 FORMAT "%8.2" ECU_ADDRESS 0xfe402a44 /end MEASUREMENT
/begin MEASUREMENT Tlib_RiReDoorRdrObj22RdrObjConfidLvl_ZCR_CANFD5 "" UBYTE RB_RBA_Common_CentralElements_CompuMethods_Identical 1 100 0.0 255.00 FORMAT "%8.2" ECU_ADDRESS 0xfe4033ae /end MEASUREMENT
/begin MEASUREMENT Tlib_RiReDoorRdrObj22RdrObjRangeStdY_ZCR_CANFD5 "" UBYTE RB_RBA_Common_CentralElements_CompuMethods_Identical 1 100 0.0 255.00 FORMAT "%8.2" ECU_ADDRESS 0xfe4033af /end MEASUREMENT
/begin MEASUREMENT Tlib_RiReDoorRdrObj22RdrObjAccStdY_ZCR_CANFD5 "" UBYTE RB_RBA_Common_CentralElements_CompuMethods_Identical 1 100 0.0 255.00 FORMAT "%8.2" ECU_ADDRESS 0xfe4033b0 /end MEASUREMENT
/begin MEASUREMENT Tlib_RiReDoorRdrObj22RdrObjRangeStdZ_ZCR_CANFD5 "" UBYTE RB_RBA_Common_CentralElements_CompuMethods_Identical 1 100 0.0 255.00 FORMAT "%8.2" ECU_ADDRESS 0xfe4033b1 /end MEASUREMENT
/begin MEASUREMENT Tlib_RiReDoorRdrObj22RdrObjSpeedStdX_ZCR_CANFD5 "" UBYTE RB_RBA_Common_CentralElements_CompuMethods_Identical 1 100 0.0 255.00 FORMAT "%8.2" ECU_ADDRESS 0xfe4033b2 /end MEASUREMENT
/begin MEASUREMENT Tlib_RiReDoorRdrObj21RdrObjSpeedStdY_ZCR_CANFD5 "" UBYTE RB_RBA_Common_CentralElements_CompuMethods_Identical 1 100 0.0 255.00 FORMAT "%8.2" ECU_ADDRESS 0xfe4033b3 /end MEASUREMENT
/begin MEASUREMENT Tlib_RiReDoorRdrObj21RdrObjConfidLvl_ZCR_CANFD5 "" UBYTE RB_RBA_Common_CentralElements_CompuMethods_Identical 1 100 0.0 255.00 FORMAT "%8.2" ECU_ADDRESS 0xfe4033b4 /end MEASUREMENT
/begin MEASUREMENT Tlib_RiReDoorRdrObj21RdrObjTrackClass_ZCR_CANFD5 "" UBYTE RB_RBA_Common_CentralElements_CompuMethods_Identical 1 100 0.0 255.00 FORMAT "%8.2" ECU_ADDRESS 0xfe4033b5 /end MEASUREMENT
/begin MEASUREMENT Tlib_RiReDoorRdrObj21RdrObjIdx_ZCR_CANFD5 "" UBYTE RB_RBA_Common_CentralElements_CompuMethods_Identical 1 100 0.0 255.00 FORMAT "%8.2" ECU_ADDRESS 0xfe4033b6 /end MEASUREMENT
/begin MEASUREMENT Tlib_RiReDoorRdrObj21RdrObjTrackAge_ZCR_CANFD5 "" UBYTE RB_RBA_Common_CentralElements_CompuMethods_Identical 1 100 0.0 255.00 FORMAT "%8.2" ECU_ADDRESS 0xfe4033b7 /end MEASUREMENT
/begin MEASUREMENT Tlib_RiReDoorRdrObj21RdrObjRangeStdZ_ZCR_CANFD5 "" UBYTE RB_RBA_Common_CentralElements_CompuMethods_Identical 1 100 0.0 255.00 FORMAT "%8.2" ECU_ADDRESS 0xfe4033b8 /end MEASUREMENT
/begin MEASUREMENT Tlib_RiReDoorRdrObj21RdrObjAccStdX_ZCR_CANFD5 "" UBYTE RB_RBA_Common_CentralElements_CompuMethods_Identical 1 100 0.0 255.00 FORMAT "%8.2" ECU_ADDRESS 0xfe4033b9 /end MEASUREMENT
/begin MEASUREMENT Tlib_RiReDoorRdrObj21RdrObjAccY_ZCR_CANFD5 "" UWORD RB_RBA_Common_CentralElements_CompuMethods_Identical 1 100 0.0 65535 FORMAT "%8.2" ECU_ADDRESS 0xfe402a46 /end MEASUREMENT
/begin MEASUREMENT Tlib_RiReDoorRdrObj21RdrObjRangeStdY_ZCR_CANFD5 "" UBYTE RB_RBA_Common_CentralElements_CompuMethods_Identical 1 100 0.0 255.00 FORMAT "%8.2" ECU_ADDRESS 0xfe4033ba /end MEASUREMENT
/begin MEASUREMENT Tlib_RiReDoorRdrObj21RdrObjSpeedStdX_ZCR_CANFD5 "" UBYTE RB_RBA_Common_CentralElements_CompuMethods_Identical 1 100 0.0 255.00 FORMAT "%8.2" ECU_ADDRESS 0xfe4033bb /end MEASUREMENT
/begin MEASUREMENT Tlib_RiReDoorRdrObj21RdrObjDataMode_ZCR_CANFD5 "" UBYTE RB_RBA_Common_CentralElements_CompuMethods_Identical 1 100 0.0 255.00 FORMAT "%8.2" ECU_ADDRESS 0xfe4033bc /end MEASUREMENT
/begin MEASUREMENT Tlib_RiReDoorRdrObj21RdrObjRangeY_ZCR_CANFD5 "" UWORD RB_RBA_Common_CentralElements_CompuMethods_Identical 1 100 0.0 65535 FORMAT "%8.2" ECU_ADDRESS 0xfe402a48 /end MEASUREMENT
/begin MEASUREMENT Tlib_RiReDoorRdrObj21RdrObjRangeStdX_ZCR_CANFD5 "" UBYTE RB_RBA_Common_CentralElements_CompuMethods_Identical 1 100 0.0 255.00 FORMAT "%8.2" ECU_ADDRESS 0xfe4033bd /end MEASUREMENT
/begin MEASUREMENT Tlib_RiReDoorRdrObj21RdrObjSpeedY_ZCR_CANFD5 "" UWORD RB_RBA_Common_CentralElements_CompuMethods_Identical 1 100 0.0 65535 FORMAT "%8.2" ECU_ADDRESS 0xfe402a4a /end MEASUREMENT
/begin MEASUREMENT Tlib_RiReDoorRdrObj21RdrObjSpeedX_ZCR_CANFD5 "" UWORD RB_RBA_Common_CentralElements_CompuMethods_Identical 1 100 0.0 65535 FORMAT "%8.2" ECU_ADDRESS 0xfe402a4c /end MEASUREMENT
/begin MEASUREMENT Tlib_RiReDoorRdrObj21RdrObjRangeZ_ZCR_CANFD5 "" UWORD RB_RBA_Common_CentralElements_CompuMethods_Identical 1 100 0.0 65535 FORMAT "%8.2" ECU_ADDRESS 0xfe402a4e /end MEASUREMENT
/begin MEASUREMENT Tlib_RiReDoorRdrObj21RdrObjAccStdY_ZCR_CANFD5 "" UBYTE RB_RBA_Common_CentralElements_CompuMethods_Identical 1 100 0.0 255.00 FORMAT "%8.2" ECU_ADDRESS 0xfe4033be /end MEASUREMENT
/begin MEASUREMENT Tlib_RiReDoorRdrObj21RdrObjMotionPattern_ZCR_CANFD5 "" UBYTE RB_RBA_Common_CentralElements_CompuMethods_Identical 1 100 0.0 255.00 FORMAT "%8.2" ECU_ADDRESS 0xfe4033bf /end MEASUREMENT
/begin MEASUREMENT Tlib_RiReDoorRdrObj21RdrObjRangeX_ZCR_CANFD5 "" UWORD RB_RBA_Common_CentralElements_CompuMethods_Identical 1 100 0.0 65535 FORMAT "%8.2" ECU_ADDRESS 0xfe402a50 /end MEASUREMENT
/begin MEASUREMENT Tlib_RiReDoorRdrObj21RdrObjAccX_ZCR_CANFD5 "" UWORD RB_RBA_Common_CentralElements_CompuMethods_Identical 1 100 0.0 65535 FORMAT "%8.2" ECU_ADDRESS 0xfe402a52 /end MEASUREMENT
/begin MEASUREMENT Tlib_RiReDoorRdrObj20RdrObjTrackAge_ZCR_CANFD5 "" UBYTE RB_RBA_Common_CentralElements_CompuMethods_Identical 1 100 0.0 255.00 FORMAT "%8.2" ECU_ADDRESS 0xfe4033c0 /end MEASUREMENT
/begin MEASUREMENT Tlib_RiReDoorRdrObj20RdrObjMotionPattern_ZCR_CANFD5 "" UBYTE RB_RBA_Common_CentralElements_CompuMethods_Identical 1 100 0.0 255.00 FORMAT "%8.2" ECU_ADDRESS 0xfe4033c1 /end MEASUREMENT
/begin MEASUREMENT Tlib_RiReDoorRdrObj20RdrObjIdx_ZCR_CANFD5 "" UBYTE RB_RBA_Common_CentralElements_CompuMethods_Identical 1 100 0.0 255.00 FORMAT "%8.2" ECU_ADDRESS 0xfe4033c2 /end MEASUREMENT
/begin MEASUREMENT Tlib_RiReDoorRdrObj20RdrObjAccX_ZCR_CANFD5 "" UWORD RB_RBA_Common_CentralElements_CompuMethods_Identical 1 100 0.0 65535 FORMAT "%8.2" ECU_ADDRESS 0xfe402a54 /end MEASUREMENT
/begin MEASUREMENT Tlib_RiReDoorRdrObj20RdrObjTrackClass_ZCR_CANFD5 "" UBYTE RB_RBA_Common_CentralElements_CompuMethods_Identical 1 100 0.0 255.00 FORMAT "%8.2" ECU_ADDRESS 0xfe4033c3 /end MEASUREMENT
/begin MEASUREMENT Tlib_RiReDoorRdrObj20RdrObjAccStdX_ZCR_CANFD5 "" UBYTE RB_RBA_Common_CentralElements_CompuMethods_Identical 1 100 0.0 255.00 FORMAT "%8.2" ECU_ADDRESS 0xfe4033c4 /end MEASUREMENT
/begin MEASUREMENT Tlib_RiReDoorRdrObj20RdrObjRangeStdY_ZCR_CANFD5 "" UBYTE RB_RBA_Common_CentralElements_CompuMethods_Identical 1 100 0.0 255.00 FORMAT "%8.2" ECU_ADDRESS 0xfe4033c5 /end MEASUREMENT
/begin MEASUREMENT Tlib_RiReDoorRdrObj20RdrObjSpeedY_ZCR_CANFD5 "" UWORD RB_RBA_Common_CentralElements_CompuMethods_Identical 1 100 0.0 65535 FORMAT "%8.2" ECU_ADDRESS 0xfe402a56 /end MEASUREMENT
/begin MEASUREMENT Tlib_RiReDoorRdrObj20RdrObjSpeedX_ZCR_CANFD5 "" UWORD RB_RBA_Common_CentralElements_CompuMethods_Identical 1 100 0.0 65535 FORMAT "%8.2" ECU_ADDRESS 0xfe402a58 /end MEASUREMENT
/begin MEASUREMENT Tlib_RiReDoorRdrObj20RdrObjAccY_ZCR_CANFD5 "" UWORD RB_RBA_Common_CentralElements_CompuMethods_Identical 1 100 0.0 65535 FORMAT "%8.2" ECU_ADDRESS 0xfe402a5a /end MEASUREMENT
/begin MEASUREMENT Tlib_RiReDoorRdrObj20RdrObjSpeedStdX_ZCR_CANFD5 "" UBYTE RB_RBA_Common_CentralElements_CompuMethods_Identical 1 100 0.0 255.00 FORMAT "%8.2" ECU_ADDRESS 0xfe4033c6 /end MEASUREMENT
/begin MEASUREMENT Tlib_RiReDoorRdrObj20RdrObjAccStdY_ZCR_CANFD5 "" UBYTE RB_RBA_Common_CentralElements_CompuMethods_Identical 1 100 0.0 255.00 FORMAT "%8.2" ECU_ADDRESS 0xfe4033c7 /end MEASUREMENT
/begin MEASUREMENT Tlib_RiReDoorRdrObj20RdrObjDataMode_ZCR_CANFD5 "" UBYTE RB_RBA_Common_CentralElements_CompuMethods_Identical 1 100 0.0 255.00 FORMAT "%8.2" ECU_ADDRESS 0xfe4033c8 /end MEASUREMENT
/begin MEASUREMENT Tlib_RiReDoorRdrObj20RdrObjSpeedStdY_ZCR_CANFD5 "" UBYTE RB_RBA_Common_CentralElements_CompuMethods_Identical 1 100 0.0 255.00 FORMAT "%8.2" ECU_ADDRESS 0xfe4033c9 /end MEASUREMENT
/begin MEASUREMENT Tlib_RiReDoorRdrObj20RdrObjRangeStdZ_ZCR_CANFD5 "" UBYTE RB_RBA_Common_CentralElements_CompuMethods_Identical 1 100 0.0 255.00 FORMAT "%8.2" ECU_ADDRESS 0xfe4033ca /end MEASUREMENT
/begin MEASUREMENT Tlib_RiReDoorRdrObj20RdrObjRangeX_ZCR_CANFD5 "" UWORD RB_RBA_Common_CentralElements_CompuMethods_Identical 1 100 0.0 65535 FORMAT "%8.2" ECU_ADDRESS 0xfe402a5c /end MEASUREMENT
/begin MEASUREMENT Tlib_RiReDoorRdrObj20RdrObjRangeY_ZCR_CANFD5 "" UWORD RB_RBA_Common_CentralElements_CompuMethods_Identical 1 100 0.0 65535 FORMAT "%8.2" ECU_ADDRESS 0xfe402a5e /end MEASUREMENT
/begin MEASUREMENT Tlib_RiReDoorRdrObj20RdrObjRangeStdX_ZCR_CANFD5 "" UBYTE RB_RBA_Common_CentralElements_CompuMethods_Identical 1 100 0.0 255.00 FORMAT "%8.2" ECU_ADDRESS 0xfe4033cb /end MEASUREMENT
/begin MEASUREMENT Tlib_RiReDoorRdrObj20RdrObjRangeZ_ZCR_CANFD5 "" UWORD RB_RBA_Common_CentralElements_CompuMethods_Identical 1 100 0.0 65535 FORMAT "%8.2" ECU_ADDRESS 0xfe402a60 /end MEASUREMENT
/begin MEASUREMENT Tlib_RiReDoorRdrObj20RdrObjConfidLvl_ZCR_CANFD5 "" UBYTE RB_RBA_Common_CentralElements_CompuMethods_Identical 1 100 0.0 255.00 FORMAT "%8.2" ECU_ADDRESS 0xfe4033cc /end MEASUREMENT
/begin MEASUREMENT Tlib_RiReDoorRdrSaveNvmFlg_ZCR_CANFD5 "" UBYTE RB_RBA_Common_CentralElements_CompuMethods_Identical 1 100 0.0 255.00 FORMAT "%8.2" ECU_ADDRESS 0xfe4033cd /end MEASUREMENT
/begin MEASUREMENT Tlib_PassDoorRdrWaveSync_ZCR_CANFD5 "" A_UINT64 RB_RBA_Common_CentralElements_CompuMethods_Identical 1 100 0.0 18446744073709551615 FORMAT "%8.2" ECU_ADDRESS 0xfe402710 /end MEASUREMENT
/begin MEASUREMENT Tlib_PassDoorRdrObj20RdrObjSpeedY_ZCR_CANFD5 "" UWORD RB_RBA_Common_CentralElements_CompuMethods_Identical 1 100 0.0 65535 FORMAT "%8.2" ECU_ADDRESS 0xfe402a62 /end MEASUREMENT
/begin MEASUREMENT Tlib_PassDoorRdrObj20RdrObjMotionPattern_ZCR_CANFD5 "" UBYTE RB_RBA_Common_CentralElements_CompuMethods_Identical 1 100 0.0 255.00 FORMAT "%8.2" ECU_ADDRESS 0xfe4033ce /end MEASUREMENT
/begin MEASUREMENT Tlib_PassDoorRdrObj20RdrObjAccY_ZCR_CANFD5 "" UWORD RB_RBA_Common_CentralElements_CompuMethods_Identical 1 100 0.0 65535 FORMAT "%8.2" ECU_ADDRESS 0xfe402a64 /end MEASUREMENT
/begin MEASUREMENT Tlib_PassDoorRdrObj20RdrObjRangeX_ZCR_CANFD5 "" UWORD RB_RBA_Common_CentralElements_CompuMethods_Identical 1 100 0.0 65535 FORMAT "%8.2" ECU_ADDRESS 0xfe402a66 /end MEASUREMENT
/begin MEASUREMENT Tlib_PassDoorRdrObj20RdrObjSpeedStdY_ZCR_CANFD5 "" UBYTE RB_RBA_Common_CentralElements_CompuMethods_Identical 1 100 0.0 255.00 FORMAT "%8.2" ECU_ADDRESS 0xfe4033cf /end MEASUREMENT
/begin MEASUREMENT Tlib_PassDoorRdrObj20RdrObjRangeStdY_ZCR_CANFD5 "" UBYTE RB_RBA_Common_CentralElements_CompuMethods_Identical 1 100 0.0 255.00 FORMAT "%8.2" ECU_ADDRESS 0xfe4033d0 /end MEASUREMENT
/begin MEASUREMENT Tlib_PassDoorRdrObj20RdrObjAccStdX_ZCR_CANFD5 "" UBYTE RB_RBA_Common_CentralElements_CompuMethods_Identical 1 100 0.0 255.00 FORMAT "%8.2" ECU_ADDRESS 0xfe4033d1 /end MEASUREMENT
/begin MEASUREMENT Tlib_PassDoorRdrObj20RdrObjSpeedX_ZCR_CANFD5 "" UWORD RB_RBA_Common_CentralElements_CompuMethods_Identical 1 100 0.0 65535 FORMAT "%8.2" ECU_ADDRESS 0xfe402a68 /end MEASUREMENT
/begin MEASUREMENT Tlib_PassDoorRdrObj20RdrObjRangeStdX_ZCR_CANFD5 "" UBYTE RB_RBA_Common_CentralElements_CompuMethods_Identical 1 100 0.0 255.00 FORMAT "%8.2" ECU_ADDRESS 0xfe4033d2 /end MEASUREMENT
/begin MEASUREMENT Tlib_PassDoorRdrObj20RdrObjSpeedStdX_ZCR_CANFD5 "" UBYTE RB_RBA_Common_CentralElements_CompuMethods_Identical 1 100 0.0 255.00 FORMAT "%8.2" ECU_ADDRESS 0xfe4033d3 /end MEASUREMENT
/begin MEASUREMENT Tlib_PassDoorRdrObj20RdrObjTrackAge_ZCR_CANFD5 "" UBYTE RB_RBA_Common_CentralElements_CompuMethods_Identical 1 100 0.0 255.00 FORMAT "%8.2" ECU_ADDRESS 0xfe4033d4 /end MEASUREMENT
/begin MEASUREMENT Tlib_PassDoorRdrObj20RdrObjAccStdY_ZCR_CANFD5 "" UBYTE RB_RBA_Common_CentralElements_CompuMethods_Identical 1 100 0.0 255.00 FORMAT "%8.2" ECU_ADDRESS 0xfe4033d5 /end MEASUREMENT
/begin MEASUREMENT Tlib_PassDoorRdrObj20RdrObjAccX_ZCR_CANFD5 "" UWORD RB_RBA_Common_CentralElements_CompuMethods_Identical 1 100 0.0 65535 FORMAT "%8.2" ECU_ADDRESS 0xfe402a6a /end MEASUREMENT
/begin MEASUREMENT Tlib_PassDoorRdrObj20RdrObjRangeY_ZCR_CANFD5 "" UWORD RB_RBA_Common_CentralElements_CompuMethods_Identical 1 100 0.0 65535 FORMAT "%8.2" ECU_ADDRESS 0xfe402a6c /end MEASUREMENT
/begin MEASUREMENT Tlib_PassDoorRdrObj20RdrObjConfidLvl_ZCR_CANFD5 "" UBYTE RB_RBA_Common_CentralElements_CompuMethods_Identical 1 100 0.0 255.00 FORMAT "%8.2" ECU_ADDRESS 0xfe4033d6 /end MEASUREMENT
/begin MEASUREMENT Tlib_PassDoorRdrObj20RdrObjIdx_ZCR_CANFD5 "" UBYTE RB_RBA_Common_CentralElements_CompuMethods_Identical 1 100 0.0 255.00 FORMAT "%8.2" ECU_ADDRESS 0xfe4033d7 /end MEASUREMENT
/begin MEASUREMENT Tlib_PassDoorRdrObj20RdrObjDataMode_ZCR_CANFD5 "" UBYTE RB_RBA_Common_CentralElements_CompuMethods_Identical 1 100 0.0 255.00 FORMAT "%8.2" ECU_ADDRESS 0xfe4033d8 /end MEASUREMENT
/begin MEASUREMENT Tlib_PassDoorRdrObj20RdrObjRangeZ_ZCR_CANFD5 "" UWORD RB_RBA_Common_CentralElements_CompuMethods_Identical 1 100 0.0 65535 FORMAT "%8.2" ECU_ADDRESS 0xfe402a6e /end MEASUREMENT
/begin MEASUREMENT Tlib_PassDoorRdrObj20RdrObjTrackClass_ZCR_CANFD5 "" UBYTE RB_RBA_Common_CentralElements_CompuMethods_Identical 1 100 0.0 255.00 FORMAT "%8.2" ECU_ADDRESS 0xfe4033d9 /end MEASUREMENT
/begin MEASUREMENT Tlib_PassDoorRdrObj20RdrObjRangeStdZ_ZCR_CANFD5 "" UBYTE RB_RBA_Common_CentralElements_CompuMethods_Identical 1 100 0.0 255.00 FORMAT "%8.2" ECU_ADDRESS 0xfe4033da /end MEASUREMENT
/begin MEASUREMENT Tlib_PassDoorRdrObj22RdrObjAccX_ZCR_CANFD5 "" UWORD RB_RBA_Common_CentralElements_CompuMethods_Identical 1 100 0.0 65535 FORMAT "%8.2" ECU_ADDRESS 0xfe402a70 /end MEASUREMENT
/begin MEASUREMENT Tlib_PassDoorRdrObj22RdrObjRangeStdZ_ZCR_CANFD5 "" UBYTE RB_RBA_Common_CentralElements_CompuMethods_Identical 1 100 0.0 255.00 FORMAT "%8.2" ECU_ADDRESS 0xfe4033db /end MEASUREMENT
/begin MEASUREMENT Tlib_PassDoorRdrObj22RdrObjMotionPattern_ZCR_CANFD5 "" UBYTE RB_RBA_Common_CentralElements_CompuMethods_Identical 1 100 0.0 255.00 FORMAT "%8.2" ECU_ADDRESS 0xfe4033dc /end MEASUREMENT
/begin MEASUREMENT Tlib_PassDoorRdrObj22RdrObjRangeY_ZCR_CANFD5 "" UWORD RB_RBA_Common_CentralElements_CompuMethods_Identical 1 100 0.0 65535 FORMAT "%8.2" ECU_ADDRESS 0xfe402a72 /end MEASUREMENT
/begin MEASUREMENT Tlib_PassDoorRdrObj22RdrObjRangeStdX_ZCR_CANFD5 "" UBYTE RB_RBA_Common_CentralElements_CompuMethods_Identical 1 100 0.0 255.00 FORMAT "%8.2" ECU_ADDRESS 0xfe4033dd /end MEASUREMENT
/begin MEASUREMENT Tlib_PassDoorRdrObj22RdrObjRangeStdY_ZCR_CANFD5 "" UBYTE RB_RBA_Common_CentralElements_CompuMethods_Identical 1 100 0.0 255.00 FORMAT "%8.2" ECU_ADDRESS 0xfe4033de /end MEASUREMENT
/begin MEASUREMENT Tlib_PassDoorRdrObj22RdrObjRangeZ_ZCR_CANFD5 "" UWORD RB_RBA_Common_CentralElements_CompuMethods_Identical 1 100 0.0 65535 FORMAT "%8.2" ECU_ADDRESS 0xfe402a74 /end MEASUREMENT
/begin MEASUREMENT Tlib_PassDoorRdrObj22RdrObjTrackClass_ZCR_CANFD5 "" UBYTE RB_RBA_Common_CentralElements_CompuMethods_Identical 1 100 0.0 255.00 FORMAT "%8.2" ECU_ADDRESS 0xfe4033df /end MEASUREMENT
/begin MEASUREMENT Tlib_PassDoorRdrObj22RdrObjSpeedStdY_ZCR_CANFD5 "" UBYTE RB_RBA_Common_CentralElements_CompuMethods_Identical 1 100 0.0 255.00 FORMAT "%8.2" ECU_ADDRESS 0xfe4033e0 /end MEASUREMENT
/begin MEASUREMENT Tlib_PassDoorRdrObj22RdrObjSpeedStdX_ZCR_CANFD5 "" UBYTE RB_RBA_Common_CentralElements_CompuMethods_Identical 1 100 0.0 255.00 FORMAT "%8.2" ECU_ADDRESS 0xfe4033e1 /end MEASUREMENT
/begin MEASUREMENT Tlib_PassDoorRdrObj22RdrObjAccStdX_ZCR_CANFD5 "" UBYTE RB_RBA_Common_CentralElements_CompuMethods_Identical 1 100 0.0 255.00 FORMAT "%8.2" ECU_ADDRESS 0xfe4033e2 /end MEASUREMENT
/begin MEASUREMENT Tlib_PassDoorRdrObj22RdrObjDataMode_ZCR_CANFD5 "" UBYTE RB_RBA_Common_CentralElements_CompuMethods_Identical 1 100 0.0 255.00 FORMAT "%8.2" ECU_ADDRESS 0xfe4033e3 /end MEASUREMENT
/begin MEASUREMENT Tlib_PassDoorRdrObj22RdrObjTrackAge_ZCR_CANFD5 "" UBYTE RB_RBA_Common_CentralElements_CompuMethods_Identical 1 100 0.0 255.00 FORMAT "%8.2" ECU_ADDRESS 0xfe4033e4 /end MEASUREMENT
/begin MEASUREMENT Tlib_PassDoorRdrObj22RdrObjAccStdY_ZCR_CANFD5 "" UBYTE RB_RBA_Common_CentralElements_CompuMethods_Identical 1 100 0.0 255.00 FORMAT "%8.2" ECU_ADDRESS 0xfe4033e5 /end MEASUREMENT
/begin MEASUREMENT Tlib_PassDoorRdrObj22RdrObjSpeedX_ZCR_CANFD5 "" UWORD RB_RBA_Common_CentralElements_CompuMethods_Identical 1 100 0.0 65535 FORMAT "%8.2" ECU_ADDRESS 0xfe402a76 /end MEASUREMENT
/*********** End of merged FUNCTION blocks ***********/ /*********** Start of merged COMPU_METHOD blocks ***********/
/begin COMPU_METHOD RB_RBA_Common_CentralElements_CompuMethods_Identical "The internal value and the physical one are identical. No physical unit available" RAT_FUNC "%10.5" "noUnit" COEFFS 0.0 1.0 0.0 0.0 0.0 1.0 REF_UNIT RB_RBA_Common_CentralElements_Units_NoUnit /end COMPU_METHOD
/*********** Start of merged UNIT blocks ***********/
/begin UNIT RB_RBA_Common_CentralElements_Units_NoUnit "No Unit" "noUnit" EXTENDED_SI SI_EXPONENTS 0 0 0 0 0 0 0 /end UNIT
/begin UNIT AUTOSAR_CanIf_Units_NoUnit "No Unit" "noUnit" EXTENDED_SI SI_EXPONENTS 0 0 0 0 0 0 0 /end UNIT
/begin UNIT AUTOSAR_CanSM_Units_NoUnit "No Unit" "noUnit" EXTENDED_SI SI_EXPONENTS 0 0 0 0 0 0 0 /end UNIT
/begin UNIT AUTOSAR_Com_Units_NoUnit "No Unit" "noUnit" EXTENDED_SI SI_EXPONENTS 0 0 0 0 0 0 0 /end UNIT
/begin UNIT AUTOSAR_ComM_Units_NoUnit "No Unit" "noUnit" EXTENDED_SI SI_EXPONENTS 0 0 0 0 0 0 0 /end UNIT
/begin UNIT AUTOSAR_Fee_Units_Fee_NoUnit "Fee No Unit" "Fee_NoUnit" EXTENDED_SI SI_EXPONENTS 0 0 0 0 0 0 0 /end UNIT
/begin UNIT AUTOSAR_Lin_Units_NoUnit "No Unit" "noUnit" EXTENDED_SI SI_EXPONENTS 0 0 0 0 0 0 0 /end UNIT
/end MODULE
/end PROJECT
