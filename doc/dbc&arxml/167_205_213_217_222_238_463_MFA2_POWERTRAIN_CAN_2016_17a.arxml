[part 2 of 5: packages /DATA_TYPES to /POWERTRAIN]
AUTOSAR XML (schema 3.2.2)
package /DATA_TYPES  (continued)
  382 x integer type:  (continued)
    c08_ECM_LHOM_Stat:  # 08_ECM_LHOM_Stat | 08 ECM LHOM Stat
      base-type=uint8
      compu {0=I_C08_ECM_LHOM_STAT_NO_LHOM (NO_LHOM) (no limp-home operation mode), 1=I_C08_ECM_LHOM_STAT_ECM_LHOM1 (ECM_LHOM1) (Engine control module in limp-home operation mode 1), 2=I_C08_ECM_LHOM_STAT_ECM_LHOM2 (ECM_LHOM2) (Engine control module in limp-home operation mode 2), 4=I_C08_ECM_LHOM_STAT_ECM_LHOM3 (ECM_LHOM3) (Engine control module in limp-home operation mode 3), 8=I_C08_ECM_LHOM_STAT_ECM_LHOM4 (ECM_LHOM4) (Engine control module in limp-home operation mode 4), 16=I_C08_ECM_LHOM_STAT_ECM_LHOM5 (ECM_LHOM5) (Engine control module in limp-home operation mode 5), 32=I_C08_ECM_LHOM_STAT_ECM_LHOM6 (ECM_LHOM6) (Engine control module in limp-home operation mode 6), 64=I_C08_ECM_LHOM_STAT_ECM_LHOM7 (ECM_LHOM7) (Engine control module in limp-home operation mode 7), 128=I_C08_ECM_LHOM_STAT_ECM_LHOM8 (ECM_LHOM8) (Engine control module in limp-home operation mode 8)}
      lower-limit=0
      upper-limit=128
    c08_EngStyle:  # 08_EngStyle
      base-type=uint8
      compu {0=I_C08_ENGSTYLE_M275E55 (M275E55) (M275 E55 [ME2.7.2]), 1=I_C08_ENGSTYLE_M273E55 (M273E55) (M273 E55 [ME9.7]), 2=I_C08_ENGSTYLE_M273E46 (M273E46) (M273 E46 [ME9.7]), 3=I_C08_ENGSTYLE_M272E35 (M272E35) (M272 E35 [ME9.7]), 4=I_C08_ENGSTYLE_M272E30 (M272E30) (M272 E30 [ME9.7]), 5=I_C08_ENGSTYLE_M272E25 (M272E25) (M272 E25 [ME9.7]), 9=I_C08_ENGSTYLE_M272E35DE (M272E35DE) (M272 E35 DE [MED9.7]), 12=I_C08_ENGSTYLE_M271E18ML135ATT (M271E18ML135ATT) (M271 E18 ML attrac. (135 kW) [SIM271KE]), 13=I_C08_ENGSTYLE_M271E18ML115ATT (M271E18ML115ATT) (M271 E16/E18 ML attrac. (115 kW) [SIM271KE]), 14=I_C08_ENGSTYLE_M272E35_224 (M272E35_224) (M272 E35 (224 kW) [ME9.7]), 15=I_C08_ENGSTYLE_M276E30GDEHLA (M276E30GDEHLA) (M276 E30G DEH LA (245/270 kW) [MED17.7]), 16=I_C08_ENGSTYLE_M276E35DES (M276E35DES) (M276 E35 DES [MED17.7]), 17=I_C08_ENGSTYLE_M276E35DESRED (M276E35DESRED) (M276 E35 DES red. [MED17.7]), 18=I_C08_ENGSTYLE_M278E46DEHLA (M278E46DEHLA) (M278 E46 DEH LA [MED17.7]), 19=I_C08_ENGSTYLE_M271E18LAEVO115 (M271E18LAEVO115) (M271 E18 LA Evo (115kW) [SIM271DE]), 20=I_C08_ENGSTYLE_M271E18LAEVO150 (M271E18LAEVO150) (M271 E18 LA Evo (150kW) [SIM271DE]), 21=I_C08_ENGSTYLE_M271E18LAEVO135 (M271E18LAEVO135) (M271 E18 LA Evo (135kW) [SIM271DE]), 22=I_C08_ENGSTYLE_M270DE16 (M270DE16) (M270 DE16 (90 kW) []), 23=I_C08_ENGSTYLE_M270DE16LA115 (M270DE16LA115) (M270 DE16 LA (115 kW) []), 24=I_C08_ENGSTYLE_M270DE20LA155 (M270DE20LA155) (M270 DE20 LA (155 kW) []), 25=I_C08_ENGSTYLE_M276E35DEH (M276E35DEH) (M276 E35 DEH [MED17.7]), 26=I_C08_ENGSTYLE_M276E35DEHRED (M276E35DEHRED) (M276 E35 DEH red. [MED17.7]), 27=I_C08_ENGSTYLE_M276E35DESLA (M276E35DESLA) (M276 E35 DES LA (270 kW) [MED17.7]), 28=I_C08_ENGSTYLE_M274DEH16LA115 (M274DEH16LA115) (M274 DEH16 LA (115kW)), 29=I_C08_ENGSTYLE_M274DEH20LA135 (M274DEH20LA135) (M274 DEH20 LA (135kW)), 30=I_C08_ENGSTYLE_M274DES20LA135 (M274DES20LA135) (M274 DES20 LA (135kW)), 31=I_C08_ENGSTYLE_M274DEH20LA155 (M274DEH20LA155) (M274 DEH20 LA (155kW)), 32=I_C08_ENGSTYLE_M274DES20LA155 (M274DES20LA155) (M274 DES20 LA (155kW)), 33=I_C08_ENGSTYLE_M274DEH20LA180 (M274DEH20LA180) (M274 DEH20 LA (180kW)), 34=I_C08_ENGSTYLE_M274DES20LA180 (M274DES20LA180) (M274 DES20 LA (180kW)), 35=I_C08_ENGSTYLE_M277E60LA (M277E60LA) (M277 E60 LA [MED17.7.8]), 36=I_C08_ENGSTYLE_M276E30DEHLA245 (M276E30DEHLA245) (M276 E30 DEH LA (245 kW) [MED17.7]), 37=I_C08_ENGSTYLE_M281E10_45 (M281E10_45) (M281 E10 (45kW) []), 38=I_C08_ENGSTYLE_M281E10_51 (M281E10_51) (M281 E10 (51kW) []), 39=I_C08_ENGSTYLE_M281DE09LA (M281DE09LA) (M281 DE09 LA (66kW) []), 40=I_C08_ENGSTYLE_M282DE12LA (M282DE12LA) (M282 DE12 LA (80 - 120 kW) []), 41=I_C08_ENGSTYLE_M276E30DEHLARED (M276E30DEHLARED) (M276 E30 DEH LA red. [MED17.7]), 42=I_C08_ENGSTYLE_M270DE20LA120 (M270DE20LA120) (M270 DE20 LA red. (120 kW) []), 43=I_C08_ENGSTYLE_M270DE16LA70 (M270DE16LA70) (M270 DE16 LA (70 kW) []), 44=I_C08_ENGSTYLE_M270DE20LA165 (M270DE20LA165) (M270 DE20 LA (165 kW) []), 45=I_C08_ENGSTYLE_M276E35DESLA245 (M276E35DESLA245) (M276 E35 DES LA (245 kW) []), 46=I_C08_ENGSTYLE_M278DEH40LA320 (M278DEH40LA320) (M278 DEH40 LA (320 kW) [MED 17.7.5]), 47=I_C08_ENGSTYLE_M176DEH40LA345 (M176DEH40LA345) (M176 DEH40 LA (345 kW) [MED 17.7.5]), 48=I_C08_ENGSTYLE_M276E30DEHLA270 (M276E30DEHLA270) (M276 E30 DEH LA (270 kW) [MED17.7]), 49=I_C08_ENGSTYLE_M176DEH40LA310 (M176DEH40LA310) (M176 DEH40 LA (310 kW) [MED 17.7.5]), 50=I_C08_ENGSTYLE_M256DEH30LA (M256DEH30LA) (M256 DEH30 LA [MRG1] Turbo und eLader (eZV, leistungsgesteigert)), 51=I_C08_ENGSTYLE_M256DEHDES30LA (M256DEHDES30LA) (M256 DEH/DES30 LA [MRG1] Monoturbo), 52=I_C08_ENGSTYLE_M256DEHDES30LAPL (M256DEHDES30LAPL) (M256 DEH/DES30 LA PL [MRG1] PlugIn-Hybrid), 53=I_C08_ENGSTYLE_M256DEHDES25LA (M256DEHDES25LA) (M256 DEH/DES25 LA [MRG1] Turbo und eLader (eZV, leistungsgesteigert)), 54=I_C08_ENGSTYLE_M274DEH16LA90 (M274DEH16LA90) (M274 DEH16 LA (90kW)), 55=I_C08_ENGSTYLE_M264DEHLA (M264DEHLA) (M264 DEH LA (95 - 225 kW) [MED17.7.7]), 56=I_C08_ENGSTYLE_M260DEHLA (M260DEHLA) (M260 DEH LA (135 - 225 kW) [MED17.7.7]), 57=I_C08_ENGSTYLE_M176DEH40LA360 (M176DEH40LA360) (M176 DEH40 LA (360 kW) [MED 17.7.5]), 107=I_C08_ENGSTYLE_AMGM139DEHLA (AMGM139DEHLA) (AMG M139 DEH LA (280 kW) [MED17.7.7]), 108=I_C08_ENGSTYLE_AMGM177DEH40LA410 (AMGM177DEH40LA410) (AMG M177 DEH40 LA (410kW) [MED17.7.5]), 109=I_C08_ENGSTYLE_AMGM177DEH40LA420 (AMGM177DEH40LA420) (AMG M177 DEH40 LA (420kW) [MED17.7.5]), 110=I_C08_ENGSTYLE_AMGM177DEH40LA430 (AMGM177DEH40LA430) (AMG M177 DEH40 LA (430kW) [MED17.7.5]), 111=I_C08_ENGSTYLE_AMGM177DEH40LA450 (AMGM177DEH40LA450) (AMG M177 DEH40 LA (450kW) [MED17.7.5]), 112=I_C08_ENGSTYLE_AMGM178DEH40LA410 (AMGM178DEH40LA410) (AMG M178 DEH40 LA (410kW) [MED17.7.5]), 113=I_C08_ENGSTYLE_AMGM178DEH40LA450 (AMGM178DEH40LA450) (AMG M178 DEH40 LA (450kW) [MED17.7.5]), 114=I_C08_ENGSTYLE_AMGM178DEH40LA340 (AMGM178DEH40LA340) (AMG M178 DEH40 LA (340 kW) [MED17.7.5]), 115=I_C08_ENGSTYLE_AMGM177DEH40LA350 (AMGM177DEH40LA350) (AMG M177 DEH40 LA (350 kW) [MED17.7.5]), 116=I_C08_ENGSTYLE_AMGM178DEH40LA370 (AMGM178DEH40LA370) (AMG M178 DEH40 LA (370 kW) [MED17.7.5]), 117=I_C08_ENGSTYLE_AMGM177DEH40LA375 (AMGM177DEH40LA375) (AMG M177 DEH40 LA (375 kW) [MED17.7.5]), 118=I_C08_ENGSTYLE_AMGM279E60LA (AMGM279E60LA) (AMG M279 E60 LA [MED17.7.8]), 119=I_C08_ENGSTYLE_AMGM133DE20LA (AMGM133DE20LA) (AMG M133 DE20 LA []), 120=I_C08_ENGSTYLE_AMGM159E63 (AMGM159E63) (AMG M159 E63 [ME9.7]), 121=I_C08_ENGSTYLE_AMGM152E55DE (AMGM152E55DE) (AMG M152 E55 DE [MED17.7]), 122=I_C08_ENGSTYLE_AMGM157E55DEHLA (AMGM157E55DEHLA) (AMG M157 E55 DEH LA [MED17.7]), 123=I_C08_ENGSTYLE_AMGM156E63HP (AMGM156E63HP) (AMG M156 E63 HP [ME9.7]), 124=I_C08_ENGSTYLE_AMGM275E60LA (AMGM275E60LA) (AMG M275 E60 LA [ME2.7.2]), 126=I_C08_ENGSTYLE_AMGM156E63 (AMGM156E63) (AMG M156 E63 [ME9.7]), 129=I_C08_ENGSTYLE_OM642DE30LA160 (OM642DE30LA160) (OM642 DE30 LA (155/160 kW) [CR5/CR6/CR60]), 130=I_C08_ENGSTYLE_OM629DE40LA (OM629DE40LA) (OM629 DE40 LA [CR5]), 131=I_C08_ENGSTYLE_OM642DE30LA140 (OM642DE30LA140) (OM642 DE30 LA red. (140 kW) [CR6]), 132=I_C08_ENGSTYLE_OM646EVODE22LA125 (OM646EVODE22LA125) (OM646EVO DE22 LA (120/125 kW) [CRD]), 133=I_C08_ENGSTYLE_OM646EVODE22LA100 (OM646EVODE22LA100) (OM646EVO DE22 LA red. (100 kW) [CRD]), 134=I_C08_ENGSTYLE_OM646EVODE22LA85 (OM646EVODE22LA85) (OM646EVO DE22 LA (85 kW) [CRD]), 135=I_C08_ENGSTYLE_OM651DE22LA150 (OM651DE22LA150) (OM651 DE22 LA (150 kW) [CRD2/CRD3]), 136=I_C08_ENGSTYLE_OM651DE22LA125 (OM651DE22LA125) (OM651 DE22 LA (120/125 kW) [CRD2/CRD3]), 137=I_C08_ENGSTYLE_OM651DE22LA100 (OM651DE22LA100) (OM651 DE22 LA (100 kW) [CRD2/CRD3]), 138=I_C08_ENGSTYLE_OM651DE22LA80 (OM651DE22LA80) (OM651 DE22 LA (80 kW) [CRD2/CRD3]), 139=I_C08_ENGSTYLE_OM642DE30LA185 (OM642DE30LA185) (OM642 DE30 LA (180/185kW) [CR60]), 140=I_C08_ENGSTYLE_OM651DE18LA80 (OM651DE18LA80) (OM651 DE18 LA (80 kW) [CRD3]), 141=I_C08_ENGSTYLE_OM651DE18LA100 (OM651DE18LA100) (OM651 DE18 LA (100 kW) [CRD3]), 142=I_C08_ENGSTYLE_OM607DE14LA66 (OM607DE14LA66) (OM607 DE14 LA (66 kW) []), 143=I_C08_ENGSTYLE_OM607DE14LA81 (OM607DE14LA81) (OM607 DE14 LA (81 kW) []), 144=I_C08_ENGSTYLE_OM622DE16LA96 (OM622DE16LA96) (OM622 DE16 LA (96 kW) []), 145=I_C08_ENGSTYLE_OM622DE16LA118 (OM622DE16LA118) (OM622 DE16 LA (118 kW) []), 146=I_C08_ENGSTYLE_OM626DE16LA96 (OM626DE16LA96) (OM626 DE16 LA (96kW) []), 147=I_C08_ENGSTYLE_OM626DE16LA118 (OM626DE16LA118) (OM626 DE16 LA (118 kW) []), 148=I_C08_ENGSTYLE_OM654DE20LA (OM654DE20LA) (OM654 DE20 LA (110 - 140 kW) [MRD1]), 149=I_C08_ENGSTYLE_OM656DE30LA230 (OM656DE30LA230) (OM656 DE30 LA (230 kW) [MRD1]), 150=I_C08_ENGSTYLE_OM608DE15LA (OM608DE15LA) (OM608 DE15 LA (85 kW) [CCR2]), 255=I_C08_ENGSTYLE_SNA (SNA) (SNA value from data type)}
      lower-limit=0
      upper-limit=255
      invalid-value:
        integer literal c08_EngStyle: type=c08_EngStyle, value=255
    c08_EVC_Country:  # 08_EVC_Country
      base-type=uint8
      compu {0=I_C08_EVC_COUNTRY_DEU (DEU) (229L GERMANY), 1=I_C08_EVC_COUNTRY_DEU_IMPORT (DEU_IMPORT) (230L GERMANY - IMPORT), 20=I_C08_EVC_COUNTRY_BEL (BEL) (513L BELGIUM), 21=I_C08_EVC_COUNTRY_DNK (DNK) (517L DENMARK), 22=I_C08_EVC_COUNTRY_FRA (FRA) (531L FRANCE), 24=I_C08_EVC_COUNTRY_GBR (GBR) (537L GREAT BRITAIN AND NORTH-IRELAND), 25=I_C08_EVC_COUNTRY_IRL (IRL) (539L IRELAND REPUBLIC), 26=I_C08_EVC_COUNTRY_ITA (ITA) (543L ITALY), 28=I_C08_EVC_COUNTRY_LUX (LUX) (547L LUXEMBOURG), 30=I_C08_EVC_COUNTRY_NDL (NDL) (553L NETHERLANDS), 31=I_C08_EVC_COUNTRY_AUT (AUT) (557L AUSTRIA), 32=I_C08_EVC_COUNTRY_PRT (PRT) (561L PORTUGAL), 33=I_C08_EVC_COUNTRY_SWE (SWE) (569L SWEDEN), 34=I_C08_EVC_COUNTRY_CHE (CHE) (571L SWITZERLAND), 35=I_C08_EVC_COUNTRY_ESP (ESP) (577L SPAIN), 53=I_C08_EVC_COUNTRY_ZAF (ZAF) (675L SOUTH AFRICAN REPUBLIC), 70=I_C08_EVC_COUNTRY_CAN (CAN) (701L CANADA), 71=I_C08_EVC_COUNTRY_USA (USA) (705L UNITED STATES (USA)), 90=I_C08_EVC_COUNTRY_BHR (BHR) (805L BAHRAIN), 91=I_C08_EVC_COUNTRY_QAT (QAT) (807L QUATAR), 92=I_C08_EVC_COUNTRY_TWN (TWN) (817L TAIWAN), 93=I_C08_EVC_COUNTRY_CHN (CHN) (819L PEOPLE'S REPUBLIC CHINA), 94=I_C08_EVC_COUNTRY_HKG (HKG) (823L HONGKONG), 95=I_C08_EVC_COUNTRY_MAC (MAC) (824L MACAU), 96=I_C08_EVC_COUNTRY_JPN (JPN) (839L JAPAN), 97=I_C08_EVC_COUNTRY_KOR (KOR) (847L REPUBLIC OF KOREA), 98=I_C08_EVC_COUNTRY_KWT (KWT) (849L KUWAIT), 99=I_C08_EVC_COUNTRY_MYS (MYS) (855L MALAYSIA), 100=I_C08_EVC_COUNTRY_OMN (OMN) (861L OMAN), 101=I_C08_EVC_COUNTRY_MNG (MNG) (863L MONGOLIA), 102=I_C08_EVC_COUNTRY_SAU (SAU) (873L SAUDI-ARABIA), 103=I_C08_EVC_COUNTRY_SGP (SGP) (875L SINGAPORE), 104=I_C08_EVC_COUNTRY_AE_AZ (AE_AZ) (878L ABU DHABI), 105=I_C08_EVC_COUNTRY_THA (THA) (879L THAILAND), 106=I_C08_EVC_COUNTRY_AE_DU (AE_DU) (880L DUBAI), 120=I_C08_EVC_COUNTRY_AUS (AUS) (901L AUSTRALIA ASSOCIATION), 122=I_C08_EVC_COUNTRY_PNG (PNG) (915L PAPUA NEW GUINEA), 123=I_C08_EVC_COUNTRY_NZL (NZL) (919L NEW ZEALAND), 126=I_C08_EVC_COUNTRY_PYF (PYF) (923L FRENCH POLYNESIA), 127=I_C08_EVC_COUNTRY_NCL (NCL) (924L NEW CALEDONIA), 128=I_C08_EVC_COUNTRY_TON (TON) (926L TONGA), 129=I_C08_EVC_COUNTRY_WSM (WSM) (927L SAMOA), 255=I_C08_EVC_COUNTRY_OTHER (OTHER) (none of listed variants)}
      lower-limit=0
      upper-limit=255
    c08_hPa_0_12700_50: base-type=uint8, compu {phys=raw*50 for raw 0..254, 255=I_C08_HPA_0_12700_50_SNA (SNA) (SNA value from data type); unit hPa}, lower-limit=0, upper-limit=255  # 08_hPa_0-12700_50
      invalid-value:
        integer literal c08_hPa_0_12700_50: type=c08_hPa_0_12700_50, value=255
    c08_hPa_0_1980_7k8: base-type=uint8, compu {phys=raw*7.795275591 for raw 0..254, 255=I_C08_HPA_0_1980_7K8_SNA (SNA) (SNA value from data type); unit hPa}, lower-limit=0, upper-limit=255  # 08_hPa_0-1980_7,8
      invalid-value:
        integer literal c08_hPa_0_1980_7k8: type=c08_hPa_0_1980_7k8, value=255
    c08_Impulses_0_254_1: base-type=uint8, compu {phys=raw for raw 0..254, 255=I_C08_IMPULSES_0_254_1_SNA (SNA) (SNA value from data type); unit Impulses}, lower-limit=0, upper-limit=255  # 08_Impulses_0-254_1
      invalid-value:
        integer literal c08_Impulses_0_254_1: type=c08_Impulses_0_254_1, value=255
    c08_kPa_0_254_1: base-type=uint8, compu {phys=raw for raw 0..254, 255=I_C08_KPA_0_254_1_SNA (SNA) (SNA value from data type); unit kPa}, lower-limit=0, upper-limit=255  # 08_kPa_0-254_1
      invalid-value:
        integer literal c08_kPa_0_254_1: type=c08_kPa_0_254_1, value=255
    c08_l_per_h_0_381_1d5: base-type=uint8, compu {phys=raw*1.5 for raw 0..254, 255=I_C08_L_PER_H_0_381_1D5_SNA (SNA) (SNA value from data type); unit l/h}, lower-limit=0, upper-limit=255  # 08_l/h_0-381_1,5
      invalid-value:
        integer literal c08_l_per_h_0_381_1d5: type=c08_l_per_h_0_381_1d5, value=255
    c08_l_0_254_1: base-type=uint8, compu {phys=raw for raw 0..254, 255=I_C08_L_0_254_1_SNA (SNA) (SNA value from data type); unit l}, lower-limit=0, upper-limit=255  # 08_l_0-254_1
      invalid-value:
        integer literal c08_l_0_254_1: type=c08_l_0_254_1, value=255
    c08_LDC_Dist: base-type=uint8, compu {phys=raw for raw 0..150, 151=I_C08_LDC_DIST_IDLE_STAR1_172_231 (IDLE_STAR1_172_231) (No object in display (only 166/MFA/172/231)), 254=I_C08_LDC_DIST_IDLE (IDLE) (No object in display (only STAR 2)), 255=I_C08_LDC_DIST_SNA (SNA) (SNA value from data type); unit m}, lower-limit=0, upper-limit=255  # 08_LDC_Dist
      invalid-value:
        integer literal c08_LDC_Dist: type=c08_LDC_Dist, value=255
    c08_LDC_Spd:  # 08_LDC_Spd
      base-type=uint8
      compu {phys=raw for raw 0..250, 251=I_C08_LDC_SPD_END (END) (End of speedometer range), 252=I_C08_LDC_SPD_WTSL (WTSL) (Winter tire speed limiter (IC internal)), 253=I_C08_LDC_SPD_SEG_RING_NOT_VSBL (SEG_RING_NOT_VSBL) (Speedometer segment ring not visible), 254=I_C08_LDC_SPD_NDEF254 (NDEF254) (not defined), 255=I_C08_LDC_SPD_SNA (SNA) (SNA value from data type); unit km/h(mph)}
      lower-limit=0
      upper-limit=255
      invalid-value:
        integer literal c08_LDC_Spd: type=c08_LDC_Spd, value=255
    c08_LDC_WTSL_Spd_Max:  # 08_LDC_WTSL_Spd_Max
      base-type=uint8
      compu {phys=raw+30 for raw 0..250, 251=I_C08_LDC_WTSL_SPD_MAX_NDEF251 (NDEF251) (not defined), 252=I_C08_LDC_WTSL_SPD_MAX_NDEF252 (NDEF252) (not defined), 253=I_C08_LDC_WTSL_SPD_MAX_WTSL_OFF (WTSL_OFF) (Winter tire speed limiter off), 254=I_C08_LDC_WTSL_SPD_MAX_WTSL_NA (WTSL_NA) (Winter tire speed limiter not available), 255=I_C08_LDC_WTSL_SPD_MAX_SNA (SNA) (SNA value from data type); unit km/h(mph)}
      lower-limit=0
      upper-limit=255
      invalid-value:
        integer literal c08_LDC_WTSL_Spd_Max: type=c08_LDC_WTSL_Spd_Max, value=255
    c08_m_p_sq_s_m10k24_10k08_0k08: base-type=uint8, compu {phys=raw*0.08-10.24 for raw 0..254, 255=I_C08_M_P_SQ_S_M10K24_10K08_0K08_SNA (SNA) (SNA value from data type); unit m/s²}, lower-limit=0, upper-limit=255  # 08_m/s²_-10,24-+10,08_0,08
      invalid-value:
        integer literal c08_m_p_sq_s_m10k24_10k08_0k08: type=c08_m_p_sq_s_m10k24_10k08_0k08, value=255
    c08_m_p_sq_s_m2k56_2k52_0k02: base-type=uint8, compu {phys=raw*0.02-2.56 for raw 0..254, 255=I_C08_M_P_SQ_S_M2K56_2K52_0K02_SNA (SNA) (SNA value from data type); unit m/s²}, lower-limit=0, upper-limit=255  # 08_m/s²_-2,56-+2,52_0,02
      invalid-value:
        integer literal c08_m_p_sq_s_m2k56_2k52_0k02: type=c08_m_p_sq_s_m2k56_2k52_0k02, value=255
    c08_m_0_150_1: base-type=uint8, compu {phys=raw for raw 0..150, 255=I_C08_M_0_150_1_SNA (SNA) (SNA value from data type); unit m}, lower-limit=0, upper-limit=255  # 08_m_0-150_1
      invalid-value:
        integer literal c08_m_0_150_1: type=c08_m_0_150_1, value=255
    c08_mbar_m381_381_3: base-type=uint8, compu {phys=raw*3-381 for raw 0..254, 255=I_C08_MBAR_M381_381_3_SNA (SNA) (SNA value from data type); unit mbar}, lower-limit=0, upper-limit=255  # 08_mbar_-381_381
      invalid-value:
        integer literal c08_mbar_m381_381_3: type=c08_mbar_m381_381_3, value=255
    c08_N_0_30_0d12: base-type=uint8, compu {phys=raw*0.12 for raw 0..250, 255=I_C08_N_0_30_0D12_SNA (SNA) (SNA value from data type); unit N}, lower-limit=0, upper-limit=255  # 08_N_0-30_0,12
      invalid-value:
        integer literal c08_N_0_30_0d12: type=c08_N_0_30_0d12, value=255
    c08_Nm_m275_p1000_5: base-type=uint8, compu {phys=raw*5-270 for raw 0..254, 255=I_C08_NM_M275_P1000_5_SNA (SNA) (SNA value from data type); unit Nm}, lower-limit=0, upper-limit=255  # 08_Nm_-275-+1000_5
      invalid-value:
        integer literal c08_Nm_m275_p1000_5: type=c08_Nm_m275_p1000_5, value=255
    c08_Nm_0_1265_5: base-type=uint8, compu {phys=raw*5 for raw 0..253, 254=I_C08_NM_0_1265_5_OVR_TRQ (OVR_TRQ) (Over running torque), 255=I_C08_NM_0_1265_5_SNA (SNA) (SNA value from data type); unit Nm}, lower-limit=0, upper-limit=255  # 08_Nm_0-1265_5
      invalid-value:
        integer literal c08_Nm_0_1265_5: type=c08_Nm_0_1265_5, value=255
    c08_Nm_0_1270_5: base-type=uint8, compu {phys=raw*5 for raw 0..254, 255=I_C08_NM_0_1270_5_SNA (SNA) (SNA value from data type); unit Nm}, lower-limit=0, upper-limit=255  # 08_Nm_0-1270_5
      invalid-value:
        integer literal c08_Nm_0_1270_5: type=c08_Nm_0_1270_5, value=255
    c08_Nm_0_2540_10: base-type=uint8, compu {phys=raw*10 for raw 0..254, 255=I_C08_NM_0_2540_10_SNA (SNA) (SNA value from data type); unit Nm}, lower-limit=0, upper-limit=255  # 08_Nm_0-2540_10
      invalid-value:
        integer literal c08_Nm_0_2540_10: type=c08_Nm_0_2540_10, value=255
    c08_Nm_0_254_1: base-type=uint8, compu {phys=raw for raw 0..254, 255=I_C08_NM_0_254_1_SNA (SNA) (SNA value from data type); unit Nm}, lower-limit=0, upper-limit=255  # 08_Nm_0-254_1
      invalid-value:
        integer literal c08_Nm_0_254_1: type=c08_Nm_0_254_1, value=255
    c08_Nm_0_508_2: base-type=uint8, compu {phys=raw*2 for raw 0..254, 255=I_C08_NM_0_508_2_SNA (SNA) (SNA value from data type); unit Nm}, lower-limit=0, upper-limit=255  # 08_Nm_0-508_2
      invalid-value:
        integer literal c08_Nm_0_508_2: type=c08_Nm_0_508_2, value=255
    c08_Nm_0_63k5_0k25: base-type=uint8, compu {phys=raw*0.25 for raw 0..254, 255=I_C08_NM_0_63K5_0K25_SNA (SNA) (SNA value from data type); unit Nm}, lower-limit=0, upper-limit=255  # 08_Nm_0-63,5_0,25
      invalid-value:
        integer literal c08_Nm_0_63k5_0k25: type=c08_Nm_0_63k5_0k25, value=255
    c08_ParkStyle_V2:  # 08_ParkStyle_V2
      base-type=uint8
      compu {0=I_C08_PARKSTYLE_V2_PARKTRONIC_ONLY (PARKTRONIC_ONLY) (only parctronic available), 1=I_C08_PARKSTYLE_V2_BRKAPC_AVL (BRKAPC_AVL) (Braking Advanced Park Control available), 2=I_C08_PARKSTYLE_V2_RPA_AVL (RPA_AVL) (Remote Park Assist available), 4=I_C08_PARKSTYLE_V2_DAA_AVL (DAA_AVL) (Drive Away Assist available), 8=I_C08_PARKSTYLE_V2_PPB_AVL (PPB_AVL) (Parktronic Plus Brake available), 16=I_C08_PARKSTYLE_V2_CTA_AVL (CTA_AVL) (Crossing Traffic Assist available), 32=I_C08_PARKSTYLE_V2_HITCHTRONIC_AVL (HITCHTRONIC_AVL) (Hitchtronic available), 255=I_C08_PARKSTYLE_V2_SNA (SNA) (SNA value from data type)}
      lower-limit=0
      upper-limit=255
      invalid-value:
        integer literal c08_ParkStyle_V2: type=c08_ParkStyle_V2, value=255
    c08_Platform_Stat:  # 08_Platform_Stat
      base-type=uint8
      compu {0=I_C08_PLATFORM_STAT_IDLE (IDLE) (Not defined), 1=I_C08_PLATFORM_STAT_STAR1 (STAR1) (Platform STAR1 (221ff)), 2=I_C08_PLATFORM_STAT_STAR2 (STAR2) (Platform STAR2 (222ff)), 4=I_C08_PLATFORM_STAT_RES4 (RES4) (reserved), 8=I_C08_PLATFORM_STAT_RES8 (RES8) (reserved), 16=I_C08_PLATFORM_STAT_RES16 (RES16) (reserved), 32=I_C08_PLATFORM_STAT_RES32 (RES32) (reserved), 64=I_C08_PLATFORM_STAT_RES64 (RES64) (reserved), 128=I_C08_PLATFORM_STAT_RES128 (RES128) (reserved), 255=I_C08_PLATFORM_STAT_SNA (SNA) (SNA value from data type)} "Plattform Status / Platform state"
      lower-limit=0
      upper-limit=255
      invalid-value:
        integer literal c08_Platform_Stat: type=c08_Platform_Stat, value=255
    c08_rpm_0_2540_10: base-type=uint8, compu {phys=raw*10 for raw 0..254, 255=I_C08_RPM_0_2540_10_SNA (SNA) (SNA value from data type); unit rpm}, lower-limit=0, upper-limit=255  # 08_rpm_0-2540_10
      invalid-value:
        integer literal c08_rpm_0_2540_10: type=c08_rpm_0_2540_10, value=255
    c08_rpm_0_5080_20: base-type=uint8, compu {phys=raw*20 for raw 0..254, 255=I_C08_RPM_0_5080_20_SNA (SNA) (SNA value from data type); unit rpm}, lower-limit=0, upper-limit=255  # 08_rpm_0-5080_20
      invalid-value:
        integer literal c08_rpm_0_5080_20: type=c08_rpm_0_5080_20, value=255
    c08_rpm_500_3000_10: base-type=uint8, compu {phys=raw*10+500 for raw 0..250, 255=I_C08_RPM_500_3000_10_SNA (SNA) (SNA value from data type); unit rpm}, lower-limit=0, upper-limit=255  # 08_rpm_500-3000_10
      invalid-value:
        integer literal c08_rpm_500_3000_10: type=c08_rpm_500_3000_10, value=255
    c08_s_0_1270_5: base-type=uint8, compu {phys=raw*5 for raw 0..254, 255=I_C08_S_0_1270_5_SNA (SNA) (SNA value from data type); unit s}, lower-limit=0, upper-limit=255  # 08_s_0-1270_5
      invalid-value:
        integer literal c08_s_0_1270_5: type=c08_s_0_1270_5, value=255
    c08_SSP_Diag_Stat:  # 08_SSP_Diag_Stat
      base-type=uint8
      compu {0=I_C08_SSP_DIAG_STAT_OK (OK) (No fault), 1=I_C08_SSP_DIAG_STAT_CURR_NOT_REACH (CURR_NOT_REACH) (Current not reached), 2=I_C08_SSP_DIAG_STAT_VOLT (VOLT) (Voltage), 3=I_C08_SSP_DIAG_STAT_TEMP_ELEC (TEMP_ELEC) (Electronic temperature), 4=I_C08_SSP_DIAG_STAT_TEMP_MOT (TEMP_MOT) (Motor temperature), 5=I_C08_SSP_DIAG_STAT_TIMEOUT (TIMEOUT) (Timeout CAN), 6=I_C08_SSP_DIAG_STAT_DSR_VAL_IMPL (DSR_VAL_IMPL) (Desired value implausible), 128=I_C08_SSP_DIAG_STAT_MOT_BL (MOT_BL) (Motor blocked), 129=I_C08_SSP_DIAG_STAT_MOT_OPN (MOT_OPN) (Motor has open circuit), 130=I_C08_SSP_DIAG_STAT_MOT_SHRT (MOT_SHRT) (Motor has short circuit), 131=I_C08_SSP_DIAG_STAT_PWR_STG_FLT (PWR_STG_FLT) (Power stage defect), 132=I_C08_SSP_DIAG_STAT_CAN_FLT (CAN_FLT) (Fatal CAN fault), 133=I_C08_SSP_DIAG_STAT_CURR_CANNOT_REACH (CURR_CANNOT_REACH) (Current cannot be reached)}
      lower-limit=0
      upper-limit=133
    c08_TxDrvPosn:  # 08_TxDrvPosn
      base-type=uint8
      compu {1=I_C08_TXDRVPOSN_M1 (M1) (Driving position "M1"), 2=I_C08_TXDRVPOSN_M2 (M2) (Driving position "M2"), 3=I_C08_TXDRVPOSN_M3 (M3) (Driving position "M3"), 4=I_C08_TXDRVPOSN_M4 (M4) (Driving position "M4"), 5=I_C08_TXDRVPOSN_M5 (M5) (Driving position "M5"), 6=I_C08_TXDRVPOSN_M6 (M6) (Driving position "M6"), 7=I_C08_TXDRVPOSN_M7 (M7) (Driving position "M7"), 8=I_C08_TXDRVPOSN_M8 (M8) (Driving position "M8"), 9=I_C08_TXDRVPOSN_M9 (M9) (Driving position "M9"), 32=I_C08_TXDRVPOSN_BLANK (BLANK) (Blank (" ")), 33=I_C08_TXDRVPOSN_D_AUTO_RADAR_RECUP (D_AUTO_RADAR_RECUP) (Automatic radar based recuperation), 34=I_C08_TXDRVPOSN_D_MAN_MIN_RECUP (D_MAN_MIN_RECUP) (Manual minimal recuperation), 35=I_C08_TXDRVPOSN_D_MAN_DEFAULT_RECUP (D_MAN_DEFAULT_RECUP) (Manual default recuperation), 36=I_C08_TXDRVPOSN_D_MAN_MAX_RECUP (D_MAN_MAX_RECUP) (Manual maximal recuperation), 37=I_C08_TXDRVPOSN_D_MAN_SPORT_RECUP (D_MAN_SPORT_RECUP) (Manual sport recuperation), 49=I_C08_TXDRVPOSN_D1 (D1) (Driving position "D1"), 50=I_C08_TXDRVPOSN_D2 (D2) (Driving position "D2"), 51=I_C08_TXDRVPOSN_D3 (D3) (Driving position "D3"), 52=I_C08_TXDRVPOSN_D4 (D4) (Driving position "D4"), 53=I_C08_TXDRVPOSN_D5 (D5) (Driving position "D5"), 54=I_C08_TXDRVPOSN_D6 (D6) (Driving position "D6"), 55=I_C08_TXDRVPOSN_D7 (D7) (Driving position "D7"), 56=I_C08_TXDRVPOSN_D8 (D8) (Driving position "D8"), 57=I_C08_TXDRVPOSN_D9 (D9) (Driving position "D9"), 65=I_C08_TXDRVPOSN_A (A) (Driving position "A"), 68=I_C08_TXDRVPOSN_D (D) (Driving position "D"), 70=I_C08_TXDRVPOSN_F (F) (Fault label "F"), 78=I_C08_TXDRVPOSN_N (N) (Driving position "N"), 80=I_C08_TXDRVPOSN_P (P) (Driving position "P"), 82=I_C08_TXDRVPOSN_R (R) (Driving position "R"), 255=I_C08_TXDRVPOSN_SNA (SNA) (SNA value from data type)}
      lower-limit=1
      upper-limit=255
      invalid-value:
        integer literal c08_TxDrvPosn: type=c08_TxDrvPosn, value=255
    c08_TxDrvProg:  # 08_TxDrvProg
      base-type=uint8
      compu {26=I_C08_TXDRVPROG_RACE_START (RACE_START) (Race start (only AMG)), 27=I_C08_TXDRVPROG_RACE_START_MAN (RACE_START_MAN) (Race Start with manual-shift-mode (AMG only)), 32=I_C08_TXDRVPROG_BLANK (BLANK) (Driving program " " (Blank)), 65=I_C08_TXDRVPROG_A (A) (Driving program "A"), 67=I_C08_TXDRVPROG_C (C) (Driving program "C"), 69=I_C08_TXDRVPROG_E (E) (Driving program "E" (Economy)), 70=I_C08_TXDRVPROG_F (F) (Fault label "F"), 71=I_C08_TXDRVPROG_E_PLUS (E_PLUS) (Driving program "E+"), 77=I_C08_TXDRVPROG_M (M) (Driving program "M"), 82=I_C08_TXDRVPROG_RACE (RACE) (Driving program "Race" (only AMG)), 83=I_C08_TXDRVPROG_S (S) (Driving program "S"), 84=I_C08_TXDRVPROG_S_PLUS (S_PLUS) (Driving program "S+" (only AMG)), 87=I_C08_TXDRVPROG_W (W) (Driving program "W"), 90=I_C08_TXDRVPROG_E_MAN (E_MAN) (Driving program "E" with manual shift-mode (AMG only)), 91=I_C08_TXDRVPROG_C_MAN (C_MAN) (Driving program "C" with manual shift-mode (AMG only)), 92=I_C08_TXDRVPROG_S_MAN (S_MAN) (Driving program "S" with manual shift-mode (AMG only)), 93=I_C08_TXDRVPROG_S_PLUS_MAN (S_PLUS_MAN) (Driving program "S+" with manual shift-mode (AMG only)), 94=I_C08_TXDRVPROG_RACE_MAN (RACE_MAN) (Driving program "Race" with manual shift-mode (AMG only)), 255=I_C08_TXDRVPROG_SNA (SNA) (SNA value from data type)}
      lower-limit=26
      upper-limit=255
      invalid-value:
        integer literal c08_TxDrvProg: type=c08_TxDrvProg, value=255
    c08_UInt_SNA_na: base-type=uint8, lower-limit=0, upper-limit=255  # 08_UInt_SNA=-
    c08_V_0_25k4_0k1: base-type=uint8, compu {phys=raw*0.1 for raw 0..254, 255=I_C08_V_0_25K4_0K1_SNA (SNA) (SNA value from data type); unit V}, lower-limit=0, upper-limit=255  # 08_V_0-25,4_0,1
      invalid-value:
        integer literal c08_V_0_25k4_0k1: type=c08_V_0_25k4_0k1, value=255
    c08_W_0_100: base-type=uint8, compu {phys=raw for raw 0..100, 255=I_C08_W_0_100_SNA (SNA) (SNA value from data type); unit W}, lower-limit=0, upper-limit=255  # 08_W_0-100
      invalid-value:
        integer literal c08_W_0_100: type=c08_W_0_100, value=255
    c08_WakeupRsn_CPC:  # 08_WakeupRsn_CPC
      base-type=uint8
      compu {0=I_C08_WAKEUPRSN_CPC_NETWORK (NETWORK) (Wakeup by network), 11=I_C08_WAKEUPRSN_CPC_CHASSIS (CHASSIS) (Wakeup by CHASSIS), 13=I_C08_WAKEUPRSN_CPC_POWERTRAIN (POWERTRAIN) (Wakeup by POWERTRAIN), 14=I_C08_WAKEUPRSN_CPC_HYBRID (HYBRID) (Wakeup by HYBRID-CAN), 15=I_C08_WAKEUPRSN_CPC_PERIPHERY (PERIPHERY) (Wakeup by PERIPHERY (only STAR 2)), 16=I_C08_WAKEUPRSN_CPC_FUELCELL (FUELCELL) (Wakeup by FUELCELL (only 252)), 130=I_C08_WAKEUPRSN_CPC_TERM_15 (TERM_15) (Wakeup by discrete terminal 15 signal), 255=I_C08_WAKEUPRSN_CPC_SNA (SNA) (SNA value from data type)}
      lower-limit=0
      upper-limit=255
      invalid-value:
        integer literal c08_WakeupRsn_CPC: type=c08_WakeupRsn_CPC, value=255
    c08_WakeupRsn_DRVU: base-type=uint8, compu {0=I_C08_WAKEUPRSN_DRVU_NETWORK (NETWORK) (Wakeup by network), 30=I_C08_WAKEUPRSN_DRVU_START_SW_PSD (START_SW_PSD) (Wakeup by start switch pressed (not 221/216)), 40=I_C08_WAKEUPRSN_DRVU_AMG_SW_PSD (AMG_SW_PSD) (Wakeup by AMG switch pressedAttribute is changed. Original value: -), 255=I_C08_WAKEUPRSN_DRVU_SNA (SNA) (SNA value from data type)}, lower-limit=0, upper-limit=255  # 08_WakeupRsn_DRVU
      invalid-value:
        integer literal c08_WakeupRsn_DRVU: type=c08_WakeupRsn_DRVU, value=255
    c08_WakeupRsn_ECM:  # 08_WakeupRsn_ECM
      base-type=uint8
      compu {0=I_C08_WAKEUPRSN_ECM_NETWORK (NETWORK) (Wakeup by network), 11=I_C08_WAKEUPRSN_ECM_CHASSIS (CHASSIS) (Wakeup by CHASSIS-CAN), 13=I_C08_WAKEUPRSN_ECM_POWERTRAIN (POWERTRAIN) (Wakeup by POWERTRAIN-CAN), 14=I_C08_WAKEUPRSN_ECM_HYBRID (HYBRID) (Wakeup by HYBRID-CAN), 130=I_C08_WAKEUPRSN_ECM_TERM_15 (TERM_15) (Wakeup by discrete terminal 15 signal), 255=I_C08_WAKEUPRSN_ECM_SNA (SNA) (SNA value from data type)}
      lower-limit=0
      upper-limit=255
      invalid-value:
        integer literal c08_WakeupRsn_ECM: type=c08_WakeupRsn_ECM, value=255
    c08_WakeupRsn_FSCM: base-type=uint8, compu {0=I_C08_WAKEUPRSN_FSCM_NETWORK (NETWORK) (Wakeup by network), 130=I_C08_WAKEUPRSN_FSCM_TERM_15 (TERM_15) (Wakeup by discrete terminal 15 signal), 255=I_C08_WAKEUPRSN_FSCM_SNA (SNA) (SNA value from data type)}, lower-limit=0, upper-limit=255  # 08_WakeupRsn_FSCM
      invalid-value:
        integer literal c08_WakeupRsn_FSCM: type=c08_WakeupRsn_FSCM, value=255
    c08_WakeupRsn_ISM: base-type=uint8, compu {0=I_C08_WAKEUPRSN_ISM_NETWORK (NETWORK) (Wakeup by network), 255=I_C08_WAKEUPRSN_ISM_SNA (SNA) (SNA value from data type)}, lower-limit=0, upper-limit=255  # 08_WakeupRsn_ISM
      invalid-value:
        integer literal c08_WakeupRsn_ISM: type=c08_WakeupRsn_ISM, value=255
    c08_WakeupRsn_SWSP: base-type=uint8, compu {0=I_C08_WAKEUPRSN_SWSP_NETWORK (NETWORK) (Wakeup by network), 255=I_C08_WAKEUPRSN_SWSP_SNA (SNA) (SNA value from data type)}, lower-limit=0, upper-limit=255  # 08_WakeupRsn_SWSP
      invalid-value:
        integer literal c08_WakeupRsn_SWSP: type=c08_WakeupRsn_SWSP, value=255
    c08_WakeupRsn_TCM: base-type=uint8, compu {0=I_C08_WAKEUPRSN_TCM_NETWORK (NETWORK) (Wakeup by network), 255=I_C08_WAKEUPRSN_TCM_SNA (SNA) (SNA value from data type)}, lower-limit=0, upper-limit=255  # 08_WakeupRsn_TCM
      invalid-value:
        integer literal c08_WakeupRsn_TCM: type=c08_WakeupRsn_TCM, value=255
    c08_degC_m40_150_SNA_1: base-type=uint8, compu {phys=raw-40 for raw 0..190, 255=I_C08_DEGC_M40_150_SNA_1_SNA (SNA) (SNA value from data type); unit °C}, lower-limit=0, upper-limit=255  # 08_°C_-40-+150_SNA_1
      invalid-value:
        integer literal c08_degC_m40_150_SNA_1: type=c08_degC_m40_150_SNA_1, value=255
    c08_degC_m40_160_1: base-type=uint8, compu {phys=raw-40 for raw 0..200, 255=I_C08_DEGC_M40_160_1_SNA (SNA) (SNA value from data type); unit °C}, lower-limit=0, upper-limit=255  # 08_°C_-40-+160_1
      invalid-value:
        integer literal c08_degC_m40_160_1: type=c08_degC_m40_160_1, value=255
    c08_degC_m40_214_1: base-type=uint8, compu {phys=raw-40 for raw 0..254, 255=I_C08_DEGC_M40_214_1_SNA (SNA) (SNA value from data type); unit °C}, lower-limit=0, upper-limit=255  # 08_°C_-40-+214_1
      invalid-value:
        integer literal c08_degC_m40_214_1: type=c08_degC_m40_214_1, value=255
    c08_degC_m40_85_0k5: base-type=uint8, compu {phys=raw*0.5-40 for raw 0..250, 255=I_C08_DEGC_M40_85_0K5_SNA (SNA) (SNA value from data type); unit °C}, lower-limit=0, upper-limit=255  # 08_°C_-40-+85_0,5
      invalid-value:
        integer literal c08_degC_m40_85_0k5: type=c08_degC_m40_85_0k5, value=255
    c08_degC_m40_85_0k5_Init: base-type=uint8, compu {phys=raw*0.5-40 for raw 0..250, 254=I_C08_DEGC_M40_85_0K5_INIT_INIT (INIT) (Initialization (221/216 only)), 255=I_C08_DEGC_M40_85_0K5_INIT_SNA (SNA) (SNA value from data type); unit °C}, lower-limit=0, upper-limit=255  # 08_°C_-40-+85_0,5_Init
      invalid-value:
        integer literal c08_degC_m40_85_0k5_Init: type=c08_degC_m40_85_0k5_Init, value=255
    c08_degC_m50_204_1: base-type=uint8, compu {phys=raw-50 for raw 0..254, 255=I_C08_DEGC_M50_204_1_SNA (SNA) (SNA value from data type); unit °C}, lower-limit=0, upper-limit=255  # 08_°C_-50-+204_1
      invalid-value:
        integer literal c08_degC_m50_204_1: type=c08_degC_m50_204_1, value=255
    c08_degC_m50_350_2: base-type=uint8, compu {phys=raw*2-50 for raw 0..200, 255=I_C08_DEGC_M50_350_2_SNA (SNA) (SNA value from data type); unit °C}, lower-limit=0, upper-limit=255  # 08_°C_-50-+350_2
      invalid-value:
        integer literal c08_degC_m50_350_2: type=c08_degC_m50_350_2, value=255
    c09_km_p_h_0_500_1: base-type=uint16, compu {phys=raw for raw 0..500, 511=I_C09_KM_P_H_0_500_1_SNA (SNA) (SNA value from data type); unit km/h}, lower-limit=0, upper-limit=511  # 09_km/h_0-500_1
      invalid-value:
        integer literal c09_km_p_h_0_500_1: type=c09_km_p_h_0_500_1, value=511
    c09_Nm_0_2550_5: base-type=uint16, compu {phys=raw*5 for raw 0..510, 511=I_C09_NM_0_2550_5_SNA (SNA) (SNA value from data type); unit Nm}, lower-limit=0, upper-limit=511  # 09_Nm_0-2550_5 | 09 Nm 0 2550 5
      invalid-value:
        integer literal c09_Nm_0_2550_5: type=c09_Nm_0_2550_5, value=511
    c10_perc_m30_70_0k1: base-type=uint16, compu {phys=raw*0.1-30 for raw 0..1000, 1023=I_C10_PERC_M30_70_0K1_SNA (SNA) (SNA value from data type); unit %}, lower-limit=0, upper-limit=1023  # 10_%_-30-+70_0,1
      invalid-value:
        integer literal c10_perc_m30_70_0k1: type=c10_perc_m30_70_0k1, value=1023
    c10_perc_0_100_0k1: base-type=uint16, compu {phys=raw*0.1 for raw 0..1000, 1023=I_C10_PERC_0_100_0K1_SNA (SNA) (SNA value from data type); unit %}, lower-limit=0, upper-limit=1023  # 10_%_0-100_0,1
      invalid-value:
        integer literal c10_perc_0_100_0k1: type=c10_perc_0_100_0k1, value=1023
    c10_m_p_sq_s_m10k24_p10k2_0k02: base-type=uint16, compu {phys=raw*0.02-10.24 for raw 0..1022, 1023=I_C10_M_P_SQ_S_M10K24_P10K2_0K02_SNA (SNA) (SNA value from data type); unit m/s²}, lower-limit=0, upper-limit=1023  # 10_m/s²_-10,24-+10,2_0,02
      invalid-value:
        integer literal c10_m_p_sq_s_m10k24_p10k2_0k02: type=c10_m_p_sq_s_m10k24_p10k2_0k02, value=1023
    c10_rpm_0_1022_1: base-type=uint16, compu {phys=raw for raw 0..1022, 1023=I_C10_RPM_0_1022_1_SNA (SNA) (SNA value from data type); unit rpm}, lower-limit=0, upper-limit=1023  # 10_rpm_0-1022_1
      invalid-value:
        integer literal c10_rpm_0_1022_1: type=c10_rpm_0_1022_1, value=1023
    c10_rpm_0_5000_5: base-type=uint16, compu {phys=raw*5 for raw 0..1000, 1023=I_C10_RPM_0_5000_5_SNA (SNA) (SNA value from data type); unit rpm}, lower-limit=0, upper-limit=1023  # 10_rpm_0-5000_5
      invalid-value:
        integer literal c10_rpm_0_5000_5: type=c10_rpm_0_5000_5, value=1023
    c10_deg_p_s_m5d12_p5d1_0d01: base-type=uint16, compu {phys=raw*0.01-5.12 for raw 0..1022, 1023=I_C10_DEG_P_S_M5D12_P5D1_0D01_SNA (SNA) (SNA value from data type); unit °/s}, lower-limit=0, upper-limit=1023  # 10_°/s_-5,12-+5,1_0,01
      invalid-value:
        integer literal c10_deg_p_s_m5d12_p5d1_0d01: type=c10_deg_p_s_m5d12_p5d1_0d01, value=1023
    c11_A_m102k4_102k2_0k1: base-type=uint16, compu {phys=raw*0.1-102.4 for raw 0..2046, 2047=I_C11_A_M102K4_102K2_0K1_SNA (SNA) (SNA value from data type); unit A}, lower-limit=0, upper-limit=2047  # 11_A_-102,4-+102,2_0,1
      invalid-value:
        integer literal c11_A_m102k4_102k2_0k1: type=c11_A_m102k4_102k2_0k1, value=2047
    c11_l_0_204k6_0k1: base-type=uint16, compu {phys=raw*0.1 for raw 0..2046, 2047=I_C11_L_0_204K6_0K1_SNA (SNA) (SNA value from data type); unit l}, lower-limit=0, upper-limit=2047  # 11_l_0-204,6_0,1
      invalid-value:
        integer literal c11_l_0_204k6_0k1: type=c11_l_0_204k6_0k1, value=2047
    c11_Nm_m500_1546k0_1k0: base-type=uint16, compu {phys=raw-500 for raw 0..2046, 2047=I_C11_NM_M500_1546K0_1K0_SNA (SNA) (SNA value from data type); unit Nm}, lower-limit=0, upper-limit=2047  # 11_Nm_-500-+1546_1
      invalid-value:
        integer literal c11_Nm_m500_1546k0_1k0: type=c11_Nm_m500_1546k0_1k0, value=2047
    c12_km_p_h_0_409k4_0k1: base-type=uint16, compu {phys=raw*0.1 for raw 0..4094, 4095=I_C12_KM_P_H_0_409K4_0K1_SNA (SNA) (SNA value from data type); unit km/h}, lower-limit=0, upper-limit=4095  # 12_km/h_0-409,4_0,1
      invalid-value:
        integer literal c12_km_p_h_0_409k4_0k1: type=c12_km_p_h_0_409k4_0k1, value=4095
    c12_m_p_sq_s_m40d96_p40d92_0d02: base-type=uint16, compu {phys=raw*0.02-40.96 for raw 0..4094, 4095=I_C12_M_P_SQ_S_M40D96_P40D92_0D02_SNA (SNA) (SNA value from data type); unit m/s²}, lower-limit=0, upper-limit=4095  # 12_m/s²_-40,96-+40,92_0,02
      invalid-value:
        integer literal c12_m_p_sq_s_m40d96_p40d92_0d02: type=c12_m_p_sq_s_m40d96_p40d92_0d02, value=4095
    c12_min_0_4094_1: base-type=uint16, compu {phys=raw for raw 0..4094, 4095=I_C12_MIN_0_4094_1_SNA (SNA) (SNA value from data type); unit min}, lower-limit=0, upper-limit=4095  # 12_min_0-4094_1
      invalid-value:
        integer literal c12_min_0_4094_1: type=c12_min_0_4094_1, value=4095
    c12_mm_m1023_1024_0k5: base-type=uint16, compu {phys=raw*0.5-1023 for raw 0..4094, 4095=I_C12_MM_M1023_1024_0K5_SNA (SNA) (SNA value from data type); unit mm}, lower-limit=0, upper-limit=4095  # 12_mm_-1023-+1024_0,5
      invalid-value:
        integer literal c12_mm_m1023_1024_0k5: type=c12_mm_m1023_1024_0k5, value=4095
    c12_Nm_m500_1547k5_0k5: base-type=uint16, compu {phys=raw*0.5-500 for raw 0..4094, 4095=I_C12_NM_M500_1547K5_0K5_SNA (SNA) (SNA value from data type); unit Nm}, lower-limit=0, upper-limit=4095  # 12_Nm_-500-+1547,5_0,5
      invalid-value:
        integer literal c12_Nm_m500_1547k5_0k5: type=c12_Nm_m500_1547k5_0k5, value=4095
    c12_Nm_0_12282_3: base-type=uint16, compu {phys=raw*3 for raw 0..4094, 4095=I_C12_NM_0_12282_3_SNA (SNA) (SNA value from data type); unit Nm}, lower-limit=0, upper-limit=4095  # 12_Nm_0-12282_3
      invalid-value:
        integer literal c12_Nm_0_12282_3: type=c12_Nm_0_12282_3, value=4095
    c12_rpm_0_16376_4: base-type=uint16, compu {phys=raw*4 for raw 0..4094, 4095=I_C12_RPM_0_16376_4_SNA (SNA) (SNA value from data type); unit rpm}, lower-limit=0, upper-limit=4095  # 12_rpm_0-16376_4
      invalid-value:
        integer literal c12_rpm_0_16376_4: type=c12_rpm_0_16376_4, value=4095
    c12_rpm_0_8188_2: base-type=uint16, compu {phys=raw*2 for raw 0..4094, 4095=I_C12_RPM_0_8188_2_SNA (SNA) (SNA value from data type); unit rpm}, lower-limit=0, upper-limit=4095  # 12_rpm_0-8188_2
      invalid-value:
        integer literal c12_rpm_0_8188_2: type=c12_rpm_0_8188_2, value=4095
    c13_Nm_m500_1547k5_0k25: base-type=uint16, compu {phys=raw*0.25-500 for raw 0..8190, 8191=I_C13_NM_M500_1547K5_0K25_SNA (SNA) (SNA value from data type); unit Nm}, lower-limit=0, upper-limit=8191  # 13_Nm_-500-+1547,5_0,25
      invalid-value:
        integer literal c13_Nm_m500_1547k5_0k25: type=c13_Nm_m500_1547k5_0k25, value=8191
    c13_Nm_0_24570_3: base-type=uint16, compu {phys=raw*3 for raw 0..8190, 8191=I_C13_NM_0_24570_3_SNA (SNA) (SNA value from data type); unit Nm}, lower-limit=0, upper-limit=8191  # 13_Nm_0-24570_3
      invalid-value:
        integer literal c13_Nm_0_24570_3: type=c13_Nm_0_24570_3, value=8191
    c14_0_163k82_0k01: base-type=uint16, compu {phys=raw*0.01 for raw 0..16382, 16383=I_C14_0_163K82_0K01_SNA (SNA) (SNA value from data type)}, lower-limit=0, upper-limit=16383  # 14_0-163,82_0,01
      invalid-value:
        integer literal c14_0_163k82_0k01: type=c14_0_163k82_0k01, value=16383
    c14_rpm_0_16382_1: base-type=uint16, compu {phys=raw for raw 0..16382, 16383=I_C14_RPM_0_16382_1_SNA (SNA) (SNA value from data type); unit rpm}, lower-limit=0, upper-limit=16383  # 14_rpm_0-16382_1
      invalid-value:
        integer literal c14_rpm_0_16382_1: type=c14_rpm_0_16382_1, value=16383
    c14_rpm_0_8191_0k5: base-type=uint16, compu {phys=raw*0.5 for raw 0..16382, 16383=I_C14_RPM_0_8191_0K5_SNA (SNA) (SNA value from data type); unit rpm}, lower-limit=0, upper-limit=16383  # 14_rpm_0-8191_0,5
      invalid-value:
        integer literal c14_rpm_0_8191_0k5: type=c14_rpm_0_8191_0k5, value=16383
    c14_V_0_1638k2_0k1: base-type=uint16, compu {phys=raw*0.1 for raw 0..16382, 16383=I_C14_V_0_1638K2_0K1_SNA (SNA) (SNA value from data type); unit V}, lower-limit=0, upper-limit=16383  # 14_V_0-1638,2_0,1
      invalid-value:
        integer literal c14_V_0_1638k2_0k1: type=c14_V_0_1638k2_0k1, value=16383
    c14_deg_p_s_m4096_4095_0k5: base-type=uint16, compu {phys=raw*0.5-4096 for raw 0..16382, 16383=I_C14_DEG_P_S_M4096_4095_0K5_SNA (SNA) (SNA value from data type); unit °/s}, lower-limit=0, upper-limit=16383  # 14_°/s_-4096-+4095_0,5
      invalid-value:
        integer literal c14_deg_p_s_m4096_4095_0k5: type=c14_deg_p_s_m4096_4095_0k5, value=16383
    c14_deg_m819k2_819_0k1: base-type=uint16, compu {phys=raw*0.1-819.2 for raw 0..16382, 16383=I_C14_DEG_M819K2_819_0K1_SNA (SNA) (SNA value from data type); unit °}, lower-limit=0, upper-limit=16383  # 14_°_-819,2-+819_0,1
      invalid-value:
        integer literal c14_deg_m819k2_819_0k1: type=c14_deg_m819k2_819_0k1, value=16383
    c15_A_m2000_0_0k1: base-type=uint16, compu {phys=raw*0.1-2000 for raw 0..20000, 32767=I_C15_A_M2000_0_0K1_SNA (SNA) (SNA value from data type); unit A}, lower-limit=0, upper-limit=32767  # 15_A_-2000-+0_0,1
      invalid-value:
        integer literal c15_A_m2000_0_0k1: type=c15_A_m2000_0_0k1, value=32767
    c16_0_65534_1: base-type=uint16, compu {phys=raw for raw 0..65534, 65535=I_C16_0_65534_1_SNA (SNA) (SNA value from data type)}, lower-limit=0, upper-limit=65535  # 16_0-65534_1
      invalid-value:
        integer literal c16_0_65534_1: type=c16_0_65534_1, value=65535
    c16_A_m3276k6_3276k8_0k1: base-type=uint16, compu {phys=raw*0.1-3276.6 for raw 0..65534, 65535=I_C16_A_M3276K6_3276K8_0K1_SNA (SNA) (SNA value from data type); unit A}, lower-limit=0, upper-limit=65535  # 16_A_-3276,6-+3276,8_0,1
      invalid-value:
        integer literal c16_A_m3276k6_3276k8_0k1: type=c16_A_m3276k6_3276k8_0k1, value=65535
    c16_Days_0_65534_1: base-type=uint16, compu {phys=raw for raw 0..65534, 65535=I_C16_DAYS_0_65534_1_SNA (SNA) (SNA value from data type); unit Days}, lower-limit=0, upper-limit=65535  # 16_Days_0-65534_1
      invalid-value:
        integer literal c16_Days_0_65534_1: type=c16_Days_0_65534_1, value=65535
    c16_g_p_s_0_655k34_0k01_nSNA: base-type=uint16, compu {phys=raw*0.01 for raw 0..65534, 65535=I_C16_G_P_S_0_655K34_0K01_NSNA_SNA (SNA) (SNA value from data type); unit g/s}, lower-limit=0, upper-limit=65535  # 16_g/s_0-655,34_0,01_w/o_SNA
      invalid-value:
        integer literal c16_g_p_s_0_655k34_0k01_nSNA: type=c16_g_p_s_0_655k34_0k01_nSNA, value=65535
    c16_kPa_0_655350_10_nSNA: base-type=uint16, compu {phys=raw*10; unit kPa}, lower-limit=0, upper-limit=65535  # 16_kPa_0-655350_10_w/o_SNA
    c16_Nm_0_65534_1: base-type=uint16, compu {phys=raw for raw 0..65534, 65535=I_C16_NM_0_65534_1_SNA (SNA) (SNA value from data type); unit Nm}, lower-limit=0, upper-limit=65535  # 16_Nm_0-65534_1
      invalid-value:
        integer literal c16_Nm_0_65534_1: type=c16_Nm_0_65534_1, value=65535
    c16_V_0_6553k4_0k1: base-type=uint16, compu {phys=raw*0.1 for raw 0..65534, 65535=I_C16_V_0_6553K4_0K1_SNA (SNA) (SNA value from data type); unit V}, lower-limit=0, upper-limit=65535  # 16_V_0-6553,4_0,1
      invalid-value:
        integer literal c16_V_0_6553k4_0k1: type=c16_V_0_6553k4_0k1, value=65535
    c16_deg_p_s_m327k68_327k66_0k01: base-type=uint16, compu {phys=raw*0.01-327.68 for raw 0..65534, 65535=I_C16_DEG_P_S_M327K68_327K66_0K01_SNA (SNA) (SNA value from data type); unit °/s}, lower-limit=0, upper-limit=65535  # 16_°/s_-327,68-+327,66_0,01
      invalid-value:
        integer literal c16_deg_p_s_m327k68_327k66_0k01: type=c16_deg_p_s_m327k68_327k66_0k01, value=65535
    c16_ul_p_250ms_0_14200_0k21668: base-type=uint16, compu {phys=raw*0.2166814173 for raw 0..65534, 65535=I_C16_UL_P_250MS_0_14200_0K21668_SNA (SNA) (SNA value from data type); unit µl/250ms}, lower-limit=0, upper-limit=65535  # 16_µl/250ms_0-14200_0,21668
      invalid-value:
        integer literal c16_ul_p_250ms_0_14200_0k21668: type=c16_ul_p_250ms_0_14200_0k21668, value=65535
    c24_0_16777215_1_SNA_na: base-type=uint32, compu {phys=raw for raw 0..16777215}, lower-limit=0, upper-limit=16777215  # 24_0-16777215_1_SNA=-
    c24_km_0_999999k9_0k1: base-type=uint32, compu {phys=raw*0.1 for raw 0..9999999, 16777215=I_C24_KM_0_999999K9_0K1_SNA (SNA) (SNA value from data type); unit km}, lower-limit=0, upper-limit=16777215  # 24_km_0-999999,9_0,1
      invalid-value:
        integer literal c24_km_0_999999k9_0k1: type=c24_km_0_999999k9_0k1, value=16777215
    c32_0_4294967295_1_SNA_na: base-type=uint32, compu {phys=raw}, lower-limit=0, upper-limit=4294967295  # 32_0-4294967295_1_SNA=-
    c32_s_0_4294967294_1: base-type=uint32, compu {phys=raw for raw 0..4294967294, 4294967295=I_C32_S_0_4294967294_1_SNA (SNA) (SNA value from data type); unit s}, lower-limit=0, upper-limit=4294967295  # 32_s_0-4294967294_1
      invalid-value:
        integer literal c32_s_0_4294967294_1: type=c32_s_0_4294967294_1, value=4294967295
  boolean type DC_BOOL: base-type=boolean
  13 x integer type, all with lower-limit=0:
    cFuelBlindOutCtrl_Rq_TCM:  # FuelBlindOutCtrl_Rq_TCM | Fuel Blind Out Ctrl Rq TCM
      base-type=uint8
      compu {0=I_CFUELBLINDOUTCTRL_RQ_TCM_NOT_ACTV (NOT_ACTV) (Blinding out not active), 1=I_CFUELBLINDOUTCTRL_RQ_TCM_ACTIVE (ACTIVE) (Blinding out active), 2=I_CFUELBLINDOUTCTRL_RQ_TCM_BLND_OUT_PATTERN1 (BLND_OUT_PATTERN1) (Blind out pattern 1), 3=I_CFUELBLINDOUTCTRL_RQ_TCM_BLND_OUT_PATTERN2 (BLND_OUT_PATTERN2) (Blind out pattern 2), 4=I_CFUELBLINDOUTCTRL_RQ_TCM_BLND_OUT_PATTERN3 (BLND_OUT_PATTERN3) (Blind out pattern 3), 5=I_CFUELBLINDOUTCTRL_RQ_TCM_BLND_OUT_PATTERN4 (BLND_OUT_PATTERN4) (Blind out pattern 4)}
      upper-limit=5
    Rsrv01: base-type=uint8, upper-limit=1
    Rsrv02: base-type=uint8, upper-limit=3
    Rsrv03: base-type=uint8, upper-limit=7
    Rsrv04: base-type=uint8, upper-limit=15
    Rsrv05: base-type=uint8, upper-limit=31
    Rsrv06: base-type=uint8, upper-limit=63
    Rsrv07: base-type=uint8, upper-limit=127
    Rsrv08: base-type=uint8, upper-limit=255
    Rsrv11: base-type=uint16, upper-limit=2047
    Rsrv12: base-type=uint16, upper-limit=4095
    Rsrv14: base-type=uint16, upper-limit=16383
    Rsrv16: base-type=uint16, upper-limit=65535
  boolean type XDIS_3jji6ucrc8il6b9sf0gioatpa: base-type=XDIS_dykpj66fw3h2aelavfkzm58wf
  boolean type XDIS_8anm4jlkd5rjz5a4dj8p5z2aw: base-type=XDIS_2lmfwx1nh07esathzzxm7jxfi
  boolean type XDIS_8zznnqbxnga51x5ej9fjpu597: base-type=XDIS_ee0ra12zbca46xykyy0a4d2jr
  integer type XDIS_ag9ggh2r04cqwuwmmjm5ytd7y: base-type=XDIS_7kkx2iefr443licwjyu56ez4s, lower-limit=0, upper-limit=3
  integer type XDIS_dgxq2p852kecqaamwh1cpsgat: base-type=XDIS_afo0uuzsb2okcpsaaswegeg5h, lower-limit=0, upper-limit=3
  boolean type XDIS_ey4gzz3x4s3pbgmamj990b7l5: base-type=XDIS_7r878ot1syizwhe8b2h1y5lyw
package /COMPUMETHODS
  compu method none_1_m3: phys=raw-3
  compu method l_per_min_0d5_0: phys=raw*0.5
  compu method percent_10_0: phys=raw*10
  compu method none_0d03_0: phys=raw*0.03
  compu method Nm_per_s_100_m100: phys=raw*100-100
  compu method l_per_min_1_0: phys=raw
  compu method none_1_2000: phys=raw+2000
  compu method percent_2_0: phys=raw*2
  compu method percent_3d22581_0: phys=raw*3.225806452
  compu method none_5_0: phys=raw*5
  compu method A_1_0: phys=raw
  compu method rpm_100_0: phys=raw*100
  compu method s_0d1_0: phys=raw*0.1
  compu method Week_1_0: phys=raw
  compu method percent_1_0: phys=raw
  compu method percent_0d4_0: phys=raw*0.4
  compu method percent_0d5_0: phys=raw*0.5
  compu method none_0d01_0d5: phys=raw*0.01+0.5
  compu method none_7d8Em3_0: phys=raw*0.007795275591
  compu method none_0d01969_1: phys=raw*0.01968503937+1
  compu method A_0d05_0: phys=raw*0.05
  compu method A_0d06_0: phys=raw*0.06
  compu method A_0d15_0: phys=raw*0.15
  compu method bar_0d05_0: phys=raw*0.05
  compu method hPa_50_0: phys=raw*50
  compu method hPa_7d8_0: phys=raw*7.795275591
  compu method Impulses_1_0: phys=raw
  compu method kPa_1_0: phys=raw
  compu method l_per_hour_1d5_0: phys=raw*1.5
  compu method l_1_0: phys=raw
  compu method m_1_0: phys=raw
  compu method km_per_h_mph_1_0: phys=raw
  compu method km_per_h_mph_1_30: phys=raw+30
  compu method m_per_s_sq_0d08_m10d24: phys=raw*0.08-10.24
  compu method m_per_s_sq_0d02_m2d56: phys=raw*0.02-2.56
  compu method mbar_3_m381: phys=raw*3-381
  compu method N_0d12_0: phys=raw*0.12
  compu method Nm_5_m270: phys=raw*5-270
  compu method Nm_5_0: phys=raw*5
  compu method Nm_10_0: phys=raw*10
  compu method Nm_1_0: phys=raw
  compu method Nm_2_0: phys=raw*2
  compu method Nm_0d25_0: phys=raw*0.25
  compu method rpm_10_0: phys=raw*10
  compu method rpm_20_0: phys=raw*20
  compu method rpm_10_500: phys=raw*10+500
  compu method s_5_0: phys=raw*5
  compu method V_0d1_0: phys=raw*0.1
  compu method W_1_0: phys=raw
  compu method deg_C_1_m40: phys=raw-40
  compu method deg_C_0d5_m40: phys=raw*0.5-40
  compu method deg_C_1_m50: phys=raw-50
  compu method deg_C_2_m50: phys=raw*2-50
  compu method km_per_h_1_0: phys=raw
  compu method percent_0d1_m30: phys=raw*0.1-30
  compu method percent_0d1_0: phys=raw*0.1
  compu method m_per_s_sq_0d02_m10d24: phys=raw*0.02-10.24
  compu method rpm_1_0: phys=raw
  compu method rpm_5_0: phys=raw*5
  compu method deg_per_s_0d01_m5d12: phys=raw*0.01-5.12
  compu method A_0d1_m102d4: phys=raw*0.1-102.4
  compu method l_0d1_0: phys=raw*0.1
  compu method Nm_1d0_m500: phys=raw-500
  compu method km_per_h_0d1_0: phys=raw*0.1
  compu method m_per_s_sq_0d02_m40d96: phys=raw*0.02-40.96
  compu method min_1_0: phys=raw
  compu method mm_0d5_m1023: phys=raw*0.5-1023
  compu method Nm_0d5_m500: phys=raw*0.5-500
  compu method Nm_3_0: phys=raw*3
  compu method rpm_4_0: phys=raw*4
  compu method rpm_2_0: phys=raw*2
  compu method Nm_0d25_m500: phys=raw*0.25-500
  compu method none_0d01_0: phys=raw*0.01
  compu method rpm_0d5_0: phys=raw*0.5
  compu method deg_per_s_0d5_m4096: phys=raw*0.5-4096
  compu method deg_0d1_m819d2: phys=raw*0.1-819.2
  compu method A_0d1_m2000: phys=raw*0.1-2000
  compu method A_0d1_m3276d6: phys=raw*0.1-3276.6
  compu method Days_1_0: phys=raw
  compu method g_per_s_0d01_0: phys=raw*0.01
  compu method deg_per_s_0d01_m327d68: phys=raw*0.01-327.68
  compu method ul_per_250ms_0d21668_0: phys=raw*0.2166814173
  compu method km_0d1_0: phys=raw*0.1
  compu method s_1_0: phys=raw
package /SYSTEM_SIGNALS
  119 x system signal:
    ABS_IndLmp_On_Rq: data-type=c02_Lgt_Off_Cont_Blink, init-value=XDIS_awwfd0w7q1wwqc5hdwlnvws3e/lOFF, length=2  # Anforderung ABS Kontrolllampe / ABS indication lamp on request
    BrkIndLmp_On_Rq_ESP: data-type=c02_Lgt_Off_Cont_Blink, init-value=XDIS_awwfd0w7q1wwqc5hdwlnvws3e/lOFF, length=2  # Bremsenkontrolllampe (rot) einschalten / Brake indication lamp (red) on request
    CRC_AWD_TCASE_Rq_ESP_Pr2: data-type=c08_CRC_woSNA, init-value=l46, length=8  # CRC-Checksumme der Signal Gruppe gemäß AUTOSAR Profil 2 / CRC-checksum of signal group according to AUTOSAR Profile 2
    CRC_DPC_Master_Rq_Pr2: data-type=c08_CRC_woSNA, init-value=l203, length=8  # CRC-Checksumme der Signal Gruppe gemäß AUTOSAR Profil 2 / CRC-checksum of signal group according to AUTOSAR Profile 2
    CRC_Eng_Rq_ABC_Pr2: data-type=c08_CRC_woSNA, init-value=l173, length=8  # CRC-Checksumme der Signal Gruppe gemäß AUTOSAR Profil 2 / CRC-checksum of signal group according to AUTOSAR Profile 2
    CRC_ESP_Disp_Rq_Pr2: data-type=c08_CRC_woSNA, init-value=l55, length=8  # CRC-Checksumme der Signal Gruppe gemäß AUTOSAR Profil 2 / CRC-checksum of signal group according to AUTOSAR Profile 2
    CRC_PT_Rq_ESP_Pr2: data-type=c08_CRC_woSNA, init-value=l76, length=8  # CRC-Checksumme der Signal Gruppe gemäß AUTOSAR Profil 2 / CRC-checksum of signal group according to AUTOSAR Profile 2
    DiffLk_M_LkTrq_Rq_ESP: data-type=c08_Nm_0_2540_10, init-value=XDIS_5tmrduq2bqfpf36001734f32g/l255, length=8  # Soll-Sperr-Moment Differentialsperre Mitte / Locking torque request of differential lock middle
    DiffLk_M_Md_Rq_ESP: data-type=c02_DiffLk_M_Md_Rq_ESP, init-value=lFREE_RUN, length=2  # Soll-Modus Differentialsperre Mitte / Differential lock middle mode request
    DPC_Md_ABC_Carv_Rq: data-type=c02_NDef_On_Off, init-value=XDIS_3y644026va6c2x8rschu8ysp4/lOFF, length=2  # Fahrprogrammwahl: Anforderung ABC Carving / Driving program control mode: ABC Carving request
    DPC_Md_ABC_Preview_Rq: data-type=c02_NDef_On_Off, init-value=XDIS_ct0p913dzrgf4i94zmfkskizo/lON, length=2  # Fahrprogrammwahl: Anforderung ABC Preview / Driving program control mode: ABC Preview request
    DPC_Md_AC_Rq: data-type=c02_NDef_ECO_Comfort, init-value=XDIS_4rxo09g2n1p0ap53lo5wet5an/lCOMFORT, length=2  # Fahrprogrammwahl: Anforderung Klimaanlage / Driving program control: air conditioning mode request
    DPC_Md_AS_Rq: data-type=c03_DPC_Md_AS, init-value=XDIS_exbq1fzviylpo20j8kwfqzkm/lCOMFORT, length=3  # Fahrprogrammwahl: Anforderung Assistenzsystem / Driving program control: assistance system mode request
    DPC_Md_ECO_Assist_Rq: data-type=c02_NDef_On_Off, init-value=XDIS_3y644026va6c2x8rschu8ysp4/lOFF, length=2  # Fahrprogrammwahl: Anforderung ECO-Assistent / Driving program control: ECO assistant request
    DPC_Md_eDrv_Rq: data-type=c02_NDef_On_Off, init-value=XDIS_ct0p913dzrgf4i94zmfkskizo/lON, length=2  # Fahrprogrammwahl: Anforderung eDrive / Driving program control: eDrive request
    DPC_Md_ESP_Rq: data-type=c03_DPC_Md_ESP_Rq, init-value=XDIS_ca1vhc1pmm1pytmy7whf3e5la/lCOMFORT, length=3  # Fahrprogrammwahl: Anforderung ESP / Driving program control ESP request
    DPC_Md_ExhstFlap_Rq: data-type=c03_DPC_Md_ExhaustFlap, init-value=XDIS_b6gytuw1gs6hpmeqn7dp2mvre/lCOMFORT, length=3  # Fahrprogrammwahl: Anforderung Abgasklappe Modus / Driving program control: ExhaustFlap mode request
    DPC_Md_Ht_Rq: data-type=c02_NDef_ECO_Comfort, init-value=XDIS_4rxo09g2n1p0ap53lo5wet5an/lCOMFORT, length=2  # Fahrprogrammwahl: Anforderung Heizung / Driving program control: heating request
    DPC_Md_SSA_Rq: data-type=c02_DPC_Md_SSA, init-value=lSSA_ON, length=2  # Fahrprogrammwahl: Anforderung Stopp/Start-Automatik / Driving program control: stop start automatic mode request
    DPC_Md_St_Rq: data-type=c03_DPC_Md_St, init-value=XDIS_aggqmvc9vx5lby09wqq991q82/lCOMFORT, length=3  # Fahrprogrammwahl: Anforderung Lenkung / Driving program control: steering mode request
    DPC_Md_Susp_Rq_V2: data-type=c05_DPC_Md_Susp_V2, init-value=lONROAD9, length=5  # Fahrprogrammwahl: Anforderung Federung/Dmpfung / Driving program control: suspension mode request
    DPC_Md_SuspLvl_Rq: data-type=c03_m2_p3_1_Init, init-value=XDIS_85wxxmdqtoxn9opwq7p7hfnz9/l0, length=3  # Fahrprogrammwahl: Anforderung Fahrzeugniveau / Driving program control: suspension level mode request
    DPC_PopupDisp_Rq: data-type=DC_BOOL, init-value=XDIS_h5tcyk98kzbgrc5svasomeyt/lfalse, length=1  # Fahrprogrammwahl: Anforderung Popup-Anzeige / Driving program control: Popup display request
    DPC_PopupSupp_Rq: data-type=DC_BOOL, init-value=XDIS_h5tcyk98kzbgrc5svasomeyt/lfalse, length=1  # Fahrprogrammwahl: Unterdrückung Popup / Driving program control: Popup suppress request
    EngTrq_Rq_ESP: data-type=c13_Nm_m500_1547k5_0k25, init-value=XDIS_1sw1jwlmccfni1v56xqj0js4n/l0, length=13  # Geford. Motormoment / Engine torque request
    EngTrq_Rq_RBS: data-type=c13_Nm_m500_1547k5_0k25, init-value=XDIS_1sw1jwlmccfni1v56xqj0js4n/l0, length=13  # Geford. Motormoment / Engine torque request
    EngTrqMax_Rq_ESP: data-type=DC_BOOL, init-value=XDIS_h5tcyk98kzbgrc5svasomeyt/lfalse, length=1  # Motormomentenanforderung Max / Engine torque request maximum
    EngTrqMax_Rq_RBS: data-type=DC_BOOL, init-value=XDIS_h5tcyk98kzbgrc5svasomeyt/lfalse, length=1  # Motormomentenanforderung Max / Engine torque request maximum
    EngTrqMin_Rq_ESP: data-type=DC_BOOL, init-value=XDIS_h5tcyk98kzbgrc5svasomeyt/lfalse, length=1  # Motormomentenanforderung Min / Engine torque request minimum
    ESP_BrkMsg_Disp_Rq: data-type=c07_ESP_BrkMsg_Disp_Rq, init-value=XDIS_42xm1f4wmbrlen77pvu12x6xu/lIDLE, length=7  # Anforderung ESP-Fehlerinfo anzeigen / ESP brake message display request
    ESP_BrkMsg_Disp_TrgRq: data-type=DC_BOOL, init-value=XDIS_h5tcyk98kzbgrc5svasomeyt/lfalse, length=1  # Anforderung ESP-Fehlerinfo erneut anzeigen / ESP brake message display retrigger request
    ESP_CtrlLmp_Info: data-type=c02_Lgt_Off_Cont_Blink, init-value=XDIS_awwfd0w7q1wwqc5hdwlnvws3e/lOFF, length=2  # ESP Infolampe Dauerlicht/Blinklicht / ESP control lamp information
    ESP_Off_IndLmp_On_Rq: data-type=DC_BOOL, init-value=XDIS_h5tcyk98kzbgrc5svasomeyt/lfalse, length=1  # Anforderung ESP-OFF-Kontrollleuchte / ESP-OFF indication lamp on request
    ESP_VDC_Msg_Disp_Rq: data-type=c07_ESP_VDC_Msg_Disp_Rq, init-value=XDIS_e75cd4727vatijfha73srtluz/lIDLE, length=7  # Anforderung ESP-Fahrdynamik Meldung anzeigen / ESP vehicle dynamics control message display request
    ESP_VDC_Msg_Disp_TrgRq: data-type=DC_BOOL, init-value=XDIS_h5tcyk98kzbgrc5svasomeyt/lfalse, length=1  # Anforderung ESP-Fahrdynamik Meldung erneut anzeigen / ESP vehicle dynamics control message display retrigger request
    LDC_AcustWarn_Rq: data-type=c02_Idle_Beep, init-value=XDIS_8kxlic6in1luauk1hsy6z4pxl/lIDLE, length=2  # Akustische Warnung Längsregler / Longitudinal controller acoustical warning request
    LDC_AcustWarn_Rq_RDU: data-type=c02_Idle_Beep, init-value=XDIS_8kxlic6in1luauk1hsy6z4pxl/lIDLE, length=2  # Akustische Warnung Längsregler / Longitudinal controller acoustical warning request
    LDC_CMS_MsgDisp_Rq_RDU: data-type=c02_LDC_CMS_MsgDisp_Rq, init-value=XDIS_73ldoj9ajgn9n812099uwsgzh/lIDLE, length=2  # Collision Mitigation System Displaymeldungen / Collision mitigation system message display request
    LDC_CMS_Stat_RDU: data-type=c03_LDC_CMS_Stat, init-value=lCMS_OFF, length=3  # Status Collision Mitigation System / Collision mitigation system status
    LDC_CMS_Warn_MsgDisp_Rq_RDU: data-type=c01_Idle_MsgRq, init-value=XDIS_cypz3b2yuf3fqw24cjvk04jm6/lIDLE, length=1  # Kollisionswarnung für den aktiven Bremsassistenten / Collision warning message for active brake assist
    LDC_Dist_Dsr_RDU: data-type=c08_m_0_150_1, init-value=XDIS_8qw8y1ioixtwbszsb4bmbbe7m/l0, length=8  # Gewünschter Abstand Längsregler / Desired longitudinal controller distance
    LDC_Dist_RDU: data-type=c08_LDC_Dist, init-value=l254, length=8  # Aktueller Abstand Längsregler / Actual longitudinal controller distance
    LDC_DTR_IndLmp_On_Rq_RDU: data-type=c02_02_Idle_On_NDef, init-value=XDIS_divyhkq3bs0q5xwv9cfusq7d8/lIDLE, length=2  # Anforderung Distronic-Kontrolllampe / Distronic indication lamp on request
    LDC_DTR_MM_Ctrl_Actv: data-type=DC_BOOL, init-value=XDIS_h5tcyk98kzbgrc5svasomeyt/lfalse, length=1  # Karten-basierte Distronic-Steuerung aktiv / Distronic map matching control active
    LDC_DTR_MsgDisp_Rq: data-type=c03_LDC_DTR_MsgDisp_Rq, init-value=XDIS_9qdy2xe69a4db0pzfj9h6vtd1/lIDLE, length=3  # Distronic-Displaymeldungen / Distronic message display request
    LDC_DTR_MsgDisp_Rq_RDU: data-type=c03_LDC_DTR_MsgDisp_Rq, init-value=XDIS_9qdy2xe69a4db0pzfj9h6vtd1/lIDLE, length=3  # Distronic-Displaymeldungen / Distronic message display request
    LDC_DTR_Stat: data-type=c04_LDC_DTR_Stat, init-value=XDIS_5gnd6l5nvhhvxw1him7pizy3p/lDTR_CC_OFF, length=4  # Status Distronic / Distronic status
    LDC_DTR_Stat_RDU_V2: data-type=c03_LDC_DTR_Stat_V2, init-value=XDIS_208p92ix4of1dcdmevcry8pej/lDTR_CC_OFF, length=3  # Status Distronic / Distronic status
    LDC_IconDisp_Rq_ESP: data-type=c03_LDC_IconDisp_Rq, init-value=lLDC_OFF, length=3  # Tempomat/ Limiter Statusanzeige / Cruise control / variable speed limiter icon display request
    LDC_IconDisp_Rq_RDU: data-type=c03_LDC_IconDisp_Rq_RDU, init-value=XDIS_7dmjz6kimzifc2t18tjt3fjca/lIDLE, length=3  # Tempomat/ Limiter Statusanzeige RDU / Cruise control / variable speed limiter icon display request RDU
    LDC_Master: data-type=c03_LDC_Master, init-value=lESP, length=3  # Längsregler-Master / Longitudinal controller master
    LDC_MsgDisp_Rq: data-type=c05_LDC_MsgDisp_Rq, init-value=XDIS_dsldnewyxrtx9nhd3nzm4zqv2/lIDLE, length=5  # Displaymeldungen Längsregler / Longitudinal controller message display request
    LDC_MsgDisp_Rq_RDU: data-type=c05_LDC_MsgDisp_Rq_RDU, init-value=XDIS_2vnz8u3lvctp7d6byghtg5nya/lIDLE, length=5  # Displaymeldungen Längsregler / Longitudinal controller message display request
    LDC_MsgDisp_TrgrRq: data-type=DC_BOOL, init-value=XDIS_h5tcyk98kzbgrc5svasomeyt/lfalse, length=1  # Längsregler-Displaymeldung erneut anzeigen / Message display retrigger request
    LDC_MsgDisp_TrgrRq_RDU: data-type=DC_BOOL, init-value=XDIS_h5tcyk98kzbgrc5svasomeyt/lfalse, length=1  # Längsregler-Displaymeldung erneut anzeigen / Message display retrigger request
    LDC_RadarSensSoil_Disp_Rq_RDU: data-type=DC_BOOL, init-value=XDIS_h5tcyk98kzbgrc5svasomeyt/lfalse, length=1  # Warnung "Radar-Sensor verschmutzt" anzeigen / Warning "Radar sensor soiled" display request
    LDC_Spd_Add: data-type=c08_LDC_Spd, init-value=XDIS_dvm76papxqeuwchaycpewq03l/l253, length=8  # Zusätzliche Geschwindigkeit Längsregler / Additional longitudinal controller speed
    LDC_Spd_Add_RDU: data-type=c08_LDC_Spd, init-value=XDIS_dvm76papxqeuwchaycpewq03l/l253, length=8  # Zusätzliche Geschwindigkeit Längsregler / Additional longitudinal controller speed
    LDC_SpdUnit_Rs: data-type=c01_UnitVehSpd, init-value=lKMH, length=1  # Antwort Geschwindigkeitseinheit / Speed unit response
    LDC_SpdUnit_Rs_RDU: data-type=c01_UnitVehSpd, init-value=lKMH, length=1  # Antwort Geschwindigkeitseinheit / Speed unit response
    LDC_SPEEDO_SegRing_Disp_Rq: data-type=c02_LDC_Disp_Rq, init-value=XDIS_b4ay52x0h55ee55xqsxnbv5sl/lOFF, length=2  # Anzeige Tachometer-Segmentring / Speedometer segment ring display request
    LDC_SPEEDO_SegRing_Disp_Rq_RDU: data-type=c02_LDC_Disp_Rq, init-value=XDIS_b4ay52x0h55ee55xqsxnbv5sl/lOFF, length=2  # Anzeige Tachometer-Segmentring / Speedometer segment ring display request
    LDC_VSL_On: data-type=DC_BOOL, init-value=XDIS_h5tcyk98kzbgrc5svasomeyt/lfalse, length=1  # Variable Geschwindigkeitsbegrenzung eingeschaltet / Variable speed limiter on
    LDC_WTSL_Flt: data-type=DC_BOOL, init-value=XDIS_h5tcyk98kzbgrc5svasomeyt/lfalse, length=1  # Winterreifen-Geschwindigkeitsbegrenzer defekt / Winter tire speed limiter fault
    LDC_WTSL_MsgDisp_Rq: data-type=c02_NotActv_Actv_SNA, init-value=XDIS_dqfgqnhk704uahrufntf35mvc/lNOTACTV, length=2  # Winterreifen-Geschwindigkeitsbegrenzer Displaymeldung / Winter tire speed limiter message display request
    LDC_WTSL_Spd_Max_Disp_TrgrRq: data-type=DC_BOOL, init-value=XDIS_h5tcyk98kzbgrc5svasomeyt/lfalse, length=1  # Maximal-Geschwindigkeit Winterreifen-Geschwindigkeitsbegrenzer erneut anzeigen / Winter tire speed limiter display retrigger request
    LDC_WTSL_Spd_Max_Stat: data-type=c08_LDC_WTSL_Spd_Max, init-value=XDIS_2wmdhujsld2cfda05itwrgdal/l253, length=8  # Status Maximal-Geschwindigkeit Winterreifen-Geschwindigkeitsbegrenzer / Winter tire speed limiter maximum speed state
    PW_FL_Bl: data-type=DC_BOOL, init-value=XDIS_h5tcyk98kzbgrc5svasomeyt/lfalse, length=1  # Fensterheber vorne links blockiert / Power window front left block shutoff
    PW_FL_LS_Stat: data-type=c02_LS_Stat, init-value=XDIS_1it9urdk9io75z2ahjunve8z6/l3, length=2  # Fensterheberansteuerung VL Status Langhub (nur Cabrio) / Power window FL long stroke state (convertible only)
    PW_FL_SS: data-type=DC_BOOL, init-value=XDIS_h5tcyk98kzbgrc5svasomeyt/lfalse, length=1  # Fensterheber vorne links in Kurzhubposition (C216, CLA, 207, 231) / Power window front left in short stroke position (C216, CLA, 207, 231)
    PW_FR_Bl: data-type=DC_BOOL, init-value=XDIS_h5tcyk98kzbgrc5svasomeyt/lfalse, length=1  # Fensterheber vorne rechts blockiert / Power window front right block shutoff
    PW_FR_LS_Stat: data-type=c02_LS_Stat, init-value=XDIS_1it9urdk9io75z2ahjunve8z6/l3, length=2  # Fensterheberansteuerung VR Status Langhub (nur Cabrio) / Power window FR long stroke state (convertible only)
    PW_FR_SS: data-type=DC_BOOL, init-value=XDIS_h5tcyk98kzbgrc5svasomeyt/lfalse, length=1  # Fensterheber vorne rechts in Kurzhubposition (C216, CLA, 207, 231) / Power window front right in short stroke position (C216, CLA, 207, 231)
    PW_Oprtn_Actv_FL: data-type=DC_BOOL, init-value=XDIS_h5tcyk98kzbgrc5svasomeyt/lfalse, length=1  # Fensterheberansteuerung vorne links aktiv / Power window front left operation active
    PW_Oprtn_Actv_FR: data-type=DC_BOOL, init-value=XDIS_h5tcyk98kzbgrc5svasomeyt/lfalse, length=1  # Fensterheberansteuerung vorne rechts aktiv / Power window front right operation active
    PW_Oprtn_Actv_RL: data-type=DC_BOOL, init-value=XDIS_h5tcyk98kzbgrc5svasomeyt/lfalse, length=1  # Fensterheberansteuerung hinten links aktiv / Power window rear left operation active
    PW_Oprtn_Actv_RR: data-type=DC_BOOL, init-value=XDIS_h5tcyk98kzbgrc5svasomeyt/lfalse, length=1  # Fensterheberansteuerung hinten rechts aktiv / Power window rear right operation active
    PW_RL_Bl: data-type=DC_BOOL, init-value=XDIS_h5tcyk98kzbgrc5svasomeyt/lfalse, length=1  # Fensterheber hinten links blockiert / Power window rear left block shutoff
    PW_RL_LS_Stat: data-type=c02_LS_Stat, init-value=XDIS_1it9urdk9io75z2ahjunve8z6/l3, length=2  # Fensterheberansteuerung HL Status Langhub (nur Cabrio) / Power window RL long stroke state (convertible only)
    PW_RL_SS: data-type=DC_BOOL, init-value=XDIS_h5tcyk98kzbgrc5svasomeyt/lfalse, length=1  # Fensterheber hinten links in Kurzhubposition (nur 216/207/231) / Power window rear left in short stroke position (only 216/207/231)
    PW_RR_Bl: data-type=DC_BOOL, init-value=XDIS_h5tcyk98kzbgrc5svasomeyt/lfalse, length=1  # Fensterheber hinten rechts blockiert / Power window rear right block shutoff
    PW_RR_LS_Stat: data-type=c02_LS_Stat, init-value=XDIS_1it9urdk9io75z2ahjunve8z6/l3, length=2  # Fensterheberansteuerung HR Status Langhub (nur Cabrio) / Power window RR long stroke state (convertible only)
    PW_RR_SS: data-type=DC_BOOL, init-value=XDIS_h5tcyk98kzbgrc5svasomeyt/lfalse, length=1  # Fensterheber hinten rechts in Kurzhubposition (nur 216/207/231) / Power window rear right in short stroke position (only 216/207/231)
    RBS_AcustWarn_Rq: data-type=c02_Idle_Chime_Beep, init-value=XDIS_6u7udc301amakedj65xpaxohy/lIDLE, length=2  # Akustische Warnung RBS (konventionelles ESP: Failboost) / RBS (conventional ESP: Failboost) acoustical warning request
    RBS_IndLmp_On_Rq: data-type=DC_BOOL, init-value=XDIS_h5tcyk98kzbgrc5svasomeyt/lfalse, length=1  # Anforderung RBS (konventionelles ESP: Failboost) Kontrolllampe / RBS (conventional ESP: Failboost) indication lamp on request
    RDU_Enbl_Rq: data-type=DC_BOOL, init-value=ltrue, length=1  # Anforderung enable RDU / Enable RDU request
    RecupEnbl_RBS: data-type=DC_BOOL, init-value=XDIS_h5tcyk98kzbgrc5svasomeyt/lfalse, length=1  # Rekuperation erlaubt / Recuperation enabled
    RollTestMd_Rq_Ack: data-type=c02_RollTestMd_Rq_Ack, init-value=XDIS_cjrgyudzoj1alqrlzqvxry20j/lOFF, length=2  # Bestätigung Rollenprüfstandsmodus / Roller test bench mode request acknowledge
    Rsrv1_AWD_TCASE_Rq_ESP_Pr2: data-type=Rsrv02, init-value=XDIS_7jeo5ges9wp8ufla3pohsuw83/l0, length=2  # Reserviert für zukünftige Verwendung / Reserved for future use
    Rsrv1_Eng_Rq_ABC_Pr2: data-type=Rsrv04, init-value=XDIS_eb9yua4lxmhrmvzyfsmxg3ler/l0, length=4  # Reserviert für zukünftige Verwendung / Reserved for future use
    Rsrv1_ESP_Disp_Rq_Pr2: data-type=Rsrv06, init-value=XDIS_zukcixzhzplmgdoo03mopm29/l0, length=6  # Reserviert für zukünftige Verwendung / Reserved for future use
    Rsrv2_AWD_TCASE_Rq_ESP_Pr2: data-type=Rsrv05, init-value=XDIS_e6yko3jf7vueybb3pnb685vj8/l0, length=5  # Reserviert für zukünftige Verwendung / Reserved for future use
    Rsrv2_DPC_Master_Rq_Pr2: data-type=Rsrv01, init-value=XDIS_e2uhxyvdu33zsyqfjnk549pp2/l0, length=1  # Reserviert für zukünftige Verwendung / Reserved for future use
    Rsrv2_Eng_Rq_ABC_Pr2: data-type=Rsrv08, init-value=XDIS_4flxbk4wkjkdew7cw07d9of66/l0, length=8  # Reserviert für zukünftige Verwendung / Reserved for future use
    Rsrv3_DPC_Master_Rq_Pr2: data-type=Rsrv03, init-value=XDIS_ds7bx5pu0edqfshg8l8g5rp9z/l0, length=3  # Reserviert für zukünftige Verwendung / Reserved for future use
    SQC_AWD_TCASE_Rq_ESP_Pr2: data-type=c04_0_15_1_SNA_na, init-value=XDIS_2gdok7is6uk227cngmpgf9wxb/l0, length=4  # Sequenzzähler / Sequence counter
    SQC_DPC_Master_Rq_Pr2: data-type=c04_0_15_1_SNA_na, init-value=XDIS_2gdok7is6uk227cngmpgf9wxb/l0, length=4  # Sequenzzähler / Sequence counter
    SQC_Eng_Rq_ABC_Pr2: data-type=c04_0_15_1_SNA_na, init-value=XDIS_2gdok7is6uk227cngmpgf9wxb/l0, length=4  # Sequenzzähler / Sequence counter
    SQC_ESP_Disp_Rq_Pr2: data-type=c04_0_15_1_SNA_na, init-value=XDIS_2gdok7is6uk227cngmpgf9wxb/l0, length=4  # Sequenzzähler / Sequence counter
    SQC_PT_Rq_ESP_Pr2: data-type=c04_0_15_1_SNA_na, init-value=XDIS_2gdok7is6uk227cngmpgf9wxb/l0, length=4  # Sequenzzähler / Sequence counter
    SSA_DsablPrmnt_Rq_ESP: data-type=DC_BOOL, init-value=XDIS_h5tcyk98kzbgrc5svasomeyt/lfalse, length=1  # Stopp/Start-Automatik dauerhaft abschalten aufgrund eine Defekts / Stop/start automatic disable permanently request due to defect
    SSA_Enbl_Rq_ESP: data-type=DC_BOOL, init-value=XDIS_h5tcyk98kzbgrc5svasomeyt/lfalse, length=1  # Stopp/Start-Automatik enable / Enable stop/start automatic request
    TSA_Warn_Supp_Rq_RDU: data-type=c02_Idle_Supp_Enbl, init-value=XDIS_d9ivlc75v57cogp2b8j4yeozx/lIDLE, length=2  # TSA Warnung unterdrückt / TSA warning suppressed
    TSSR_Ft_Posn: data-type=c16_0_65534_1, init-value=XDIS_c0gbhw8dm66an6qaea4j1vw2p/l65535, length=16  # Schiebehebedach Position vorne / Front tilt/slide sunroof position
    TSSR_Ft_RB_Stat: data-type=c02_RB_Stat, init-value=XDIS_5e48z89l5sbwn0bg9qrzp9ct1/l3, length=2  # Dach-Rollo Status vorne / Front roller blind state
    TSSR_R_RB_Stat: data-type=c02_RB_Stat, init-value=XDIS_5e48z89l5sbwn0bg9qrzp9ct1/l3, length=2  # Fond-Dachrollo Status / Rear roller blind state
    WhlSlpRecup: data-type=DC_BOOL, init-value=XDIS_h5tcyk98kzbgrc5svasomeyt/lfalse, length=1  # Radschlupf während Rekuperation / Wheel is slipping during recuperation
    Win_FL_CT_Oprtn_Enbl: data-type=DC_BOOL, init-value=XDIS_h5tcyk98kzbgrc5svasomeyt/lfalse, length=1  # Fenster VL in Position für Verdeckansteuerung / Window FL in position for convertible top operation
    Win_FR_CT_Oprtn_Enbl: data-type=DC_BOOL, init-value=XDIS_h5tcyk98kzbgrc5svasomeyt/lfalse, length=1  # Fenster VR in Position für Verdeckansteuerung / Window FR in position for convertible top operation
    Win_RL_CT_Oprtn_Enbl: data-type=DC_BOOL, init-value=XDIS_h5tcyk98kzbgrc5svasomeyt/lfalse, length=1  # Fenster HL in Position für Verdeckansteuerung / Window RL in position for convertible top operation (dummy)
    Win_RL_SS_Rq_Dr_FL: data-type=DC_BOOL, init-value=XDIS_h5tcyk98kzbgrc5svasomeyt/lfalse, length=1  # Fenster hinten links in Kurzhub fahren / Window rear left into short stroke request
    Win_RL_SS_Rq_Dr_RL: data-type=DC_BOOL, init-value=XDIS_h5tcyk98kzbgrc5svasomeyt/lfalse, length=1  # Fenster hinten links in Kurzhub fahren / Window rear left into short stroke request (dummy)
    Win_RR_CT_Oprtn_Enbl: data-type=DC_BOOL, init-value=XDIS_h5tcyk98kzbgrc5svasomeyt/lfalse, length=1  # Fenster HR in Position für Verdeckansteuerung / Window RR in position for convertible top operation (dummy)
    Win_RR_SS_Rq_Dr_FR: data-type=DC_BOOL, init-value=XDIS_h5tcyk98kzbgrc5svasomeyt/lfalse, length=1  # Fenster hinten rechts in Kurzhub fahren / Window rear right into short stroke request
    Win_RR_SS_Rq_Dr_RR: data-type=DC_BOOL, init-value=XDIS_h5tcyk98kzbgrc5svasomeyt/lfalse, length=1  # Fenster hinten rechts in Kurzhub fahren / Window rear right into short stroke request (dummy)
    WinThermProt_FL_Actv: data-type=DC_BOOL, init-value=XDIS_h5tcyk98kzbgrc5svasomeyt/lfalse, length=1
    WinThermProt_FR_Actv: data-type=DC_BOOL, init-value=XDIS_h5tcyk98kzbgrc5svasomeyt/lfalse, length=1
    WinThermProt_RL_Actv: data-type=DC_BOOL, init-value=XDIS_h5tcyk98kzbgrc5svasomeyt/lfalse, length=1
    WinThermProt_RR_Actv: data-type=DC_BOOL, init-value=XDIS_h5tcyk98kzbgrc5svasomeyt/lfalse, length=1
  106 x system signal group:
    APPL_ECU_ASX_1: system-signal=[APPL_ECU_ASX_1A, APPL_ECU_ASX_1B, APPL_ECU_ASX_1C, APPL_ECU_ASX_1D, APPL_ECU_ASX_1E, APPL_ECU_ASX_1F, APPL_ECU_ASX_1G, APPL_ECU_ASX_1H]  # Applikation zu Steuergerät / Application to ECU
    APPL_ECU_ISM1: system-signal=[APPL_ECU_ISM_1A, APPL_ECU_ISM_1B, APPL_ECU_ISM_1C, APPL_ECU_ISM_1D, APPL_ECU_ISM_1E, APPL_ECU_ISM_1F, APPL_ECU_ISM_1G, APPL_ECU_ISM_1H]  # Steuergerät zu Applikation / ECU to Application
    APPL_ECU_ISM2: system-signal=[APPL_ECU_ISM_2A, APPL_ECU_ISM_2B, APPL_ECU_ISM_2C, APPL_ECU_ISM_2D, APPL_ECU_ISM_2E, APPL_ECU_ISM_2F, APPL_ECU_ISM_2G, APPL_ECU_ISM_2H]  # Steuergerät zu Applikation / ECU to Application
    APPL_ECU_SSP_1: system-signal=[APPL_ECU_SSP_1A, APPL_ECU_SSP_1B, APPL_ECU_SSP_1C, APPL_ECU_SSP_1D, APPL_ECU_SSP_1E, APPL_ECU_SSP_1F, APPL_ECU_SSP_1G, APPL_ECU_SSP_1H]  # Messdaten / Measurement data
    AWD_TCASE_Rq_ESP_Pr2: system-signal=[CRC_AWD_TCASE_Rq_ESP_Pr2, DiffLk_M_LkTrq_Rq_ESP, DiffLk_M_Md_Rq_ESP, ESP_FricCoeff_Stat, Rsrv1_AWD_TCASE_Rq_ESP_Pr2, Rsrv2_AWD_TCASE_Rq_ESP_Pr2, SQC_AWD_TCASE_Rq_ESP_Pr2]  # Anforderung Differentialsperren / Allradkupplung / Differential locks AWD Clutch request
    AWD_TCASE_Stat1_Pr2: system-signal=[AWD_Clutch_Stat, AWD_Err_Stat_V2, AWD_OprtnMd, CRC_AWD_TCASE_Stat1_Pr2, ESP_Md_Rq_AWD, Gr_TCASE_V2, LkTrq_Estim_AWD_V2, RearGrTemp_Estim_AWD, Rsrv1_AWD_TCASE_Stat1_Pr2, SQC_AWD_TCASE_Stat1_Pr2]  # Status Allradantrieb und Verteilergetriebe / All wheel drive and transfer case state
    BrkSys_Stat_Pr2: system-signal=[Brk_Stat, BrkIntrvntn_Actv_AS, BrkIntrvntn_Actv_CWA, BrkIntrvntn_Actv_EPKB, BrkIntrvntn_Actv_ESP, BrkPdl_Stat, BrkRq_PT_Enbl, BrkTrq_D_V2, BrkTrq_V2, CRC_BrkSys_Stat_Pr2, DSR_Actv, DSR_Sys_Flt, EmgBrk_Actv, ESP_Oprtn_Stat_AS_V2, ESP_Sys_Stat_V2, FTW_PressDrop_Stat, FullBrk_Actv, Rsrv5_BrkSys_Stat_Pr2, SQC_BrkSys_Stat_Pr2, SSA_EmgBrk_Actv]  # Status Bremssystem / Brake system state
    CPC_PredStrat_Data_AR2: system-signal=[Act_DynFct_Rq_DS, CoastMd_Rq_CPC, Funct_GrShft_Rq_DS, GrShft_Rq_DS, Pred_Radar_DS_Stat, Pred_Slope_DS, Pred_VehAccel_Y_DS, RadarBsd_GrShft_Rq_DS, TrafficFlow_Info_DS]
    DAC_ECM_Data: system-signal=[DAC_ECM_Data1, DAC_ECM_Data2, DAC_ECM_Data3, DAC_ECM_Data4, DAC_ECM_Data5, DAC_ECM_Data6, DAC_ECM_Data7, DAC_ECM_Data8]  # FBS-Botschaft an ECM / Driving authorization checker
    DAC_ISM_Data: system-signal=[DAC_ISM_Data1, DAC_ISM_Data2, DAC_ISM_Data3, DAC_ISM_Data4, DAC_ISM_Data5, DAC_ISM_Data6, DAC_ISM_Data7, DAC_ISM_Data8]  # FBS-Botschaft an ISM / Driving authorization checker
    DAC_TCM_Data: system-signal=[DAC_TCM_Data1, DAC_TCM_Data2, DAC_TCM_Data3, DAC_TCM_Data4, DAC_TCM_Data5, DAC_TCM_Data6, DAC_TCM_Data7, DAC_TCM_Data8]  # FBS-Botschaft an TCM / Driving authorization checker
    DPC_Master_Rq_Pr2: system-signal=[CRC_DPC_Master_Rq_Pr2, DPC_GlobalMd_Rq, DPC_Md_ABC_Carv_Rq, DPC_Md_ABC_Preview_Rq, DPC_Md_AC_Rq, DPC_Md_AS_Rq, DPC_Md_ECO_Assist_Rq, DPC_Md_eDrv_Rq, DPC_Md_ESP_Rq, DPC_Md_ExhstFlap_Rq, DPC_Md_Ht_Rq, DPC_Md_PT_Rq, DPC_Md_PwrFreeD_Plus_Rq, DPC_Md_SSA_Rq, DPC_Md_St_Rq, DPC_Md_Susp_Rq_V2, DPC_Md_SuspLvl_Rq, DPC_Md_Tx_Rq, DPC_PopupDisp_Rq, DPC_PopupSupp_Rq, Rsrv2_DPC_Master_Rq_Pr2, Rsrv3_DPC_Master_Rq_Pr2, SQC_DPC_Master_Rq_Pr2]  # Fahrprogrammwahl Master-Anforderung / Driving program control master request
    ECM_DAC_Data: system-signal=[ECM_DAC_Data1, ECM_DAC_Data2, ECM_DAC_Data3, ECM_DAC_Data4, ECM_DAC_Data5, ECM_DAC_Data6, ECM_DAC_Data7, ECM_DAC_Data8]  # FBS-Botschaft an EIS / Driving authorization checker
    ECM_OBD: system-signal=[AirFlowRate, AirPress_Manifold, AirTemp_Outsd_Sens_Flt, EngLoad_OBD, FuelPress_OBD, OBD_DrvCycCond_Stat, OBD_GnrlDenCond_PDTC_Del, OBD_GnrlDenCond_Stat, OBD_WarmupCond_Actv]  # Motorsteuergerät OBD / Engine control module OBD
    ECU_APPL_ASX_1: system-signal=[ECU_APPL_ASX_1A, ECU_APPL_ASX_1B, ECU_APPL_ASX_1C, ECU_APPL_ASX_1D, ECU_APPL_ASX_1E, ECU_APPL_ASX_1F, ECU_APPL_ASX_1G, ECU_APPL_ASX_1H]  # Applikation zu Steuergerät / Application to ECU
    ECU_APPL_ISM{1..3}: system-signal=[ECU_APPL_ISM_{1..3}A, ECU_APPL_ISM_{1..3}B, ECU_APPL_ISM_{1..3}C, ECU_APPL_ISM_{1..3}D, ECU_APPL_ISM_{1..3}E, ECU_APPL_ISM_{1..3}F, ECU_APPL_ISM_{1..3}G, ECU_APPL_ISM_{1..3}H]  # Steuergerät zu Applikation / ECU to Application
    ECU_APPL_SSP_1: system-signal=[ECU_APPL_SSP_1A, ECU_APPL_SSP_1B, ECU_APPL_SSP_1C, ECU_APPL_SSP_1D, ECU_APPL_SSP_1E, ECU_APPL_SSP_1F, ECU_APPL_SSP_1G, ECU_APPL_SSP_1H]  # Messdaten / Measurement data
    EM01_Stat1_Pr2: system-signal=[CRC_EM01_Stat1_Pr2, EM01_DC_Volt, EM01_Emg_Rq, EM01_NegTrq_Rs, EM01_PerfLim_Rq, EM01_RotDir, EM01_RPM, EM01_Trq, EM01_VehImmobSyst_Actv_Md, Rsrv1_EM01_Stat1_Pr2, SQC_EM01_Stat1_Pr2]
    EM_PtMngmnt_Pr2: system-signal=[CRC_EM_PtMngmnt_Pr2, ElecBoost_Avl, HDC_Md_Rq_EM01_V2, HDC_Slip_Rq_TCC, HDC_Trq_Rq_TCC, HDC_TxInRpm_Min_Rq, Recup_Avl, Rsrv1_EM_PtMngmnt_Rq_Pr2, Rsrv2_EM_PtMngmnt_Rq_Pr2, Rsrv3_EM_PtMngmnt_Rq_Pr2, SQC_EM_PtMngmnt_Pr2, TxHybDrvMd_Rq_ECM_V2, TxPkPosn_Rq_PNHV]
    Eng_Rq_ABC_Pr2: system-signal=[ABC_PmpTrq, CRC_Eng_Rq_ABC_Pr2, EngRPM_Rq_ABC, Rsrv1_Eng_Rq_ABC_Pr2, Rsrv2_Eng_Rq_ABC_Pr2, SQC_Eng_Rq_ABC_Pr2]  # Active Body Control Anforderung an Motorsteuergerät / Active Body Control Engine request
    Eng_Rs1_PT_Pr2: system-signal=[CRC_Eng_Rs1_PT_Pr2, EngRPM_Enbl_Rq_TCM, EngTrq_Ack_ECM, EngTrq_Enbl_Rq_TCM, EngTrqSel_AS_TTC_V2, EngTrqSel_D_TTC_V2, EngTrqSel_ESP_TTC_V2, EngTrqTrgtGr, Rsrv1_Eng_Rs1_PT_Pr2, SQC_Eng_Rs1_PT_Pr2, TrqCoord_Ifc_CPC_TCM]  # Motoransprechverhalten Powertrain Management / Engine response Powertrain management
    Eng_Rs2_PT_Pr2: system-signal=[CRC_Eng_Rs2_PT_Pr2, EngTrqMaxETC_V2, EngTrqMaxETCStatic, EngTrqMinTTC_V2, EngTrqStatic_PT_V2, Rsrv1_Eng_Rs2_PT_Pr2, Rsrv2_Eng_Rs2_PT_Pr2, Rsrv3_Eng_Rs2_PT_Pr2, SQC_Eng_Rs2_PT_Pr2]  # Motoransprechverhalten Powertrain Management / Engine response Powertrain management
    Eng_Rs3_Pr2: system-signal=[AccelPdlPosn, AccelPdlPosn_D_Raw, AccelPdlPosn_Raw, AccelPdlPosnSens_Flt, CRC_Eng_Rs3_Pr2, KickDnSw_Psd, Rsrv2_Eng_Rs3_Pr2, SQC_Eng_Rs3_Pr2, StartBrk_Rq_ECM]
    Eng_Rs4_Pr2: system-signal=[CRC_Eng_Rs4_Pr2, EngTrq_DynOffset, EngTrqMinDyn_TTC, Rsrv0_Eng_Rs4_Pr2, Rsrv1_Eng_Rs4_Pr2, SQC_Eng_Rs4_Pr2]  # Motoransprechverhalten 4 / Engine response 4
    Eng_Rs_EngCtrl_Pr2: system-signal=[AddPwrCnsmr_On_Rq, CRC_Eng_Rs_EngCtrl_Pr2, EngRPM, EngRPM_Sens_LHOM, EngRun_Stat, EngStyle, EngTrq, EngTrqLmtd_Misfire, EngTrqMaxCorrFctr, OFC_Stat_PT, Rsrv2_Eng_Rs_EngCtrl_Pr2, SQC_Eng_Rs_EngCtrl_Pr2]  # Motoransprechverhalten Engine Control / Engine response Engine Control
    EPKB_Stat_Pr2: system-signal=[BatCplSw_Rq_EPKB, BrkLgt_On_Rq, CRC_EPKB_Stat_Pr2, DynBrkMd, EPkBrk_Stat, ESP_Enbl_Rq_EPKB, PkBrk_Stat, PkBrkSw_Stat, Rsrv1_EPKB_Stat_Pr2, Rsrv2_EPKB_Stat_Pr2, Rsrv3_EPKB_Stat_Pr2, Rsrv4_EPKB_Stat_Pr2, SQC_EPKB_Stat_Pr2, TxPkPosn_Rq_EPKB]  # Status elektrische Parkbremse / Electrical parking brake state
    ESP_Disp_Rq_Pr2: system-signal=[ABS_IndLmp_On_Rq, BrkIndLmp_On_Rq_ESP, CRC_ESP_Disp_Rq_Pr2, ESP_BrkMsg_Disp_Rq, ESP_BrkMsg_Disp_TrgRq, ESP_CtrlLmp_Info, ESP_Md_Rq_Ack, ESP_Off_IndLmp_On_Rq, ESP_VDC_Msg_Disp_Rq, ESP_VDC_Msg_Disp_TrgRq, RBS_AcustWarn_Rq, RBS_IndLmp_On_Rq, RollTestMd_Rq_Ack, Rsrv1_ESP_Disp_Rq_Pr2, SQC_ESP_Disp_Rq_Pr2]  # Anzeige ESP / ESP display request
    EVC_CfgBit_01_32_Pr2: system-signal=[CRC_EVC_CfgBit_01_32_Pr2, EVC_01_Ver_USA_Avl, EVC_02_Ver_Mexico_Avl, EVC_03_Ver_Japan_Avl, EVC_04_Ver_GulfStates_Avl, EVC_05_Ver_Australia_Avl, EVC_06_Ver_China_Avl, EVC_07_Ver_S_Korea_Avl, EVC_08_Ver_Canada_Avl, EVC_09_FullHyb_Avl, EVC_0A_Hyb_20kW_Avl, EVC_0B_PlugInHyb_80kW_Avl, EVC_0C_AllWheelDr_Avl, EVC_0D_4x2Drive_Avl, EVC_0E_Presf_Avl, EVC_0F_TrlrHtch_Avl, EVC_10_KG_Avl, EVC_11_AutTrunkLid_Avl, EVC_12_AutRearDr_Avl, EVC_13_PwrCls_Avl, EVC_14_RainSens_Avl, EVC_15_DRLt_Avl, EVC_16_FogLmp_Avl, EVC_17_IL_Pk_Avl, EVC_18_AmbLgt_Avl, EVC_19_ElDrPosnSel_Avl, EVC_1A_IntSfProt_Avl, EVC_1B_VTA_Avl, EVC_1C_HghVTP_Avl, EVC_1D_SecurityVer_Avl, EVC_1E_GuardLvl_B4_Avl, EVC_1F_GuardLvl_B6_Avl, EVC_20_GuardLvl_B7_Avl, EVC_21_Pullman_Avl, EVC_22_SpecClos_Avl, EVC_23_PASS_Avl, EVC_24_ICH_Avl, EVC_25_HVAC_R_Avl, EVC_26_SSA_Avl, EVC_27_HandsFreeAcc_Avl, EVC_28_PlugInHyb_50kW_Avl, EVC_29_Hyb_30kW_Avl, EVC_2A_SeatElAdj_F_OprtnR_Avl, EVC_2B_DSI_Sel_Avl, EVC_2C_WC_VEDA_Avl, EVC_2D_AutoSpdCtrl_Avl, EVC_2E_AddEquipBlock_Avl, EVC_2F_AddEquip_Avl, EVC_30_AddEquip_Avl, EVC_31_AddEquip_Avl, EVC_32_AddEquip_Avl, EVC_CfgBit_01_32_Stat, SQC_EVC_CfgBit_01_32_Pr2]  # EVC-CfgMessage[Bitfeld:01h-32h] / EVC-CfgMessage[Bitfield:01h-32h]
    EVC_CfgBit_33_64_Pr2: system-signal=[CRC_EVC_CfgBit_33_64_Pr2, EVC_33_EmgOpn_F_Avl, EVC_34_Curtain_F_Avl, EVC_35_EmgOpn_Inact, EVC_36_SpecVehPW_FL_Avl, EVC_37_SpecVehPW_FR_Avl, EVC_38_SpecVehPW_RL_Avl, EVC_39_SpecVehPW_RR_Avl, EVC_3A_RB_F_Avl, EVC_3B_RB_R_Avl, EVC_3C_SeatDrvDyn_Ft_Avl, EVC_3D_ComfHdRst_Ft_Avl, EVC_3E_SeatMultiCont_Ft_Avl, EVC_3F_SeatHt_Ft_Avl, EVC_40_SeatClim_Ft_Avl, EVC_41_SeatMem_LHD_Avl, EVC_42_SeatMem_RHD_Avl, EVC_43_SeatMemPk_Avl, EVC_44_ReclSeat_Avl, EVC_45_SeatMultiCont_R_Avl, EVC_46_SeatBkRstAdj_R_Avl, EVC_47_SeatHt_R_Avl, EVC_48_SeatClim_R_Avl, EVC_49_WShWashHt_Avl, EVC_4A_TaxiPwrSup_Avl, EVC_4B_TaxiRoofLmpCon_Avl, EVC_4C_TaxiEmgAlm_Avl, EVC_4D_RadioHdFree_Avl, EVC_4E_GAS_Avl, EVC_4F_CtrlU_MultiFunc_Avl, EVC_50_TaxInMirr_Avl, EVC_51_DistRecInMirr_Avl, EVC_52_PreInstRad_Avl, EVC_53_VehHandi_Avl, EVC_54_PanelHt_Ft_Avl, EVC_55_SeatComfHt_Ft_Avl, EVC_56_SeatComfHt_R_Avl, EVC_57_IntFoldHdRst_Ft_Avl, EVC_58_SeatInd_R_Avl, EVC_59_SeatChauffPos_P_Avl, EVC_5A_SeatMContMass_Ft_Avl, EVC_5B_PanelHt_R_Avl, EVC_5C_Airscarf_Ft_Avl, EVC_5D_SeatLimit_P_Avl, EVC_5E_TaxiRoofLmp_Avl, EVC_5F_SeatElAdj_LHD_Avl, EVC_60_SeatElAdj_RHD_Avl, EVC_61_AMGPerfSusp_Avl, EVC_62_ShiftExhstSys_Avl, EVC_63_ActvLDA_MPC_Avl, EVC_64_EAS_Avl, EVC_CfgBit_33_64_Stat, SQC_EVC_CfgBit_33_64_Pr2]  # EVC-CfgMessage[Bitfeld:33h-64h] / EVC-CfgMessage[Bitfield:33h-64h]
    EVC_CfgBit_65_96_Pr2: system-signal=[CRC_EVC_CfgBit_65_96_Pr2, EVC_65_CruiseCtrl_Avl, EVC_66_OffRoadPk_Avl, EVC_67_CMS_Avl, EVC_68_CMS_R_Avl, EVC_69_BrkEngg_PP_Avl, EVC_6A_BasExtd_Avl, EVC_6B_MirrFld_Avl, EVC_6C_BSM_Avl, EVC_6D_ActvBSM_Avl, EVC_6E_TurnAss_Avl, EVC_6F_ADTR_Avl, EVC_70_DTR_Pro_Avl, EVC_71_ALS_Avl, EVC_72_ActvLDA_Avl, EVC_73_FCW_Avl, EVC_74_LaneRec_Avl, EVC_75_NV_Avl, EVC_76_RoadSignDtct_Avl, EVC_77_RVC_Avl, EVC_78_SurrView_Avl, EVC_79_PTS_Avl, EVC_7A_APG_Avl, EVC_7B_ActPKAS_Avl, EVC_7C_IHC_Avl, EVC_7D_IHC_Plus_Avl, EVC_7E_BasPlusQ_Avl, EVC_7F_ECO_St_Avl, EVC_80_PSTS_Avl, EVC_81_ABC_Avl, EVC_82_SteelAirSusp_Avl, EVC_83_AirSemiActv_Susp_Avl, EVC_84_SportSusp_Avl, EVC_85_SportPk_AMG_Avl, EVC_86_SportPk_Avl, EVC_87_SportPk_Ext_Avl, EVC_88_DualView_Avl, EVC_89_Entertain_R_Avl, EVC_8A_DigTV_Avl, EVC_8B_DAB_Tun_Avl, EVC_8C_MTUS_Avl, EVC_8D_UCI_Avl, EVC_8E_SndSys_Avl, EVC_8F_WShViewWin_Avl, EVC_90_WSh_Clr_Avl, EVC_91_WSh_Ht_Avl, EVC_92_WShBL_Prot_Avl, EVC_93_WSh_Ht_Lcut_Avl, EVC_94_OptPack_Clas_Avl, EVC_95_OptPack_Avan_Avl, EVC_96_OptPack_Eleg_Avl, EVC_CfgBit_65_96_Stat, SQC_EVC_CfgBit_65_96_Pr2]  # EVC-CfgMessage[Bitfeld:65h-96h] / EVC-CfgMessage[Bitfield:65h-96h]
    EVC_CfgList_01_0C_Pr2: system-signal=[CRC_EVC_CfgList_01_0C_Pr2, EVC_CfgList_01_0C_Stat, EVC_List01_StStyle, EVC_List02_BodyStyle, EVC_List03_RoofStyle, EVC_List04_HL_Style, EVC_List05_TxStyle, EVC_List06_VehLineYear, EVC_List07_HVAC_Style, EVC_List08_Country, EVC_List09_HU_Style, EVC_List0A_TPM_Style, EVC_List0B_AddEquip, EVC_List0C_VehLine, SQC_EVC_CfgList_01_0C_Pr2]  # EVC-CfgMessage[Listen:01h-0Ch] / EVC-CfgMessage[Lists:01h-0Ch]
    FFAP_DbPls_Rq: system-signal=[FFAP_DbPls_IntrmLgth_Rq, FFAP_DbPlsI_Force_Max_Rq, FFAP_DbPlsTrgr_Rq]
    FFAP_SignalAttr_Rq: system-signal=[FFAP_AmpliFctr_Rq, FFAP_Freq_Rq, FFAP_SigFormat_Rq]  # FFAP Signaleigenschaften / FFAP Signal attribute request
    Fuel_Rq_Pr2: system-signal=[CRC_Fuel_Rq_Pr2, FuelLowPress_Sys_Rq, FuelPress_Rq, Rsrv1_Fuel_Rq_Pr2, Rsrv2_Fuel_Rq_Pr2, SQC_Fuel_Rq_Pr2]  # Fuel Request
    HVAC_CompTrq_Pr2: system-signal=[CRC_HVAC_CompTrq_Pr2, HVAC_CompTrq_Ft, Rsrv1_HVAC_Comp_Trq_Pr2, SQC_HVAC_CompTrq_Pr2]  # KLimaanlage Kompressormoment / HVAC compressor torque
    Ign_Stat_Pr2: system-signal=[CRC_Ign_Stat_Pr2, EngSt_Enbl_Rq_KG, ESL_Lk_Rq, Ign_On_StartProc_Inact, ISw_Stat, KG_IgnCtrl_Actv, KG_StartSw_Psd, RemSt_IgnCtrl_Actv, RemSt_IgnCtrl_Info, SPCR_AcustWarn_Rq_EIS, SPCR_Conf_EIS, SPCR_Flt_EIS, SQC_Ign_Stat_Pr2, TxPkPosn_Emg_Rq, TxPkPosn_Rq, TxPkPosn_Rq_SPCR_Enbl, TxPkPosnAuto_Enbl]  # Zündungsstatus / Ignition state
    ISM_DAC_Data: system-signal=[ISM_DAC_Data1, ISM_DAC_Data2, ISM_DAC_Data3, ISM_DAC_Data4, ISM_DAC_Data5, ISM_DAC_Data6, ISM_DAC_Data7, ISM_DAC_Data8]  # FBS-Botschaft an EIS / Driving authorization checker
    ISM_TxDrvPosn_Disp_Rq_Pr2: system-signal=[CRC_ISM_TxDrvPosn_Disp_Rq_Pr2, Rsrv3_ISM_TxDrvPosn_Disp_Rq_Pr2, SBW_ShiftLk_Msg_RevGr_ISM, SQC_ISM_TxDrvPosn_Disp_Rq_Pr2, TxDrvPosn_Disp_Rq_ISM]  # Anforderung Anzeige Getriebefahrstufe / Transmission driving position display request
    LDC_Disp_Rq_ESP: system-signal=[LDC_AcustWarn_Rq, LDC_DTR_MM_Ctrl_Actv, LDC_DTR_MsgDisp_Rq, LDC_DTR_Stat, LDC_IconDisp_Rq_ESP, LDC_Master, LDC_MsgDisp_Rq, LDC_MsgDisp_TrgrRq, LDC_Spd_Add, LDC_Spd_Dsr, LDC_SpdUnit_Rs, LDC_SPEEDO_SegRing_Disp_Rq, LDC_VSL_On, LDC_WTSL_Flt, LDC_WTSL_MsgDisp_Rq, LDC_WTSL_Spd_Max_Disp_TrgrRq, LDC_WTSL_Spd_Max_Stat]  # Anforderung Display-Anzeigen Längsregler / Longitudinal controller display request
    LDC_Disp_Rq_RDU_V2: system-signal=[LDC_AcustWarn_Rq_RDU, LDC_CMS_MsgDisp_Rq_RDU, LDC_CMS_Stat_RDU, LDC_CMS_Warn_MsgDisp_Rq_RDU, LDC_Dist_Dsr_RDU, LDC_Dist_RDU, LDC_DTR_IndLmp_On_Rq_RDU, LDC_DTR_MsgDisp_Rq_RDU, LDC_DTR_Stat_RDU_V2, LDC_IconDisp_Rq_RDU, LDC_MsgDisp_Rq_RDU, LDC_MsgDisp_TrgrRq_RDU, LDC_RadarSensSoil_Disp_Rq_RDU, LDC_Spd_Add_RDU, LDC_Spd_Dsr_RDU, LDC_SpdUnit_Rs_RDU, LDC_SPEEDO_SegRing_Disp_Rq_RDU, TSA_Warn_Supp_Rq_RDU]  # Anforderung Display-Anzeigen Längsregler / Longitudinal controller display request
    LDC_Rq_SCCM_Pr2: system-signal=[CRC_LDC_Rq_SCCM_Pr2, DTR_Dist_Rq, Rsrv1_LDC_Rq_SCCM_Pr2, Rsrv2_LDC_Rq_SCCM_Pr2, SpdCtrlLvr_Stat_V3, SQC_LDC_Rq_SCCM_Pr2, VSL_Enbl_Rq]  # SCCM-Anforderungen Längsregler / Longitudinal controller request by SCCM
    Meas_SSP: system-signal=[Meas_SSP_1A, Meas_SSP_1B, Meas_SSP_1C, Meas_SSP_1D, Meas_SSP_1E, Meas_SSP_1F, Meas_SSP_1G, Meas_SSP_1H]  # Messdaten / Measurement data
    Mess_TCM_HS{1..8}_AR: system-signal=[MESS_TCM_HS{1..8}_B1_AR, MESS_TCM_HS{1..8}_B2_AR, MESS_TCM_HS{1..8}_B3_AR, MESS_TCM_HS{1..8}_B4_AR, MESS_TCM_HS{1..8}_B5_AR, MESS_TCM_HS{1..8}_B6_AR, MESS_TCM_HS{1..8}_B7_AR, MESS_TCM_HS{1..8}_B8_AR]  # Messdaten / Measurement data
    Mess_TCM_HSA_AR: system-signal=[MESS_TCM_HSA_B1_AR, MESS_TCM_HSA_B2_AR, MESS_TCM_HSA_B3_AR, MESS_TCM_HSA_B4_AR, MESS_TCM_HSA_B5_AR, MESS_TCM_HSA_B6_AR, MESS_TCM_HSA_B7_AR, MESS_TCM_HSA_B8_AR]  # Messdaten / Measurement data
    Mess_TCM_HSB_AR: system-signal=[MESS_TCM_HSB_B1_AR, MESS_TCM_HSB_B2_AR, MESS_TCM_HSB_B3_AR, MESS_TCM_HSB_B4_AR, MESS_TCM_HSB_B5_AR, MESS_TCM_HSB_B6_AR, MESS_TCM_HSB_B7_AR, MESS_TCM_HSB_B8_AR]  # Messdaten / Measurement data
    Mess_TCM_HSC_AR: system-signal=[MESS_TCM_HSC_B1_AR, MESS_TCM_HSC_B2_AR, MESS_TCM_HSC_B3_AR, MESS_TCM_HSC_B4_AR, MESS_TCM_HSC_B5_AR, MESS_TCM_HSC_B6_AR, MESS_TCM_HSC_B7_AR, MESS_TCM_HSC_B8_AR]  # Messdaten / Measurement data
    Mess_TCM_HSD_AR: system-signal=[MESS_TCM_HSD_B1_AR, MESS_TCM_HSD_B2_AR, MESS_TCM_HSD_B3_AR, MESS_TCM_HSD_B4_AR, MESS_TCM_HSD_B5_AR, MESS_TCM_HSD_B6_AR, MESS_TCM_HSD_B7_AR, MESS_TCM_HSD_B8_AR]  # Messdaten / Measurement data
    Mess_TCM_HSE_AR: system-signal=[MESS_TCM_HSE_B1_AR, MESS_TCM_HSE_B2_AR, MESS_TCM_HSE_B3_AR, MESS_TCM_HSE_B4_AR, MESS_TCM_HSE_B5_AR, MESS_TCM_HSE_B6_AR, MESS_TCM_HSE_B7_AR, MESS_TCM_HSE_B8_AR]  # Messdaten / Measurement data
    Mess_TCM_HSF_AR: system-signal=[MESS_TCM_HSF_B1_AR, MESS_TCM_HSF_B2_AR, MESS_TCM_HSF_B3_AR, MESS_TCM_HSF_B4_AR, MESS_TCM_HSF_B5_AR, MESS_TCM_HSF_B6_AR, MESS_TCM_HSF_B7_AR, MESS_TCM_HSF_B8_AR]  # Messdaten / Measurement data
    Mess_TCM_HSG_AR: system-signal=[MESS_TCM_HSG_B1_AR, MESS_TCM_HSG_B2_AR, MESS_TCM_HSG_B3_AR, MESS_TCM_HSG_B4_AR, MESS_TCM_HSG_B5_AR, MESS_TCM_HSG_B6_AR, MESS_TCM_HSG_B7_AR, MESS_TCM_HSG_B8_AR]  # Messdaten / Measurement data
    Mess_TCM_HSH_AR: system-signal=[MESS_TCM_HSH_B1_AR, MESS_TCM_HSH_B2_AR, MESS_TCM_HSH_B3_AR, MESS_TCM_HSH_B4_AR, MESS_TCM_HSH_B5_AR, MESS_TCM_HSH_B6_AR, MESS_TCM_HSH_B7_AR, MESS_TCM_HSH_B8_AR]  # Messdaten / Measurement data
    OC_P_ORC_Stat: system-signal=[OC_P_Flt_ORC, OC_P_ORC]  # Status Sitzbelegungserkennung Beifahrer / Occupant classification passenger state
    PARK_Drv_Rq_ESP_Pr2: system-signal=[CRC_PARK_Drv_Rq_ESP_Pr2, PARK_DrvDir_Rq_ESP, PARK_DrvDir_Stat_ESP, PARK_ShiftLk_Rq_ESP, PT_AS_Actv, Rsrv1_PARK_Drv_Rq_ESP_Pr2, Rsrv2_PARK_Drv_Rq_ESP_Pr2, Rsrv3_PARK_Drv_Rq_ESP_Pr2, Rsrv4_PARK_Drv_Rq_ESP_Pr2, SQC_PARK_Drv_Rq_ESP_Pr2]  # PARK fordert ESP an / PARK Requests ESP
    PARK_Drv_Rs_TCM_Pr2: system-signal=[CRC_PARK_Drv_Rs_TCM_Pr2, PARK_DrvDir_Stat_TCM, Rsrv1_PARK_Drv_Rs_TCM_Pr2, Rsrv2_PARK_Drv_Rs_TCM_Pr2, SQC_PARK_Drv_Rs_TCM_Pr2, TCM_Dir_Stat]  # TCM Antwort an PARK / TCM response to PARK
    ParkCfg_Stat_Pr2: system-signal=[CRC_ParkCfg_Stat_Pr2, ParkGuid_Stat, ParkStyle_V2, Rsrv1_ParkCfg_Stat_Pr2, Rsrv2_ParkCfg_Stat_Pr2, SQC_ParkCfg_Stat_Pr2]
    PdlPosn_OBD: system-signal=[AccelPdlPosn_OBD, AccelPdlPosn_Red_OBD]  # Redundanter Pedalwert / accelerator pedal position
    PN14_Gen_Stat: system-signal=[GenLoad, PN14_GenExctCurr]  # Powernet 14V generator status
    PN14_SupBat_Stat: system-signal=[PN14_SupBat_Curr, PN14_SupBat_Volt, PN14_SupBatCutSw_Stat]  # Bordnetz 14V Status Verbraucherbatterie / Powernet 14V Supply battery status
    PN14_TDP_Stat: system-signal=[PN14_TDP_PreWarn_Tm, PN14_TDP_Sw_Stat]  # Status Tiefentladeschutz 14V Bordnetz / Powernet 14V total discharge protection switch state
    PT_Rq_ESP_Pr2: system-signal=[ActvDnShift_Rq_AS, CRC_PT_Rq_ESP_Pr2, DynFLDS_Supp_Rq_AS, EngTrq_Rq_ESP, EngTrq_Rq_RBS, EngTrqMax_Rq_ESP, EngTrqMax_Rq_RBS, EngTrqMin_Rq_ESP, EngTrqMin_Rq_RBS, GrMax_Rq_ESP_V2, GrMin_Rq_ESP_V2, GrMinMax_Rq_DTR, PwrFreeD_Supp_Rq_AS, RDU_Enbl_Rq, RecupEnbl_RBS, ShftChrDsp_Rq_AS, SQC_PT_Rq_ESP_Pr2, SSA_DsablPrmnt_Rq_ESP, SSA_Enbl_Rq_ESP, WhlSlpRecup]  # Antriebsstrang-Request / Powertrain request
    PT_Stat_Pr2: system-signal=[CRC_PT_Stat_Pr2, PT_Rdy_V2, SQC_PT_Stat_Pr2, SSA_Standby_Stat]  # Powertrain status / Powertrain stat
    PtMngmnt_Rq_Pr2: system-signal=[CRC_PtMngmnt_Rq_Pr2, GrMax_Rq_ECM_V2, GrMin_Rq_ECM_V2, Recup_Dsabl_Rq_PT, Rsrv1_PtMngmnt_Rq_Pr2, Rsrv2_PtMngmnt_Rq_Pr2, SQC_PtMngmnt_Rq_Pr2, SSA_EngSp, SSA_Sp_Warn, TxPkPosn_Rq_ECM]  # Anforderung vom Powertrain Management / Request from Powertrain management
    PtMngmnt_Stat2_Pr2: system-signal=[CRC_PtMngmnt_Stat2_Pr2, EM2_BoostTrqMax_TCM, HDC_GrdntMd_Rq_WDC, HDC_NoShiftDwn_Rq, PushStrtCtl_Rq_CPC, Rsrv1_PtMngmnt_Stat2_Pr2, SQC_PtMngmnt_Stat2_Pr2, WDC_OutTrq_Rq_ECM_V3]  # Powertrain Management Status #2 / Powertrain Management State 2
    PW_FL_Stat_V2: system-signal=[PW_FL_Bl, PW_FL_LS_Stat, PW_FL_Norm, PW_FL_Posn_Stat, PW_FL_Posn_V2, PW_FL_SS, PW_Oprtn_Actv_FL, Win_FL_CT_Oprtn_Enbl, Win_RL_SS_Rq_Dr_FL, WinThermProt_FL_Actv]
    PW_FR_Stat_V2: system-signal=[PW_FR_Bl, PW_FR_LS_Stat, PW_FR_Norm, PW_FR_Posn_Stat, PW_FR_Posn_V2, PW_FR_SS, PW_Oprtn_Actv_FR, Win_FR_CT_Oprtn_Enbl, Win_RR_SS_Rq_Dr_FR, WinThermProt_FR_Actv]
    PW_RL_Stat_V2: system-signal=[PW_Oprtn_Actv_RL, PW_RL_Bl, PW_RL_LS_Stat, PW_RL_Norm, PW_RL_Posn_Stat, PW_RL_Posn_V2, PW_RL_SS, Win_RL_CT_Oprtn_Enbl, Win_RL_SS_Rq_Dr_RL, WinThermProt_RL_Actv]
    PW_RR_Stat_V2: system-signal=[PW_Oprtn_Actv_RR, PW_RR_Bl, PW_RR_LS_Stat, PW_RR_Norm, PW_RR_Posn_Stat, PW_RR_Posn_V2, PW_RR_SS, Win_RR_CT_Oprtn_Enbl, Win_RR_SS_Rq_Dr_RR, WinThermProt_RR_Actv]
    ROE_ASX: system-signal=[ROE_DTC_ASX, ROE_DTC_Stat_ASX, ROE_Header_ASX]  # RoE-lite / RoE lite
    ROE_AWD: system-signal=[ROE_DTC_AWD, ROE_DTC_Stat_AWD, ROE_Header_AWD]  # RoE-lite / RoE lite
    ROE_FFAP: system-signal=[ROE_DTC_FFAP, ROE_DTC_Stat_FFAP, ROE_Header_FFAP]  # RoE-lite / RoE lite
    ROE_FSCM: system-signal=[ROE_DTC_FSCM, ROE_DTC_Stat_FSCM, ROE_Header_FSCM]  # RoE-lite / RoE lite
    ROE_ISM: system-signal=[ROE_DTC_ISM, ROE_DTC_Stat_ISM, ROE_Header_ISM]  # RoE-lite / RoE lite
    ROE_TCM: system-signal=[ROE_DTC_Stat_TCM, ROE_DTC_TCM, ROE_Header_TCM]  # RoE-lite / RoE lite
    SBW_Drv_Pk_Posn_CPC_Pr2: system-signal=[CRC_SBW_Drv_Pk_Posn_CPC_Pr2, Rsrv0_SBW_Drv_Pk_Posn_CPC_Pr2, Rsrv1_SBW_Drv_Pk_Posn_CPC_Pr2, SBW_Msg_Disp_Rq_CPC, SQC_SBW_Drv_Pk_Posn_CPC_Pr2, TCM_PkPosn_Flt_Stat_CPC, TxDrvPosn_Disp_Rq_CPC]
    SBW_Drv_Pk_Posn_TCM_Pr2: system-signal=[CRC_SBW_Drv_Pk_Posn_TCM_Pr2, SBW_ShiftLk_Msg_RevGr_TCM, SQC_SBW_Drv_Pk_Posn_TCM_Pr2, TCM_PkPosn_Flt_Stat, TxDrvPosn_Disp_Rq_TCM]
    SBW_Rq_DRVU_Pr2: system-signal=[CRC_SBW_Rq_DRVU_Pr2, Rsrv1_SBW_Rq_DRVU_Pr2, Rsrv2_SBW_Rq_DRVU_Pr2, SQC_SBW_Rq_DRVU_Pr2, StW_Sw_Stat3_DRVU, TSL_P_Psd_StW_DRVU, TSL_RND_Posn_StW_DRVU, TxmtId_SBW_Rq_DRVU]  # DRVU-Anforderungen Shift by Wire / Shift by wire request by DRVU
    SBW_Rq_SCCM_Pr2: system-signal=[CRC_SBW_Rq_SCCM_Pr2, Rsrv1_SBW_Rq_SCCM_Pr2, Rsrv2_SBW_Rq_SCCM_Pr2, SQC_SBW_Rq_SCCM_Pr2, StWhl_Sw_Stat3, TSL_P_Psd_StW, TSL_RND_Posn_StW, TxmtId_SBW_Rq_SCCM]  # SCCM-Anforderungen Shift by Wire / Shift by wire request by SCCM
    SBW_Rs_TCM_Pr2: system-signal=[CRC_SBW_Rs_TCM_Pr2, Rsrv1_SBW_Rs_TCM_Pr2, Rsrv2_SBW_Rs_TCM_Pr2, SBW_Ext_RevGr_Rq, SBW_ShiftLk_RevGr, SQC_SBW_Rs_TCM_Pr2, StartLkSw, TSL_Posn_Rq, TxmtId_SBW_Rs_TCM, TxSelVlvPosn]  # Shift by Wire Response TCM
    SBW_Stat_Pr2: system-signal=[CRC_SBW_Stat_Pr2, EmgPath_Enbl, EmgPath_Volt, ISM_LHOM, Key_P_Enbl, Rsrv1_SBW_Stat_Pr2, SHW_MnTrctAxl_D_DrvPosn_Enbl, SHW_MnTrctAxl_DrvPosn_Tgt_Rq_TCM, SHW_MnTrctAxl_Flt1, SHW_MnTrctAxl_Flt2, SHW_MnTrctAxl_Flt3, SHW_MnTrctAxl_Flt4, SHW_MnTrctAxl_Flt5, SHW_MnTrctAxl_Flt6, SHW_MnTrctAxl_Flt7, SHW_MnTrctAxl_Flt8, SHW_MnTrctAxl_N_DrvPosn_Enbl, SHW_MnTrctAxl_P_DrvPosn_Enbl, SHW_MnTrctAxl_R_DrvPosn_Enbl, SPCR_Dsabl_Rq_ISM, SQC_SBW_Stat_Pr2, TSL_Posn_ISM, TSL_Posn_ISM_Init, TSL_Posn_P_ISM, TSL_Posn_Target, TSL_ShiftLk_Stat, TxN_Posn_Rq_D_V2, TxPkPosn_Emg_Actv]  # Shift by wire status
    SHW_Rq2_Pr2: system-signal=[CRC_SHW_Rq2_Pr2, Key_P_Enbl_CPC, PARK_DrvDir_Stat_CPC, Rsrv0_SHW_Rq2_Pr2, ShW_DrvPosn_PRND_Lever_CPC, SHW_Emg_P_Path_Rq, SHW_MnTrctAxl_D_Allowed, SHW_MnTrctAxl_DrvPosn_Imm_Rq, SHW_MnTrctAxl_DrvPosn_N_Actv_Rq, SHW_MnTrctAxl_DrvPosn_Target_Rq, SHW_MnTrctAxl_N_Allowed, SHW_MnTrctAxl_P_Allowed, SHW_MnTrctAxl_R_Allowed, ShW_MnTrctAxl_ShiftLk_Stat, SPCR_Dsabl_Rq_CPC, SQC_SHW_Rq2_Pr2, TxLHOM_Stat_Rq_CPC]  # Shift By Wire Request
    StWhl_Angl_Stat_Pr2: system-signal=[CRC_StWhl_Angl_Stat_Pr2, Rsrv2_StWhl_Angl_Stat_Pr2, Rsrv3_StWhl_Angl_Stat_Pr2, SQC_StWhl_Angl_Stat_Pr2, StWhl_Angl, StWhl_AnglSens_Id, StWhl_AnglSens_Stat, StWhl_AnglSensVld_Stat, StWhl_AnglSpd]  # Lenkradwinkel / Steering wheel angle
    TCM_DAC_Data: system-signal=[TCM_DAC_Data1, TCM_DAC_Data2, TCM_DAC_Data3, TCM_DAC_Data4, TCM_DAC_Data5, TCM_DAC_Data6, TCM_DAC_Data7, TCM_DAC_Data8]  # FBS-Botschaft an EIS / Driving authorization checker
    TCM_Data2_Pr2: system-signal=[CRC_TCM_Data2_Pr2, EM_BoostTrq_Rq_TCM, EngWhlTrqRatio_TCM, Gr, Gr_Target, SQC_TCM_Data2_Pr2, SSA_Enbl_Rq_TCM, SSA_Enbl_Stat_TCM, TSL_Posn_TCM, TxDrvTrqAbsVal]  # TCM Data 2 / TCM Date 2
    TCM_Data3_Pr2: system-signal=[CRC_TCM_Data3_Pr2, EngTrqMax_Rq_TCM, EngTrqMin_Rq_TCM, SQC_TCM_Data3_Pr2, Tx_Safe_Cls, TxOutRPM_Plaus, TxOutRPM_V2, TxTurbineRPM_V2]  # TCM Rpms
    TCM_Data5_Pr2: system-signal=[CRC_TCM_Data5_Pr2, Rsrv0_TCM_Data5_Pr2, SQC_TCM_Data5_Pr2, Trq_Offset_Temp_PT_Ovl]  # TCM Data 5 / TCM Date 5
    TCM_Disp_Rq_AMG: system-signal=[TCM_TxLED_Disp_Rq, TCM_TxShift_Disp_Rq, TxBurnOut_Stat]  # TCM Display Anforderung (nur AMG) / TCM display request (only AMG)
    TCM_EngIntrvntn_Pr2: system-signal=[BrkRq_TCM, CRC_TCM_EngIntrvntn_Pr2, EngRPM_Ctrl_Rq, EngRPM_Rq_TCM, EngSt_Enbl_Rq_TCM, EngTrq_Rq_TCM_V2, EngTrqMax_Rq_TCM, EngTrqMin_Rq_TCM, IntrvntnMd_TCM, SQC_TCM_EngIntrvntn_Pr2, SSA_Clutch_Stat, TC_Trq, TccPushStrtCtl_TCM, Tx_Safe_Cls, TxHybDrvMd_Sync_Actv, TxHybDrvMd_V2, TxOutRPM_Plaus, WDC_Boost_Dsabl]  # TCM Engine Intervention Signalgroup
    TCM_WDC_Data_Pr2: system-signal=[Converter_TempCritic, CRC_TCM_WDC_Data_Pr2, DrvAccelMax_Stat, EngTrqMax_WDC_Rq_TCM, EngTrqMin_WDC_Rq_TCM, EngTrqWDC_Rq_TCM_V2, Rsrv3_TCM_WDC_Data_Pr2, SQC_TCM_WDC_Data_Pr2, TCC_TempCritic, TxSlp_Stat, VehCreep_Actv, WDC_IntrvntnMd_TCM, WDC_Stat, WDC_TempCritic, WDC_Trq_V2, WDC_TrqPreCtrl]
    TrqConv_Pr2: system-signal=[CRC_TrqConv_Pr2, Rsrv0_TrqConv_Pr2, SQC_TrqConv_Pr2, TrqConv_Amp_Fact, TrqConv_Pmp_Trq]  # Torque Converter
    TSSR_Stat: system-signal=[TSSR_Ft_Posn, TSSR_Ft_RB_Stat, TSSR_Ft_Stat, TSSR_R_RB_Stat]
    Tx_Rq_PtMngmnt_ECM_Pr2: system-signal=[CRC_Tx_Rq_PtMngmnt_ECM_Pr2, Creep_Off_Rq, ECM_LHOM_Stat, EngExhstAfterTreat_Actv, EngTrqMaxNxtGr, Gr1_Rq_ECM, OFC_Decel_Rdy, Rsrv4_Tx_Rq_PtMngmnt_ECM_Pr2, ShftChrDsp_Rq, SQC_Tx_Rq_PtMngmnt_ECM_Pr2, TCC_Rq]  # Schaltanforderung von Powertrain Management / Transmission request from Powertrain management
    TxLHOM2_Stat: system-signal=[TxLHOM2_Gr_Hold, TxLHOM2_Gr_Lock, TxLHOM2_Stat_Clutch, TxLHOM2_Stat_Hybrid, TxLHOM2_Stat_OilPump, TxLHOM2_TX_Hydr, TxLHOM2_TX_PwrFree, TxLHOM2_TX_Tractn]  # Status Getriebenotlauf / Transmission limp-home operation mode state
    VehDyn_Stat1_Pr2: system-signal=[CRC_VehDyn_Stat1_Pr2, Rsrv1_VehDyn_Stat1_Pr2, SPCR_Excpt_Rq_V2, SPCR_Md, SPCR_Sp_Stat, SQC_VehDyn_Stat1_Pr2, VehAccel_X_Offset, VehAccel_X_Qual, VehAccel_X_V2, VehAccel_Y_Offset, VehAccel_Y_Qual, VehAccel_Y_V2]  # Fahrdynamik-Status / Vehicle dynamics state
    VehDyn_Stat2_Pr2: system-signal=[BrkTrq_R, CRC_VehDyn_Stat2_Pr2, EPKB_Enbl_Rq, HSA_Sys_Flt, PkBrk_Rq_SPCR, SPCR_AS_Dsabl, SPCR_AS_Off_Rq, SPCR_Style, SPCR_Veh_Immo, SQC_VehDyn_Stat2_Pr2, TxPkPosn_Rq_SPCR, VehYawRate_Raw, VehYawRate_Raw_Qual, VehYawRateOffset_V2]  # Fahrdynamik-Status / Vehicle dynamics state
    VIN: system-signal=[VIN_Data1, VIN_Data2, VIN_Data3, VIN_Data4, VIN_Data5, VIN_Data6, VIN_Data7, VIN_MsgPart]  # Fahrzeug-Identnummer / Vehicle Identification Number
    Whl_Lt_Stat_Pr2: system-signal=[CRC_Whl_Lt_Stat_Pr2, SQC_Whl_Lt_Stat_Pr2, WhlDir_FL_Stat, WhlDir_RL_Stat, WhlPlsCnt_FL, WhlPlsCnt_RL, WhlRPM_FL, WhlRPM_FL_Qual, WhlRPM_RL, WhlRPM_RL_Qual]  # Status Räder links / Left wheels state
    Whl_Rt_Stat_Pr2: system-signal=[CRC_Whl_Rt_Stat_Pr2, SQC_Whl_Rt_Stat_Pr2, WhlDir_FR_Stat, WhlDir_RR_Stat, WhlPlsCnt_FR, WhlPlsCnt_RR, WhlRPM_FR, WhlRPM_FR_Qual, WhlRPM_RR, WhlRPM_RR_Qual]  # Status Räder rechts / Right wheels state
package /CONSTANTS
  465 x constant specification:
    XDIS_3tke51neyh9tc3i280hit3n6t
      value:
        integer literal l255: type=c08_Nm_0_63k5_0k25, value=255
    XDIS_awwfd0w7q1wwqc5hdwlnvws3e
      value:
        integer literal lOFF: type=c02_Lgt_Off_Cont_Blink, value=0
    XDIS_m57vh5549mw8mqr4231e8x8w
      value:
        integer literal l255: type=c08_perc_0_100_0k4, value=255
    XDIS_6nwcppt78y5a4afdqmccomosu
      value:
        integer literal l0: type=c08_perc_0_100_0k3922_nSNA, value=0
    XDIS_h5tcyk98kzbgrc5svasomeyt
      value:
        boolean literal lfalse: type=DC_BOOL, value=false
    XDIS_dnf6hhyeye1ebcwx2imhebqum
      value:
        integer literal l7: type=c03_Act_DynFct_Rq_DS, value=7
    XDIS_5sfhqiu7nz4478bnqecv2gpz3
      value:
        integer literal lSPORT_COMFORT_OFF: type=c02_ADC_SwLED_Rq_V2, value=0
    XDIS_9c2ktvv4dqi4a8yers35z0afm
      value:
        integer literal l0: type=c16_g_p_s_0_655k34_0k01_nSNA, value=0
    XDIS_c5xycso0vrr1p5epixucixwbx
      value:
        integer literal l0: type=c08_kPa_0_254_1, value=0
    XDIS_2fhjzhyzrl6fjzklwzp7lg8jy
      value:
        integer literal l255: type=c08_hPa_0_1980_7k8, value=255
    XDIS_6xus7h4johp7w01aac5miev9n
      value:
        integer literal l255: type=c08_degC_m40_85_0k5_Init, value=255
    XDIS_blybmtx9riv2qoxuohj41e22d
      value:
        integer literal l255: type=c08_degC_m40_85_0k5, value=255
    XDIS_4kp2g078a5fpwjt4cdz62uku2
      value:
        integer literal l3: type=c02_AMG_MenuSw_Psd, value=3
    XDIS_daq9spsdlmsva4t7y2tw69dn3
      value:
        integer literal l3: type=c02_NPsd_Psd, value=3
    XDIS_2kt9ss9xytkqyzr4359iyexvi
      value:
        integer literal l0: type=c08_UInt_SNA_na, value=0
    XDIS_ezq64jqrud10seps4g49pyj4h
      value:
        integer literal lNOTACTV: type=c02_NotActv_Actv_NDef, value=0
    XDIS_8tx3f7ckagrzwkrx5whhfvm3h
      value:
        integer literal l3: type=c02_Opn_Slip_Cls, value=3
    XDIS_5lx6mbkgozmiuxgrncigny9gq
      value:
        integer literal l15: type=c04_AWD_Err_Stat_V2, value=15
    XDIS_7eryo4j0uk38grwid6m4x71mx
      value:
        integer literal lNORMAL: type=c02_AWD_OprtnMd, value=0
    XDIS_2gdok7is6uk227cngmpgf9wxb
      value:
        integer literal l0: type=c04_0_15_1_SNA_na, value=0
    XDIS_dl69ynb9ox7e9q5squkescmw4
      value:
        integer literal lIDLE: type=c02_BatCplSw_Rq, value=0
    XDIS_8z0kx9i590v6kt4gu7vxxhvcm
      value:
        integer literal l3: type=c02_Brk_Stat, value=3
    XDIS_222cmje3au9eeyrzykrya1i1q
      value:
        integer literal lOFF: type=c02_Off_On, value=0
    XDIS_4qu7eufkaqbzjiqze2el5aejn
      value:
        integer literal l3: type=c02_Pdl_Stat, value=3
    XDIS_8lqogi22x73sbyxgtced8ohw
      value:
        integer literal lTHS_DSABL: type=c02_BrkRq_PT_Enbl, value=0
    XDIS_rtkpsgicnvz0wz7o7glhec19
      value:
        integer literal lIDLE: type=c02_brkrq_tcm, value=0
    XDIS_dzq15i09jdpilg2seasjx6evl
      value:
        integer literal l8191: type=c13_Nm_0_24570_3, value=8191
    XDIS_8lat4df4nlo7dz90hid6xl14r
      value:
        integer literal l4095: type=c12_Nm_0_12282_3, value=4095
    XDIS_cjqmqud5sht0aoicxmhuicieh
      value:
        integer literal lNO_FLT: type=c01_NoFault_KeptAwake, value=0
    XDIS_4q3sxcq1uglc3l4vfg73a7rs7
      value:
        integer literal l3: type=c02_Clutch_Actv_Stat, value=3
    XDIS_bkpull7u5zeddix9lwe9zclr8
      value:
        integer literal lDISENGG: type=c03_Clutch_Stat, value=2
    XDIS_2t4xaut0t5vtattx6puvpt4xi
      value:
        integer literal l255: type=c08_degC_m50_350_2, value=255
    XDIS_45s2axouwl9b7rqy0ln7n3duo
      value:
        integer literal lCOAST_INACTV: type=c02_CoastMd_Disp_Rq, value=0
    XDIS_d70t0nscru75hebntakcwyznu
      value:
        integer literal l7: type=c03_CoastMd_Rq, value=7
    XDIS_eq7hqtn5dthlfyvd3lzdvxjr0
      value:
        integer literal lCOAST_DASBL: type=c02_CoastMd_Stat, value=0
    XDIS_9zsg7nirpdj3g8gia96831vcb
      value:
        integer literal l3: type=c02_ContEngRun_Stat, value=3
    XDIS_87qydukld3c5zcs28j4nphbki
      value:
        integer literal l46: type=c08_CRC_woSNA, value=46
    XDIS_9cvrk4mmvoquwgofjqv6wqpyt
      value:
        integer literal l47: type=c08_CRC_woSNA, value=47
    XDIS_480659ktrozshakfne03i18p5
      value:
        integer literal l16: type=c08_CRC_woSNA, value=16
    XDIS_2fj75efta7cvdt9vh2ea884x
      value:
        integer literal l203: type=c08_CRC_woSNA, value=203
    XDIS_abpbyaw8gys684hvnjvynd45h
      value:
        integer literal l131: type=c08_CRC_woSNA, value=131
    XDIS_c5g0l1m53noyd4og91ixrth1t
      value:
        integer literal l74: type=c08_CRC_woSNA, value=74
    XDIS_9czkmncmedzmxeedif0qdnexr
      value:
        integer literal l173: type=c08_CRC_woSNA, value=173
    XDIS_6hd1ethnfjfrek923zy35it47
      value:
        integer literal l106: type=c08_CRC_woSNA, value=106
    XDIS_61jhjno1eql03t0ane8bmw0b1
      value:
        integer literal l241: type=c08_CRC_woSNA, value=241
    XDIS_c064zbos0vfa7550pfh5jx2xk
      value:
        integer literal l55: type=c08_CRC_woSNA, value=55
    XDIS_brgssc38itbhey39pna4t94g5
      value:
        integer literal l70: type=c08_CRC_woSNA, value=70
    XDIS_3tu9isaznsrxc2wub5d755ikk
      value:
        integer literal l97: type=c08_CRC_woSNA, value=97
    XDIS_adfk05eih17tkr1rc64t8r7im
      value:
        integer literal l120: type=c08_CRC_woSNA, value=120
    XDIS_e4h9i5tu90eljz447pjje3093
      value:
        integer literal l221: type=c08_CRC_woSNA, value=221
    XDIS_4it4j52ufeugfkbqc7m2ll65i
      value:
        integer literal l209: type=c08_CRC_woSNA, value=209
    XDIS_3iuw5u1s4x8m4bvwk1hf8p7nf
      value:
        integer literal l234: type=c08_CRC_woSNA, value=234
    XDIS_eemgff3harmlwafncazhvxtb2
      value:
        integer literal l33: type=c08_CRC_woSNA, value=33
    XDIS_6eavpzlbnub0ru89gwatra2xh
      value:
        integer literal l171: type=c08_CRC_woSNA, value=171
    XDIS_6jkvfjk41h8zoohg8oqhc16xi
      value:
        integer literal l75: type=c08_CRC_woSNA, value=75
    XDIS_30imihhvgapoyzijz8u8ypbyv
      value:
        integer literal l34: type=c08_CRC_woSNA, value=34
    XDIS_8rs0jwnqhqfbac6z4dkjbg2wa
      value:
        integer literal l155: type=c08_CRC_woSNA, value=155
    XDIS_de4bqgsbapq7lyk9cafas7dl9
      value:
        integer literal l196: type=c08_CRC_woSNA, value=196
    XDIS_btot70u8f37q040cyqgugpjm7
      value:
        integer literal l175: type=c08_CRC_woSNA, value=175
    XDIS_1becqk591kjkbrp3o855q7ie
      value:
        integer literal l192: type=c08_CRC_woSNA, value=192
    XDIS_46bsehq8dol21c8zgbmf46ucj
      value:
        integer literal l20: type=c08_CRC_woSNA, value=20
    XDIS_e0dyo9wvosp885sckg5h27pnn
      value:
        integer literal l76: type=c08_CRC_woSNA, value=76
    XDIS_crljb2b82zjgduk7fkqh5f175
      value:
        integer literal l183: type=c08_CRC_woSNA, value=183
    XDIS_chb84mn100h9c1hkqp46ucnxz
      value:
        integer literal l193: type=c08_CRC_woSNA, value=193
    XDIS_2n0tujthjzfh0f2qp4xtvpga9
      value:
        integer literal l239: type=c08_CRC_woSNA, value=239
    XDIS_6aotsok9bqldw1zrh69fzoux7
      value:
        integer literal l135: type=c08_CRC_woSNA, value=135
    XDIS_6dqgmwkhadewfnxhgnhzu34p1
      value:
        integer literal l205: type=c08_CRC_woSNA, value=205
    XDIS_lo9vfrsxtnabyf29a7c33q0o
      value:
        integer literal l126: type=c08_CRC_woSNA, value=126
    XDIS_bs6p3mdmorrqmqj3hi5ov6qi7
      value:
        integer literal l219: type=c08_CRC_woSNA, value=219
    XDIS_5c6g646hdskdmdgyqv0dxajev
      value:
        integer literal l245: type=c08_CRC_woSNA, value=245
    XDIS_efk529sldh2cob4oslwdtb993
      value:
        integer literal l80: type=c08_CRC_woSNA, value=80
    XDIS_36bdczye9onmb3ya1skcvm7cz
      value:
        integer literal l83: type=c08_CRC_woSNA, value=83
    XDIS_cmv8g2rvuwmp3163kzctsukh5
      value:
        integer literal l115: type=c08_CRC_woSNA, value=115
    XDIS_4n32ztbzzk14sudfrds7mhv6o
      value:
        integer literal l204: type=c08_CRC_woSNA, value=204
    XDIS_2qlkubwtxe6v5l82p1wjycckk
      value:
        integer literal l28: type=c08_CRC_woSNA, value=28
    XDIS_469omh35ellyn90aj0h5n8r0f
      value:
        integer literal l243: type=c08_CRC_woSNA, value=243
    XDIS_aaz6y6k29q2w5bhyy51bdrtsz
      value:
        integer literal l35: type=c08_CRC_woSNA, value=35
    XDIS_8mkbrye4saa0nuc1et4qijw3g
      value:
        integer literal l168: type=c08_CRC_woSNA, value=168
    XDIS_ab5s5kc7fc90v687u26beu0np
      value:
        integer literal l247: type=c08_CRC_woSNA, value=247
    XDIS_di356mmt5w3a9njzuhn01zxwt
      value:
        integer literal l0: type=c08_CRC_woSNA, value=0
    XDIS_ep8rpczh0wldpmdkc7kcjz02o
      value:
        integer literal l144: type=c08_CRC_woSNA, value=144
    XDIS_8qdi3elilivdzh499jr1d0mu5
      value:
        integer literal l7: type=c03_CT_Stat, value=7
    XDIS_7gd3auxmk1537dxoewcnzblfs
      value:
        integer literal l255: type=c08_perc_0_100_0k5, value=255
    XDIS_6tykre2bg23tt4ujbskjxzeqb
      value:
        integer literal lDSABL: type=c01_Disabled_Enabled, value=0
    XDIS_81n12vvyd5dnsp1722jk8zl4p
      value:
        integer literal lNO_ZAS: type=c02_CylCutoff_Stat, value=0
    XDIS_2x6qhs0nt51q72g71quz2c4ol
      value:
        integer literal l65535: type=c16_Days_0_65534_1, value=65535
    XDIS_dfmsesljm1l0qmgkteetm3xmh
      value:
        integer literal l255: type=c08_Nm_0_1270_5, value=255
    XDIS_5tmrduq2bqfpf36001734f32g
      value:
        integer literal l255: type=c08_Nm_0_2540_10, value=255
    XDIS_8na235yooobwawdywh6ai5l6
      value:
        integer literal lFREE_RUN: type=c02_DiffLk_M_Md_Rq_ESP, value=0
    XDIS_ae5xrnuvh33g0yb25el7eep4k
      value:
        integer literal lIDLE: type=c02_DiffLk_Trq_Rq_AMG, value=0
    XDIS_2hao8tsf64q8e8318i7ljtjd0
      value:
        integer literal lALL_CLS: type=c01_DL_AllDr_Stat_CPC, value=0
    XDIS_41wlneoof3s174x1y63qsu1os
      value:
        integer literal lCOMFORT: type=c04_DPC_GlobalMd_Rq, value=0
    XDIS_3y644026va6c2x8rschu8ysp4
      value:
        integer literal lOFF: type=c02_NDef_On_Off, value=2
    XDIS_ct0p913dzrgf4i94zmfkskizo
      value:
        integer literal lON: type=c02_NDef_On_Off, value=1
    XDIS_4rxo09g2n1p0ap53lo5wet5an
      value:
        integer literal lCOMFORT: type=c02_NDef_ECO_Comfort, value=2
    XDIS_exbq1fzviylpo20j8kwfqzkm
      value:
        integer literal lCOMFORT: type=c03_DPC_Md_AS, value=1
    XDIS_ee6lf6fesmlxx9pcig2c90tw0
      value:
        integer literal lINIT: type=c04_DPC_Md_ASX, value=0
    XDIS_ca1vhc1pmm1pytmy7whf3e5la
      value:
        integer literal lCOMFORT: type=c03_DPC_Md_ESP_Rq, value=1
    XDIS_b6gytuw1gs6hpmeqn7dp2mvre
      value:
        integer literal lCOMFORT: type=c03_DPC_Md_ExhaustFlap, value=1
    XDIS_didolfsk1r6nfzojvd6lbxo4w
      value:
        integer literal lCOMFORT: type=c04_DPC_Md_PT, value=1
    XDIS_27yy43sur4i39ew6ik8whm1v7
      value:
        integer literal lSSA_ON: type=c02_DPC_Md_SSA, value=1
    XDIS_aggqmvc9vx5lby09wqq991q82
      value:
        integer literal lCOMFORT: type=c03_DPC_Md_St, value=1
    XDIS_68yw0mdlpkc62n96snkbby7kv
      value:
        integer literal lONROAD9: type=c05_DPC_Md_Susp_V2, value=9
    XDIS_85wxxmdqtoxn9opwq7p7hfnz9
      value:
        integer literal l0: type=c03_m2_p3_1_Init, value=0
    XDIS_qkvu5pqsnjj53jpo6exsklnq
      value:
        integer literal lINIT: type=c04_DPC_Md_PT_Rx_HU, value=0
    XDIS_3u7u0iu3wn1birdp0aca67u8y
      value:
        integer literal lAUTO: type=c02_NDef_Man_Auto, value=2
    XDIS_2ww10q9x8mhbjoiy8rtqj5oin
      value:
        integer literal lEXT: type=c02_Ndef_NoExt_Ext, value=2
    XDIS_e0f4j0yy4zy31nyz9m3jukr04
      value:
        integer literal lEXT: type=c02_Sleep_Local_Ext, value=2
    XDIS_67um0ctsifexegftsp97takil
      value:
        integer literal lOFF: type=c02_Off_Enbl_Actv, value=0
    XDIS_77fxcf0bwhvvuz9q4jitpa0mm
      value:
        integer literal l0: type=c08_rpm_500_3000_10, value=0
    XDIS_5ilxwnkz53oa90kwdz13h1cg1
      value:
        integer literal lNO_RQ: type=c02_ESP_LastMd_Disp_Rq, value=0
    XDIS_37r48co1agrbd30wx53gabdmv
      value:
        integer literal l255: type=c08_0_200_1, value=255
    XDIS_9261mudls0nkj1mlaum4vlelr
      value:
        integer literal l0: type=c07_0_127_1, value=0
    XDIS_1zhllr2xfwzb4a7tpzx4f54fs
      value:
        integer literal l0: type=c08_0_254_1, value=0
    XDIS_34pxfrh12b3pknp94x9up6ty8
      value:
        integer literal l3: type=c02_DynBrkMd, value=3
    XDIS_7rsnpoiiencgp952qxy5gtc8v
      value:
        integer literal l3: type=c02_NotActv_Actv_NDef, value=3
    XDIS_dkxworoovwcoo0dwynzmp76a8
      value:
        integer literal lNO_LHOM: type=c08_ECM_LHOM_Stat, value=0
    XDIS_9r0gtu7ve79mlahhb23ex7m2g
      value:
        integer literal l3: type=c02_EDIFF_MsgDisp_Rq_AMG, value=3
    XDIS_i4e3ph6igxm4spvtvcd0aaxn
      value:
        integer literal l0: type=c08_A_0_30d1_0d15, value=0
    XDIS_em3qjydapl05yf4dt066kijsc
      value:
        integer literal l0: type=c08_rpm_0_5080_20, value=0
    XDIS_cn7ds5rce5o16qs43tbneudnt
      value:
        integer literal lOFF: type=c04_ElectricFuelPmp_Stat, value=0
    XDIS_9rrg0shmfwprce4xy23v3tfyt
      value:
        integer literal l16383: type=c14_V_0_1638k2_0k1, value=16383
    XDIS_cd3oy5177qa3y14g9h238t663
      value:
        integer literal lIDLE: type=c03_EM01_Emg_Rq, value=0
    XDIS_91v13cnwelt8obxl65urhlwfi
      value:
        integer literal lFALSE: type=c01_EM01_NegTrq_Rs, value=0
    XDIS_143yj8chof4gyrz0n8zsr7dhu
      value:
        integer literal l7: type=c03_l_per_min_0_3_0k5, value=7
    XDIS_8olq1vzwet2qxm5w4donr6tmx
      value:
        integer literal l15: type=c04_l_per_min_0_14_1, value=15
    XDIS_9tk8nsfd7or9qg8w6lzymt0lv
      value:
        integer literal l7: type=c03_EM01_Cool_Rq_V2, value=7
    XDIS_1cav0xjb9y4fsb77r4kp8hkbg
      value:
        integer literal lSAME: type=c01_Dir_Same_Opposite, value=0
    XDIS_carqyv2gq7ncv789c849hnl6r
      value:
        integer literal l255: type=c08_degC_m40_214_1, value=255
    XDIS_82nfehr3ho0td8jgmxjg4mj72
      value:
        integer literal l16383: type=c14_rpm_0_16382_1, value=16383
    XDIS_emg3258s4xg6nj4415gnzzldg
      value:
        integer literal l8191: type=c13_Nm_m500_1547k5_0k25, value=8191
    XDIS_9gn5j7uadcycp6vp4d1kfab5z
      value:
        integer literal lREL: type=c02_Rel_Lock_SNA, value=0
    XDIS_6eq3dok2smxmzb9ovf38bf5xt
      value:
        integer literal l255: type=c08_Nm_0_508_2, value=255
    XDIS_e1wuwi89appks4l77615nudip
      value:
        integer literal l65535: type=c16_A_m3276k6_3276k8_0k1, value=65535
    XDIS_521gwchioxgex9yqc7rslp1tg
      value:
        integer literal l65535: type=c16_V_0_6553k4_0k1, value=65535
    XDIS_2mdcyyt3qya3c0y8ckut05qg9
      value:
        integer literal l0: type=c04_EM_Trq_RecupGrdnt_Max, value=0
    XDIS_6h0vlx83b98yborknhrn3o3li
      value:
        integer literal l255: type=c08_V_0_25k4_0k1, value=255
    XDIS_6w7kc8amiekknqhh61qaaoij9
      value:
        integer literal l127: type=c07_per_0to100_1_SNA, value=127
    XDIS_526m332undv8qhobkm645cf10
      value:
        integer literal l255: type=c08_perc_0_100_1, value=255
    XDIS_4l8q09vxqhutv9go97s4i82pi
      value:
        integer literal l0: type=c10_rpm_0_5000_5, value=0
    XDIS_1nz5n0qzadj575y05e4gngho0
      value:
        integer literal lIDLE_WARM: type=c02_EngIdleRPM_Lvl, value=0
    XDIS_by3pnjb56nx4asd57bp96c9qh
      value:
        integer literal lSOFT: type=c02_Soft_Mid_Hard_SNA, value=0
    XDIS_9cqn87tsf02uy044vd3qzo44h
      value:
        integer literal lNORMAL: type=c02_Norm_Flt_Ndef_SNA, value=0
    XDIS_enuzrfb1f0b4exavz9gba8664
      value:
        integer literal l255: type=c08_1_6_0k01969, value=255
    XDIS_8zts0kx160si29lg57dawvd0v
      value:
        integer literal l255: type=c08_degC_m40_160_1, value=255
    XDIS_81noapvlbj6bhwcisaskiut23
      value:
        integer literal l3: type=c02_SpdCtrl_Rq, value=3
    XDIS_4lbkzmttx3raa0rous18ftgmy
      value:
        integer literal l255: type=c08_rpm_0_2540_10, value=255
    XDIS_dd6txh2gockdf2ckmql7drv7h
      value:
        integer literal l4095: type=c12_rpm_0_8188_2, value=4095
    XDIS_e2t9m2m3ca6n6meo150yhdrbk
      value:
        integer literal lOFF: type=c02_Off_OnIdle_NDef, value=0
    XDIS_1ps1d53o7u62lv4xtueyronz7
      value:
        integer literal l7: type=c03_EngRun_Stat, value=7
    XDIS_c8v40vytc583vwtspwjkq57k3
      value:
        integer literal l0: type=c32_s_0_4294967294_1, value=0
    XDIS_d65q5o6fvqky5zbqr8rc19l61
      value:
        integer literal l4095: type=c12_min_0_4094_1, value=4095
    XDIS_efjwndmyv9jwvt4o20fd0h4jr
      value:
        integer literal l0: type=c06_0_63_1_SNA_na, value=0
    XDIS_8avi24l4s7lv1vscy4ses376c
      value:
        integer literal l255: type=c08_EngStyle, value=255
    XDIS_60vl5omr41k0bd97hj1xlgn6g
      value:
        integer literal l0: type=c11_Nm_m500_1546k0_1k0, value=0
    XDIS_69jg6h6dhtx5icztjq3x4sq6f
      value:
        boolean literal ltrue: type=DC_BOOL, value=true
    XDIS_1sw1jwlmccfni1v56xqj0js4n
      value:
        integer literal l0: type=c13_Nm_m500_1547k5_0k25, value=0
    XDIS_c1d4l3fliyrryv1w2ncd3uiy6
      value:
        integer literal l2047: type=c11_Nm_m500_1546k0_1k0, value=2047
    XDIS_df4l51ldxkjdjel6wt0z6lnkz
      value:
        integer literal lSTABLE: type=c03_EngTrq_Unstbl_Stat, value=0
    XDIS_327f49tzxohck8g8esrcyugmz
      value:
        integer literal l255: type=c08_0_1k98_0k0078, value=255
    XDIS_f0jm83g6n4vnto6hmbi72xlou
      value:
        integer literal l255: type=c08_Nm_0_1265_5, value=255
    XDIS_9cv1zr7d4o7iodto62m2lekxl
      value:
        integer literal l16383: type=c14_0_163k82_0k01, value=16383
    XDIS_a5y42lspsaonemgf5sbikbeo
      value:
        integer literal l7: type=c03_EPkBrk_Stat, value=7
    XDIS_wgd5ub5vm3gd9qfahupgvut1
      value:
        integer literal lDEFAULT: type=c02_ESL_Lk_Rq, value=0
    XDIS_42xm1f4wmbrlen77pvu12x6xu
      value:
        integer literal lIDLE: type=c07_ESP_BrkMsg_Disp_Rq, value=0
    XDIS_2b0kumr7w8srfxx8b0glpobif
      value:
        integer literal lIDLE: type=c03_ESP_FricCoeff_Stat, value=0
    XDIS_aeqb7ln0dc3h9rywce4zfzuzq
      value:
        integer literal lNO_INTRVNTN: type=c02_ESP_Intrvntn_Stat_ECM, value=0
    XDIS_144h16k13t6h9czp5y7udtr3s
      value:
        integer literal lON: type=c02_ESP_Md_Rq_Ack, value=0
    XDIS_2reuwl7zojojhy2sw95t6y4vo
      value:
        integer literal lNO: type=c02_ESP_Md_Rq_AMG, value=0
    XDIS_eazlpb63im4v75gekmzelypm9
      value:
        integer literal lNORM: type=c04_ESP_Oprtn_Stat_AS_V2, value=0
    XDIS_yx540jbnz7p1msygozw5vzp8
      value:
        integer literal lNORM: type=c03_ESP_Sys_Stat, value=1
    XDIS_e75cd4727vatijfha73srtluz
      value:
        integer literal lIDLE: type=c07_ESP_VDC_Msg_Disp_Rq, value=0
    XDIS_b0sx1bf1u21ozu36byqxxhp5b
      value:
        integer literal l3: type=c02_EVC_Stat, value=3
    XDIS_2mu1yfynzx7eq98ugq1zsz33c
      value:
        integer literal l3: type=c02_StStyle, value=3
    XDIS_dil9l0u36vmrk4slsnp17mahd
      value:
        integer literal lOTHER: type=c05_EVC_BodyStyle, value=31
    XDIS_d9yd6xyexwqqqwkngpic257wx
      value:
        integer literal lOTHER: type=c03_EVC_RoofStyle, value=7
    XDIS_577jt4tp9alp9uu1sij0270o4
      value:
        integer literal lOTHER: type=c04_EVC_HL_Style, value=15
    XDIS_54ybgp27x5vskb2dv6vwhabu9
      value:
        integer literal lOTHER: type=c04_EVC_TxStyle, value=15
    XDIS_ajew9a0uit45wx0xtvu446cfv
      value:
        integer literal l31: type=c05_EVC_VehLineYear, value=31
    XDIS_7j9pky1up2b8g1la265uef3we
      value:
        integer literal lOTHER: type=c03_EVC_HVAC_Style, value=7
    XDIS_diolmgay34ck0c0molf9pznyp
      value:
        integer literal lOTHER: type=c08_EVC_Country, value=255
    XDIS_b444aizu620gbf4q6u6nf1acq
      value:
        integer literal lOTHER: type=c05_EVC_HU_Style, value=31
    XDIS_dr87ylzskw1u9hclvhhcvy8qz
      value:
        integer literal lOTHER: type=c03_EVC_TPM_Style, value=7
    XDIS_33qjvgjtp408uvl55msel1lo3
      value:
        integer literal lOTHER: type=c02_EVC_AddEquip, value=3
    XDIS_71s5eiv53ol0041jb1i5btwvv
      value:
        integer literal lOTHER: type=c06_EVC_VehLine, value=63
    XDIS_dj236vlj8xzzdctuelqz8u9rt
      value:
        integer literal lIDLE: type=c03_ExhstFlap_Stg, value=0
    XDIS_2hjdem9i1croyuwfcpuw9nxsq
      value:
        integer literal lLED_OFF: type=c02_ExhstFlap_SwLED_Rq, value=0
    XDIS_39a0u0s1i4hro531fl4hhze0m
      value:
        integer literal l0: type=c10_perc_0_100_0k1, value=0
    XDIS_5dn2zgpfmcdlqbsmco91plwk2
      value:
        integer literal l0: type=c08_perc_0_100_0k4, value=0
    XDIS_aybv6ycjlpcbqdlifi85r6ucj
      value:
        integer literal lOFF: type=c02_FFAP_ActvMd, value=0
    XDIS_dwkkwxo6wj781mseotfv3qvps
      value:
        integer literal lAMPL_0: type=c03_FFAP_AmpliFctr, value=0
    XDIS_23a4hkjw60ovp13lkco2u4r84
      value:
        integer literal l3: type=c02_FFAP_CurCtrl, value=3
    XDIS_5k29pyc5m6vm6v3rbqmtacxgc
      value:
        integer literal l0: type=c08_A_0_15_0k06, value=0
    XDIS_9o9w4r3c7nlvofkl5ojjgzneq
      value:
        integer literal lLGTH_50: type=c03_FFAP_DbPls_IntrmLgth_Rq, value=0
    XDIS_6feupoo3eiy4ek55zngxjj07v
      value:
        integer literal lFORCE_0: type=c03_FFAP_DbPlsI_Force_Max, value=0
    XDIS_5oh5kl7akxgsgla43g6u9o8yv
      value:
        integer literal lNO_DBPLSTRGR: type=c02_FFAP_DbPlsTrgr_Rq, value=0
    XDIS_df0ppdzkk2y7b69g4p1e9moaw
      value:
        integer literal l0: type=c08_degC_m40_150_SNA_1, value=0
    XDIS_5xemvfg590iym6h4wtm0j7kst
      value:
        integer literal l0: type=c08_N_0_30_0d12, value=0
    XDIS_exa6unll9w3l7oe2zguvjybp1
      value:
        integer literal lHZ_5: type=c03_FFAP_Frequency, value=0
    XDIS_etkgb0ahlv2vzx54do643cq63
      value:
        integer literal l3: type=c03_FFAP_SigFormat, value=3
    XDIS_ewtdrsxwev3sdrb0l7wuuy5x2
      value:
        integer literal l255: type=c08_0_255_1_SNA_na, value=255
    XDIS_eyvjtlfat7mxs0ushx899rtu2
      value:
        integer literal l0: type=c05_0_31_1_SNA_na, value=0
    XDIS_b4sbk9fmoxi84guz56apqcnq0
      value:
        integer literal lNOT_SUPPORTED: type=c03_RBS_DTC_Stat, value=0
    XDIS_1hrjz35hano4wz5acruqrrcn7
      value:
        integer literal l7: type=c03_FTW_PressDrop_Stat, value=7
    XDIS_cubji0i1shbvjcj1svot8svly
      value:
        integer literal lNOT_ACTV: type=cFuelBlindOutCtrl_Rq_TCM, value=0
    XDIS_a07pbof8nfjy6sopkumlg9k7r
      value:
        integer literal l65535: type=c16_ul_p_250ms_0_14200_0k21668, value=65535
    XDIS_75kgv6x5wmeuyxn4jb0wfq7lq
      value:
        integer literal l7: type=c03_FuelLowPress_Sys_Rq, value=7
    XDIS_7frps0id7o3a7jqx301qmd2zx
      value:
        integer literal l255: type=c08_bar_0_10_0k05, value=255
    XDIS_4uzadvcjidv26jpzq30itq1yy
      value:
        integer literal l255: type=c08_mbar_m381_381_3, value=255
    XDIS_bcvzfb8xc82lopd6nomhoa8hz
      value:
        integer literal l0: type=c08_hPa_0_12700_50, value=0
    XDIS_e9zhhnisie6tjwwjh17mqaa4r
      value:
        integer literal l65535: type=c16_kPa_0_655350_10_nSNA, value=65535
    XDIS_1qgh8ijswcrhuty1cyrfufsk3
      value:
        integer literal l255: type=c08_degC_m50_204_1, value=255
    XDIS_7aptig5ed7lppf85ff76xckus
      value:
        integer literal l0: type=c08_l_per_h_0_381_1d5, value=0
    XDIS_8qlmnw9tobi7dd8p2sllxpb9v
      value:
        integer literal l7: type=c03_Funct_GrShft_Rq_DS, value=7
    XDIS_2crnikbdfbucgvm5bjgk7sxb0
      value:
        integer literal l63: type=c06_perc_0_31_3k22581, value=63
    XDIS_dez57pzmykmhphfykjtcbqq8k
      value:
        integer literal l15: type=c04_Gr, value=15
    XDIS_atinj15as1edtr54we098gq70
      value:
        integer literal l15: type=c04_Gr_Target, value=15
    XDIS_t15dy9y69dbq57aa6cdecyq
      value:
        integer literal l15: type=c04_Gr_Target_Disp_Rq_V2, value=15
    XDIS_3wemiyqgjwvlumaoj8nb1rfke
      value:
        integer literal l15: type=c04_Gr_Target_Disp_Rq, value=15
    XDIS_dmnv8c42ay2tyyqj6pd44a0cd
      value:
        integer literal l7: type=c02_Gr_TCASE_V2, value=7
    XDIS_7uq2qghvjbhki2cbg83r4b55h
      value:
        integer literal lPASSIVE: type=c04_GrMax_Rq_v2, value=0
    XDIS_9m6sblz9nzl5h9osu1t5bxtb7
      value:
        integer literal lPASSIVE: type=c04_GrMin_Rq_v2, value=0
    XDIS_5ovt5l93gwvy4it3m7ozigx3d
      value:
        integer literal l7: type=c03_GrShft_Rq_DS, value=7
    XDIS_8bnock8yflgyavdtylluepc9l
      value:
        integer literal lOK: type=c01_Ok_Flt_EM01, value=0
    XDIS_blyfc6j17ckx0dleyticlsaev
      value:
        integer literal l7: type=c03_HDC_GrdntMd_Rq_WDC, value=7
    XDIS_8iaq8201r0988d05ciiqwp1g4
      value:
        integer literal lIDLE: type=c04_HDC_Md_Rq_EM, value=0
    XDIS_2gh0e6dr37noeqbe7360vka4a
      value:
        integer literal l1023: type=c10_rpm_0_1022_1, value=1023
    XDIS_9p4jd6b80gmaaivpmq4d5qs5n
      value:
        integer literal l0: type=c12_Nm_m500_1547k5_0k5, value=0
    XDIS_5wlhhg7dgislovnjkmheyehg9
      value:
        integer literal l63: type=c06_rpm_0_6200_100, value=63
    XDIS_7qoj6r9colqyo5dpw709poxq6
      value:
        integer literal l3: type=c02_HtPwr_Stat, value=3
    XDIS_5kqf2dbype8wo99wu5c8aruyw
      value:
        integer literal l3: type=c02_REM_CLS_OPN, value=3
    XDIS_b7ef3mnghukxmc04ohxr08npp
      value:
        integer literal l15: type=c04_perc_0_100_10_SNA, value=15
    XDIS_8jlkrpnlx80l2hsrzz68ooa35
      value:
        integer literal lINACTV: type=c02_Vprzr_DryVnTmr_Stat, value=0
    XDIS_cc0dp8n5jytppo4a8e0x313gy
      value:
        integer literal lIDLE: type=c03_Hyb_GrChg_Rq, value=0
    XDIS_6rsrt0bcqw0hj0x9gpci6pd8t
      value:
        integer literal lLOAD_VOLT_REG: type=c04_HybDrv_Md, value=1
    XDIS_c05hnb78baz70infus9v8d45i
      value:
        integer literal lSTARTER_ST: type=c02_HybStartMd, value=0
    XDIS_b5zxkweu0kmj71e9nec7nhqky
      value:
        integer literal l32767: type=c15_A_m2000_0_0k1, value=32767
    XDIS_7iqmvm5ur5x2cozuic1m6ch0f
      value:
        integer literal l63: type=c06_0_310_5, value=63
    XDIS_bjcgahg6rsx9xrvjh2w4f04lk
      value:
        integer literal lMFC: type=c02_IntrvntnMd, value=0
    XDIS_15e0cs7gc4dn7o9pdwabj5z3d
      value:
        integer literal l7: type=c03_ISw_Stat, value=7
    XDIS_8kxlic6in1luauk1hsy6z4pxl
      value:
        integer literal lIDLE: type=c02_Idle_Beep, value=0
    XDIS_73ldoj9ajgn9n812099uwsgzh
      value:
        integer literal lIDLE: type=c02_LDC_CMS_MsgDisp_Rq, value=0
    XDIS_6zeifewigeuz0yl88qw12u7x3
      value:
        integer literal lCMS_OFF: type=c03_LDC_CMS_Stat, value=0
    XDIS_cypz3b2yuf3fqw24cjvk04jm6
      value:
        integer literal lIDLE: type=c01_Idle_MsgRq, value=0
    XDIS_8qw8y1ioixtwbszsb4bmbbe7m
      value:
        integer literal l0: type=c08_m_0_150_1, value=0
    XDIS_bfkiqdqfabq2f62imzbjohlcn
      value:
        integer literal l254: type=c08_LDC_Dist, value=254
    XDIS_divyhkq3bs0q5xwv9cfusq7d8
      value:
        integer literal lIDLE: type=c02_02_Idle_On_NDef, value=0
    XDIS_9qdy2xe69a4db0pzfj9h6vtd1
      value:
        integer literal lIDLE: type=c03_LDC_DTR_MsgDisp_Rq, value=0
    XDIS_5gnd6l5nvhhvxw1him7pizy3p
      value:
        integer literal lDTR_CC_OFF: type=c04_LDC_DTR_Stat, value=0
    XDIS_208p92ix4of1dcdmevcry8pej
      value:
        integer literal lDTR_CC_OFF: type=c03_LDC_DTR_Stat_V2, value=0
    XDIS_binzo6nem9hvibkghtkgf41kd
      value:
        integer literal lLDC_OFF: type=c03_LDC_IconDisp_Rq, value=0
    XDIS_7dmjz6kimzifc2t18tjt3fjca
      value:
        integer literal lIDLE: type=c03_LDC_IconDisp_Rq_RDU, value=0
    XDIS_bpfq00xr3itvm6zvig9dnf5ra
      value:
        integer literal lESP: type=c03_LDC_Master, value=0
    XDIS_dsldnewyxrtx9nhd3nzm4zqv2
      value:
        integer literal lIDLE: type=c05_LDC_MsgDisp_Rq, value=0
    XDIS_2vnz8u3lvctp7d6byghtg5nya
      value:
        integer literal lIDLE: type=c05_LDC_MsgDisp_Rq_RDU, value=0
    XDIS_dvm76papxqeuwchaycpewq03l
      value:
        integer literal l253: type=c08_LDC_Spd, value=253
    XDIS_cic0haze2mv1o7z7z6g4jp3er
      value:
        integer literal lKMH: type=c01_UnitVehSpd, value=0
    XDIS_b4ay52x0h55ee55xqsxnbv5sl
      value:
        integer literal lOFF: type=c02_LDC_Disp_Rq, value=0
    XDIS_dqfgqnhk704uahrufntf35mvc
      value:
        integer literal lNOTACTV: type=c02_NotActv_Actv_SNA, value=0
    XDIS_2wmdhujsld2cfda05itwrgdal
      value:
        integer literal l253: type=c08_LDC_WTSL_Spd_Max, value=253
    XDIS_5o7arrtv1ss14lripulpcuxnk
      value:
        integer literal l0: type=c09_Nm_0_2550_5, value=0
    XDIS_1pnuwiuijo5o0phdmlg74ub0g
      value:
        integer literal l3: type=c03_Mobile_Chrg_Rq, value=3
    XDIS_5un2e5dvr5cfu5m0829mn2f54
      value:
        boolean literal lfalse: type=XDIS_8zznnqbxnga51x5ej9fjpu597, value=false
    XDIS_9kvl7kybe3ytco3yjv5uyh4l
      value:
        integer literal l0: type=XDIS_ag9ggh2r04cqwuwmmjm5ytd7y, value=0
    XDIS_bxrvh10jawmlothu6ak0oeoq1
      value:
        boolean literal lfalse: type=XDIS_3jji6ucrc8il6b9sf0gioatpa, value=false
    XDIS_4setjwl49z8hlvz1qf446y4u9
      value:
        boolean literal lfalse: type=XDIS_8anm4jlkd5rjz5a4dj8p5z2aw, value=false
    XDIS_28el54ybfxmt2nm5z16pi8wul
      value:
        boolean literal lfalse: type=XDIS_ey4gzz3x4s3pbgmamj990b7l5, value=false
    XDIS_atkxru0u5pzxs91gr5r6s45de
      value:
        integer literal l0: type=XDIS_dgxq2p852kecqaamwh1cpsgat, value=0
    XDIS_6e9q4150byqlwe23kptfa43j2
      value:
        integer literal lINACT: type=c02_OBD_Cond_Stat, value=0
    XDIS_ehlzrftaw166ro710ipf0xhvc
      value:
        integer literal lTRQ_CSERS_OFF: type=c02_OBD_CSERS_EMTrqRng_Rq, value=0
    XDIS_79kcl4xvfeg18xpfwptyrag20
      value:
        integer literal lINACT: type=c02_OBD_IgnCycCond_Stat, value=0
    XDIS_603bz7gng9wboqmhgqjtjb9et
      value:
        integer literal lINACT: type=c02_OBD_IgnCycCondICE_Stat, value=0
    XDIS_8spmd8rxc4l164byfeohhgwuq
      value:
        integer literal l3: type=c02_OC_Fast, value=3
    XDIS_dkb5h6hnop6bsl0vyu1k4jwow
      value:
        integer literal l7: type=c03_OC, value=7
    XDIS_dznokohfo5bydzpn240kqeaa2
      value:
        integer literal l16777215: type=c24_km_0_999999k9_0k1, value=16777215
    XDIS_e20gnm5txixk6vheaqfbd4u3b
      value:
        integer literal lIDLE: type=c02_OFC_Stat, value=0
    XDIS_4v614sdwfh8bujpigj1pmwdvy
      value:
        integer literal lIDLE: type=c04_PARK_DrvDir_Rq_EBS, value=0
    XDIS_5cef29zuo9cutic9pjz31ahco
      value:
        integer literal l15: type=c04_PARK_DrvDir_Stat_EBS, value=15
    XDIS_617d24xuqh44r69m83zq6at3s
      value:
        integer literal lIDLE: type=c04_PARK_DrvDir_Stat_EBS, value=0
    XDIS_1l6f96pw4vszyqpuzfnufi8hg
      value:
        integer literal lACTIVE: type=c02_PARK_ShiftLk_Rq_EBS, value=0
    XDIS_etp3wtolhvzkltmkujy67hofr
      value:
        integer literal lPARK_GUI_INACT: type=c02_ParkGuide_Stat, value=0
    XDIS_8rj9jyau39wef0k9rwkix7ooy
      value:
        integer literal l255: type=c08_ParkStyle_V2, value=255
    XDIS_62zcs6tgdsblatw2e20ozynnd
      value:
        integer literal l0: type=c04_0_0k42_0k03, value=0
    XDIS_9bedfvqjtr0mscrwef9zzxxmf
      value:
        integer literal lPH_0: type=c02_PhsGrShiftStrt, value=0
    XDIS_zagt0434oztx3kr7c6elmean
      value:
        integer literal lIDLE: type=c02_PkBrk_Rq_ESP, value=0
    XDIS_792fn6nanbwsc1tnzw8o9lx5c
      value:
        integer literal l7: type=c03_PkBrk_Stat, value=7
    XDIS_256fs0r9jnfeiadezxr0n6q99
      value:
        integer literal l3: type=c02_PkBrk_Sw_Stat, value=3
    XDIS_agi6p6zvygr3lbs5fmlv3zb47
      value:
        integer literal lSTAR2: type=c08_Platform_Stat, value=2
    XDIS_5w87injun6w7pq05fk5wskrg3
      value:
        integer literal lHYBRID: type=c03_Hyb_EV_ESave_Blank_Chrg, value=0
    XDIS_37u671a64pxgywqfufc5m7a6l
      value:
        integer literal l0: type=c07_0_126_1_SNA, value=0
    XDIS_2wcffyjyaskh0k7y4ufyneacn
      value:
        integer literal lOFF: type=c03_PN14_EHC_Prio_Rq, value=0
    XDIS_cs0ttnzu21fq87jdomn5pyq2e
      value:
        integer literal l255: type=c08_A_0_12k7_0k05, value=255
    XDIS_7fjp9m00yv1c68qpmhcmvk34n
      value:
        integer literal l15: type=c04_PN14_GenStyle, value=15
    XDIS_48lw99wcmt2gfe6ctxxml2dph
      value:
        integer literal l3: type=c02_PN14_Hibern_Md_Flt, value=3
    XDIS_e0p8eo65xegbkeoit2yb8bj0v
      value:
        integer literal l3: type=c02_Off_On, value=3
    XDIS_7qofwcgungbr7ph21duzxj03
      value:
        integer literal l63: type=c06_Week_0_60_1, value=63
    XDIS_8cnr808ly5qpki2hl534wi8ls
      value:
        integer literal l50: type=c08_perc_0_100_1, value=50
    XDIS_cwzsz5ekwyls7to4nkihtfz4x
      value:
        integer literal l255: type=c08_W_0_100, value=255
    XDIS_1493hz1qjdm1qmt6pdh34vxlu
      value:
        integer literal l2047: type=c11_A_m102k4_102k2_0k1, value=2047
    XDIS_28in454bjabczdszdzybakplk
      value:
        integer literal lCLS: type=c02_BatCutSw_Stat, value=0
    XDIS_9508tv54aq3zqlpdrmfulokrl
      value:
        integer literal l60: type=c08_s_0_1270_5, value=60
    XDIS_15lbynoto8hu3um81qo7cznt0
      value:
        integer literal lCLS: type=c03_PN14_TDP_Sw_Stat, value=0
    XDIS_csegq0grcmpyfro5u6kyzxmql
      value:
        integer literal l3: type=c02_TransMd_Stat, value=3
    XDIS_e7m4guz2uvj6p2oxh8v2fcmko
      value:
        integer literal l255: type=c08_degC_m40_150_SNA_1, value=255
    XDIS_54tv8lvpsqhu4dtjgc8hg03xr
      value:
        integer literal l3: type=c02_Idle_Active_Inactive, value=3
    XDIS_9q9tei3m1fjehhzmxi2ewe8ef
      value:
        integer literal l1023: type=c10_perc_m30_70_0k1, value=1023
    XDIS_9e7l6lmqsltnn6zpnqq36qyov
      value:
        integer literal l255: type=c08_m_p_sq_s_m10k24_10k08_0k08, value=255
    XDIS_7slpd5uy08tpkficw8xdx499o
      value:
        integer literal lIDLE: type=c06_VehAccel_X_AS_Actv, value=0
    XDIS_26sxlx80yin980793saoh5k2z
      value:
        integer literal lPT_NOT_RDY: type=c02_PT_Rdy_V2, value=0
    XDIS_zz0bvoayey7hxgtzjt8dx3ui
      value:
        integer literal lPASSIVE: type=c02_PushStrtCtl_Rq_ECM, value=0
    XDIS_1it9urdk9io75z2ahjunve8z6
      value:
        integer literal l3: type=c02_LS_Stat, value=3
    XDIS_6gtvtx8k4w3ft2iz5jjwfb9x2
      value:
        integer literal l3: type=c02_PW_Posn_Stat, value=3
    XDIS_aa60nt5d7egr455yb39jbe86r
      value:
        integer literal l4095: type=c12_mm_m1023_1024_0k5, value=4095
    XDIS_brn6ekenriy9tl0cxpiegrr91
      value:
        integer literal lIDLE: type=c02_PwrFreeD_Supp_Rq, value=0
    XDIS_80m5pwr2zjsnpgmh203n30pqt
      value:
        integer literal l7: type=c03_RaceStMd_Disp_Rq_AMG, value=7
    XDIS_ex01vmxcoylj8za4oq7tkykis
      value:
        integer literal l3: type=c02_RadarBsd_GrShft_Rq_DS, value=3
    XDIS_6u7udc301amakedj65xpaxohy
      value:
        integer literal lIDLE: type=c02_Idle_Chime_Beep, value=0
    XDIS_2qf0xexx71gb6ldbah24rtevt
      value:
        integer literal l63: type=c06_perc_0_100_2, value=63
    XDIS_3yrq9mnal4qz7t6k18ggw335e
      value:
        integer literal lENBL: type=c02_Enable_Disable, value=0
    XDIS_f33ngg3qknqq6hf5cbz1jyfyc
      value:
        integer literal lNO_RQ: type=c02_RemSt_IgnCtrl_Info, value=0
    XDIS_54hqjticj13w8h93lytddd91y
      value:
        integer literal lLOCKED: type=c02_Locked_Unlocked_Err, value=0
    XDIS_bjt3ib7wqik0sqxbiyd3ycy7c
      value:
        integer literal l3: type=c02_Disengg_Engg, value=3
    XDIS_d00a2pwsicon8afnf0ovtodtq
      value:
        integer literal l0: type=c24_0_16777215_1_SNA_na, value=0
    XDIS_e83grhz0aqm1yaa82ns55ebek
      value:
        integer literal l0: type=c08_0_255_1_SNA_na, value=0
    XDIS_9kfeku4pd58cucxn1pomd525e
      value:
        integer literal l940295: type=c32_0_4294967295_1_SNA_na, value=940295
    XDIS_cjrgyudzoj1alqrlzqvxry20j
      value:
        integer literal lOFF: type=c02_RollTestMd_Rq_Ack, value=0
    XDIS_ei6iywhjasod43zzayamrf7c3
      value:
        integer literal l0: type=Rsrv14, value=0
    XDIS_zukcixzhzplmgdoo03mopm29
      value:
        integer literal l0: type=Rsrv06, value=0
    XDIS_1uvqkcvexva3vp6bv7zoxjawg
      value:
        integer literal l0: type=Rsrv07, value=0
    XDIS_eb9yua4lxmhrmvzyfsmxg3ler
      value:
        integer literal l0: type=Rsrv04, value=0
    XDIS_e2uhxyvdu33zsyqfjnk549pp2
      value:
        integer literal l0: type=Rsrv01, value=0
    XDIS_7jeo5ges9wp8ufla3pohsuw83
      value:
        integer literal l0: type=Rsrv02, value=0
    XDIS_dn8lf2t3vtro1vkmqfxqg05qy
      value:
        integer literal l0: type=Rsrv16, value=0
    XDIS_e2tmoqhrqj608ty4o78grs9ui
      value:
        integer literal l0: type=Rsrv11, value=0
    XDIS_e6yko3jf7vueybb3pnb685vj8
      value:
        integer literal l0: type=Rsrv05, value=0
    XDIS_4flxbk4wkjkdew7cw07d9of66
      value:
        integer literal l0: type=Rsrv08, value=0
    XDIS_ds7bx5pu0edqfshg8l8g5rp9z
      value:
        integer literal l0: type=Rsrv03, value=0
    XDIS_cvmn4avy0ja0228879wthq11
      value:
        integer literal l16383: type=Rsrv16, value=16383
    XDIS_94njywbs6xys4vfs8fqiw3tks
      value:
        integer literal l0: type=Rsrv12, value=0
    XDIS_1btwp40vfzysklfc9vhyfb8lg
      value:
        integer literal lIDLE: type=c03_SBW_Msg_Disp_Rq, value=0
    XDIS_5ky3lk60o7o5ndyw6cx2aook
      value:
        integer literal l3: type=c02_SBW_ShiftLk_Msg_RevGr_TCM, value=3
    XDIS_clyp4rnqvnur3375emik09qin
      value:
        integer literal lSKL0: type=c04_ShftChrDsp_Rq, value=0
    XDIS_7fuy3lbapfu6pimv173ymd816
      value:
        integer literal l15: type=c04_Axl_DrvPosn, value=15
    XDIS_1k5vkm94zt4a73vdeqoa0g6c7
      value:
        integer literal l3: type=c02_Enable_Disable, value=3
    XDIS_3oivp0pi6kmqha929czbczm38
      value:
        integer literal l3: type=c02_Inact_Act, value=3
    XDIS_efk9f76682gf9dv40xdoqarq5
      value:
        integer literal l15: type=c04_Axl_DrvPosn_TCM, value=15
    XDIS_7yalllmilw1ujjshxp2jku3lj
      value:
        integer literal lIDLE: type=c02_TSL_ShiftLk_Stat, value=0
    XDIS_6c0ho8dqug272cu2mxvfyusfu
      value:
        integer literal lIDLE: type=c02_SPCR_AS_Dsabl, value=0
    XDIS_13ry15l7m1nqhgsb8pw451blv
      value:
        integer literal lIDLE: type=c02_SPCR_AS_Off_Rq, value=0
    XDIS_bj323usp5tar4q637dzkmfzmo
      value:
        integer literal lNOT_CONF: type=c02_SPCR_Conf, value=0
    XDIS_7mxpvz159xy8a7nxu6wns204f
      value:
        integer literal lAS_ENBL: type=c02_SPCR_Excpt_Rq_V2, value=0
    XDIS_evtq29vnc82ir0skkaa0j816s
      value:
        integer literal lIDLE: type=c04_SPCR_Md, value=0
    XDIS_a0mnckcw51hoouji6de3yexpn
      value:
        integer literal lIDLE: type=c02_SPCR_Sp_Stat, value=0
    XDIS_ed014lb60hw74udh9elmget2z
      value:
        integer literal l3: type=c02_SPCR_Style, value=3
    XDIS_4pnyu939a70ign9h5lx3uqui1
      value:
        integer literal lFWD: type=c02_SpdCtrlLvr_Stat_V3, value=1
    XDIS_c52lksz5u322bd4oae8xkj7fh
      value:
        integer literal l3: type=c02_Spoil_R_MsgDisp_Rq_AMG, value=3
    XDIS_v6vz84cs1bbwfzvdkzdfu0kg
      value:
        integer literal l3: type=c02_Spoil_R_Posn_AMG, value=3
    XDIS_5p2inx1jl8ttoognylk9cabtm
      value:
        integer literal lDSABL: type=c02_SSA_Clutch_Stat, value=0
    XDIS_b8q5x963jgbcgi7vqgvbxetx1
      value:
        integer literal lSSA_ENBL: type=c02_SSA_ENBL_DSABL_PNA_TCM, value=0
    XDIS_cl9hhu1gng8x671c0kz6fdpur
      value:
        integer literal lDEFAULT: type=c02_SSA_Standby_Stat, value=0
    XDIS_ass9zq7bb2aby3lv1fwo915q6
      value:
        integer literal l0: type=c6_a_0_62_1, value=0
    XDIS_ehiwrlaxe2swhpb7nvelu4but
      value:
        integer literal lOK: type=c08_SSP_Diag_Stat, value=0
    XDIS_en42on5yw1lm3gyhbsc51ikyg
      value:
        integer literal lNO_RQ: type=c02_SSP_Pwr_Rq, value=0
    XDIS_3n9rgrz9tok0wnh8jc8bxqw6f
      value:
        integer literal lSTRT_DWNSHIFT_AVL: type=c03_StrtVarAvl_Stat_TCM, value=3
    XDIS_37i8ggidhjfrzshzqdevgqf78
      value:
        integer literal lNPSD: type=c03_Npsd_Plus_Minus, value=0
    XDIS_7o500du5tkpdngqoew5gqb2da
      value:
        integer literal l16383: type=c14_deg_m819k2_819_0k1, value=16383
    XDIS_dc50r0564m27u25mpavzz6le9
      value:
        integer literal lTEST: type=c02_StWhl_AnglSens_Id, value=0
    XDIS_6q9u9l4u4l6ehi32avn6s3vof
      value:
        integer literal lERR_INI: type=c02_StWhl_AnglSens_Stat, value=3
    XDIS_aisncfqoaa0ayc9t8zh16mg56
      value:
        integer literal lINVLD: type=c02_StWhl_AnglSensVld_Stat, value=0
    XDIS_bprucmwcs9loym60q0osalcwr
      value:
        integer literal l16383: type=c14_deg_p_s_m4096_4095_0k5, value=16383
    XDIS_6y1s8o04spumiv3g0r74kz1ku
      value:
        integer literal lINI: type=c03_StWhl_Sw_Stat3, value=6
    XDIS_7ac7g75sp85ia2flzoyksljo7
      value:
        integer literal lNONE: type=c03_Susp_Stat_AMG, value=0
    XDIS_3bh4hz6f9npcj7z85ik5esdib
      value:
        integer literal l127: type=c07_perc_0_100_1, value=127
    XDIS_ahldgnuii6jwiml6x5zur6yaa
      value:
        integer literal l2047: type=c11_l_0_204k6_0k1, value=2047
    XDIS_cd4bn1so8z4o8wforq3f7ykbn
      value:
        integer literal l255: type=c08_l_0_254_1, value=255
    XDIS_7wl5gcuj8x65uixr208rp9qno
      value:
        integer literal l255: type=c08_Nm_m275_p1000_5, value=255
    XDIS_6nmd1urt4d1stcmz9cbruyn1m
      value:
        integer literal l0: type=c06_s_0_6d2_0d1, value=0
    XDIS_9vf8oyj79fjmg5flnq3b19drd
      value:
        integer literal l63: type=c06_s_0_6d2_0d1, value=63
    XDIS_78dwd9co71eo75ypbfqjg5emx
      value:
        integer literal l3: type=c02_TCC_Rq, value=3
    XDIS_8tt52gotd7sah7r3hmwlwejm1
      value:
        integer literal lPASSIVE: type=c02_TccPushStrtCtl_TCM, value=0
    XDIS_2quzou7gbuptic5scarc72vwd
      value:
        integer literal l31: type=c05_TCM_Dir_Stat, value=31
    XDIS_6aph7vt7h588vh2n3ky4tffzu
      value:
        integer literal lIDLE: type=c02_TCM_EngIdleRPM_Lvl_Rq, value=0
    XDIS_7ksp2j8cgi96g5rowq7ywoklr
      value:
        integer literal lIDLE: type=c02_TCM_LHOM_Stat, value=0
    XDIS_8k19ab1yez6czusrvo38kfnut
      value:
        integer literal lIDLE: type=c02_TCM_PkPosn_Flt, value=0
    XDIS_82nnft7uwz4cxp9vzn6tew6vu
      value:
        integer literal lIDLE: type=c02_TCM_Temp_Flt, value=0
    XDIS_6h6s0bv7efp11m4nlf9yg5z0a
      value:
        integer literal lLED_OFF: type=c05_TCM_TxLED, value=0
    XDIS_bmt0u1x06oaiquus1ilde29fw
      value:
        integer literal lNO_RQ: type=c04_TCM_TxShift, value=0
    XDIS_7xmnmysjdekva9q0y0lravx16
      value:
        integer literal lREL: type=c02_Rel_Lock_Free_SNA, value=0
    XDIS_4g73cqjaawfv5dydbaqapujlx
      value:
        integer literal l0: type=c03_l_per_min_0_3_0k5, value=0
    XDIS_bvznr5hc07mn59ifk3pkwudq7
      value:
        integer literal l7: type=c03_TrafficFlow_Info_DS, value=7
    XDIS_3b2408oy0czl0zjvs4t4fel2g
      value:
        integer literal l3: type=c02_Trl_Stat, value=3
    XDIS_atdfawq2fo29xmbv147hlg3xp
      value:
        integer literal l255: type=c08_Nm_0_254_1, value=255
    XDIS_ew010c64wkf2naegyf4kegrn
      value:
        integer literal l255: type=c08_0k5_3_0k01, value=255
    XDIS_2iashc329dzvn51tf3v4nxcs8
      value:
        integer literal lFALSE: type=c01_FalseTrue, value=0
    XDIS_d9ivlc75v57cogp2b8j4yeozx
      value:
        integer literal lIDLE: type=c02_Idle_Supp_Enbl, value=0
    XDIS_46hl4413mztp2ukvqdcv4cwpj
      value:
        integer literal lIDLE: type=c02_TSL_MtnLk_Disp_Rq_V2, value=0
    XDIS_ekoet742eksgh9ctith6nex6m
      value:
        integer literal lIDLE: type=c02_TSL_MtnLk2_3_Disp_Rq_V2, value=0
    XDIS_14t9fsb52vme4w2qcdz9a54fa
      value:
        integer literal lINI: type=c02_TSL_P_Psd_StW, value=2
    XDIS_1tyvwxaq4y58gqcagg85x4e42
      value:
        integer literal l15: type=c04_TSL_Posn, value=15
    XDIS_bhy3npdfdmqko9e6gfrk3t83o
      value:
        integer literal lNO_INIT: type=c02_TSL_Posn_ISM_Init, value=0
    XDIS_d6tvoxnbt7llon5hsxajrlmsy
      value:
        integer literal l15: type=c04_TSL_Posn_Rq, value=15
    XDIS_bo54gn5pc8vza1o6cvxoet0d5
      value:
        integer literal l15: type=c04_TSL_Posn_Target, value=15
    XDIS_33c02c3rpodye2msroia5xjdy
      value:
        integer literal l7: type=c03_TSL_Posn, value=7
    XDIS_arh4cc0juzqoc7r4h5upl0lsk
      value:
        integer literal lINI: type=c04_TSL_RND_Posn_StW, value=6
    XDIS_c0gbhw8dm66an6qaea4j1vw2p
      value:
        integer literal l65535: type=c16_0_65534_1, value=65535
    XDIS_5e48z89l5sbwn0bg9qrzp9ct1
      value:
        integer literal l3: type=c02_RB_Stat, value=3
    XDIS_3m20hovfm8hy3au4j9itz9zkd
      value:
        integer literal l7: type=c03_TSSR_Stat, value=7
    XDIS_erebtjnp6vmvpjp0dso95abr3
      value:
        integer literal lINACTV: type=c02_InActv_Actv, value=0
    XDIS_a58mn9o4uu1v5pm2u3atr58rq
      value:
        integer literal lINACTIVE: type=c02_TxBurnOut_Stat, value=0
    XDIS_1cx5hyudrxwg04ni87gsdlad7
      value:
        integer literal l255: type=c08_TxDrvPosn, value=255
    XDIS_bh1p1818zl6ing1j8hr41frrg
      value:
        integer literal l255: type=c08_TxDrvProg, value=255
    XDIS_4qewlle7j7rbeqfdf440jk899
      value:
        integer literal lNO_RES_TCM: type=c02_TxDrvProgLim, value=0
    XDIS_bt22q3rlqrhrx8ewv1le28p03
      value:
        integer literal l65535: type=c16_Nm_0_65534_1, value=65535
    XDIS_25am78id1b13kwscefmblmtkx
      value:
        integer literal lPT_DISENGG: type=c04_TxHybDrvMd_Rq_V2, value=0
    XDIS_5s8u596gzgg1jcia3zb9rgy8b
      value:
        integer literal l15: type=c04_TxHybMd_V2, value=15
    XDIS_5g7hv7745ltohm7o2m7fq7geg
      value:
        integer literal lIDLE: type=c04_TxInertia_EngStrt_Idx, value=0
    XDIS_d9d4j8pud1bc2gccx30bxvgll
      value:
        integer literal lNO_ERR: type=c01_TxLHOM2_Gr_Hold, value=0
    XDIS_19bpc3qki6ufb0nd2g04yymzw
      value:
        integer literal lNO_ERR: type=c01_TxLHOM2_Gr_Lock, value=0
    XDIS_9wnti3b86z86vp5lluf598xvm
      value:
        integer literal lNO_ERR: type=c04_TxLHOM2_Stat_Clutch, value=0
    XDIS_3d8w0ml35eo9p3omdramavqlz
      value:
        integer literal lNO_ERR: type=c01_TxLHOM2_Stat_Hybrid, value=0
    XDIS_f4w4lghlkvlrhdq7uf1qiqcx8
      value:
        integer literal lNO_ERR: type=c02_TxLHOM2_Stat_OilPump, value=0
    XDIS_3wraeq63y46f1h635edz2q693
      value:
        integer literal lNO_ERR: type=c01_TxLHOM2_TX_Hydr, value=0
    XDIS_eciuz8f875mp8z8df48vic54u
      value:
        integer literal lNO_ERR: type=c01_TxLHOM2_TX_PwrFree, value=0
    XDIS_19ur4oy7prrsmc5v5u3gi9jtd
      value:
        integer literal lNO_ERR: type=c01_TxLHOM2_TX_Tractn, value=0
    XDIS_cp15m9fykvsp5qxq4tueq4c0
      value:
        integer literal lNO_REQ: type=c03_TxLHOM_Stat_Rq_CPC, value=0
    XDIS_7vktjk568kyyf5dxsiqxdhljy
      value:
        integer literal l7: type=c03_TxMechStyle, value=7
    XDIS_7r8rqqm9bzb4ksfh4tbf956i2
      value:
        integer literal lEWM: type=c02_TxmtId_SBW_Rq_DRVU, value=0
    XDIS_e06dodsc3ez64f6agiitc7pqb
      value:
        integer literal lEWM: type=c02_TxmtId_SBW_Rq_SCCM, value=0
    XDIS_chp9mqijhk8rn6j5ty318nor4
      value:
        integer literal lVGS_NAG2: type=c02_TxmtId_SBW_Rs_TCM, value=0
    XDIS_a7fn7gu0o6trtoxxkozis2zcm
      value:
        integer literal l3: type=c02_InActv_Actv, value=3
    XDIS_6orcl756eoqwhq5aunx3kjhn8
      value:
        integer literal l0: type=c05_l_per_min_0_15_0k5, value=0
    XDIS_c5ocfhi8et6dfyhtan4nkmz07
      value:
        integer literal l4095: type=c12_rpm_0_16376_4, value=4095
    XDIS_2db0f8ngs6vghwr5wq6rrafpy
      value:
        integer literal lIDLE: type=c02_TxPkPos_Rq, value=0
    XDIS_dcnxhky8pp02zzvemp22clxcz
      value:
        integer literal l3: type=c02_PNHV_TxPkPosn_Rq, value=3
    XDIS_8i34raomewkyeoeuimjig1t87
      value:
        integer literal l15: type=c04_TxSelVlvPos_Actl, value=15
    XDIS_cv70zed5pprac0yqjn2k05rnv
      value:
        integer literal lIDLE: type=c02_TxShftRcmnd_Disp_Rq_TCM, value=0
    XDIS_6q0nuqtid6q3bbxouehdfsw29
      value:
        integer literal l3: type=c02_TxShiftStyle_V2, value=3
    XDIS_4ld9eknd9hbtp85sn1cgsehjf
      value:
        integer literal l3: type=c02_TxSlp_Stat, value=3
    XDIS_2w6cbkwiimui1ikli98aqr08p
      value:
        integer literal l0: type=c08_degC_m40_214_1, value=0
    XDIS_ca1sbg763fh3u69idk2hszod2
      value:
        integer literal lKMH_KM: type=c01_UnitVehSpd_IC, value=0
    XDIS_3574ocltinkktr2wwgz9j67w1
      value:
        integer literal l255: type=c08_m_p_sq_s_m2k56_2k52_0k02, value=255
    XDIS_2gax48rqljyy38clo3tdyfut0
      value:
        integer literal lELEC: type=c02_Signal_Qual, value=1
    XDIS_5e62jzeb2fc0ic26itktsmydt
      value:
        integer literal l4095: type=c12_m_p_sq_s_m40d96_p40d92_0d02, value=4095
    XDIS_drqm7m0w6ph9omeq6ml23fh7e
      value:
        integer literal l1023: type=c10_m_p_sq_s_m10k24_p10k2_0k02, value=1023
    XDIS_bt1zhn7y1ejr6qxakir4f40fx
      value:
        integer literal l15: type=c04_VehDrvProg_V3, value=15
    XDIS_6gordusgbyogi4gfgkos43f1m
      value:
        integer literal l3: type=c02_NPsd_NDefORDown_PsdORUp, value=3
    XDIS_ebr88xzzgc4mibfyqj4hfu07p
      value:
        integer literal l250: type=c09_km_p_h_0_500_1, value=250
    XDIS_1fl5m527mfqxrtai409n5nt6p
      value:
        integer literal l4095: type=c12_km_p_h_0_409k4_0k1, value=4095
    XDIS_2ti1tb937zofciy7tyx78817u
      value:
        integer literal l65535: type=c16_deg_p_s_m327k68_327k66_0k01, value=65535
    XDIS_9at492ayvc0eu41j1vsg7u9fh
      value:
        integer literal l1023: type=c10_deg_p_s_m5d12_p5d1_0d01, value=1023
    XDIS_924qw6koy0pgxo1lr9qanbbdz
      value:
        integer literal l255: type=c08_UInt_SNA_na, value=255
    XDIS_b2vio5hx9hk9i8xkusx6f9nkf
      value:
        integer literal l3: type=c02_VIN, value=3
    XDIS_3n14ia5jbtvrmzyyp9apgzvw8
      value:
        integer literal l255: type=c08_WakeupRsn_SWSP, value=255
    XDIS_zfdazignwfnolwf6r1u16rwh
      value:
        integer literal l255: type=c08_WakeupRsn_CPC, value=255
    XDIS_3c4ksz7u3rji951ohmnidw85i
      value:
        integer literal l255: type=c08_WakeupRsn_DRVU, value=255
    XDIS_3y4lg9s0dpmmrleq719wxccpi
      value:
        integer literal l255: type=c08_WakeupRsn_ECM, value=255
    XDIS_c1uleirk2bcioplgr7prkm23d
      value:
        integer literal l255: type=c08_WakeupRsn_FSCM, value=255
    XDIS_2o0otao352rw44tj5bta4i007
      value:
        integer literal l255: type=c08_WakeupRsn_ISM, value=255
    XDIS_e4uet9j8xwkldgba4oq2381xs
      value:
        integer literal l255: type=c08_WakeupRsn_TCM, value=255
    XDIS_10vorrxz282yylz1thjvk5dvx
      value:
        integer literal lMFC: type=c02_WDC_IntrvntnMd_TCM, value=0
    XDIS_eoa5ig83h5a3fm98rgipqj3hz
      value:
        integer literal l4095: type=c12_Nm_m500_1547k5_0k5, value=4095
    XDIS_6n8ah31u6sz3w1m3lpg434vip
      value:
        integer literal l15: type=c04_WDC_Stat, value=15
    XDIS_1qop2uga8u6pailb3xixw6g6t
      value:
        integer literal l3: type=c02_WhlDir, value=3
    XDIS_a8d4ztmqyi6w3ybp8z5ft5e0
      value:
        integer literal l255: type=c08_Impulses_0_254_1, value=255
    XDIS_eso3tkwpkvbawn94lsv7hjxdg
      value:
        integer literal l16383: type=c14_rpm_0_8191_0k5, value=16383
package /ECU_INSTANCES
  10 x ecu instance, all with com-processing-period=0.0050:
    ASX: associated-i-pdu-group=[TxMess_ASX_POWERTRAIN, TxNorm_ASX_POWERTRAIN, RxNorm_ASX_POWERTRAIN], diagnostic-address=1578, sleep-mode-supported=true, wake-up-over-bus-supported=true
      can communication controller ASX_POWERTRAIN: wake-up-by-controller-supported=true, can-controller-attributes=can-controller-configuration-requirements={max-number-of-time-quanta-per-bit=20, max-sample-point=81.25, max-sync-jump-width=20.0, min-number-of-time-quanta-per-bit=15, min-sample-point=80.0, min-sync-jump-width=18.75}, nm-msg-cycle-offset=0.03, nm-msg-reduced-time=1.51, nm-user-data-enabled=true
      can communication connector XDIS_49itp1vliru6t3jfbko77gn3l: channel=POWERTRAIN, comm-controller=ASX_POWERTRAIN, nm-address=42
    CPC: associated-i-pdu-group=[TxNorm_CPC_POWERTRAIN, TxRedu_CPC_POWERTRAIN, RxNorm_CPC_POWERTRAIN], diagnostic-address=2021, sleep-mode-supported=true, wake-up-over-bus-supported=true
      can communication controller CPC_POWERTRAIN: wake-up-by-controller-supported=true, can-controller-attributes=can-controller-configuration-requirements={max-number-of-time-quanta-per-bit=20, max-sample-point=81.25, max-sync-jump-width=20.0, min-number-of-time-quanta-per-bit=15, min-sample-point=80.0, min-sync-jump-width=18.75}, nm-msg-cycle-offset=0.01, nm-msg-reduced-time=1.89, nm-user-data-enabled=true
      can communication connector XDIS_3ok1kc7qnfrmoouz6zcasiq44: channel=POWERTRAIN, comm-controller=CPC_POWERTRAIN, nm-address=89
    DRVU: associated-i-pdu-group=[TxNorm_DRVU_POWERTRAIN, RxNorm_DRVU_POWERTRAIN], sleep-mode-supported=true, wake-up-over-bus-supported=true
      can communication controller DRVU_POWERTRAIN: wake-up-by-controller-supported=true, can-controller-attributes=can-controller-configuration-requirements={max-number-of-time-quanta-per-bit=20, max-sample-point=81.25, max-sync-jump-width=20.0, min-number-of-time-quanta-per-bit=15, min-sample-point=80.0, min-sync-jump-width=18.75}, nm-msg-cycle-offset=0.05, nm-msg-reduced-time=1.77, nm-user-data-enabled=true
      can communication connector XDIS_11u29gyq1e51ix3x8m52o1aku: channel=POWERTRAIN, comm-controller=DRVU_POWERTRAIN, nm-address=77
    ECM: associated-i-pdu-group=[TxNorm_ECM_POWERTRAIN, RxNorm_ECM_POWERTRAIN], diagnostic-address=2016, sleep-mode-supported=true, wake-up-over-bus-supported=true
      can communication controller ECM_POWERTRAIN: wake-up-by-controller-supported=true, can-controller-attributes=can-controller-configuration-requirements={max-number-of-time-quanta-per-bit=20, max-sample-point=81.25, max-sync-jump-width=20.0, min-number-of-time-quanta-per-bit=15, min-sample-point=80.0, min-sync-jump-width=18.75}, nm-msg-cycle-offset=0.0, nm-msg-reduced-time=1.88, nm-user-data-enabled=true
      can communication connector XDIS_5pe4eqqkrx0lrl1b67lrr5l42: channel=POWERTRAIN, comm-controller=ECM_POWERTRAIN, nm-address=88
    FFAP_STAR_2: associated-i-pdu-group=[TxNorm_FFAP_STAR_2_POWERTRAIN, RxNorm_FFAP_STAR_2_POWERTRAIN], diagnostic-address=1500, sleep-mode-supported=false, wake-up-over-bus-supported=false
      can communication controller FFAP_STAR_2_POWERTRAIN: wake-up-by-controller-supported=false, can-controller-attributes=can-controller-configuration-requirements={max-number-of-time-quanta-per-bit=20, max-sample-point=81.25, max-sync-jump-width=20.0, min-number-of-time-quanta-per-bit=15, min-sample-point=80.0, min-sync-jump-width=18.75}, nm-user-data-enabled=true
      can communication connector XDIS_c72dufe5cx3e7qbatpga1hygd: channel=POWERTRAIN, comm-controller=FFAP_STAR_2_POWERTRAIN
    FSCM: associated-i-pdu-group=[TxNorm_FSCM_POWERTRAIN, RxNorm_FSCM_POWERTRAIN], diagnostic-address=2019, sleep-mode-supported=true, wake-up-over-bus-supported=true
      can communication controller FSCM_POWERTRAIN: wake-up-by-controller-supported=true, can-controller-attributes=can-controller-configuration-requirements={max-number-of-time-quanta-per-bit=20, max-sample-point=81.25, max-sync-jump-width=20.0, min-number-of-time-quanta-per-bit=15, min-sample-point=80.0, min-sync-jump-width=18.75}, nm-msg-cycle-offset=0.04, nm-msg-reduced-time=1.92, nm-user-data-enabled=true
      can communication connector XDIS_1436dbah15lq29z99i3amvzp5: channel=POWERTRAIN, comm-controller=FSCM_POWERTRAIN, nm-address=92
    ISM: associated-i-pdu-group=[TxMess_ISM_POWERTRAIN, TxNorm_ISM_POWERTRAIN, RxNorm_ISM_POWERTRAIN], diagnostic-address=1631, sleep-mode-supported=true, wake-up-over-bus-supported=true
      can communication controller ISM_POWERTRAIN: wake-up-by-controller-supported=true, can-controller-attributes=can-controller-configuration-requirements={max-number-of-time-quanta-per-bit=20, max-sample-point=81.25, max-sync-jump-width=20.0, min-number-of-time-quanta-per-bit=15, min-sample-point=80.0, min-sync-jump-width=18.75}, nm-msg-cycle-offset=0.07, nm-msg-reduced-time=1.95, nm-user-data-enabled=true
      can communication connector XDIS_6bnwgewl5i1i9gxjca55filo2: channel=POWERTRAIN, comm-controller=ISM_POWERTRAIN, nm-address=95
    SSP: associated-i-pdu-group=[TxMess_SSP_POWERTRAIN, TxNorm_SSP_POWERTRAIN, RxNorm_SSP_POWERTRAIN], diagnostic-address=1632, sleep-mode-supported=false, wake-up-over-bus-supported=false
      can communication controller SSP_POWERTRAIN: wake-up-by-controller-supported=false, can-controller-attributes=can-controller-configuration-requirements={max-number-of-time-quanta-per-bit=20, max-sample-point=81.25, max-sync-jump-width=20.0, min-number-of-time-quanta-per-bit=15, min-sample-point=80.0, min-sync-jump-width=18.75}, nm-user-data-enabled=true
      can communication connector XDIS_6bycd53b3b83wcbdr7ht5a16u: channel=POWERTRAIN, comm-controller=SSP_POWERTRAIN
    TCM: associated-i-pdu-group=[TxMess_TCM_POWERTRAIN, TxNorm_TCM_POWERTRAIN, RxNorm_TCM_POWERTRAIN], diagnostic-address=2017, sleep-mode-supported=true, wake-up-over-bus-supported=true
      can communication controller TCM_POWERTRAIN: wake-up-by-controller-supported=true, can-controller-attributes=can-controller-configuration-requirements={max-number-of-time-quanta-per-bit=20, max-sample-point=81.25, max-sync-jump-width=20.0, min-number-of-time-quanta-per-bit=15, min-sample-point=80.0, min-sync-jump-width=18.75}, nm-msg-cycle-offset=0.02, nm-msg-reduced-time=1.9, nm-user-data-enabled=true
      can communication connector XDIS_ezray0teml101xbe2qouy0iov: channel=POWERTRAIN, comm-controller=TCM_POWERTRAIN, nm-address=90
    TGW: associated-i-pdu-group=RxNorm_TGW_POWERTRAIN, diagnostic-address=1592, sleep-mode-supported=true, wake-up-over-bus-supported=true
      can communication controller TGW_POWERTRAIN: wake-up-by-controller-supported=true, can-controller-attributes=can-controller-configuration-requirements={max-number-of-time-quanta-per-bit=20, max-sample-point=81.25, max-sync-jump-width=20.0, min-number-of-time-quanta-per-bit=15, min-sample-point=80.0, min-sync-jump-width=18.75}, nm-msg-cycle-offset=0.0, nm-msg-reduced-time=1.56, nm-user-data-enabled=true
      can communication connector XDIS_erz0bnroau7b4umwrxo6ewq9a: channel=POWERTRAIN, comm-controller=TGW_POWERTRAIN, nm-address=56
package /POWERTRAIN
  can cluster POWERTRAIN:
    max-frame-length=8
    nm-node-detection-enabled=true
    nm-node-id-enabled=true
    nm-repeat-message-support=true
    protocol-name=CAN
    protocol-version=can2.0b
    speed=500000
    nm-bus-load-reduction-active=true
    nm-bus-load-reduction-enabled=true
    nm-immediate-restart-enabled=true
    nm-lower-can-id=1280
    nm-msg-cycle-time=2.0
    nm-remote-sleep-indication-time=5.0
    nm-repeat-message-state-time=6.0
    nm-timeout-time=5.0
    nm-upper-can-id=1407
    nm-wait-bus-sleep-time=1.5
