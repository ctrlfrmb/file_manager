[part 1 of 5: packages /UNITS to /DATA_TYPES]
AUTOSAR XML (schema 3.2.2)
# Copyright (c) 2016 Daimler AG
standard types defined: boolean, uint16, uint32, uint8
package /UNITS
  32 x unit:
    percent: display-name=%  # %
    A: display-name=A
    bar: display-name=bar
    Days: display-name=Days
    g_per_s: display-name=g/s  # g/s
    hPa: display-name=hPa
    Impulses: display-name=Impulses
    km: display-name=km
    km_per_h: display-name=km/h  # km/h
    km_per_h_mph: display-name=km/h(mph)  # km/h(mph)
    kPa: display-name=kPa
    l: display-name=l
    l_per_hour: display-name=l/h  # l/h
    l_per_min: display-name=l/min  # l/min
    m: display-name=m
    m_per_s_sq: display-name=m/s²  # m/s²
    mbar: display-name=mbar
    min: display-name=min
    mm: display-name=mm
    N: display-name=N
    Nm: display-name=Nm
    Nm_per_s: display-name=Nm/s  # Nm/s
    NoUnit: display-name=NoUnit
    rpm: display-name=rpm
    s: display-name=s
    V: display-name=V
    W: display-name=W
    Week: display-name=Week
    deg: display-name=°  # °
    deg_per_s: display-name=°/s  # °/s
    deg_C: display-name=°C  # °C
    ul_per_250ms: display-name=µl/250ms  # µl/250ms
package /BaseTypeGeneric
  6 x base type, all with category=SW_FIXED_LENGTH, base-type-size=8, base-type-encoding=NONE:
    XDIS_2lmfwx1nh07esathzzxm7jxfi
    XDIS_7kkx2iefr443licwjyu56ez4s
    XDIS_7r878ot1syizwhe8b2h1y5lyw
    XDIS_afo0uuzsb2okcpsaaswegeg5h
    XDIS_dykpj66fw3h2aelavfkzm58wf
    XDIS_ee0ra12zbca46xykyy0a4d2jr
package /DATA_TYPES
  382 x integer type:
    c01_Dir_Same_Opposite: base-type=uint8, compu {0=I_C01_DIR_SAME_OPPOSITE_SAME (SAME) (Same direction as combustion engine), 1=I_C01_DIR_SAME_OPPOSITE_OPPOSITE (OPPOSITE) (Opposite direction as combustion engine)}, lower-limit=0, upper-limit=1  # 01_Dir_Same_Opposite
    c01_Disabled_Enabled: base-type=uint8, compu {0=I_C01_DISABLED_ENABLED_DSABL (DSABL) (Disabled), 1=I_C01_DISABLED_ENABLED_ENBL (ENBL) (Enabled)}, lower-limit=0, upper-limit=1  # 01_Disabled_Enabled
    c01_DL_AllDr_Stat_CPC: base-type=uint8, compu {0=I_C01_DL_ALLDR_STAT_CPC_ALL_CLS (ALL_CLS) (All doors and deck lid closed), 1=I_C01_DL_ALLDR_STAT_CPC_ANY_OPN (ANY_OPN) (Any door or deck lid open)}, lower-limit=0, upper-limit=1  # 01_DL_AllDr_Stat_CPC | 01 DL Doors Open Stat
    c01_EM01_NegTrq_Rs: base-type=uint8, compu {0=I_C01_EM01_NEGTRQ_RS_FALSE (FALSE) (Negative torque is done correctly), 1=I_C01_EM01_NEGTRQ_RS_TRUE (TRUE) (Negative torque is not done correctly)}, lower-limit=0, upper-limit=1  # 01_EM01_NegTrq_Rs
    c01_FalseTrue: base-type=uint8, compu {0=I_C01_FALSETRUE_FALSE (FALSE) (False), 1=I_C01_FALSETRUE_TRUE (TRUE) (True)}, lower-limit=0, upper-limit=1  # 01_FalseTrue
    c01_Idle_MsgRq: base-type=uint8, compu {0=I_C01_IDLE_MSGRQ_IDLE (IDLE) (Idle), 1=I_C01_IDLE_MSGRQ_MSG_REQUEST (MSG_REQUEST) (Message Request)}, lower-limit=0, upper-limit=1  # 01_Idle_MsgRq
    c01_NoFault_KeptAwake: base-type=uint8, compu {0=I_C01_NOFAULT_KEPTAWAKE_NO_FLT (NO_FLT) (No fault), 1=I_C01_NOFAULT_KEPTAWAKE_BUS_FLT_KPT_AWAKE (BUS_FLT_KPT_AWAKE) (Bus faulty, kept awake)}, lower-limit=0, upper-limit=1  # 01_NoFault_KeptAwake
    c01_Ok_Flt_EM01: base-type=uint8, compu {0=I_C01_OK_FLT_EM01_OK (OK) (Electric Machine available without restrictions), 1=I_C01_OK_FLT_EM01_FAULT (FAULT) (Electric machine not available due error)}, lower-limit=0, upper-limit=1  # 01_Ok_Flt_EM01
    c01_TxLHOM2_Gr_Hold: base-type=uint8, compu {0=I_C01_TXLHOM2_GR_HOLD_NO_ERR (NO_ERR) (No error), 1=I_C01_TXLHOM2_GR_HOLD_UNBL_SHFT_GR (UNBL_SHFT_GR) (Unable to shift out of current gear)}, lower-limit=0, upper-limit=1  # 01_TxLHOM2_Gr_Hold
    c01_TxLHOM2_Gr_Lock: base-type=uint8, compu {0=I_C01_TXLHOM2_GR_LOCK_NO_ERR (NO_ERR) (No error), 1=I_C01_TXLHOM2_GR_LOCK_GR_LOCK (GR_LOCK) (Gears are locked)}, lower-limit=0, upper-limit=1  # 01_TxLHOM2_Gr_Lock
    c01_TxLHOM2_Stat_Hybrid: base-type=uint8, compu {0=I_C01_TXLHOM2_STAT_HYBRID_NO_ERR (NO_ERR) (No error), 1=I_C01_TXLHOM2_STAT_HYBRID_CURR_NOT_CORR_RQ (CURR_NOT_CORR_RQ) (Current hybrid state does not correspond with the requested hybrid state)}, lower-limit=0, upper-limit=1  # 01_TxLHOM2_Stat_Hybrid
    c01_TxLHOM2_TX_Hydr: base-type=uint8, compu {0=I_C01_TXLHOM2_TX_HYDR_NO_ERR (NO_ERR) (No error), 1=I_C01_TXLHOM2_TX_HYDR_HYDR_LIM_MOD (HYDR_LIM_MOD) (Hydraulic limp-home mode)}, lower-limit=0, upper-limit=1  # 01_TxLHOM2_TX_Hydr
    c01_TxLHOM2_TX_PwrFree: base-type=uint8, compu {0=I_C01_TXLHOM2_TX_PWRFREE_NO_ERR (NO_ERR) (No error), 1=I_C01_TXLHOM2_TX_PWRFREE_UNBL_TRANS_TRQ (UNBL_TRANS_TRQ) (Transmission unable to transfer torque)}, lower-limit=0, upper-limit=1  # 01_TxLHOM2_TX_PwrFree
    c01_TxLHOM2_TX_Tractn: base-type=uint8, compu {0=I_C01_TXLHOM2_TX_TRACTN_NO_ERR (NO_ERR) (No error), 1=I_C01_TXLHOM2_TX_TRACTN_UNDES_TRQ_TRANS (UNDES_TRQ_TRANS) (Undesired torque transfer in transmission)}, lower-limit=0, upper-limit=1  # 01_TxLHOM2_TX_Tractn
    c01_UnitVehSpd: base-type=uint8, compu {0=I_C01_UNITVEHSPD_KMH (KMH) (Vehicle speed unit "km/h" (kilometers per hour)), 1=I_C01_UNITVEHSPD_MPH (MPH) (Vehicle speed unit "mph" (miles per hour))}, lower-limit=0, upper-limit=1  # 01_UnitVehSpd
    c01_UnitVehSpd_IC: base-type=uint8, compu {0=I_C01_UNITVEHSPD_IC_KMH_KM (KMH_KM) (Vehicle speed unit "km/h" (kilometers per hour) and distance unit "km" (kilometers)), 1=I_C01_UNITVEHSPD_IC_MPH_MI (MPH_MI) (Vehicle speed unit "mph" (miles per hour) and distance unit "mi" (miles))}, lower-limit=0, upper-limit=1  # 01_UnitVehSpd_IC
    c02_ADC_SwLED_Rq_V2: base-type=uint8, compu {0=I_C02_ADC_SWLED_RQ_V2_SPORT_COMFORT_OFF (SPORT_COMFORT_OFF) (Sport-LED and Comfort-LED off), 1=I_C02_ADC_SWLED_RQ_V2_COMFORT_ON (COMFORT_ON) (Comfort-LED on), 2=I_C02_ADC_SWLED_RQ_V2_SPORT_ON (SPORT_ON) (Sport-LED on), 3=I_C02_ADC_SWLED_RQ_V2_SPORT_PLUS_ON (SPORT_PLUS_ON) (Sport+, i.e. both LEDs on (only AMG))}, lower-limit=0, upper-limit=3  # 02_ADC_SwLED_Rq_V2
    c02_AMG_MenuSw_Psd: base-type=uint8, compu {0=I_C02_AMG_MENUSW_PSD_NPSD (NPSD) (Not pressed), 1=I_C02_AMG_MENUSW_PSD_SHRT_PSD (SHRT_PSD) (Short pressed (AMG menu)), 2=I_C02_AMG_MENUSW_PSD_LONG_PSD (LONG_PSD) (Long pressed (AMG menu and memory)), 3=I_C02_AMG_MENUSW_PSD_SNA (SNA) (SNA value from data type)}, lower-limit=0, upper-limit=3  # 02_AMG_MenuSw_Psd
      invalid-value:
        integer literal c02_AMG_MenuSw_Psd: type=c02_AMG_MenuSw_Psd, value=3
    c02_AWD_OprtnMd: base-type=uint8, compu {0=I_C02_AWD_OPRTNMD_NORMAL (NORMAL) (Normal mode), 1=I_C02_AWD_OPRTNMD_LIMIT_MAX (LIMIT_MAX) (Restricted mode, maximum limit controlled externally), 2=I_C02_AWD_OPRTNMD_EXTERNAL_CTRLD (EXTERNAL_CTRLD) (External controlled mode, target torque controlled externally), 3=I_C02_AWD_OPRTNMD_PASSIVE (PASSIVE) (Passive mode)}, lower-limit=0, upper-limit=3  # 02_AWD_OprtnMd | 02 AWD Oprtn Md
    c02_BatCplSw_Rq: base-type=uint8, compu {0=I_C02_BATCPLSW_RQ_IDLE (IDLE) (No request), 1=I_C02_BATCPLSW_RQ_CLOSE (CLOSE) (Close battery coupling switch), 2=I_C02_BATCPLSW_RQ_NDEF2 (NDEF2) (not defined), 3=I_C02_BATCPLSW_RQ_SNA (SNA) (SNA value from data type)}, lower-limit=0, upper-limit=3  # 02_BatCplSw_Rq
      invalid-value:
        integer literal c02_BatCplSw_Rq: type=c02_BatCplSw_Rq, value=3
    c02_BatCutSw_Stat: base-type=uint8, compu {0=I_C02_BATCUTSW_STAT_CLS (CLS) (Battery cutoff switch is closed), 1=I_C02_BATCUTSW_STAT_PREOPN (PREOPN) (Battery cutoff switch opens in 300 sec), 2=I_C02_BATCUTSW_STAT_OPN (OPN) (Battery cutoff switch is open), 3=I_C02_BATCUTSW_STAT_SNA (SNA) (SNA value from data type)}, lower-limit=0, upper-limit=3  # 02_BatCutSw_Stat
      invalid-value:
        integer literal c02_BatCutSw_Stat: type=c02_BatCutSw_Stat, value=3
    c02_Brk_Stat: base-type=uint8, compu {0=I_C02_BRK_STAT_IDLE (IDLE) (No braking), 1=I_C02_BRK_STAT_BRAKING (BRAKING) (Braking), 2=I_C02_BRK_STAT_NDEF2 (NDEF2) (not defined), 3=I_C02_BRK_STAT_SNA (SNA) (SNA value from data type)}, lower-limit=0, upper-limit=3  # 02_Brk_Stat
      invalid-value:
        integer literal c02_Brk_Stat: type=c02_Brk_Stat, value=3
    c02_BrkRq_PT_Enbl: base-type=uint8, compu {0=THS_DSABL (Transmission hold support disable), 1=THS_ENBL (Transmission hold support enable), 2=THS_HOLD_ACTV (Transmission hold support hold active), 3=THS_GO_ACTV (Transmission hold support go active)}, lower-limit=0, upper-limit=3  # 02_BrkRq_PT_Enbl
    c02_brkrq_tcm: base-type=uint8, compu {0=I_C02_BRKRQ_TCM_IDLE (IDLE) (Standby), 1=I_C02_BRKRQ_TCM_BRK_RQ (BRK_RQ) (Brake request TCM), 2=I_C02_BRKRQ_TCM_GO_RQ (GO_RQ) (Go request TCM), 3=I_C02_BRKRQ_TCM_SNA (SNA) (SNA value from data type)}, lower-limit=0, upper-limit=3  # 02_BrkRq_TCM
      invalid-value:
        integer literal c02_brkrq_tcm: type=c02_brkrq_tcm, value=3
    c02_Clutch_Actv_Stat: base-type=uint8, compu {0=I_C02_CLUTCH_ACTV_STAT_NDEF0 (NDEF0) (no change), 1=I_C02_CLUTCH_ACTV_STAT_CLS_START (CLS_START) (power train will be closed), 2=I_C02_CLUTCH_ACTV_STAT_OPN_START (OPN_START) (power train will be opend), 3=I_C02_CLUTCH_ACTV_STAT_SNA (SNA) (SNA value from data type)}, lower-limit=0, upper-limit=3  # 02_Clutch_Actv_Stat
      invalid-value:
        integer literal c02_Clutch_Actv_Stat: type=c02_Clutch_Actv_Stat, value=3
    c02_CoastMd_Disp_Rq: base-type=uint8, compu {0=I_C02_COASTMD_DISP_RQ_COAST_INACTV (COAST_INACTV) (Coasting mode inactive), 1=I_C02_COASTMD_DISP_RQ_COAST_ACTV (COAST_ACTV) (Coasting mode active), 2=I_C02_COASTMD_DISP_RQ_NDEF2 (NDEF2) (not defined), 3=I_C02_COASTMD_DISP_RQ_SNA (SNA) (SNA value from data type)}, lower-limit=0, upper-limit=3  # 02_CoastMd_Disp_Rq
      invalid-value:
        integer literal c02_CoastMd_Disp_Rq: type=c02_CoastMd_Disp_Rq, value=3
    c02_CoastMd_Stat: base-type=uint8, compu {0=I_C02_COASTMD_STAT_COAST_DASBL (COAST_DASBL) (Coasting disabled), 1=I_C02_COASTMD_STAT_COAST_ENBL (COAST_ENBL) (Coasting enabled), 2=I_C02_COASTMD_STAT_COAST_TRANS_ACTV (COAST_TRANS_ACTV) (Transition from/to coasting active), 3=I_C02_COASTMD_STAT_COAST_ACTV (COAST_ACTV) (Coasting active)} "02_CoastMd_Stat", lower-limit=0, upper-limit=3  # 02_CoastMd_Stat | 02 Coast Md Stat
    c02_ContEngRun_Stat:  # 02_ContEngRun_Stat
      base-type=uint8
      compu {0=I_C02_CONTENGRUN_STAT_CONT_ENG_RUN_OFF (CONT_ENG_RUN_OFF) (Continuous Engine Running off), 1=I_C02_CONTENGRUN_STAT_CONT_ENG_RUN_ON (CONT_ENG_RUN_ON) (Continuous Engine Running on), 2=I_C02_CONTENGRUN_STAT_NDEF (NDEF) (not defined), 3=I_C02_CONTENGRUN_STAT_SNA (SNA) (SNA value from data type)} "Status Motorweiterlaufschaltung / Continuous Engine Running State"
      lower-limit=0
      upper-limit=3
      invalid-value:
        integer literal c02_ContEngRun_Stat: type=c02_ContEngRun_Stat, value=3
    c02_CylCutoff_Stat: base-type=uint8, compu {0=I_C02_CYLCUTOFF_STAT_NO_ZAS (NO_ZAS) (no cylinder cutoff), 1=I_C02_CYLCUTOFF_STAT_ZAS_RQ (ZAS_RQ) (cylinder cutoff request (ecm internal)), 2=I_C02_CYLCUTOFF_STAT_ZAS_SHIFT (ZAS_SHIFT) (cylinder cutoff shifting), 3=I_C02_CYLCUTOFF_STAT_ZAS_ACTV (ZAS_ACTV) (cylinder cutoff active)}, lower-limit=0, upper-limit=3  # 02_CylCutoff_Stat
    c02_DiffLk_M_Md_Rq_ESP:  # 02_DiffLk_M_Md_Rq_ESP
      base-type=uint8
      compu {0=I_C02_DIFFLK_M_MD_RQ_ESP_FREE_RUN (FREE_RUN) (Differential lock mode "Free running"), 1=I_C02_DIFFLK_M_MD_RQ_ESP_LMT_MAX (LMT_MAX) (Differential lock mode "Limit max"; only for BR463 = "DS active"), 2=I_C02_DIFFLK_M_MD_RQ_ESP_ESP (ESP) (Differential lock mode "ESP controlled" ; only for BR463 = "DS start"), 3=I_C02_DIFFLK_M_MD_RQ_ESP_INACTV_LMT_MIN (INACTV_LMT_MIN) (Differential lock mode "Inactive", or "Limit Min" (only BR167); only for BR463 = “DS Error”)}
      lower-limit=0
      upper-limit=3
    c02_DiffLk_Trq_Rq_AMG: base-type=uint8, compu {0=I_C02_DIFFLK_TRQ_RQ_AMG_IDLE (IDLE) (No request), 1=I_C02_DIFFLK_TRQ_RQ_AMG_SLOW_OPN (SLOW_OPN) (Slow opening), 2=I_C02_DIFFLK_TRQ_RQ_AMG_EXTERNAL_MODE (EXTERNAL_MODE) (External mode), 3=I_C02_DIFFLK_TRQ_RQ_AMG_INACTV (INACTV) (Inactive)}, lower-limit=0, upper-limit=3  # 02_DiffLk_Trq_Rq_AMG | 02 Diff Lk Trq Rq AMG
    c02_Disengg_Engg: base-type=uint8, compu {0=I_C02_DISENGG_ENGG_DISENGG (DISENGG) (Disengaged), 1=I_C02_DISENGG_ENGG_ENGG (ENGG) (Engaged), 2=I_C02_DISENGG_ENGG_NDEF2 (NDEF2) (not defined), 3=I_C02_DISENGG_ENGG_SNA (SNA) (SNA value from data type)}, lower-limit=0, upper-limit=3  # 02_Disengg_Engg
      invalid-value:
        integer literal c02_Disengg_Engg: type=c02_Disengg_Engg, value=3
    c02_DPC_Md_SSA: base-type=uint8, compu {0=I_C02_DPC_MD_SSA_NDEF0 (NDEF0) (not defined), 1=I_C02_DPC_MD_SSA_SSA_ON (SSA_ON) (Stop start automatic on), 2=I_C02_DPC_MD_SSA_SSA_OFF (SSA_OFF) (Stop start automatic off), 3=I_C02_DPC_MD_SSA_SNA (SNA) (SNA value from data type)}, lower-limit=0, upper-limit=3  # 02_DPC_Md_SSA
      invalid-value:
        integer literal c02_DPC_Md_SSA: type=c02_DPC_Md_SSA, value=3
    c02_DynBrkMd: base-type=uint8, compu {0=I_C02_DYNBRKMD_IDLE (IDLE) (No dynamic braking), 1=I_C02_DYNBRKMD_ESP_SBC (ESP_SBC) (Dynamic braking via ESP), 2=I_C02_DYNBRKMD_EPKB (EPKB) (Dynamic braking via EPKB), 3=I_C02_DYNBRKMD_SNA (SNA) (SNA value from data type)}, lower-limit=0, upper-limit=3  # 02_DynBrkMd
      invalid-value:
        integer literal c02_DynBrkMd: type=c02_DynBrkMd, value=3
    c02_EDIFF_MsgDisp_Rq_AMG: base-type=uint8, compu {0=I_C02_EDIFF_MSGDISP_RQ_AMG_IDLE (IDLE) (No request), 1=I_C02_EDIFF_MSGDISP_RQ_AMG_EDIFF_FLT_PER (EDIFF_FLT_PER) (Message "Ediff system fault permanent"), 2=I_C02_EDIFF_MSGDISP_RQ_AMG_EDIFF_FLT_TMP (EDIFF_FLT_TMP) (Message "Ediff system fault temporary"), 3=I_C02_EDIFF_MSGDISP_RQ_AMG_SNA (SNA) (SNA value from data type)}, lower-limit=0, upper-limit=3  # 02_EDIFF_MsgDisp_Rq_AMG
      invalid-value:
        integer literal c02_EDIFF_MsgDisp_Rq_AMG: type=c02_EDIFF_MsgDisp_Rq_AMG, value=3
    c02_Enable_Disable: base-type=uint8, compu {0=I_C02_ENABLE_DISABLE_ENBL (ENBL) (Enable), 1=I_C02_ENABLE_DISABLE_DSABL (DSABL) (Disable), 2=I_C02_ENABLE_DISABLE_NDEF2 (NDEF2) (not defined), 3=I_C02_ENABLE_DISABLE_SNA (SNA) (SNA value from data type)}, lower-limit=0, upper-limit=3  # 02_Enable_Disable
      invalid-value:
        integer literal c02_Enable_Disable: type=c02_Enable_Disable, value=3
    c02_EngIdleRPM_Lvl: base-type=uint8, compu {0=I_C02_ENGIDLERPM_LVL_IDLE_WARM (IDLE_WARM) (Default engine idle speed for warm engine), 1=I_C02_ENGIDLERPM_LVL_IDLE_SPD1 (IDLE_SPD1) (Changed engine idle speed 1), 2=I_C02_ENGIDLERPM_LVL_IDLE_SPD2 (IDLE_SPD2) (Changed engine idle speed 2), 3=I_C02_ENGIDLERPM_LVL_SNA (SNA) (SNA value from data type)}, lower-limit=0, upper-limit=3  # 02_EngIdleRPM_Lvl
      invalid-value:
        integer literal c02_EngIdleRPM_Lvl: type=c02_EngIdleRPM_Lvl, value=3
    c02_ESL_Lk_Rq: base-type=uint8, compu {0=I_C02_ESL_LK_RQ_DEFAULT (DEFAULT) (Default, no request), 1=I_C02_ESL_LK_RQ_ORC_RQ (ORC_RQ) (ORC requested), 2=I_C02_ESL_LK_RQ_SAM_F_RQ (SAM_F_RQ) (SAM_F requested), 3=I_C02_ESL_LK_RQ_ORC_SAM_F_RQ (ORC_SAM_F_RQ) (ORC and SAM_F requested)}, lower-limit=0, upper-limit=3  # 02_ESL_Lk_Rq
    c02_ESP_Intrvntn_Stat_ECM:  # 02_ESP_Intrvntn_Stat_ECM
      base-type=uint8
      compu {0=I_C02_ESP_INTRVNTN_STAT_ECM_NO_INTRVNTN (NO_INTRVNTN) (No ESP intervention), 1=I_C02_ESP_INTRVNTN_STAT_ECM_OVR_EM_INTRVNTN (OVR_EM_INTRVNTN) (ESP intervention over E-Machine), 2=I_C02_ESP_INTRVNTN_STAT_ECM_OVR_ENG_INTRVNTN (OVR_ENG_INTRVNTN) (ESP intervention over Engine), 3=I_C02_ESP_INTRVNTN_STAT_ECM_OVR_EM_ENG_INTRVNTN (OVR_EM_ENG_INTRVNTN) (ESP intervention over Engine and E-Mashine)}
      lower-limit=0
      upper-limit=3
    c02_ESP_LastMd_Disp_Rq:  # 02_ESP_LastMd_Disp_Rq
      base-type=uint8
      compu {0=I_C02_ESP_LASTMD_DISP_RQ_NO_RQ (NO_RQ) (No request for last-mode handshake), 1=I_C02_ESP_LASTMD_DISP_RQ_LAST_MD_SPORT_RQ (LAST_MD_SPORT_RQ) (Request for ESP-Sport last-mode handshake), 2=I_C02_ESP_LASTMD_DISP_RQ_LAST_MD_OFF_RQ (LAST_MD_OFF_RQ) (Request for ESP-OFF last-mode handshake), 3=I_C02_ESP_LASTMD_DISP_RQ_SNA (SNA) (SNA value from data type)}
      lower-limit=0
      upper-limit=3
      invalid-value:
        integer literal c02_ESP_LastMd_Disp_Rq: type=c02_ESP_LastMd_Disp_Rq, value=3
    c02_ESP_Md_Rq_Ack: base-type=uint8, compu {0=I_C02_ESP_MD_RQ_ACK_ON (ON) (ESP is on), 1=I_C02_ESP_MD_RQ_ACK_OFF (OFF) (ESP is off), 2=I_C02_ESP_MD_RQ_ACK_AMG_SPORT (AMG_SPORT) (ESP in AMG-Sport mode (only AMG)), 3=I_C02_ESP_MD_RQ_ACK_SNA (SNA) (SNA value from data type)}, lower-limit=0, upper-limit=3  # 02_ESP_Md_Rq_Ack
      invalid-value:
        integer literal c02_ESP_Md_Rq_Ack: type=c02_ESP_Md_Rq_Ack, value=3
    c02_ESP_Md_Rq_AMG: base-type=uint8, compu {0=I_C02_ESP_MD_RQ_AMG_NO (NO) (No request), 1=I_C02_ESP_MD_RQ_AMG_ESP_SH (ESP_SH) (ESP sport-handling mode request), 2=I_C02_ESP_MD_RQ_AMG_ESP_OFF (ESP_OFF) (ESP off request), 3=I_C02_ESP_MD_RQ_AMG_SNA (SNA) (SNA value from data type)}, lower-limit=0, upper-limit=3  # 02_ESP_Md_Rq_AMG
      invalid-value:
        integer literal c02_ESP_Md_Rq_AMG: type=c02_ESP_Md_Rq_AMG, value=3
    c02_EVC_AddEquip: base-type=uint8, compu {0=I_C02_EVC_ADDEQUIP_VAR_0 (VAR_0) (variant 0), 3=I_C02_EVC_ADDEQUIP_OTHER (OTHER) (none of listed variants)}, lower-limit=0, upper-limit=3  # 02_EVC_AddEquip
    c02_EVC_Stat: base-type=uint8, compu {0=I_C02_EVC_STAT_NDEF0 (NDEF0) (not defined), 1=I_C02_EVC_STAT_PROG (PROG) (programmed), 2=I_C02_EVC_STAT_REQ (REQ) (request), 3=I_C02_EVC_STAT_SNA (SNA) (SNA value from data type)} "EVC Botschaftsstatus / EVC message status", lower-limit=0, upper-limit=3  # 02_EVC_Stat
      invalid-value:
        integer literal c02_EVC_Stat: type=c02_EVC_Stat, value=3
    c02_ExhstFlap_SwLED_Rq: base-type=uint8, compu {0=I_C02_EXHSTFLAP_SWLED_RQ_LED_OFF (LED_OFF) (Exhaust flap idle stage; all LEDs off), 1=I_C02_EXHSTFLAP_SWLED_RQ_LED_STAGE1 (LED_STAGE1) (LEDs according to stage 1 on), 2=I_C02_EXHSTFLAP_SWLED_RQ_LED_STAGE2 (LED_STAGE2) (LEDs according to stage 2 on), 3=I_C02_EXHSTFLAP_SWLED_RQ_LED_STAGE3 (LED_STAGE3) (LEDs according to stage 3 on)}, lower-limit=0, upper-limit=3  # 02_ExhstFlap_SwLED_Rq
    c02_FFAP_ActvMd: base-type=uint8, compu {0=I_C02_FFAP_ACTVMD_OFF (OFF) (FFP off), 1=I_C02_FFAP_ACTVMD_BASIC (BASIC) (FFP on - basic mode), 2=I_C02_FFAP_ACTVMD_NDEF (NDEF) (not defined), 3=I_C02_FFAP_ACTVMD_SNA (SNA) (SNA value from data type)}, lower-limit=0, upper-limit=3  # 02_FFAP_ActvMd
      invalid-value:
        integer literal c02_FFAP_ActvMd: type=c02_FFAP_ActvMd, value=3
    c02_FFAP_CurCtrl: base-type=uint8, compu {0=I_C02_FFAP_CURCTRL_DONE (DONE) (Request accomplished), 1=I_C02_FFAP_CURCTRL_PART_DONE (PART_DONE) (Request partially accomplished), 2=I_C02_FFAP_CURCTRL_NOT_DONE (NOT_DONE) (Request not accomplished), 3=I_C02_FFAP_CURCTRL_SNA (SNA) (SNA value from data type)}, lower-limit=0, upper-limit=3  # 02_FFAP_CurCtrl
      invalid-value:
        integer literal c02_FFAP_CurCtrl: type=c02_FFAP_CurCtrl, value=3
    c02_FFAP_DbPlsTrgr_Rq: base-type=uint8, compu {0=I_C02_FFAP_DBPLSTRGR_RQ_NO_DBPLSTRGR (NO_DBPLSTRGR) (No trigger of double impulse), 1=I_C02_FFAP_DBPLSTRGR_RQ_DBPLSTRGR (DBPLSTRGR) (Trigger Douible Impulse), 2=I_C02_FFAP_DBPLSTRGR_RQ_RES2 (RES2) (Reserved), 3=I_C02_FFAP_DBPLSTRGR_RQ_SNA (SNA) (SNA value from data type)}, lower-limit=0, upper-limit=3  # 02_FFAP_DbPlsTrgr_Rq
      invalid-value:
        integer literal c02_FFAP_DbPlsTrgr_Rq: type=c02_FFAP_DbPlsTrgr_Rq, value=3
    c02_HtPwr_Stat: base-type=uint8, compu {0=I_C02_HTPWR_STAT_CLS (CLS) (Heating cutoff valve is closed), 1=I_C02_HTPWR_STAT_OPN (OPN) (Heating cutoff valve is open), 2=I_C02_HTPWR_STAT_CYC (CYC) (Heating cutoff valve is cyclic clocked), 3=I_C02_HTPWR_STAT_SNA (SNA) (SNA value from data type)}, lower-limit=0, upper-limit=3  # 02_HtPwr_Stat
      invalid-value:
        integer literal c02_HtPwr_Stat: type=c02_HtPwr_Stat, value=3
    c02_HybStartMd: base-type=uint8, compu {0=I_C02_HYBSTARTMD_STARTER_ST (STARTER_ST) (The starter will perform the next start), 1=I_C02_HYBSTARTMD_EM_ST (EM_ST) (The EM will perform the next start), 2=I_C02_HYBSTARTMD_COMB_ST (COMB_ST) (Starter and EM will perform the next start), 3=I_C02_HYBSTARTMD_SNA (SNA) (SNA value from data type)}, lower-limit=0, upper-limit=3  # 02_HybStartMd
      invalid-value:
        integer literal c02_HybStartMd: type=c02_HybStartMd, value=3
    c02_Idle_Active_Inactive: base-type=uint8, compu {0=I_C02_IDLE_ACTIVE_INACTIVE_IDLE (IDLE) (No request), 1=I_C02_IDLE_ACTIVE_INACTIVE_ACTIVE (ACTIVE) (Active), 2=I_C02_IDLE_ACTIVE_INACTIVE_INACTIVE (INACTIVE) (Inactive), 3=I_C02_IDLE_ACTIVE_INACTIVE_SNA (SNA) (SNA value from data type)}, lower-limit=0, upper-limit=3  # 02_Idle_Active_Inactive
      invalid-value:
        integer literal c02_Idle_Active_Inactive: type=c02_Idle_Active_Inactive, value=3
    c02_Idle_Beep: base-type=uint8, compu {0=I_C02_IDLE_BEEP_IDLE (IDLE) (No request), 1=I_C02_IDLE_BEEP_CONT (CONT) (Continuous beep), 2=I_C02_IDLE_BEEP_NDEF2 (NDEF2) (not defined), 3=I_C02_IDLE_BEEP_SNA (SNA) (SNA value from data type)}, lower-limit=0, upper-limit=3  # 02_Idle_Beep
      invalid-value:
        integer literal c02_Idle_Beep: type=c02_Idle_Beep, value=3
    c02_Idle_Chime_Beep: base-type=uint8, compu {0=I_C02_IDLE_CHIME_BEEP_IDLE (IDLE) (No acoustical warning), 1=I_C02_IDLE_CHIME_BEEP_CHIME (CHIME) (Acoustical warning: chime), 2=I_C02_IDLE_CHIME_BEEP_BEEP (BEEP) (Acoustical warning: beep), 3=I_C02_IDLE_CHIME_BEEP_SNA (SNA) (SNA value from data type)}, lower-limit=0, upper-limit=3  # 02_Idle_Chime_Beep
      invalid-value:
        integer literal c02_Idle_Chime_Beep: type=c02_Idle_Chime_Beep, value=3
    c02_02_Idle_On_NDef: base-type=uint8, compu {0=I_C02_02_IDLE_ON_NDEF_IDLE (IDLE) (No request), 1=I_C02_02_IDLE_ON_NDEF_ON (ON) (On), 2=I_C02_02_IDLE_ON_NDEF_NDEF2 (NDEF2) (not defined), 3=I_C02_02_IDLE_ON_NDEF_SNA (SNA) (SNA value from data type)}, lower-limit=0, upper-limit=3  # 02_Idle_On_NDef
      invalid-value:
        integer literal c02_02_Idle_On_NDef: type=c02_02_Idle_On_NDef, value=3
    c02_Idle_Supp_Enbl: base-type=uint8, compu {0=I_C02_IDLE_SUPP_ENBL_IDLE (IDLE) (No request), 1=I_C02_IDLE_SUPP_ENBL_SUPP (SUPP) (Suppress), 2=I_C02_IDLE_SUPP_ENBL_ENBL (ENBL) (Enable), 3=I_C02_IDLE_SUPP_ENBL_SNA (SNA) (SNA value from data type)}, lower-limit=0, upper-limit=3  # 02_Idle_Supp_Enbl
      invalid-value:
        integer literal c02_Idle_Supp_Enbl: type=c02_Idle_Supp_Enbl, value=3
    c02_Inact_Act: base-type=uint8, compu {0=I_C02_INACT_ACT_INACTIVE (INACTIVE) (Inactive), 1=I_C02_INACT_ACT_ACTIVE (ACTIVE) (Active), 2=I_C02_INACT_ACT_NDEF2 (NDEF2) (not defined), 3=I_C02_INACT_ACT_SNA (SNA) (SNA value from data type)}, lower-limit=0, upper-limit=3  # 02_Inact_Act
      invalid-value:
        integer literal c02_Inact_Act: type=c02_Inact_Act, value=3
    c02_InActv_Actv: base-type=uint8, compu {0=I_C02_INACTV_ACTV_INACTV (INACTV) (No neutral position request from driver), 1=I_C02_INACTV_ACTV_ACTV (ACTV) (Neutral position request from driver), 3=I_C02_INACTV_ACTV_SNA (SNA) (SNA value from data type)}, lower-limit=0, upper-limit=3  # 02_InActv_Actv
      invalid-value:
        integer literal c02_InActv_Actv: type=c02_InActv_Actv, value=3
    c02_OBD_IgnCycCondICE_Stat: base-type=uint8, compu {0=I_C02_OBD_IGNCYCCONDICE_STAT_INACT (INACT) (inactive), 1=I_C02_OBD_IGNCYCCONDICE_STAT_ACTV (ACTV) (active), 2=I_C02_OBD_IGNCYCCONDICE_STAT_FLT (FLT) (fault), 3=I_C02_OBD_IGNCYCCONDICE_STAT_NDEF (NDEF) (not defined)}, lower-limit=0, upper-limit=3  # 02_InActv_Actv_Flt_Ndef
    c02_IntrvntnMd: base-type=uint8, compu {0=I_C02_INTRVNTNMD_MFC (MFC) (Intervention mode minimum fuel consumption), 1=I_C02_INTRVNTNMD_FAST (FAST) (Intervention mode fastest), 2=I_C02_INTRVNTNMD_RATE_DEC (RATE_DEC) (Intervention mode fastest with rate action - Torque decreasing), 3=I_C02_INTRVNTNMD_RATE_INC (RATE_INC) (Intervention mode fastest with rate action - Torque increasing)}, lower-limit=0, upper-limit=3  # 02_IntrvntnMd
    c02_LDC_CMS_MsgDisp_Rq: base-type=uint8, compu {0=I_C02_LDC_CMS_MSGDISP_RQ_IDLE (IDLE) (No request), 1=I_C02_LDC_CMS_MSGDISP_RQ_MSG1_3F3 (MSG1_3F3) (Message "Collision mitigation system defective"), 2=I_C02_LDC_CMS_MSGDISP_RQ_MSG2_3F2 (MSG2_3F2) (Message "Collision mitigation system temporarily without function"), 3=I_C02_LDC_CMS_MSGDISP_RQ_SNA (SNA) (SNA value from data type)}, lower-limit=0, upper-limit=3  # 02_LDC_CMS_MsgDisp_Rq
      invalid-value:
        integer literal c02_LDC_CMS_MsgDisp_Rq: type=c02_LDC_CMS_MsgDisp_Rq, value=3
    c02_LDC_Disp_Rq: base-type=uint8, compu {0=I_C02_LDC_DISP_RQ_OFF (OFF) (Off), 1=I_C02_LDC_DISP_RQ_ON (ON) (On), 2=I_C02_LDC_DISP_RQ_PRESELECT_MARKER (PRESELECT_MARKER) (Preselect Marker), 3=I_C02_LDC_DISP_RQ_SNA (SNA) (SNA value from data type)}, lower-limit=0, upper-limit=3  # 02_LDC_Disp_Rq
      invalid-value:
        integer literal c02_LDC_Disp_Rq: type=c02_LDC_Disp_Rq, value=3
    c02_Lgt_Off_Cont_Blink: base-type=uint8, compu {0=I_C02_LGT_OFF_CONT_BLINK_OFF (OFF) (Off), 1=I_C02_LGT_OFF_CONT_BLINK_CONT (CONT) (Continuous light), 2=I_C02_LGT_OFF_CONT_BLINK_BLINK (BLINK) (Blinking light), 3=I_C02_LGT_OFF_CONT_BLINK_SNA (SNA) (SNA value from data type)}, lower-limit=0, upper-limit=3  # 02_Light_Off_Cont_Blink
      invalid-value:
        integer literal c02_Lgt_Off_Cont_Blink: type=c02_Lgt_Off_Cont_Blink, value=3
    c02_Locked_Unlocked_Err: base-type=uint8, compu {0=I_C02_LOCKED_UNLOCKED_ERR_LOCKED (LOCKED) (Locked), 1=I_C02_LOCKED_UNLOCKED_ERR_UNLOCKED (UNLOCKED) (Unlocked), 2=I_C02_LOCKED_UNLOCKED_ERR_ERR (ERR) (Error), 3=I_C02_LOCKED_UNLOCKED_ERR_SNA (SNA) (SNA value from data type)}, lower-limit=0, upper-limit=3  # 02_Locked_Unlocked_Err
      invalid-value:
        integer literal c02_Locked_Unlocked_Err: type=c02_Locked_Unlocked_Err, value=3
    c02_LS_Stat: base-type=uint8, compu {0=I_C02_LS_STAT_NDEF0 (NDEF0) (Not defined), 1=I_C02_LS_STAT_LS_OR_ABOVE (LS_OR_ABOVE) (Long stroke position or above), 2=I_C02_LS_STAT_BELOW_LS (BELOW_LS) (Below long stroke position), 3=I_C02_LS_STAT_SNA (SNA) (SNA value from data type)}, lower-limit=0, upper-limit=3  # 02_LS_Stat
      invalid-value:
        integer literal c02_LS_Stat: type=c02_LS_Stat, value=3
    c02_NDef_ECO_Comfort: base-type=uint8, compu {0=I_C02_NDEF_ECO_COMFORT_NDEF0 (NDEF0) (not defined), 1=I_C02_NDEF_ECO_COMFORT_ECO (ECO) (ECO mode), 2=I_C02_NDEF_ECO_COMFORT_COMFORT (COMFORT) (Comfort mode), 3=I_C02_NDEF_ECO_COMFORT_SNA (SNA) (SNA value from data type)}, lower-limit=0, upper-limit=3  # 02_NDef_ECO_Comfort
      invalid-value:
        integer literal c02_NDef_ECO_Comfort: type=c02_NDef_ECO_Comfort, value=3
    c02_NDef_Man_Auto: base-type=uint8, compu {0=I_C02_NDEF_MAN_AUTO_NDEF0 (NDEF0) (not defined), 1=I_C02_NDEF_MAN_AUTO_MANUAL (MANUAL) (Manual mode), 2=I_C02_NDEF_MAN_AUTO_AUTO (AUTO) (Automatic mode), 3=I_C02_NDEF_MAN_AUTO_SNA (SNA) (SNA value from data type)}, lower-limit=0, upper-limit=3  # 02_NDef_Man_Auto
      invalid-value:
        integer literal c02_NDef_Man_Auto: type=c02_NDef_Man_Auto, value=3
    c02_Ndef_NoExt_Ext: base-type=uint8, compu {0=I_C02_NDEF_NOEXT_EXT_NDEF0 (NDEF0) (not defined), 1=I_C02_NDEF_NOEXT_EXT_NO_EXT (NO_EXT) (DPM external mode not allowed), 2=I_C02_NDEF_NOEXT_EXT_EXT (EXT) (DPM external mode allowed), 3=I_C02_NDEF_NOEXT_EXT_SNA (SNA) (SNA value from data type)}, lower-limit=0, upper-limit=3  # 02_Ndef_NoExt_Ext
      invalid-value:
        integer literal c02_Ndef_NoExt_Ext: type=c02_Ndef_NoExt_Ext, value=3
    c02_NDef_On_Off: base-type=uint8, compu {0=I_C02_NDEF_ON_OFF_NDEF0 (NDEF0) (not defined), 1=I_C02_NDEF_ON_OFF_ON (ON) (On), 2=I_C02_NDEF_ON_OFF_OFF (OFF) (Off), 3=I_C02_NDEF_ON_OFF_SNA (SNA) (SNA value from data type)}, lower-limit=0, upper-limit=3  # 02_NDef_On_Off
      invalid-value:
        integer literal c02_NDef_On_Off: type=c02_NDef_On_Off, value=3
    c02_Norm_Flt_Ndef_SNA: base-type=uint8, compu {0=I_C02_NORM_FLT_NDEF_SNA_NORMAL (NORMAL) (Normal Operation), 1=I_C02_NORM_FLT_NDEF_SNA_FLT (FLT) (Engine mountings control fault), 2=I_C02_NORM_FLT_NDEF_SNA_NDEF2 (NDEF2) (not defined), 3=I_C02_NORM_FLT_NDEF_SNA_SNA (SNA) (SNA value from data type)}, lower-limit=0, upper-limit=3  # 02_Norm_Flt_Ndef_SNA
      invalid-value:
        integer literal c02_Norm_Flt_Ndef_SNA: type=c02_Norm_Flt_Ndef_SNA, value=3
    c02_NotActv_Actv_NDef: base-type=uint8, compu {0=I_C02_NOTACTV_ACTV_NDEF_NOTACTV (NOTACTV) (discrete input is not active), 1=I_C02_NOTACTV_ACTV_NDEF_ACTV (ACTV) (discrete input is active), 2=I_C02_NOTACTV_ACTV_NDEF_NDEF2 (NDEF2) (not defined), 3=I_C02_NOTACTV_ACTV_NDEF_SNA (SNA) (SNA value from data type)}, lower-limit=0, upper-limit=3  # 02_NotActv_Actv_NDef
      invalid-value:
        integer literal c02_NotActv_Actv_NDef: type=c02_NotActv_Actv_NDef, value=3
    c02_NotActv_Actv_SNA: base-type=uint8, compu {0=I_C02_NOTACTV_ACTV_SNA_NOTACTV (NOTACTV) (not active), 1=I_C02_NOTACTV_ACTV_SNA_ACTV (ACTV) (active), 3=I_C02_NOTACTV_ACTV_SNA_SNA (SNA) (SNA value from data type)}, lower-limit=0, upper-limit=3  # 02_NotActv_Actv_SNA
      invalid-value:
        integer literal c02_NotActv_Actv_SNA: type=c02_NotActv_Actv_SNA, value=3
    c02_NPsd_Psd: base-type=uint8, compu {0=I_C02_NPSD_PSD_NPSD (NPSD) (Not pressed), 1=I_C02_NPSD_PSD_NDEF1 (NDEF1) (not defined), 2=I_C02_NPSD_PSD_PSD (PSD) (Pressed), 3=I_C02_NPSD_PSD_SNA (SNA) (SNA value from data type)}, lower-limit=0, upper-limit=3  # 02_Npsd_Ndef_Psd
      invalid-value:
        integer literal c02_NPsd_Psd: type=c02_NPsd_Psd, value=3
    c02_NPsd_NDefORDown_PsdORUp: base-type=uint8, compu {0=I_C02_NPSD_NDEFORDOWN_PSDORUP_NPSD (NPSD) (Not pressed), 1=I_C02_NPSD_NDEFORDOWN_PSDORUP_NDEF1_DN_PSD (NDEF1_DN_PSD) (not defined or (only 205) down pressed), 2=I_C02_NPSD_NDEFORDOWN_PSDORUP_PSD_UP_PSD (PSD_UP_PSD) (Pressed or (only 205) up pressed), 3=I_C02_NPSD_NDEFORDOWN_PSDORUP_SNA (SNA) (SNA value from data type)}, lower-limit=0, upper-limit=3  # 02_NPsd_NDefORDown_PsdORUp
      invalid-value:
        integer literal c02_NPsd_NDefORDown_PsdORUp: type=c02_NPsd_NDefORDown_PsdORUp, value=3
    c02_OBD_Cond_Stat: base-type=uint8, compu {0=I_C02_OBD_COND_STAT_INACT (INACT) (Conditions not fulfilled), 1=I_C02_OBD_COND_STAT_ACTV (ACTV) (Conditions fulfilled), 2=I_C02_OBD_COND_STAT_FLT (FLT) (Fault), 3=I_C02_OBD_COND_STAT_NDEF3 (NDEF3) (not defined)}, lower-limit=0, upper-limit=3  # 02_OBD_Cond_Stat
    c02_OBD_CSERS_EMTrqRng_Rq:  # 02_OBD_CSERS_EMTrqRng_Rq
      base-type=uint8
      compu {0=I_C02_OBD_CSERS_EMTRQRNG_RQ_TRQ_CSERS_OFF (TRQ_CSERS_OFF) (No torque request for load increase/decrease because of ERS while cold start), 1=I_C02_OBD_CSERS_EMTRQRNG_RQ_TRQ_CSERS_ON (TRQ_CSERS_ON) (Torque request for load increase/decrease because of ERS while cold start), 2=I_C02_OBD_CSERS_EMTRQRNG_RQ_NDEF (NDEF) (not defined), 3=I_C02_OBD_CSERS_EMTRQRNG_RQ_SNA (SNA) (SNA value from data type)}
      lower-limit=0
      upper-limit=3
      invalid-value:
        integer literal c02_OBD_CSERS_EMTrqRng_Rq: type=c02_OBD_CSERS_EMTrqRng_Rq, value=3
    c02_OBD_IgnCycCond_Stat: base-type=uint8, compu {0=I_C02_OBD_IGNCYCCOND_STAT_INACT (INACT) (Conditions not fulfilled), 1=I_C02_OBD_IGNCYCCOND_STAT_ACTV (ACTV) (Conditions fulfilled), 2=I_C02_OBD_IGNCYCCOND_STAT_FLT (FLT) (Fault), 3=I_C02_OBD_IGNCYCCOND_STAT_NDEF3 (NDEF3) (not defined)}, lower-limit=0, upper-limit=3  # 02_OBD_IgnCycCond_Stat
    c02_OC_Fast: base-type=uint8, compu {0=I_C02_OC_FAST_PSG_PRESENT (PSG_PRESENT) (Passenger present), 1=I_C02_OC_FAST_PSG_ABSENT (PSG_ABSENT) (Passenger absent), 2=I_C02_OC_FAST_FAULT (FAULT) (Fault), 3=I_C02_OC_FAST_SNA (SNA) (SNA value from data type)}, lower-limit=0, upper-limit=3  # 02_OC_Fast
      invalid-value:
        integer literal c02_OC_Fast: type=c02_OC_Fast, value=3
    c02_OFC_Stat: base-type=uint8, compu {0=I_C02_OFC_STAT_IDLE (IDLE) (Not active), 1=I_C02_OFC_STAT_FULL (FULL) (Fully active), 2=I_C02_OFC_STAT_PART (PART) (Partly active), 3=I_C02_OFC_STAT_SNA (SNA) (SNA value from data type)} "Schubabschaltung / Overrun fuel cutoff active", lower-limit=0, upper-limit=3  # 02_OFC_Stat
      invalid-value:
        integer literal c02_OFC_Stat: type=c02_OFC_Stat, value=3
    c02_Off_Enbl_Actv: base-type=uint8, compu {0=I_C02_OFF_ENBL_ACTV_OFF (OFF) (Off), 1=I_C02_OFF_ENBL_ACTV_ENBL (ENBL) (Enabled), 2=I_C02_OFF_ENBL_ACTV_ACTV (ACTV) (Active), 3=I_C02_OFF_ENBL_ACTV_SNA (SNA) (SNA value from data type)}, lower-limit=0, upper-limit=3  # 02_Off_Enbl_Actv
      invalid-value:
        integer literal c02_Off_Enbl_Actv: type=c02_Off_Enbl_Actv, value=3
    c02_Off_On: base-type=uint8, compu {0=I_C02_OFF_ON_OFF (OFF) (Off), 1=I_C02_OFF_ON_ON (ON) (On), 2=I_C02_OFF_ON_NDEF2 (NDEF2) (not defined), 3=I_C02_OFF_ON_SNA (SNA) (SNA value from data type)}, lower-limit=0, upper-limit=3  # 02_Off_On
      invalid-value:
        integer literal c02_Off_On: type=c02_Off_On, value=3
    c02_Off_OnIdle_NDef: base-type=uint8, compu {0=I_C02_OFF_ONIDLE_NDEF_OFF (OFF) (Off), 1=I_C02_OFF_ONIDLE_NDEF_ON_IDLE (ON_IDLE) (On and idle), 2=I_C02_OFF_ONIDLE_NDEF_NDEF2 (NDEF2) (not defined), 3=I_C02_OFF_ONIDLE_NDEF_SNA (SNA) (SNA value from data type)}, lower-limit=0, upper-limit=3  # 02_Off_OnIdle_NDef
      invalid-value:
        integer literal c02_Off_OnIdle_NDef: type=c02_Off_OnIdle_NDef, value=3
    c02_Opn_Slip_Cls: base-type=uint8, compu {0=I_C02_OPN_SLIP_CLS_OPN (OPN) (Open), 1=I_C02_OPN_SLIP_CLS_SLIP (SLIP) (Slipping), 2=I_C02_OPN_SLIP_CLS_CLS (CLS) (Closed (fully locking)), 3=I_C02_OPN_SLIP_CLS_SNA (SNA) (SNA value from data type)}, lower-limit=0, upper-limit=3  # 02_Opn_Slip_Cls | 02 Opn Slip Cls
      invalid-value:
        integer literal c02_Opn_Slip_Cls: type=c02_Opn_Slip_Cls, value=3
    c02_PARK_ShiftLk_Rq_EBS: base-type=uint8, compu {0=I_C02_PARK_SHIFTLK_RQ_EBS_ACTIVE (ACTIVE) (Shift Lock active, leaving P disabled), 1=I_C02_PARK_SHIFTLK_RQ_EBS_PASSIVE (PASSIVE) (Shift Lock passive, leaving P enabled), 3=I_C02_PARK_SHIFTLK_RQ_EBS_SNA (SNA) (SNA value from data type)}, lower-limit=0, upper-limit=3  # 02_PARK_ShiftLk_Rq_ESP
      invalid-value:
        integer literal c02_PARK_ShiftLk_Rq_EBS: type=c02_PARK_ShiftLk_Rq_EBS, value=3
    c02_ParkGuide_Stat:  # 02_ParkGuide_Stat
      base-type=uint8
      compu {0=I_C02_PARKGUIDE_STAT_PARK_GUI_INACT (PARK_GUI_INACT) (Parking guidance inactive), 1=I_C02_PARKGUIDE_STAT_PARK_GUI_ACT (PARK_GUI_ACT) (Parking guidance active), 2=I_C02_PARKGUIDE_STAT_PARK_GUI_INACT_LONG_ACTV (PARK_GUI_INACT_LONG_ACTV) (Parking guidance inactive but other longitudinal park controller active), 3=I_C02_PARKGUIDE_STAT_SNA (SNA) (SNA value from data type)} "Status Parkführungc / Parking guidance state"
      lower-limit=0
      upper-limit=3
      invalid-value:
        integer literal c02_ParkGuide_Stat: type=c02_ParkGuide_Stat, value=3
    c02_Pdl_Stat: base-type=uint8, compu {0=I_C02_PDL_STAT_UPSTOP (UPSTOP) (Pedal upstopped), 1=I_C02_PDL_STAT_PSD (PSD) (Pedal pressed), 2=I_C02_PDL_STAT_NDEF2 (NDEF2) (not defined), 3=I_C02_PDL_STAT_SNA (SNA) (SNA value from data type)}, lower-limit=0, upper-limit=3  # 02_Pdl_Stat
      invalid-value:
        integer literal c02_Pdl_Stat: type=c02_Pdl_Stat, value=3
    c02_PhsGrShiftStrt: base-type=uint8, compu {0=I_C02_PHSGRSHIFTSTRT_PH_0 (PH_0) (Phase 0), 1=I_C02_PHSGRSHIFTSTRT_PH_1 (PH_1) (Phase 1), 2=I_C02_PHSGRSHIFTSTRT_PH_2 (PH_2) (Phase 2), 3=I_C02_PHSGRSHIFTSTRT_SNA (SNA) (SNA value from data type)}, lower-limit=0, upper-limit=3  # 02_PhsGrShiftStrt
      invalid-value:
        integer literal c02_PhsGrShiftStrt: type=c02_PhsGrShiftStrt, value=3
    c02_PkBrk_Rq_ESP: base-type=uint8, compu {0=I_C02_PKBRK_RQ_ESP_IDLE (IDLE) (No request), 1=I_C02_PKBRK_RQ_ESP_ENGG (ENGG) (Engage request), 2=I_C02_PKBRK_RQ_ESP_RELS (RELS) (Release request), 3=I_C02_PKBRK_RQ_ESP_SNA (SNA) (SNA value from data type)}, lower-limit=0, upper-limit=3  # 02_PkBrk_Rq_ESP
      invalid-value:
        integer literal c02_PkBrk_Rq_ESP: type=c02_PkBrk_Rq_ESP, value=3
    c02_PkBrk_Sw_Stat: base-type=uint8, compu {0=I_C02_PKBRK_SW_STAT_IDLE (IDLE) (Not pressed), 1=I_C02_PKBRK_SW_STAT_ENGG (ENGG) (Apply (Engage pushed)), 2=I_C02_PKBRK_SW_STAT_RELS (RELS) (Release (Release pulled)), 3=I_C02_PKBRK_SW_STAT_SNA (SNA) (SNA value from data type)}, lower-limit=0, upper-limit=3  # 02_PkBrk_Sw_Stat
      invalid-value:
        integer literal c02_PkBrk_Sw_Stat: type=c02_PkBrk_Sw_Stat, value=3
    c02_PN14_Hibern_Md_Flt: base-type=uint8, compu {0=I_C02_PN14_HIBERN_MD_FLT_NO_ERROR (NO_ERROR) (No error), 1=I_C02_PN14_HIBERN_MD_FLT_BAT_LO (BAT_LO) (Battery state of charge low), 2=I_C02_PN14_HIBERN_MD_FLT_PERM_ERR (PERM_ERR) (Permanent error), 3=I_C02_PN14_HIBERN_MD_FLT_SNA (SNA) (SNA value from data type)} "Fehler Funktion "Lange Standzeit" / Powernet Hibernation mode fault", lower-limit=0, upper-limit=3  # 02_PN14_Hibern_Md_Flt
      invalid-value:
        integer literal c02_PN14_Hibern_Md_Flt: type=c02_PN14_Hibern_Md_Flt, value=3
    c02_PT_Rdy_V2: base-type=uint8, compu {0=I_C02_PT_RDY_V2_PT_NOT_RDY (PT_NOT_RDY) (Powertrain is not ready), 1=I_C02_PT_RDY_V2_PT_RDY (PT_RDY) (Powertrain is ready), 2=I_C02_PT_RDY_V2_NDEF2 (NDEF2) (not defined), 3=I_C02_PT_RDY_V2_SNA (SNA) (SNA value from data type)} "Antrieb bereit / Powertrain ready", lower-limit=0, upper-limit=3  # 02_PT_Rdy_V2
      invalid-value:
        integer literal c02_PT_Rdy_V2: type=c02_PT_Rdy_V2, value=3
    c02_PushStrtCtl_Rq_ECM: base-type=uint8, compu {0=I_C02_PUSHSTRTCTL_RQ_ECM_PASSIVE (PASSIVE) (passive - engine start not possible), 1=I_C02_PUSHSTRTCTL_RQ_ECM_ACTIVE_RQ (ACTIVE_RQ) (active engine start request), 2=I_C02_PUSHSTRTCTL_RQ_ECM_AVAILABLE (AVAILABLE) (available - engine start possible), 3=I_C02_PUSHSTRTCTL_RQ_ECM_ABORT (ABORT) (abortion, engine start by starter)}, lower-limit=0, upper-limit=3  # 02_PushStrtCtl_Rq_ECM
    c02_PW_Posn_Stat: base-type=uint8, compu {0=I_C02_PW_POSN_STAT_INTERMEDIATE (INTERMEDIATE) (Intermediate position), 1=I_C02_PW_POSN_STAT_WNDW_OPN (WNDW_OPN) (Window completely opened), 2=I_C02_PW_POSN_STAT_WNDW_CLS (WNDW_CLS) (Window completely closed), 3=I_C02_PW_POSN_STAT_SNA (SNA) (SNA value from data type)}, lower-limit=0, upper-limit=3  # 02_PW_Posn_Stat
      invalid-value:
        integer literal c02_PW_Posn_Stat: type=c02_PW_Posn_Stat, value=3
    c02_PwrFreeD_Supp_Rq: base-type=uint8, compu {0=I_C02_PWRFREED_SUPP_RQ_IDLE (IDLE) (No request), 1=I_C02_PWRFREED_SUPP_RQ_SUPP_STOP (SUPP_STOP) (Suppress or stop sailing), 2=I_C02_PWRFREED_SUPP_RQ_ENBL (ENBL) (Enable), 3=I_C02_PWRFREED_SUPP_RQ_SAIL_RQ (SAIL_RQ) (Request to activate sailing)}, lower-limit=0, upper-limit=3  # 02_PwrFreeD_Supp_Rq
    c02_RadarBsd_GrShft_Rq_DS: base-type=uint8, compu {0=I_C02_RADARBSD_GRSHFT_RQ_DS_NO_SHFT (NO_SHFT) (no shift), 1=I_C02_RADARBSD_GRSHFT_RQ_DS_PROH_UP (PROH_UP) (prohibitoin Upshift), 2=I_C02_RADARBSD_GRSHFT_RQ_DS_RQ_DWN (RQ_DWN) (request Downshift), 3=I_C02_RADARBSD_GRSHFT_RQ_DS_SNA (SNA) (SNA value from data type)}, lower-limit=0, upper-limit=3  # 02_RadarBsd_GrShft_Rq_DS
      invalid-value:
        integer literal c02_RadarBsd_GrShft_Rq_DS: type=c02_RadarBsd_GrShft_Rq_DS, value=3
    c02_RB_Stat: base-type=uint8, compu {0=I_C02_RB_STAT_OPN (OPN) (Open), 1=I_C02_RB_STAT_CLS (CLS) (Close), 2=I_C02_RB_STAT_INTERMEDIATE (INTERMEDIATE) (Intermediate position), 3=I_C02_RB_STAT_SNA (SNA) (SNA value from data type)}, lower-limit=0, upper-limit=3  # 02_RB_Stat
      invalid-value:
        integer literal c02_RB_Stat: type=c02_RB_Stat, value=3
    c02_Rel_Lock_Free_SNA: base-type=uint8, compu {0=I_C02_REL_LOCK_FREE_SNA_REL (REL) (Released (FBS released)), 1=I_C02_REL_LOCK_FREE_SNA_LOCK (LOCK) (Locked (FBS not released)), 2=I_C02_REL_LOCK_FREE_SNA_FREE (FREE) (Free), 3=I_C02_REL_LOCK_FREE_SNA_SNA (SNA) (SNA value from data type)} "CiA447 State", lower-limit=0, upper-limit=3  # 02_Rel_Lock_Free_SNA
      invalid-value:
        integer literal c02_Rel_Lock_Free_SNA: type=c02_Rel_Lock_Free_SNA, value=3
    c02_Rel_Lock_SNA: base-type=uint8, compu {0=I_C02_REL_LOCK_SNA_REL (REL) (Released (FBS released)), 1=I_C02_REL_LOCK_SNA_LOCK (LOCK) (Locked (FBS not released)), 2=I_C02_REL_LOCK_SNA_NDEF2 (NDEF2) (not defined), 3=I_C02_REL_LOCK_SNA_SNA (SNA) (SNA value from data type)} "CiA447 State", lower-limit=0, upper-limit=3  # 02_Rel_Lock_SNA
      invalid-value:
        integer literal c02_Rel_Lock_SNA: type=c02_Rel_Lock_SNA, value=3
    c02_REM_CLS_OPN: base-type=uint8, compu {0=I_C02_REM_CLS_OPN_REMOTE (REMOTE) (Controlled by BMS), 1=I_C02_REM_CLS_OPN_CLOSE (CLOSE) (Close request), 2=I_C02_REM_CLS_OPN_OPEN (OPEN) (Open request), 3=I_C02_REM_CLS_OPN_SNA (SNA) (SNA value from data type)}, lower-limit=0, upper-limit=3  # 02_REM_CLS_OPN
      invalid-value:
        integer literal c02_REM_CLS_OPN: type=c02_REM_CLS_OPN, value=3
    c02_RemSt_IgnCtrl_Info:  # 02_RemSt_IgnCtrl_Info
      base-type=uint8
      compu {0=I_C02_REMST_IGNCTRL_INFO_NO_RQ (NO_RQ) (No remote engine start request), 1=I_C02_REMST_IGNCTRL_INFO_PRECON (PRECON) (Remote engine start for pre air conditioning), 2=I_C02_REMST_IGNCTRL_INFO_BAT_CHRG (BAT_CHRG) (Remote engine start for charging of the battery), 3=I_C02_REMST_IGNCTRL_INFO_SNA (SNA) (SNA value from data type)} "Klemmensteuerung Motorfernstart Information / Remote start ignition information"
      lower-limit=0
      upper-limit=3
      invalid-value:
        integer literal c02_RemSt_IgnCtrl_Info: type=c02_RemSt_IgnCtrl_Info, value=3
    c02_RollTestMd_Rq_Ack: base-type=uint8, compu {0=I_C02_ROLLTESTMD_RQ_ACK_OFF (OFF) (Roller test bench mode is off), 1=I_C02_ROLLTESTMD_RQ_ACK_ON (ON) (Roller test bench mode is on), 2=I_C02_ROLLTESTMD_RQ_ACK_NDEF2 (NDEF2) (not defined), 3=I_C02_ROLLTESTMD_RQ_ACK_SNA (SNA) (SNA value from data type)}, lower-limit=0, upper-limit=3  # 02_RollTestMd_Rq_Ack
      invalid-value:
        integer literal c02_RollTestMd_Rq_Ack: type=c02_RollTestMd_Rq_Ack, value=3
    c02_SBW_ShiftLk_Msg_RevGr_TCM: base-type=uint8, compu {0=I_C02_SBW_SHIFTLK_MSG_REVGR_TCM_IDLE (IDLE) (No Message), 1=I_C02_SBW_SHIFTLK_MSG_REVGR_TCM_BRK_R (BRK_R) (Press brake insert to R), 2=I_C02_SBW_SHIFTLK_MSG_REVGR_TCM_NDEF1 (NDEF1) (not defined), 3=I_C02_SBW_SHIFTLK_MSG_REVGR_TCM_SNA (SNA) (SNA value from data type)}, lower-limit=0, upper-limit=3  # 02_SBW_ShiftLk_Msg_RevGr | 02 SBW Shift Lk Msg Rev Gr TCM
      invalid-value:
        integer literal c02_SBW_ShiftLk_Msg_RevGr_TCM: type=c02_SBW_ShiftLk_Msg_RevGr_TCM, value=3
    c02_Signal_Qual: base-type=uint8, compu {0=I_C02_SIGNAL_QUAL_NDEF0 (NDEF0) (not defined), 1=I_C02_SIGNAL_QUAL_ELEC (ELEC) (Electrical checks passed), 2=I_C02_SIGNAL_QUAL_FUNC (FUNC) (Functional and electrical checks passed), 3=I_C02_SIGNAL_QUAL_SIG_DEF (SIG_DEF) (Signal defect detected)} "DT for signal qualifier", lower-limit=0, upper-limit=3  # 02_SignalQual
    c02_Sleep_Local_Ext: base-type=uint8, compu {0=I_C02_SLEEP_LOCAL_EXT_SLEEP (SLEEP) (DPM limit sleep mode), 1=I_C02_SLEEP_LOCAL_EXT_LOCAL (LOCAL) (DPM limit local mode), 2=I_C02_SLEEP_LOCAL_EXT_EXT (EXT) (DPM limit external mode), 3=I_C02_SLEEP_LOCAL_EXT_SNA (SNA) (SNA value from data type)}, lower-limit=0, upper-limit=3  # 02_Sleep_Local_Ext
      invalid-value:
        integer literal c02_Sleep_Local_Ext: type=c02_Sleep_Local_Ext, value=3
    c02_Soft_Mid_Hard_SNA: base-type=uint8, compu {0=I_C02_SOFT_MID_HARD_SNA_SOFT (SOFT) (Soft), 1=I_C02_SOFT_MID_HARD_SNA_MIDDLE (MIDDLE) (Middle), 2=I_C02_SOFT_MID_HARD_SNA_HARD (HARD) (Hard), 3=I_C02_SOFT_MID_HARD_SNA_SNA (SNA) (SNA value from data type)}, lower-limit=0, upper-limit=3  # 02_Soft_Mid_Hard_SNA
      invalid-value:
        integer literal c02_Soft_Mid_Hard_SNA: type=c02_Soft_Mid_Hard_SNA, value=3
    c02_SPCR_AS_Dsabl: base-type=uint8, compu {0=I_C02_SPCR_AS_DSABL_IDLE (IDLE) (No request), 1=I_C02_SPCR_AS_DSABL_AS_NOT_ENBL (AS_NOT_ENBL) (Enabling assistance system not allowed (temperature)), 2=I_C02_SPCR_AS_DSABL_AS_DSABL (AS_DSABL) (Disable assistance system request (temperature)), 3=I_C02_SPCR_AS_DSABL_SNA (SNA) (SNA value from data type)}, lower-limit=0, upper-limit=3  # 02_SPCR_AS_Dsabl
      invalid-value:
        integer literal c02_SPCR_AS_Dsabl: type=c02_SPCR_AS_Dsabl, value=3
    c02_SPCR_AS_Off_Rq:  # 02_SPCR_AS_Off_Rq
      base-type=uint8
      compu {0=I_C02_SPCR_AS_OFF_RQ_IDLE (IDLE) (No request), 1=I_C02_SPCR_AS_OFF_RQ_AS_TMP_OFF (AS_TMP_OFF) (Assistance system temporary off, enabling not allowed), 2=I_C02_SPCR_AS_OFF_RQ_AS_CNTS_OFF (AS_CNTS_OFF) (Assistance system continously off, enabling not allowed), 3=I_C02_SPCR_AS_OFF_RQ_SPCR_NA (SPCR_NA) (Stop coordinator not available, enabling not allowed)}
      lower-limit=0
      upper-limit=3
    c02_SPCR_Conf: base-type=uint8, compu {0=I_C02_SPCR_CONF_NOT_CONF (NOT_CONF) (Not configured), 1=I_C02_SPCR_CONF_HOLD_NO_SBW (HOLD_NO_SBW) (Configured for hold without shift by wire (warning strategy)), 2=I_C02_SPCR_CONF_HOLD_AND_SBW (HOLD_AND_SBW) (Configured for hold with shift by wire (immobilizing strategy)), 3=I_C02_SPCR_CONF_SNA (SNA) (SNA value from data type)}, lower-limit=0, upper-limit=3  # 02_SPCR_Conf
      invalid-value:
        integer literal c02_SPCR_Conf: type=c02_SPCR_Conf, value=3
    c02_SPCR_Excpt_Rq_V2:  # 02_SPCR_Excpt_Rq_V2
      base-type=uint8
      compu {0=I_C02_SPCR_EXCPT_RQ_V2_AS_ENBL (AS_ENBL) (Assistance system enable), 1=I_C02_SPCR_EXCPT_RQ_V2_AS_DSABL_DRV_ABSENT (AS_DSABL_DRV_ABSENT) (Assistance system disable because driver absent), 2=I_C02_SPCR_EXCPT_RQ_V2_AS_DSABL_EH_OPN (AS_DSABL_EH_OPN) (Assistance system disable because engine hood / deck lid open), 3=I_C02_SPCR_EXCPT_RQ_V2_AS_DSABL (AS_DSABL) (Assistance system disable because driver absent and engine hood / deck lid open)}
      lower-limit=0
      upper-limit=3
    c02_SPCR_Sp_Stat: base-type=uint8, compu {0=I_C02_SPCR_SP_STAT_IDLE (IDLE) (Vehicle not stopped, or not held by assistance system), 1=I_C02_SPCR_SP_STAT_STOP (STOP) (Vehicle stopped and held by assistance system (using service brake)), 2=I_C02_SPCR_SP_STAT_NDEF2 (NDEF2) (not defined), 3=I_C02_SPCR_SP_STAT_SNA (SNA) (SNA value from data type)}, lower-limit=0, upper-limit=3  # 02_SPCR_Sp_Stat
      invalid-value:
        integer literal c02_SPCR_Sp_Stat: type=c02_SPCR_Sp_Stat, value=3
    c02_SPCR_Style: base-type=uint8, compu {0=I_C02_SPCR_STYLE_NO_SPCR (NO_SPCR) (Stop coordinator not available), 1=I_C02_SPCR_STYLE_SPCR_NO_SBW (SPCR_NO_SBW) (Stop coordinator without shift by wire (warning strategy)), 2=I_C02_SPCR_STYLE_SPCR_WITH_SBW (SPCR_WITH_SBW) (Stop coordinator with shift by wire (immobilizing strategy)), 3=I_C02_SPCR_STYLE_SNA (SNA) (SNA value from data type)}, lower-limit=0, upper-limit=3  # 02_SPCR_Style
      invalid-value:
        integer literal c02_SPCR_Style: type=c02_SPCR_Style, value=3
    c02_SpdCtrl_Rq: base-type=uint8, compu {0=I_C02_SPDCTRL_RQ_NO_SPD_CTRL (NO_SPD_CTRL) (No speed request active), 1=I_C02_SPDCTRL_RQ_SPD_CTRL1 (SPD_CTRL1) (Speed control strategy 1 request), 2=I_C02_SPDCTRL_RQ_SPD_CTRL2 (SPD_CTRL2) (Speed control strategy 2 request), 3=I_C02_SPDCTRL_RQ_SNA (SNA) (SNA value from data type)}, lower-limit=0, upper-limit=3  # 02_SpdCtrl_Rq
      invalid-value:
        integer literal c02_SpdCtrl_Rq: type=c02_SpdCtrl_Rq, value=3
    c02_Spoil_R_MsgDisp_Rq_AMG: base-type=uint8, compu {0=I_C02_SPOIL_R_MSGDISP_RQ_AMG_IDLE (IDLE) (No request), 1=I_C02_SPOIL_R_MSGDISP_RQ_AMG_SPOIL_R_FLT (SPOIL_R_FLT) (Message "Rear spoiler system fault"), 2=I_C02_SPOIL_R_MSGDISP_RQ_AMG_SPOIL_R_MAN_DN (SPOIL_R_MAN_DN) (Message "Rear spoiler manually down"), 3=I_C02_SPOIL_R_MSGDISP_RQ_AMG_SNA (SNA) (SNA value from data type)}, lower-limit=0, upper-limit=3  # 02_Spoil_R_MsgDisp_Rq_AMG
      invalid-value:
        integer literal c02_Spoil_R_MsgDisp_Rq_AMG: type=c02_Spoil_R_MsgDisp_Rq_AMG, value=3
    c02_Spoil_R_Posn_AMG: base-type=uint8, compu {0=I_C02_SPOIL_R_POSN_AMG_SPOIL_DN (SPOIL_DN) (Rear spoiler is down), 1=I_C02_SPOIL_R_POSN_AMG_SPOIL_MV (SPOIL_MV) (Rear spoiler is in motion), 2=I_C02_SPOIL_R_POSN_AMG_SPOIL_UP (SPOIL_UP) (Rear spoiler is up), 3=I_C02_SPOIL_R_POSN_AMG_SNA (SNA) (SNA value from data type)}, lower-limit=0, upper-limit=3  # 02_Spoil_R_Posn_AMG
      invalid-value:
        integer literal c02_Spoil_R_Posn_AMG: type=c02_Spoil_R_Posn_AMG, value=3
    c02_SSA_Clutch_Stat: base-type=uint8, compu {0=I_C02_SSA_CLUTCH_STAT_DSABL (DSABL) (Automatic start disabled (clutch may be engaged)), 1=I_C02_SSA_CLUTCH_STAT_ENBL (ENBL) (Automatic start enabled (clutch is disengaged)), 2=I_C02_SSA_CLUTCH_STAT_NDEF2 (NDEF2) (not defined), 3=I_C02_SSA_CLUTCH_STAT_SNA (SNA) (SNA value from data type)}, lower-limit=0, upper-limit=3  # 02_SSA_Clutch_Stat
      invalid-value:
        integer literal c02_SSA_Clutch_Stat: type=c02_SSA_Clutch_Stat, value=3
    c02_SSA_ENBL_DSABL_PNA_TCM: base-type=uint8, compu {0=I_C02_SSA_ENBL_DSABL_PNA_TCM_SSA_ENBL (SSA_ENBL) (Enable SSA), 1=I_C02_SSA_ENBL_DSABL_PNA_TCM_SSA_DSABL (SSA_DSABL) (Disable SSA), 2=I_C02_SSA_ENBL_DSABL_PNA_TCM_SSA_PNA (SSA_PNA) (SSA permanently not available), 3=I_C02_SSA_ENBL_DSABL_PNA_TCM_SNA (SNA) (SNA value from data type)}, lower-limit=0, upper-limit=3  # 02_SSA_ENBL_DSABL_PNA_TCM
      invalid-value:
        integer literal c02_SSA_ENBL_DSABL_PNA_TCM: type=c02_SSA_ENBL_DSABL_PNA_TCM, value=3
    c02_SSA_Standby_Stat: base-type=uint8, compu {0=I_C02_SSA_STANDBY_STAT_DEFAULT (DEFAULT) (default), 1=I_C02_SSA_STANDBY_STAT_STANDBY (STANDBY) (Standby Mode active), 2=I_C02_SSA_STANDBY_STAT_NDEF (NDEF) (not defined), 3=I_C02_SSA_STANDBY_STAT_SNA (SNA) (SNA value from data type)}, lower-limit=0, upper-limit=3  # 02_SSA_Standby_Stat
      invalid-value:
        integer literal c02_SSA_Standby_Stat: type=c02_SSA_Standby_Stat, value=3
    c02_SSP_Pwr_Rq: base-type=uint8, compu {0=I_C02_SSP_PWR_RQ_NO_RQ (NO_RQ) (No SSP power increase request), 1=I_C02_SSP_PWR_RQ_STG1 (STG1) (SSP power increase request stage1), 2=I_C02_SSP_PWR_RQ_STG2 (STG2) (SSP power increase request stage2), 3=I_C02_SSP_PWR_RQ_STG3 (STG3) (SSP power increase request stage3)} "02_SSP_Pwr_Rq", lower-limit=0, upper-limit=3  # 02_SSP_Pwr_Rq | 02 SSP Pwr Rq
    c02_StStyle: base-type=uint8, compu {0=I_C02_STSTYLE_NDEF0 (NDEF0) (not defined), 1=I_C02_STSTYLE_LHD (LHD) (Left hand drive), 2=I_C02_STSTYLE_RHD (RHD) (Right hand drive), 3=I_C02_STSTYLE_SNA (SNA) (SNA value from data type)}, lower-limit=0, upper-limit=3  # 02_StStyle
      invalid-value:
        integer literal c02_StStyle: type=c02_StStyle, value=3
    c02_StWhl_AnglSens_Id: base-type=uint8, compu {0=I_C02_STWHL_ANGLSENS_ID_TEST (TEST) (Test module), 1=I_C02_STWHL_ANGLSENS_ID_VALEO (VALEO) (Valeo module), 2=I_C02_STWHL_ANGLSENS_ID_KOSTAL (KOSTAL) (Kostal module)}, lower-limit=0, upper-limit=2  # 02_StWhl_AnglSens_Id
    c02_StWhl_AnglSens_Stat: base-type=uint8, compu {0=I_C02_STWHL_ANGLSENS_STAT_OK (OK) (Steering wheel angle sensor ok), 1=I_C02_STWHL_ANGLSENS_STAT_INI (INI) (Steering wheel angle sensor not initialized), 2=I_C02_STWHL_ANGLSENS_STAT_ERR (ERR) (Steering wheel angle sensor fault), 3=I_C02_STWHL_ANGLSENS_STAT_ERR_INI (ERR_INI) (Steering wheel angle sensor fault and not initialized)}, lower-limit=0, upper-limit=3  # 02_StWhl_AnglSens_Stat
    c02_StWhl_AnglSensVld_Stat: base-type=uint8, compu {0=I_C02_STWHL_ANGLSENSVLD_STAT_INVLD (INVLD) (Invalid), 1=I_C02_STWHL_ANGLSENSVLD_STAT_VLD (VLD) (Valid), 2=I_C02_STWHL_ANGLSENSVLD_STAT_INIT (INIT) (Initialization), 3=I_C02_STWHL_ANGLSENSVLD_STAT_SNA (SNA) (SNA value from data type)}, lower-limit=0, upper-limit=3  # 02_StWhl_AnglSensVld_Stat
      invalid-value:
        integer literal c02_StWhl_AnglSensVld_Stat: type=c02_StWhl_AnglSensVld_Stat, value=3
    c02_TCC_Rq: base-type=uint8, compu {0=I_C02_TCC_RQ_IDLE (IDLE) (No request), 1=I_C02_TCC_RQ_DISENGG (DISENGG) (Lockup clutch disengage), 2=I_C02_TCC_RQ_ENGG (ENGG) (Lockup clutch engage), 3=I_C02_TCC_RQ_SNA (SNA) (SNA value from data type)}, lower-limit=0, upper-limit=3  # 02_TCC_Rq
      invalid-value:
        integer literal c02_TCC_Rq: type=c02_TCC_Rq, value=3
    c02_TccPushStrtCtl_TCM: base-type=uint8, compu {0=I_C02_TCCPUSHSTRTCTL_TCM_PASSIVE (PASSIVE) (passive), 1=I_C02_TCCPUSHSTRTCTL_TCM_TCM_ACTIVE_RQ (TCM_ACTIVE_RQ) (TCM active engine (tow-) start request), 2=I_C02_TCCPUSHSTRTCTL_TCM_AVAILABLE (AVAILABLE) (engine (tow-) start available), 3=I_C02_TCCPUSHSTRTCTL_TCM_NOT_AVAILABLE (NOT_AVAILABLE) (engine (tow-) start not available)}, lower-limit=0, upper-limit=3  # 02_TccPushStrtCtl_TCM
    c02_TCM_EngIdleRPM_Lvl_Rq: base-type=uint8, compu {0=I_C02_TCM_ENGIDLERPM_LVL_RQ_IDLE (IDLE) (No request), 1=I_C02_TCM_ENGIDLERPM_LVL_RQ_LVL1 (LVL1) (TCM level 1 request), 2=I_C02_TCM_ENGIDLERPM_LVL_RQ_LVL2 (LVL2) (TCM level 2 request), 3=I_C02_TCM_ENGIDLERPM_LVL_RQ_SNA (SNA) (SNA value from data type)}, lower-limit=0, upper-limit=3  # 02_TCM_EngIdleRPM_Lvl_Rq
      invalid-value:
        integer literal c02_TCM_EngIdleRPM_Lvl_Rq: type=c02_TCM_EngIdleRPM_Lvl_Rq, value=3
    c02_TCM_LHOM_Stat: base-type=uint8, compu {0=I_C02_TCM_LHOM_STAT_IDLE (IDLE) (No limp-home), 1=I_C02_TCM_LHOM_STAT_PART_LHOM (PART_LHOM) (Gear partially limp-home mode: "R" not possible), 2=I_C02_TCM_LHOM_STAT_PWRFREE_LHOM (PWRFREE_LHOM) (Power free limp-home: Stop, select "P"), 3=I_C02_TCM_LHOM_STAT_NDEF3 (NDEF3) (not defined)}, lower-limit=0, upper-limit=3  # 02_TCM_LHOM_Stat
    c02_TCM_PkPosn_Flt:  # 02_TCM_PkPosn_Flt
      base-type=uint8
      compu {0=I_C02_TCM_PKPOSN_FLT_IDLE (IDLE) (No fault), 1=I_C02_TCM_PKPOSN_FLT_PK_LK_FLT (PK_LK_FLT) (Parking position fault, engage parking brake), 2=I_C02_TCM_PKPOSN_FLT_ENGG_D (ENGG_D) (Engage transmission driving position), 3=I_C02_TCM_PKPOSN_FLT_PK_LK_FLT_WARN (PK_LK_FLT_WARN) (Parking position fault, transmission not in parking position)} "TCM REX Parksperren Fehlercode / TCM REX Park Position Fault"
      lower-limit=0
      upper-limit=3
    c02_TCM_Temp_Flt: base-type=uint8, compu {0=I_C02_TCM_TEMP_FLT_IDLE (IDLE) (No fault), 1=I_C02_TCM_TEMP_FLT_OVRHT (OVRHT) (Transmission overheated, drive carefully), 2=I_C02_TCM_TEMP_FLT_COOL_FLT (COOL_FLT) (Transmission cooling fault), 3=I_C02_TCM_TEMP_FLT_NDEF3 (NDEF3) (not defined)}, lower-limit=0, upper-limit=3  # 02_TCM_Temp_Flt
    c02_TransMd_Stat: base-type=uint8, compu {0=I_C02_TRANSMD_STAT_OFF (OFF) (Transport mode permanently off), 1=I_C02_TRANSMD_STAT_TEMP_OFF (TEMP_OFF) (Transport mode temporarily off), 2=I_C02_TRANSMD_STAT_ACTV (ACTV) (Transport mode active), 3=I_C02_TRANSMD_STAT_SNA (SNA) (SNA value from data type)}, lower-limit=0, upper-limit=3  # 02_TransMd_Stat
      invalid-value:
        integer literal c02_TransMd_Stat: type=c02_TransMd_Stat, value=3
    c02_Trl_Stat: base-type=uint8, compu {0=I_C02_TRL_STAT_NONE (NONE) (Trailer not detected), 1=I_C02_TRL_STAT_OK (OK) (Trailer detected), 2=I_C02_TRL_STAT_NDEF2 (NDEF2) (not defined), 3=I_C02_TRL_STAT_SNA (SNA) (SNA value from data type)}, lower-limit=0, upper-limit=3  # 02_Trl_Stat
      invalid-value:
        integer literal c02_Trl_Stat: type=c02_Trl_Stat, value=3
    c02_TSL_MtnLk2_3_Disp_Rq_V2: base-type=uint8, compu {0=I_C02_TSL_MTNLK2_3_DISP_RQ_V2_IDLE (IDLE) (No lock symbol display), 1=I_C02_TSL_MTNLK2_3_DISP_RQ_V2_ARR_UP (ARR_UP) (Lock symbol arrow up), 2=I_C02_TSL_MTNLK2_3_DISP_RQ_V2_ARR_DN (ARR_DN) (Lock symbol arrow down)}, lower-limit=0, upper-limit=2  # 02_TSL_MtnLk2_3_Disp_Rq_V2
    c02_TSL_MtnLk_Disp_Rq_V2: base-type=uint8, compu {0=I_C02_TSL_MTNLK_DISP_RQ_V2_IDLE (IDLE) (No lock symbol display), 1=I_C02_TSL_MTNLK_DISP_RQ_V2_ARR_UP_DN (ARR_UP_DN) (Lock symbol arrow up and down), 2=I_C02_TSL_MTNLK_DISP_RQ_V2_ARR_LT (ARR_LT) (Lock symbol arrow left)}, lower-limit=0, upper-limit=2  # 02_TSL_MtnLk_Disp_Rq_V2
    c02_TSL_P_Psd_StW: base-type=uint8, compu {0=I_C02_TSL_P_PSD_STW_IDLE (IDLE) (Transmission selector lever "P" not pressed), 1=I_C02_TSL_P_PSD_STW_PSD (PSD) (Transmission selector lever "P" pressed), 2=I_C02_TSL_P_PSD_STW_INI (INI) (Transmission selector lever "P" switch not initialized), 3=I_C02_TSL_P_PSD_STW_SNA (SNA) (SNA value from data type)}, lower-limit=0, upper-limit=3  # 02_TSL_P_Psd_StW
      invalid-value:
        integer literal c02_TSL_P_Psd_StW: type=c02_TSL_P_Psd_StW, value=3
    c02_TSL_Posn_ISM_Init: base-type=uint8, compu {0=I_C02_TSL_POSN_ISM_INIT_NO_INIT (NO_INIT) (No Init), 1=I_C02_TSL_POSN_ISM_INIT_P_INIT (P_INIT) (P-init), 2=I_C02_TSL_POSN_ISM_INIT_N_INIT (N_INIT) (N-init), 3=I_C02_TSL_POSN_ISM_INIT_NDEF3 (NDEF3) (not defined)}, lower-limit=0, upper-limit=3  # 02_TSL_Posn_ISM_Init
    c02_TSL_ShiftLk_Stat: base-type=uint8, compu {0=I_C02_TSL_SHIFTLK_STAT_IDLE (IDLE) (No shift lock state available (old ISM)), 1=I_C02_TSL_SHIFTLK_STAT_NACTV (NACTV) (Shift lock not activated), 2=I_C02_TSL_SHIFTLK_STAT_ACTV (ACTV) (Shift lock activated), 3=I_C02_TSL_SHIFTLK_STAT_SNA (SNA) (SNA value from data type)}, lower-limit=0, upper-limit=3  # 02_TSL_ShiftLk_Stat
      invalid-value:
        integer literal c02_TSL_ShiftLk_Stat: type=c02_TSL_ShiftLk_Stat, value=3
    c02_TxBurnOut_Stat: base-type=uint8, compu {0=I_C02_TXBURNOUT_STAT_INACTIVE (INACTIVE) (Inactive), 1=I_C02_TXBURNOUT_STAT_ENBL (ENBL) (Enable), 2=I_C02_TXBURNOUT_STAT_ACTIVE (ACTIVE) (Active), 3=I_C02_TXBURNOUT_STAT_ABORT (ABORT) (Abort)}, lower-limit=0, upper-limit=3  # 02_TxBurnOut_Stat
    c02_TxDrvProgLim: base-type=uint8, compu {0=I_C02_TXDRVPROGLIM_NO_RES_TCM (NO_RES_TCM) (No restrictions by TCM), 1=I_C02_TXDRVPROGLIM_M_NOT_ALLOWED (M_NOT_ALLOWED) (M not allowed), 2=I_C02_TXDRVPROGLIM_DEFAULT_RQ_FP (DEFAULT_RQ_FP) (Default request FP), 3=I_C02_TXDRVPROGLIM_NDEF1 (NDEF1) (not defined)}, lower-limit=0, upper-limit=3  # 02_TxDrvProgLim
    c02_TxLHOM2_Stat_OilPump: base-type=uint8, compu {0=I_C02_TXLHOM2_STAT_OILPUMP_NO_ERR (NO_ERR) (No error), 1=I_C02_TXLHOM2_STAT_OILPUMP_E_PMP_E_ERR (E_PMP_E_ERR) (Electric pump has electric failure), 2=I_C02_TXLHOM2_STAT_OILPUMP_HYD_PRESS_ERR (HYD_PRESS_ERR) (Hydraulic back pressure valve failure), 3=I_C02_TXLHOM2_STAT_OILPUMP_PRI_OILPMP_ERR (PRI_OILPMP_ERR) (Primary oil pump error)}, lower-limit=0, upper-limit=3  # 02_TxLHOM2_Stat_OilPump
    c02_TxmtId_SBW_Rq_DRVU: base-type=uint8, compu {0=I_C02_TXMTID_SBW_RQ_DRVU_EWM (EWM), 1=I_C02_TXMTID_SBW_RQ_DRVU_SCCM (SCCM) (not defined), 2=I_C02_TXMTID_SBW_RQ_DRVU_DSI_AMG (DSI_AMG) (not defined), 3=I_C02_TXMTID_SBW_RQ_DRVU_NDEF3 (NDEF3) (not defined)}, lower-limit=0, upper-limit=3  # 02_TxmtId_SBW_Rq_DRVU
    c02_TxmtId_SBW_Rq_SCCM: base-type=uint8, compu {0=I_C02_TXMTID_SBW_RQ_SCCM_EWM (EWM), 1=I_C02_TXMTID_SBW_RQ_SCCM_SCCM (SCCM), 2=I_C02_TXMTID_SBW_RQ_SCCM_NDEF2 (NDEF2) (not defined), 3=I_C02_TXMTID_SBW_RQ_SCCM_NDEF3 (NDEF3) (not defined)}, lower-limit=0, upper-limit=3  # 02_TxmtId_SBW_Rq_SCCM
    c02_TxmtId_SBW_Rs_TCM: base-type=uint8, compu {0=I_C02_TXMTID_SBW_RS_TCM_VGS_NAG2 (VGS_NAG2) (VGS-NAG2), 1=I_C02_TXMTID_SBW_RS_TCM_EGS52 (EGS52), 2=I_C02_TXMTID_SBW_RS_TCM_NDEF2 (NDEF2) (not defined), 3=I_C02_TXMTID_SBW_RS_TCM_NDEF3 (NDEF3) (not defined)}, lower-limit=0, upper-limit=3  # 02_TxmtId_SBW_Rs_TCM
    c02_TxPkPos_Rq: base-type=uint8, compu {0=I_C02_TXPKPOS_RQ_IDLE (IDLE) (No request), 1=I_C02_TXPKPOS_RQ_P_ENGG (P_ENGG) (Engage transmission parking position), 2=I_C02_TXPKPOS_RQ_NDEF2 (NDEF2) (not defined), 3=I_C02_TXPKPOS_RQ_SNA (SNA) (SNA value from data type)}, lower-limit=0, upper-limit=3  # 02_TxPkPos_Rq
      invalid-value:
        integer literal c02_TxPkPos_Rq: type=c02_TxPkPos_Rq, value=3
    c02_PNHV_TxPkPosn_Rq: base-type=uint8, compu {0=I_C02_PNHV_TXPKPOSN_RQ_DRV_ALLOW (DRV_ALLOW) (Not inhibited), 1=I_C02_PNHV_TXPKPOSN_RQ_P_ENGG (P_ENGG) (Engage transmission parking position), 2=I_C02_PNHV_TXPKPOSN_RQ_P_HOLD (P_HOLD) (Hold parking position), 3=I_C02_PNHV_TXPKPOSN_RQ_SNA (SNA) (SNA value from data type)}, lower-limit=0, upper-limit=3  # 02_TxPkPosn_Rq_PNHV
      invalid-value:
        integer literal c02_PNHV_TxPkPosn_Rq: type=c02_PNHV_TxPkPosn_Rq, value=3
    c02_TxShftRcmnd_Disp_Rq_TCM: base-type=uint8, compu {0=I_C02_TXSHFTRCMND_DISP_RQ_TCM_IDLE (IDLE) (No Recommendation), 1=I_C02_TXSHFTRCMND_DISP_RQ_TCM_UP (UP) (Upshift recommendation), 2=I_C02_TXSHFTRCMND_DISP_RQ_TCM_DOWN (DOWN) (Downshift recommendation), 3=I_C02_TXSHFTRCMND_DISP_RQ_TCM_SNA (SNA) (SNA value from data type)}, lower-limit=0, upper-limit=3  # 02_TxShiftRcmmnd_Disp_Rq_TCM
      invalid-value:
        integer literal c02_TxShftRcmnd_Disp_Rq_TCM: type=c02_TxShftRcmnd_Disp_Rq_TCM, value=3
    c02_TxShiftStyle_V2: base-type=uint8, compu {0=I_C02_TXSHIFTSTYLE_V2_SBW_TCM (SBW_TCM) (Integrated shift by wire (iSBW)), 1=I_C02_TXSHIFTSTYLE_V2_SBW_ISM (SBW_ISM) (Shift by wire (ISM)), 2=I_C02_TXSHIFTSTYLE_V2_MS_TSLM (MS_TSLM) (Mechanical shifting (TSLM)), 3=I_C02_TXSHIFTSTYLE_V2_SNA (SNA) (SNA value from data type)}, lower-limit=0, upper-limit=3  # 02_TxShiftStyle_V2
      invalid-value:
        integer literal c02_TxShiftStyle_V2: type=c02_TxShiftStyle_V2, value=3
    c02_TxSlp_Stat: base-type=uint8, compu {0=I_C02_TXSLP_STAT_IDLE (IDLE) (keine Anforderung), 1=I_C02_TXSLP_STAT_SLP_NOT_ADJUSTED (SLP_NOT_ADJUSTED) (Schlupfanforderung nicht eingeregelt), 2=I_C02_TXSLP_STAT_SLP_ADJUSTED (SLP_ADJUSTED) (Schlupfanforderung eingeregelt), 3=I_C02_TXSLP_STAT_SNA (SNA) (SNA value from data type)}, lower-limit=0, upper-limit=3  # 02_TxSlp_Stat
      invalid-value:
        integer literal c02_TxSlp_Stat: type=c02_TxSlp_Stat, value=3
    c02_VIN: base-type=uint8, compu {0=I_C02_VIN_LO (LO) (VIN chars 1 - 7), 1=I_C02_VIN_MID (MID) (VIN chars 8 - 14), 2=I_C02_VIN_HI (HI) (VIN chars 15 - 17), 3=I_C02_VIN_SNA (SNA) (SNA value from data type)}, lower-limit=0, upper-limit=3  # 02_VIN
      invalid-value:
        integer literal c02_VIN: type=c02_VIN, value=3
    c02_Vprzr_DryVnTmr_Stat:  # 02_Vprzr_DryVnTmr_Stat
      base-type=uint8
      compu {0=I_C02_VPRZR_DRYVNTMR_STAT_INACTV (INACTV) (Inactive, no timer requested), 1=I_C02_VPRZR_DRYVNTMR_STAT_ACTV (ACTV) (Active, Timer started), 2=I_C02_VPRZR_DRYVNTMR_STAT_EXPIRED (EXPIRED) (Timer has expired), 3=I_C02_VPRZR_DRYVNTMR_STAT_SNA (SNA) (SNA value from data type)} "Verdampfertrockenlüften Zustand timer / Vaporizer dry ventilation timer state"
      lower-limit=0
      upper-limit=3
      invalid-value:
        integer literal c02_Vprzr_DryVnTmr_Stat: type=c02_Vprzr_DryVnTmr_Stat, value=3
    c02_WDC_IntrvntnMd_TCM:  # 02_WDC_IntrvntnMd_TCM
      base-type=uint8
      compu {0=I_C02_WDC_INTRVNTNMD_TCM_MFC (MFC) (Intervention mode minimum fuel consumption / MFC), 1=I_C02_WDC_INTRVNTNMD_TCM_FAST (FAST) (Intervention mode fastest / FAST), 2=I_C02_WDC_INTRVNTNMD_TCM_RATE_DEC (RATE_DEC) (Intervention mode fastest with rate action - Torque decreasing / RATE_DEC), 3=I_C02_WDC_INTRVNTNMD_TCM_RATE_INC (RATE_INC) (Intervention mode fastest with rate action - Torque increasing / RATE_INC)} "Brücke / Bridge"
      lower-limit=0
      upper-limit=3
    c02_WhlDir: base-type=uint8, compu {0=I_C02_WHLDIR_VOID (VOID) (Neither forward nor backward (stop)), 1=I_C02_WHLDIR_FORWARD (FORWARD) (Direction forward), 2=I_C02_WHLDIR_BACKWARD (BACKWARD) (Direction backward), 3=I_C02_WHLDIR_SNA (SNA) (SNA value from data type)}, lower-limit=0, upper-limit=3  # 02_WhlDir
      invalid-value:
        integer literal c02_WhlDir: type=c02_WhlDir, value=3
    c03_m2_p3_1_Init: base-type=uint8, compu {phys=raw-3 for raw 1..6, 0=I_C03_M2_P3_1_INIT_INIT (INIT) (Initialization), 7=I_C03_M2_P3_1_INIT_SNA (SNA) (SNA value from data type)}, lower-limit=0, upper-limit=7  # 03_-2-+3_1_Init | 03 2 +3 1 Init
      invalid-value:
        integer literal c03_m2_p3_1_Init: type=c03_m2_p3_1_Init, value=7
    c03_Act_DynFct_Rq_DS:  # 03_Act_DynFct_Rq_DS
      base-type=uint8
      compu {0=I_C03_ACT_DYNFCT_RQ_DS_NO_INFLUENCE (NO_INFLUENCE) (No influence), 1=I_C03_ACT_DYNFCT_RQ_DS_DSP_HIGHWAY (DSP_HIGHWAY) (Displacement - Highway), 2=I_C03_ACT_DYNFCT_RQ_DS_CUTOFF_BUILDUPAREA (CUTOFF_BUILDUPAREA) (cutoff - builduparea), 3=I_C03_ACT_DYNFCT_RQ_DS_DSP_RD_NORMAL (DSP_RD_NORMAL) (Displacement - Road-normal), 4=I_C03_ACT_DYNFCT_RQ_DS_DSP_RD_SMALL (DSP_RD_SMALL) (Displacement - Road-small), 5=I_C03_ACT_DYNFCT_RQ_DS_DSP_RMP_ON_HIGHWAY (DSP_RMP_ON_HIGHWAY) (Displacement - ramp on Highway), 7=I_C03_ACT_DYNFCT_RQ_DS_SNA (SNA) (SNA value from data type)}
      lower-limit=0
      upper-limit=7
      invalid-value:
        integer literal c03_Act_DynFct_Rq_DS: type=c03_Act_DynFct_Rq_DS, value=7
    c03_Clutch_Stat:  # 03_Clutch_Stat
      base-type=uint8
      compu {0=I_C03_CLUTCH_STAT_NDEF0 (NDEF0) (not defined), 1=I_C03_CLUTCH_STAT_ENGG (ENGG) (Engaged), 2=I_C03_CLUTCH_STAT_DISENGG (DISENGG) (Disengaged), 3=I_C03_CLUTCH_STAT_PRE_DISENGG (PRE_DISENGG) (Previous to disengaged), 4=I_C03_CLUTCH_STAT_SLIP (SLIP) (Slipping), 5=I_C03_CLUTCH_STAT_SLIP_ENGG_OR_SYNC_DRV_AW (SLIP_ENGG_OR_SYNC_DRV_AW) (Between slipping and engaged/ P2 Hybrid: Synchronisation Star), 6=I_C03_CLUTCH_STAT_DISENGG_SLIP (DISENGG_SLIP) (Between disengaged and slipping), 7=I_C03_CLUTCH_STAT_NDEF7 (NDEF7) (not defined)}
      lower-limit=0
      upper-limit=7
    c03_CoastMd_Rq:  # 03_CoastMd_Rq
      base-type=uint8
      compu {0=I_C03_COASTMD_RQ_INACTV (INACTV) (no shift), 1=I_C03_COASTMD_RQ_COAST (COAST) (coasting mode), 2=I_C03_COASTMD_RQ_NO_COAST (NO_COAST) (no coasting mode), 3=I_C03_COASTMD_RQ_PRED_PROHIBITS (PRED_PROHIBITS) (prediction prohibits coasting), 4=I_C03_COASTMD_RQ_ENG_PROHIBITS (ENG_PROHIBITS) (engine prohibits coasting), 5=I_C03_COASTMD_RQ_ENG_PRED_PROHIBITS (ENG_PRED_PROHIBITS) (engine and prediction prohibits coasting), 6=I_C03_COASTMD_RQ_NDEF6 (NDEF6) (not defined), 7=I_C03_COASTMD_RQ_SNA (SNA) (SNA value from data type)}
      lower-limit=0
      upper-limit=7
      invalid-value:
        integer literal c03_CoastMd_Rq: type=c03_CoastMd_Rq, value=7
    c03_CT_Stat:  # 03_CT_Stat
      base-type=uint8
      compu {0=I_C03_CT_STAT_UNLCKD (UNLCKD) (Unlocked), 1=I_C03_CT_STAT_OPN_LCKD (OPN_LCKD) (Open and locked), 2=I_C03_CT_STAT_CLSD_LCKD (CLSD_LCKD) (Closed and locked), 3=I_C03_CT_STAT_INVLD_UNLCKD (INVLD_UNLCKD) (Invalid, unlocked), 4=I_C03_CT_STAT_NDEF4 (NDEF4) (Not defined), 5=I_C03_CT_STAT_NDEF5 (NDEF5) (Not defined), 6=I_C03_CT_STAT_NDEF6 (NDEF6) (Not defined), 7=I_C03_CT_STAT_SNA (SNA) (SNA value from data type)}
      lower-limit=0
      upper-limit=7
      invalid-value:
        integer literal c03_CT_Stat: type=c03_CT_Stat, value=7
    c03_DPC_Md_AS: base-type=uint8, compu {1=I_C03_DPC_MD_AS_COMFORT (COMFORT) (Comfort mode), 2=I_C03_DPC_MD_AS_EDRIVE (EDRIVE) (E-Drive mode), 3=I_C03_DPC_MD_AS_SPORT (SPORT) (Sport mode), 4=I_C03_DPC_MD_AS_SPORT_PLUS (SPORT_PLUS) (Sport+ mode), 5=I_C03_DPC_MD_AS_ECO (ECO) (ECO mode), 7=I_C03_DPC_MD_AS_SNA (SNA) (SNA value from data type)}, lower-limit=1, upper-limit=7  # 03_DPC_Md_AS
      invalid-value:
        integer literal c03_DPC_Md_AS: type=c03_DPC_Md_AS, value=7
    c03_DPC_Md_ESP_Rq:  # 03_DPC_Md_ESP_Rq
      base-type=uint8
      compu {0=I_C03_DPC_MD_ESP_RQ_NDEF0 (NDEF0) (not defined), 1=I_C03_DPC_MD_ESP_RQ_COMFORT (COMFORT) (Comfort), 2=I_C03_DPC_MD_ESP_RQ_SPORT (SPORT) (Sport), 3=I_C03_DPC_MD_ESP_RQ_OFF (OFF) (Off), 4=I_C03_DPC_MD_ESP_RQ_SPORT_PLUS (SPORT_PLUS) (Sport +), 5=I_C03_DPC_MD_ESP_RQ_ALLROAD (ALLROAD) (Allroad), 6=I_C03_DPC_MD_ESP_RQ_OFFROAD (OFFROAD) (Offroad), 7=I_C03_DPC_MD_ESP_RQ_SNA (SNA) (SNA value from data type)}
      lower-limit=0
      upper-limit=7
      invalid-value:
        integer literal c03_DPC_Md_ESP_Rq: type=c03_DPC_Md_ESP_Rq, value=7
    c03_DPC_Md_ExhaustFlap:  # 03_DPC_Md_ExhstFlap
      base-type=uint8
      compu {0=I_C03_DPC_MD_EXHAUSTFLAP_NDEF0 (NDEF0) (not defined), 1=I_C03_DPC_MD_EXHAUSTFLAP_COMFORT (COMFORT) (Comfort), 2=I_C03_DPC_MD_EXHAUSTFLAP_SPORT (SPORT) (Sport), 3=I_C03_DPC_MD_EXHAUSTFLAP_SPORTPLUS (SPORTPLUS) (Sport+), 4=I_C03_DPC_MD_EXHAUSTFLAP_RACE (RACE) (Race), 5=I_C03_DPC_MD_EXHAUSTFLAP_NDEF5 (NDEF5) (not defined), 6=I_C03_DPC_MD_EXHAUSTFLAP_NDEF6 (NDEF6) (not defined), 7=I_C03_DPC_MD_EXHAUSTFLAP_SNA (SNA) (SNA value from data type)}
      lower-limit=0
      upper-limit=7
      invalid-value:
        integer literal c03_DPC_Md_ExhaustFlap: type=c03_DPC_Md_ExhaustFlap, value=7
    c03_DPC_Md_St: base-type=uint8, compu {1=I_C03_DPC_MD_ST_COMFORT (COMFORT) (Comfort mode), 2=I_C03_DPC_MD_ST_SPORT (SPORT) (Sport mode), 3=I_C03_DPC_MD_ST_SPORTPLUS (SPORTPLUS) (Sport+ mode), 7=I_C03_DPC_MD_ST_SNA (SNA) (SNA value from data type)}, lower-limit=1, upper-limit=7  # 03_DPC_Md_St
      invalid-value:
        integer literal c03_DPC_Md_St: type=c03_DPC_Md_St, value=7
    c03_EM01_Cool_Rq_V2:  # 03_EM01_Cool_Rq_V2
      base-type=uint8
      compu {0=I_C03_EM01_COOL_RQ_V2_NO_RQ (NO_RQ) (Power electronic: No request), 1=I_C03_EM01_COOL_RQ_V2_WARNING_EXCLUSIVE (WARNING_EXCLUSIVE) (Power electronic: Exclusive Warning request), 2=I_C03_EM01_COOL_RQ_V2_DECLUTCH_RQ (DECLUTCH_RQ) (Power electronic: E-Motor Declutch request), 3=I_C03_EM01_COOL_RQ_V2_SPD_THRS1 (SPD_THRS1) (Power electronic: E-Motor max Speed Threshold 1), 4=I_C03_EM01_COOL_RQ_V2_SPD_THRS2 (SPD_THRS2) (Power electronic: E-Motor max Speed Threshold 2), 5=I_C03_EM01_COOL_RQ_V2_ZERO_SPD_RQ (ZERO_SPD_RQ) (Power electronic: E-Motor Zero Speed request), 6=I_C03_EM01_COOL_RQ_V2_NDEF (NDEF) (Not defined), 7=I_C03_EM01_COOL_RQ_V2_SNA (SNA) (SNA value from data type)}
      lower-limit=0
      upper-limit=7
      invalid-value:
        integer literal c03_EM01_Cool_Rq_V2: type=c03_EM01_Cool_Rq_V2, value=7
    c03_EM01_Emg_Rq: base-type=uint8, compu {0=I_C03_EM01_EMG_RQ_IDLE (IDLE) (No request), 1=I_C03_EM01_EMG_RQ_LHOM (LHOM) (Limp-home), 2=I_C03_EM01_EMG_RQ_TPS (TPS) (Three phase short), 3=I_C03_EM01_EMG_RQ_TPO (TPO) (Threee phase open), 7=I_C03_EM01_EMG_RQ_SNA (SNA) (SNA value from data type)}, lower-limit=0, upper-limit=7  # 03_EM01_Emg_Rq
      invalid-value:
        integer literal c03_EM01_Emg_Rq: type=c03_EM01_Emg_Rq, value=7
    c03_EngRun_Stat:  # 03_EngRun_Stat
      base-type=uint8
      compu {0=I_C03_ENGRUN_STAT_STOP (STOP) (Engine is stopped), 1=I_C03_ENGRUN_STAT_START (START) (Engine starting), 2=I_C03_ENGRUN_STAT_IDLE_UNSTBL (IDLE_UNSTBL) (Engine idling, unstable), 3=I_C03_ENGRUN_STAT_IDLE_STBL (IDLE_STBL) (Engine idling, stable), 4=I_C03_ENGRUN_STAT_UNLIMITED (UNLIMITED) (Engine running, unlimited rpm), 5=I_C03_ENGRUN_STAT_LIMITED (LIMITED) (Engine running, limited rpm), 6=I_C03_ENGRUN_STAT_NDEF6 (NDEF6) (not defined), 7=I_C03_ENGRUN_STAT_SNA (SNA) (SNA value from data type)}
      lower-limit=0
      upper-limit=7
      invalid-value:
        integer literal c03_EngRun_Stat: type=c03_EngRun_Stat, value=7
    c03_EngTrq_Unstbl_Stat:  # 03_EngTrq_Unstbl_Stat
      base-type=uint8
      compu {0=I_C03_ENGTRQ_UNSTBL_STAT_STABLE (STABLE) (Engine torque stable), 1=I_C03_ENGTRQ_UNSTBL_STAT_UNSTBL_LVL1 (UNSTBL_LVL1) (One cylinder eccentric), 2=I_C03_ENGTRQ_UNSTBL_STAT_UNSTBL_LVL2 (UNSTBL_LVL2) (Two cylinder not in firing order eccentric), 3=I_C03_ENGTRQ_UNSTBL_STAT_UNSTBL_LVL3 (UNSTBL_LVL3) (Two cylinder in firing order eccentric), 4=I_C03_ENGTRQ_UNSTBL_STAT_UNSTBL_LVL4 (UNSTBL_LVL4) (One cylinder bank eccentric), 5=I_C03_ENGTRQ_UNSTBL_STAT_UNSTBL_LVLX (UNSTBL_LVLx) (Collecting failure), 6=I_C03_ENGTRQ_UNSTBL_STAT_UNSTBL_LVL6 (UNSTBL_LVL6) (At least one cylinder shut off because of ignition failure), 7=I_C03_ENGTRQ_UNSTBL_STAT_SNA (SNA) (SNA value from data type)}
      lower-limit=0
      upper-limit=7
      invalid-value:
        integer literal c03_EngTrq_Unstbl_Stat: type=c03_EngTrq_Unstbl_Stat, value=7
    c03_EPkBrk_Stat:  # 03_EPkBrk_Stat
      base-type=uint8
      compu {0=I_C03_EPKBRK_STAT_ERR (ERR) (Fatal system error), 1=I_C03_EPKBRK_STAT_NORM (NORM) (Normal operation), 2=I_C03_EPKBRK_STAT_DIAG (DIAG) (Diagnostics), 3=I_C03_EPKBRK_STAT_INIT (INIT) (Initialization), 4=I_C03_EPKBRK_STAT_PART (PART) (Partial operation), 5=I_C03_EPKBRK_STAT_NO_ENGG (NO_ENGG) (Partial operation, engaging not possible), 6=I_C03_EPKBRK_STAT_NDEF6 (NDEF6) (not defined), 7=I_C03_EPKBRK_STAT_SNA (SNA) (SNA value from data type)}
      lower-limit=0
      upper-limit=7
      invalid-value:
        integer literal c03_EPkBrk_Stat: type=c03_EPkBrk_Stat, value=7
    c03_ESP_FricCoeff_Stat:  # 03_ESP_FricCoeff_Stat
      base-type=uint8
      compu {0=I_C03_ESP_FRICCOEFF_STAT_IDLE (IDLE) (No indication by ESP), 1=I_C03_ESP_FRICCOEFF_STAT_VERY_HIGH_FRIC (VERY_HIGH_FRIC) (very high friction coefficient), 2=I_C03_ESP_FRICCOEFF_STAT_HIGH_FRIC (HIGH_FRIC) (high friction coefficient), 3=I_C03_ESP_FRICCOEFF_STAT_MEDIUM_FRIC_UP (MEDIUM_FRIC_UP) (upper medium friction coefficient), 4=I_C03_ESP_FRICCOEFF_STAT_MEDIUM_FRIC_LO (MEDIUM_FRIC_LO) (lower medium friction coefficient), 5=I_C03_ESP_FRICCOEFF_STAT_LOW_FRIC (LOW_FRIC) (low friction coefficient), 6=I_C03_ESP_FRICCOEFF_STAT_VERY_LOW_FRIC (VERY_LOW_FRIC) (very low friction coefficient), 7=I_C03_ESP_FRICCOEFF_STAT_SNA (SNA) (SNA value from data type)}
      lower-limit=0
      upper-limit=7
      invalid-value:
        integer literal c03_ESP_FricCoeff_Stat: type=c03_ESP_FricCoeff_Stat, value=7
    c03_ESP_Sys_Stat:  # 03_ESP_Sys_Stat_V2
      base-type=uint8
      compu {0=I_C03_ESP_SYS_STAT_TMP_OFF (TMP_OFF) (System temporarily off), 1=I_C03_ESP_SYS_STAT_NORM (NORM) (Normal operation), 2=I_C03_ESP_SYS_STAT_ERR (ERR) (System error), 3=I_C03_ESP_SYS_STAT_DIAG (DIAG) (Diagnostics), 4=I_C03_ESP_SYS_STAT_EMT (EMT) (Exhaust emission test), 5=I_C03_ESP_SYS_STAT_TBCC_ON (TBCC_ON) (Test bench cruise control on (no regulation)), 6=I_C03_ESP_SYS_STAT_TBCC_REG_ACTV (TBCC_REG_ACTV) (Test bench cruise control regulation active)}
      lower-limit=0
      upper-limit=6
    c03_EVC_HVAC_Style: base-type=uint8, compu {0=I_C03_EVC_HVAC_STYLE_AIRCOND (AirCond) (580 AIR CONDITIONING), 1=I_C03_EVC_HVAC_STYLE_AUTOCLIMATECTRL (AutoClimateCtrl) (581 AUTOMATIC CLIMATE CONTROL), 7=I_C03_EVC_HVAC_STYLE_OTHER (OTHER) (none of listed variants)}, lower-limit=0, upper-limit=7  # 03_EVC_HVAC_Style
    c03_EVC_RoofStyle:  # 03_EVC_RoofStyle
      base-type=uint8
      compu {0=I_C03_EVC_ROOFSTYLE_PANORAMAROOF (PANORAMAROOF) (413 PANORAMA TOP SLIDING ROOF ELECTRIC), 1=I_C03_EVC_ROOFSTYLE_SUNROOF (SUNROOF) (414 ELECTRIC TILT/SLIDE SUNROOF IN GLASS VERSION), 2=I_C03_EVC_ROOFSTYLE_GLASS_VAR_TRANSP (GLASS_VAR_TRANSP) (398 GLASS-ROOF WITH VARIABLE TRANSPARENCY), 3=I_C03_EVC_ROOFSTYLE_SOLAR_MODULE (SOLAR_MODULE) (419 SOLAR MODULE), 7=I_C03_EVC_ROOFSTYLE_OTHER (OTHER) (none of listed variants)}
      lower-limit=0
      upper-limit=7
    c03_EVC_TPM_Style:  # 03_EVC_TPM_Style
      base-type=uint8
      compu {0=I_C03_EVC_TPM_STYLE_INFLPRESSCTRL_LOW (InflPressCtrl_Low) (470 INFLATION PRESSURE CONTROL LOW LINE), 1=I_C03_EVC_TPM_STYLE_INFLPRESSCTRL_HIGHMID (InflPressCtrl_HighMid) (475 INFLATION PRESSURE CONTROL HIGH LINE/MID LINE), 2=I_C03_EVC_TPM_STYLE_RUNFLATIND (RunFlatInd) (477 RUN-FLAT INDICATOR), 7=I_C03_EVC_TPM_STYLE_OTHER (OTHER) (none of listed variants)}
      lower-limit=0
      upper-limit=7
    c03_ExhstFlap_Stg:  # 03_ExhstFlap_Stg
      base-type=uint8
      compu {0=I_C03_EXHSTFLAP_STG_IDLE (IDLE) (Exhaust flap idle stage), 1=I_C03_EXHSTFLAP_STG_STAGE1 (STAGE1) (Exhaust flap stage 1), 2=I_C03_EXHSTFLAP_STG_STAGE2 (STAGE2) (Exhaust flap stage 2), 3=I_C03_EXHSTFLAP_STG_STAGE3 (STAGE3) (Exhaust flap stage 3), 4=I_C03_EXHSTFLAP_STG_STAGE4 (STAGE4) (Exhaust flap stage 4), 5=I_C03_EXHSTFLAP_STG_STAGE5 (STAGE5) (Exhaust flap stage 5), 6=I_C03_EXHSTFLAP_STG_STAGE6 (STAGE6) (Exhaust flap stage 6), 7=I_C03_EXHSTFLAP_STG_SNA (SNA) (SNA value from data type)}
      lower-limit=0
      upper-limit=7
      invalid-value:
        integer literal c03_ExhstFlap_Stg: type=c03_ExhstFlap_Stg, value=7
    c03_FFAP_AmpliFctr:  # 03_FFAP_AmpliFctr
      base-type=uint8
      compu {0=I_C03_FFAP_AMPLIFCTR_AMPL_0 (AMPL_0) (Amplitude 0% of maximum force), 1=I_C03_FFAP_AMPLIFCTR_AMPL_20 (AMPL_20) (Amplitude 20% of maximum force), 2=I_C03_FFAP_AMPLIFCTR_AMPL_40 (AMPL_40) (Amplitude 40% of maximum force), 3=I_C03_FFAP_AMPLIFCTR_AMPL_60 (AMPL_60) (Amplitude 60% of maximum force), 4=I_C03_FFAP_AMPLIFCTR_AMPL_80 (AMPL_80) (Amplitude 80% of maximum force), 5=I_C03_FFAP_AMPLIFCTR_AMPL_100 (AMPL_100) (Amplitude 100% of maximum force), 6=I_C03_FFAP_AMPLIFCTR_AMPL_120 (AMPL_120) (Amplitude 120% of maximum force), 7=I_C03_FFAP_AMPLIFCTR_AMPL_140 (AMPL_140) (Amplitude 140% of maximum force)}
      lower-limit=0
      upper-limit=7
    c03_FFAP_DbPls_IntrmLgth_Rq:  # 03_FFAP_DbPls_IntrmLgth_Rq
      base-type=uint8
      compu {0=I_C03_FFAP_DBPLS_INTRMLGTH_RQ_LGTH_50 (LGTH_50) (50 ms), 1=I_C03_FFAP_DBPLS_INTRMLGTH_RQ_LGTH_100 (LGTH_100) (100 ms), 2=I_C03_FFAP_DBPLS_INTRMLGTH_RQ_LGTH_150 (LGTH_150) (150 ms), 3=I_C03_FFAP_DBPLS_INTRMLGTH_RQ_LGTH_200 (LGTH_200) (200 ms), 4=I_C03_FFAP_DBPLS_INTRMLGTH_RQ_LGTH_250 (LGTH_250) (250 ms), 5=I_C03_FFAP_DBPLS_INTRMLGTH_RQ_LGTH_300 (LGTH_300) (300 ms), 6=I_C03_FFAP_DBPLS_INTRMLGTH_RQ_LGTH_350 (LGTH_350) (350 ms), 7=I_C03_FFAP_DBPLS_INTRMLGTH_RQ_LGTH_400 (LGTH_400) (400 ms)}
      lower-limit=0
      upper-limit=7
    c03_FFAP_DbPlsI_Force_Max:  # 03_FFAP_DbPlsI_Force_Max
      base-type=uint8
      compu {0=I_C03_FFAP_DBPLSI_FORCE_MAX_FORCE_0 (FORCE_0) (0 N), 1=I_C03_FFAP_DBPLSI_FORCE_MAX_FORCE_2 (FORCE_2) (2 N), 2=I_C03_FFAP_DBPLSI_FORCE_MAX_FORCE_4 (FORCE_4) (4 N), 3=I_C03_FFAP_DBPLSI_FORCE_MAX_FORCE_6 (FORCE_6) (6 N), 4=I_C03_FFAP_DBPLSI_FORCE_MAX_FORCE_8 (FORCE_8) (8 N), 5=I_C03_FFAP_DBPLSI_FORCE_MAX_FORCE_10 (FORCE_10) (10 N), 6=I_C03_FFAP_DBPLSI_FORCE_MAX_FORCE_12 (FORCE_12) (12 N), 7=I_C03_FFAP_DBPLSI_FORCE_MAX_SNA (SNA) (SNA value from data type)}
      lower-limit=0
      upper-limit=7
      invalid-value:
        integer literal c03_FFAP_DbPlsI_Force_Max: type=c03_FFAP_DbPlsI_Force_Max, value=7
    c03_FFAP_Frequency:  # 03_FFAP_Frequency
      base-type=uint8
      compu {0=I_C03_FFAP_FREQUENCY_HZ_5 (HZ_5) (5 Hz), 1=I_C03_FFAP_FREQUENCY_HZ_10 (HZ_10) (10 Hz), 2=I_C03_FFAP_FREQUENCY_HZ_15 (HZ_15) (15 Hz), 3=I_C03_FFAP_FREQUENCY_HZ_20 (HZ_20) (20 Hz), 4=I_C03_FFAP_FREQUENCY_NDEF4 (NDEF4) (not defined), 5=I_C03_FFAP_FREQUENCY_NDEF5 (NDEF5) (not defined), 6=I_C03_FFAP_FREQUENCY_NDEF6 (NDEF6) (not defined), 7=I_C03_FFAP_FREQUENCY_SNA (SNA) (SNA value from data type)}
      lower-limit=0
      upper-limit=7
      invalid-value:
        integer literal c03_FFAP_Frequency: type=c03_FFAP_Frequency, value=7
    c03_FFAP_SigFormat: base-type=uint8, compu {0=I_C03_FFAP_SIGFORMAT_SINUS (SINUS) (Sinus), 1=I_C03_FFAP_SIGFORMAT_SAWTOOTH (SAWTOOTH) (Sawtooth), 2=I_C03_FFAP_SIGFORMAT_RECTANGLE (RECTANGLE) (Rectangle), 3=I_C03_FFAP_SIGFORMAT_SNA (SNA) (SNA value from data type)}, lower-limit=0, upper-limit=3  # 03_FFAP_SigFormat
      invalid-value:
        integer literal c03_FFAP_SigFormat: type=c03_FFAP_SigFormat, value=3
    c03_FTW_PressDrop_Stat:  # 03_FTW_PressDrop_Stat
      base-type=uint8
      compu {0=I_C03_FTW_PRESSDROP_STAT_OK (OK) (Flat tire warning: ok), 1=I_C03_FTW_PRESSDROP_STAT_WARN_EXPECT (WARN_EXPECT) (Flat tire warning: pressure drop warning expected), 2=I_C03_FTW_PRESSDROP_STAT_WARN_ACTV (WARN_ACTV) (Flat tire warning: pressure drop warning active), 3=I_C03_FTW_PRESSDROP_STAT_WARN_LAST_IGN_CYC (WARN_LAST_IGN_CYC) (Flat tire warning: pressure drop warning during last ignition cycle), 7=I_C03_FTW_PRESSDROP_STAT_SNA (SNA) (SNA value from data type)}
      lower-limit=0
      upper-limit=7
      invalid-value:
        integer literal c03_FTW_PressDrop_Stat: type=c03_FTW_PressDrop_Stat, value=7
    c03_FuelLowPress_Sys_Rq:  # 03_FuelLowPress_Sys_Rq
      base-type=uint8
      compu {0=I_C03_FUELLOWPRESS_SYS_RQ_OFF (OFF) (pressure off), 1=I_C03_FUELLOWPRESS_SYS_RQ_HOLD_COMP_PROT (HOLD_COMP_PROT) (pressure hold for component protection), 2=I_C03_FUELLOWPRESS_SYS_RQ_HOLD_SSA (HOLD_SSA) (pressure hold for restart (SSA)), 3=I_C03_FUELLOWPRESS_SYS_RQ_CTRL_DYN (CTRL_DYN) (pressure control dynamic), 4=I_C03_FUELLOWPRESS_SYS_RQ_CRASH_OFF (CRASH_OFF) (Crash pressure off), 7=I_C03_FUELLOWPRESS_SYS_RQ_SNA (SNA) (SNA value from data type)}
      lower-limit=0
      upper-limit=7
      invalid-value:
        integer literal c03_FuelLowPress_Sys_Rq: type=c03_FuelLowPress_Sys_Rq, value=7
    c03_Funct_GrShft_Rq_DS:  # 03_Funct_GrShft_Rq_DS
      base-type=uint8
      compu {0=I_C03_FUNCT_GRSHFT_RQ_DS_NONE (NONE) (None), 1=I_C03_FUNCT_GRSHFT_RQ_DS_PROBABLE_STOP (PROBABLE_STOP) (Probable stop), 2=I_C03_FUNCT_GRSHFT_RQ_DS_PREDICTED_STOP (PREDICTED_STOP) (Predicted stop), 3=I_C03_FUNCT_GRSHFT_RQ_DS_MAX_SPEED (MAX_SPEED) (Max speed), 4=I_C03_FUNCT_GRSHFT_RQ_DS_PREDICTED_ACCELERATION (PREDICTED_ACCELERATION) (Predicted acceleration), 5=I_C03_FUNCT_GRSHFT_RQ_DS_PREDICTED_SWITCHBACK (PREDICTED_SWITCHBACK) (Predicted Switchback), 7=I_C03_FUNCT_GRSHFT_RQ_DS_SNA (SNA) (SNA value from data type)}
      lower-limit=0
      upper-limit=7
      invalid-value:
        integer literal c03_Funct_GrShft_Rq_DS: type=c03_Funct_GrShft_Rq_DS, value=7
    c02_Gr_TCASE_V2:  # 03_Gr_TCASE_V2
      base-type=uint8
      compu {0=I_C02_GR_TCASE_V2_SHIFT_LO (SHIFT_LO) (Shift to low range in progress), 1=I_C02_GR_TCASE_V2_SHIFT_HI (SHIFT_HI) (Shift to high range in progress), 2=I_C02_GR_TCASE_V2_SHIFT_N (SHIFT_N) (Shift to neutral in progress), 3=I_C02_GR_TCASE_V2_GR_LO (GR_LO) (Low range (offroad gear)), 4=I_C02_GR_TCASE_V2_GR_HI (GR_HI) (High range (road gear)), 5=I_C02_GR_TCASE_V2_GR_N (GR_N) (Neutral gear), 7=I_C02_GR_TCASE_V2_SNA (SNA) (SNA value from data type)}
      lower-limit=0
      upper-limit=7
      invalid-value:
        integer literal c02_Gr_TCASE_V2: type=c02_Gr_TCASE_V2, value=7
    c03_GrShft_Rq_DS:  # 03_GrShft_Rq_DS
      base-type=uint8
      compu {0=I_C03_GRSHFT_RQ_DS_NONE (NONE) (None), 1=I_C03_GRSHFT_RQ_DS_UPSHIFT_FORBID (UPSHIFT_FORBID) (Upshift forbidden), 2=I_C03_GRSHFT_RQ_DS_UPSHIFT (UPSHIFT) (Request upshift), 3=I_C03_GRSHFT_RQ_DS_DOWNSHIFT_FORBID (DOWNSHIFT_FORBID) (Downshift forbidden), 4=I_C03_GRSHFT_RQ_DS_DOWNSHIFT (DOWNSHIFT) (Request Downshift), 7=I_C03_GRSHFT_RQ_DS_SNA (SNA) (SNA value from data type)}
      lower-limit=0
      upper-limit=7
      invalid-value:
        integer literal c03_GrShft_Rq_DS: type=c03_GrShft_Rq_DS, value=7
    c03_HDC_GrdntMd_Rq_WDC:  # 03_HDC_GrdntMd_Rq_WDC
      base-type=uint8
      compu {0=I_C03_HDC_GRDNTMD_RQ_WDC_DISABLED (DISABLED) (No gradient mode), 1=I_C03_HDC_GRDNTMD_RQ_WDC_SLOW (SLOW) (Slow gradient), 2=I_C03_HDC_GRDNTMD_RQ_WDC_NORMAL (NORMAL) (Normal gradient), 3=I_C03_HDC_GRDNTMD_RQ_WDC_FAST (FAST) (Fast gradient), 4=I_C03_HDC_GRDNTMD_RQ_WDC_MAX (MAX) (Maximum gradient), 5=I_C03_HDC_GRDNTMD_RQ_WDC_NDEF5 (NDEF5) (not defined), 6=I_C03_HDC_GRDNTMD_RQ_WDC_NDEF6 (NDEF6) (not defined), 7=I_C03_HDC_GRDNTMD_RQ_WDC_SNA (SNA) (SNA value from data type)}
      lower-limit=0
      upper-limit=7
      invalid-value:
        integer literal c03_HDC_GrdntMd_Rq_WDC: type=c03_HDC_GrdntMd_Rq_WDC, value=7
    c03_Hyb_EV_ESave_Blank_Chrg:  # 03_Hyb_EV_ESave_Blank_Chrg
      base-type=uint8
      compu {0=I_C03_HYB_EV_ESAVE_BLANK_CHRG_HYBRID (HYBRID) (Hybrid Mode), 1=I_C03_HYB_EV_ESAVE_BLANK_CHRG_EV (EV) (EV Mode), 2=I_C03_HYB_EV_ESAVE_BLANK_CHRG_ESAVE (ESAVE) (E-Save Mode), 3=I_C03_HYB_EV_ESAVE_BLANK_CHRG_BLANK (BLANK) (Blank (" ") Keine Anzeige), 4=I_C03_HYB_EV_ESAVE_BLANK_CHRG_CHARGE (CHARGE) (Charge Mode), 7=I_C03_HYB_EV_ESAVE_BLANK_CHRG_SNA (SNA) (SNA value from data type)}
      lower-limit=0
      upper-limit=7
      invalid-value:
        integer literal c03_Hyb_EV_ESave_Blank_Chrg: type=c03_Hyb_EV_ESave_Blank_Chrg, value=7
    c03_Hyb_GrChg_Rq:  # 03_Hyb_GrChg_Rq
      base-type=uint8
      compu {0=I_C03_HYB_GRCHG_RQ_IDLE (IDLE) (Idle), 1=I_C03_HYB_GRCHG_RQ_LIMIT_NOW (LIMIT_NOW) (Limit input shaft speed low, EMGY-shift prog), 2=I_C03_HYB_GRCHG_RQ_CH_SHIFT_PG (CH_SHIFT_PG) (Change to ICE-shift program), 3=I_C03_HYB_GRCHG_RQ_INC_SPD_SHAFT_GRDS (INC_SPD_SHAFT_GRDS) (Increase speed of input shaft on grades), 4=I_C03_HYB_GRCHG_RQ_EMODE (EMODE) (E-Mode), 5=I_C03_HYB_GRCHG_RQ_SILENT_EMODE (SILENT_EMODE) (Silent E-Mode), 6=I_C03_HYB_GRCHG_RQ_LIMIT_HIGH (LIMIT_HIGH) (Limit input shaft speed high, STND-shift prog), 7=I_C03_HYB_GRCHG_RQ_SNA (SNA) (SNA value from data type)}
      lower-limit=0
      upper-limit=7
      invalid-value:
        integer literal c03_Hyb_GrChg_Rq: type=c03_Hyb_GrChg_Rq, value=7
    c03_ISw_Stat: base-type=uint8, compu {0=I_C03_ISW_STAT_IGN_LOCK (IGN_LOCK) (Ignition lock (0)), 1=I_C03_ISW_STAT_IGN_OFF (IGN_OFF) (Ignition off (15c)), 2=I_C03_ISW_STAT_IGN_ACC (IGN_ACC) (Ignition accessory (15r)), 4=I_C03_ISW_STAT_IGN_ON (IGN_ON) (Ignition on (15)), 5=I_C03_ISW_STAT_IGN_START (IGN_START) (Ignition start (50)), 7=I_C03_ISW_STAT_SNA (SNA) (SNA value from data type)}, lower-limit=0, upper-limit=7  # 03_ISw_Stat
      invalid-value:
        integer literal c03_ISw_Stat: type=c03_ISw_Stat, value=7
    c03_l_per_min_0_3_0k5: base-type=uint8, compu {phys=raw*0.5 for raw 0..6, 7=I_C03_L_PER_MIN_0_3_0K5_SNA (SNA) (SNA value from data type); unit l/min}, lower-limit=0, upper-limit=7  # 03_l/min-0-3_0,5
      invalid-value:
        integer literal c03_l_per_min_0_3_0k5: type=c03_l_per_min_0_3_0k5, value=7
    c03_LDC_CMS_Stat:  # 03_LDC_CMS_Stat
      base-type=uint8
      compu {0=I_C03_LDC_CMS_STAT_CMS_OFF (CMS_OFF) (Collision mitigation system off), 1=I_C03_LDC_CMS_STAT_CMS_ON (CMS_ON) (Collision mitigation system on (working)), 2=I_C03_LDC_CMS_STAT_CMS_DEF (CMS_DEF) (Collision mitigation system defective), 3=I_C03_LDC_CMS_STAT_CMS_OFF_GPS (CMS_OFF_GPS) (Collision mitigation system off due to blocked GPS position), 4=I_C03_LDC_CMS_STAT_CMS_OFF_RADAR (CMS_OFF_RADAR) (Collision mitigation system off due to disabled radar sensor), 7=I_C03_LDC_CMS_STAT_SNA (SNA) (SNA value from data type)}
      lower-limit=0
      upper-limit=7
      invalid-value:
        integer literal c03_LDC_CMS_Stat: type=c03_LDC_CMS_Stat, value=7
    c03_LDC_DTR_MsgDisp_Rq:  # 03_LDC_DTR_MsgDisp_Rq
      base-type=uint8
      compu {0=I_C03_LDC_DTR_MSGDISP_RQ_IDLE (IDLE) (No request), 1=I_C03_LDC_DTR_MSGDISP_RQ_MSG1_03F (MSG1_03F) (Message "Distronic defective"), 2=I_C03_LDC_DTR_MSGDISP_RQ_MSG2_0E5 (MSG2_0E5) (Message "Distronic and Speedtronic defective"), 3=I_C03_LDC_DTR_MSGDISP_RQ_MSG3_17B (MSG3_17B) (Message "Distronic switched off due to soiled radar sensor"), 4=I_C03_LDC_DTR_MSGDISP_RQ_MSG4_3AD (MSG4_3AD) (Message "Distronic switched off due to blocked GPS"), 5=I_C03_LDC_DTR_MSGDISP_RQ_MSG5_0E5_248 (MSG5_0E5_248) (Message "Cruise control and Speedtronic defective"), 6=I_C03_LDC_DTR_MSGDISP_RQ_MSG6_24D_364 (MSG6_24D_364) (Message "(Advandced) Distronic available again"), 7=I_C03_LDC_DTR_MSGDISP_RQ_SNA (SNA) (SNA value from data type)}
      lower-limit=0
      upper-limit=7
      invalid-value:
        integer literal c03_LDC_DTR_MsgDisp_Rq: type=c03_LDC_DTR_MsgDisp_Rq, value=7
    c03_LDC_DTR_Stat_V2:  # 03_LDC_DTR_Stat_V2
      base-type=uint8
      compu {0=I_C03_LDC_DTR_STAT_V2_DTR_CC_OFF (DTR_CC_OFF) (Distronic and cruise control off), 1=I_C03_LDC_DTR_STAT_V2_DTR_ON (DTR_ON) (Distronic on (working)), 2=I_C03_LDC_DTR_STAT_V2_DTR_DEF (DTR_DEF) (Distronic defective), 3=I_C03_LDC_DTR_STAT_V2_NDEF3 (NDEF3) (Not defined), 4=I_C03_LDC_DTR_STAT_V2_NDEF4 (NDEF4) (Not defined), 5=I_C03_LDC_DTR_STAT_V2_DTR_PSV (DTR_PSV) (Distronic passive), 6=I_C03_LDC_DTR_STAT_V2_NDEF6 (NDEF6) (Not defined), 7=I_C03_LDC_DTR_STAT_V2_SNA (SNA) (SNA value from data type)}
      lower-limit=0
      upper-limit=7
      invalid-value:
        integer literal c03_LDC_DTR_Stat_V2: type=c03_LDC_DTR_Stat_V2, value=7
    c03_LDC_IconDisp_Rq:  # 03_LDC_IconDisp_Rq
      base-type=uint8
      compu {0=I_C03_LDC_ICONDISP_RQ_LDC_OFF (LDC_OFF) (Cruise control and variable speed limiter off), 1=I_C03_LDC_ICONDISP_RQ_CC_PRESELECT_WO_SETSPEED (CC_PRESELECT_WO_SETSPEED) (Cruise control preselected w/o setspeed), 2=I_C03_LDC_ICONDISP_RQ_CC_ON (CC_ON) (Cruise control on), 3=I_C03_LDC_ICONDISP_RQ_VSL_PRESELECT_WO_SETSPEED (VSL_PRESELECT_WO_SETSPEED) (Variable speed limiter preselected w/o setspeed), 4=I_C03_LDC_ICONDISP_RQ_VSL_ON (VSL_ON) (Variable speed limiter on), 5=I_C03_LDC_ICONDISP_RQ_CC_PRESELECT_W_SETSPEED (CC_PRESELECT_W_SETSPEED) (Cruise control preselected with setspeed), 6=I_C03_LDC_ICONDISP_RQ_VSL_PRESELECT_W_SETSPEED (VSL_PRESELECT_W_SETSPEED) (Variable speed limiter preselected with setspeed), 7=I_C03_LDC_ICONDISP_RQ_SNA (SNA) (SNA value from data type)}
      lower-limit=0
      upper-limit=7
      invalid-value:
        integer literal c03_LDC_IconDisp_Rq: type=c03_LDC_IconDisp_Rq, value=7
    c03_LDC_IconDisp_Rq_RDU:  # 03_LDC_IconDisp_Rq_RDU
      base-type=uint8
      compu {0=I_C03_LDC_ICONDISP_RQ_RDU_IDLE (IDLE) (no request), 1=I_C03_LDC_ICONDISP_RQ_RDU_PRESELECT_WO_SETSPEED (PRESELECT_WO_SETSPEED) (preselect w/o setspeed), 2=I_C03_LDC_ICONDISP_RQ_RDU_DTR_ON (DTR_ON) (DTR on), 3=I_C03_LDC_ICONDISP_RQ_RDU_DTR_ON_ACTV (DTR_ON_ACTV) (DTR on, distance control active), 4=I_C03_LDC_ICONDISP_RQ_RDU_DRIVEAWAY_RDY (DRIVEAWAY_RDY) (driveaway ready), 5=I_C03_LDC_ICONDISP_RQ_RDU_DEFECT (DEFECT) (defect), 6=I_C03_LDC_ICONDISP_RQ_RDU_PRESELECT_W_SETSPEED (PRESELECT_W_SETSPEED) (preselect with setspeed), 7=I_C03_LDC_ICONDISP_RQ_RDU_SNA (SNA) (SNA value from data type)}
      lower-limit=0
      upper-limit=7
      invalid-value:
        integer literal c03_LDC_IconDisp_Rq_RDU: type=c03_LDC_IconDisp_Rq_RDU, value=7
    c03_LDC_Master: base-type=uint8, compu {0=I_C03_LDC_MASTER_ESP (ESP) (ESP is Master), 1=I_C03_LDC_MASTER_RDU (RDU) (RDU is Master), 2=I_C03_LDC_MASTER_SDTR (SDTR) (SDTR is Master), 7=I_C03_LDC_MASTER_SNA (SNA) (SNA value from data type)}, lower-limit=0, upper-limit=7  # 03_LDC_Master
      invalid-value:
        integer literal c03_LDC_Master: type=c03_LDC_Master, value=7
    c03_Mobile_Chrg_Rq: base-type=uint8, compu {0=I_C03_MOBILE_CHRG_RQ_DO_NOT_CHARGE (DO_NOT_CHARGE) (Mobile device must not charge), 1=I_C03_MOBILE_CHRG_RQ_CHARGE (CHARGE) (Mobile device may charge), 2=I_C03_MOBILE_CHRG_RQ_NDEF2 (NDEF2) (not defined), 3=I_C03_MOBILE_CHRG_RQ_SNA (SNA) (SNA value from data type)}, lower-limit=0, upper-limit=3  # 03_Mobile_Chrg_Rq
      invalid-value:
        integer literal c03_Mobile_Chrg_Rq: type=c03_Mobile_Chrg_Rq, value=3
    c03_Npsd_Plus_Minus:  # 03_Npsd_Plus_Minus
      base-type=uint8
      compu {0=I_C03_NPSD_PLUS_MINUS_NPSD (NPSD) (Nothing pressed), 1=I_C03_NPSD_PLUS_MINUS_PLUS (PLUS) ("+" pressed), 2=I_C03_NPSD_PLUS_MINUS_MINUS (MINUS) ("-" pressed), 3=I_C03_NPSD_PLUS_MINUS_PLUS_MINUS (PLUS_MINUS) ("+" and "-" pressed), 4=I_C03_NPSD_PLUS_MINUS_NDEF4 (NDEF4) (not defined), 5=I_C03_NPSD_PLUS_MINUS_NDEF5 (NDEF5) (not defined), 6=I_C03_NPSD_PLUS_MINUS_NDEF6 (NDEF6) (not defined), 7=I_C03_NPSD_PLUS_MINUS_SNA (SNA) (SNA value from data type)}
      lower-limit=0
      upper-limit=7
      invalid-value:
        integer literal c03_Npsd_Plus_Minus: type=c03_Npsd_Plus_Minus, value=7
    c03_OC: base-type=uint8, compu {0=I_C03_OC_CLASS0 (CLASS0) (Class 0 (not occupied)), 1=I_C03_OC_CLASS1 (CLASS1) (Class 1 (child seat detected)), 2=I_C03_OC_CLASS2 (CLASS2) (Class 2 (5% occupation detected)), 3=I_C03_OC_CLASS3 (CLASS3) (Class 3 (50% occupation detected)), 4=I_C03_OC_CLASS4 (CLASS4) (Class 4 (95% occupation detected)), 7=I_C03_OC_SNA (SNA) (SNA value from data type)}, lower-limit=0, upper-limit=7  # 03_OC
      invalid-value:
        integer literal c03_OC: type=c03_OC, value=7
    c03_PkBrk_Stat:  # 03_PkBrk_Stat
      base-type=uint8
      compu {0=I_C03_PKBRK_STAT_NO_END_POSN (NO_END_POSN) (No end position), 1=I_C03_PKBRK_STAT_INC (INC) (Increasing tensioning force), 2=I_C03_PKBRK_STAT_DEC (DEC) (Decreasing tensioning force), 3=I_C03_PKBRK_STAT_ENGG (ENGG) (Parking brake is engaged), 4=I_C03_PKBRK_STAT_RELS (RELS) (Parking brake is released), 5=I_C03_PKBRK_STAT_NDEF5 (NDEF5) (not defined), 6=I_C03_PKBRK_STAT_NDEF6 (NDEF6) (not defined), 7=I_C03_PKBRK_STAT_SNA (SNA) (SNA value from data type)}
      lower-limit=0
      upper-limit=7
      invalid-value:
        integer literal c03_PkBrk_Stat: type=c03_PkBrk_Stat, value=7
    c03_PN14_EHC_Prio_Rq:  # 03_PN14_EHC_Prio_Rq
      base-type=uint8
      compu {0=I_C03_PN14_EHC_PRIO_RQ_OFF (OFF) (EHC off), 1=I_C03_PN14_EHC_PRIO_RQ_EHC_PRIO1 (EHC_PRIO1) (EHC priority 1), 2=I_C03_PN14_EHC_PRIO_RQ_EHC_PRIO2 (EHC_PRIO2) (EHC priority 2), 3=I_C03_PN14_EHC_PRIO_RQ_EHC_PRIO3 (EHC_PRIO3) (EHC priority 3), 4=I_C03_PN14_EHC_PRIO_RQ_NDEF4 (NDEF4) (not defined), 5=I_C03_PN14_EHC_PRIO_RQ_NDEF5 (NDEF5) (not defined), 6=I_C03_PN14_EHC_PRIO_RQ_NDEF6 (NDEF6) (not defined), 7=I_C03_PN14_EHC_PRIO_RQ_SNA (SNA) (SNA value from data type)} "Anforderung für EHC Priorität / Priority of EHC request"
      lower-limit=0
      upper-limit=7
      invalid-value:
        integer literal c03_PN14_EHC_Prio_Rq: type=c03_PN14_EHC_Prio_Rq, value=7
    c03_PN14_TDP_Sw_Stat:  # 03_PN14_TDP_Sw_Stat
      base-type=uint8
      compu {0=I_C03_PN14_TDP_SW_STAT_CLS (CLS) (TDP switch is closed), 1=I_C03_PN14_TDP_SW_STAT_PRE_RESET (PRE_RESET) (Pre-Reset warning), 2=I_C03_PN14_TDP_SW_STAT_RESET (RESET) (Reset active), 3=I_C03_PN14_TDP_SW_STAT_PRE_OPN (PRE_OPN) (Pre-Open warning), 4=I_C03_PN14_TDP_SW_STAT_OPN (OPN) (TDP switch is open), 7=I_C03_PN14_TDP_SW_STAT_SNA (SNA) (SNA value from data type)}
      lower-limit=0
      upper-limit=7
      invalid-value:
        integer literal c03_PN14_TDP_Sw_Stat: type=c03_PN14_TDP_Sw_Stat, value=7
    c03_RaceStMd_Disp_Rq_AMG:  # 03_RaceStMd_Disp_Rq_AMG
      base-type=uint8
      compu {0=I_C03_RACESTMD_DISP_RQ_AMG_IDLE (IDLE) (Race start mode off or passive), 1=I_C03_RACESTMD_DISP_RQ_AMG_AVL (AVL) (Race start mode available), 2=I_C03_RACESTMD_DISP_RQ_AMG_ACTV (ACTV) (Race start mode active), 3=I_C03_RACESTMD_DISP_RQ_AMG_ON (ON) (Race start mode on), 4=I_C03_RACESTMD_DISP_RQ_AMG_CANCEL (CANCEL) (Race start mode cancel), 5=I_C03_RACESTMD_DISP_RQ_AMG_NPOSBL (NPOSBL) (Race start mode not possible), 6=I_C03_RACESTMD_DISP_RQ_AMG_ACK (ACK) (Race start acknowledge), 7=I_C03_RACESTMD_DISP_RQ_AMG_SNA (SNA) (SNA value from data type)}
      lower-limit=0
      upper-limit=7
      invalid-value:
        integer literal c03_RaceStMd_Disp_Rq_AMG: type=c03_RaceStMd_Disp_Rq_AMG, value=7
    c03_RBS_DTC_Stat:  # 03_RBS_DTC_Stat
      base-type=uint8
      compu {0=I_C03_RBS_DTC_STAT_NOT_SUPPORTED (NOT_SUPPORTED) (Not supported), 1=I_C03_RBS_DTC_STAT_CRIT_DISABLED (CRIT_DISABLED) (Critically disabled), 2=I_C03_RBS_DTC_STAT_NO_STAT_TO_REPORT (NO_STAT_TO_REPORT) (No status to report), 3=I_C03_RBS_DTC_STAT_DIAG_PASSED (DIAG_PASSED) (Diagnostic passed), 4=I_C03_RBS_DTC_STAT_DIAG_FAILED (DIAG_FAILED) (Diagnostic failed), 7=I_C03_RBS_DTC_STAT_SNA (SNA) (SNA value from data type)}
      lower-limit=0
      upper-limit=7
      invalid-value:
        integer literal c03_RBS_DTC_Stat: type=c03_RBS_DTC_Stat, value=7
    c03_SBW_Msg_Disp_Rq:  # 03_SBW_Msg_Disp_Rq
      base-type=uint8
      compu {0=I_C03_SBW_MSG_DISP_RQ_IDLE (IDLE) (No message), 1=I_C03_SBW_MSG_DISP_RQ_M1 (M1) (Message 1), 2=I_C03_SBW_MSG_DISP_RQ_M2 (M2) (Message 2), 3=I_C03_SBW_MSG_DISP_RQ_M3 (M3) (Message 3), 4=I_C03_SBW_MSG_DISP_RQ_M4 (M4) (Message 4), 5=I_C03_SBW_MSG_DISP_RQ_M5 (M5) (Message 5), 6=I_C03_SBW_MSG_DISP_RQ_M6 (M6) (Message 6), 7=I_C03_SBW_MSG_DISP_RQ_M7 (M7) (Message 7)}
      lower-limit=0
      upper-limit=7
    c03_StrtVarAvl_Stat_TCM:  # 03_StrtVarAvl_Stat_TCM
      base-type=uint8
      compu {0=I_C03_STRTVARAVL_STAT_TCM_NDEF1 (NDEF1) (ndef), 1=I_C03_STRTVARAVL_STAT_TCM_STRT_DEFAULT_AVL (STRT_DEFAULT_AVL) (Default High Voltage Engine Start available), 2=I_C03_STRTVARAVL_STAT_TCM_STRT_UPSHIFT_AVL (STRT_UPSHIFT_AVL) (Engine Start supported by Upshift available), 3=I_C03_STRTVARAVL_STAT_TCM_STRT_DWNSHIFT_AVL (STRT_DWNSHIFT_AVL) (Engine Start supported by Downshift or Transmission Slip available)}
      lower-limit=0
      upper-limit=3
    c03_StWhl_Sw_Stat3:  # 03_StWhl_Sw_Stat3
      base-type=uint8
      compu {0=I_C03_STWHL_SW_STAT3_NPSD (NPSD) (Nothing pressed), 1=I_C03_STWHL_SW_STAT3_PLUS (PLUS) ("+" pressed), 2=I_C03_STWHL_SW_STAT3_MINUS (MINUS) ("-" pressed), 3=I_C03_STWHL_SW_STAT3_PLUS_MINUS (PLUS_MINUS) ("+" and "-" pressed), 4=I_C03_STWHL_SW_STAT3_NDEF4 (NDEF4) (not defined), 5=I_C03_STWHL_SW_STAT3_NDEF5 (NDEF5) (not defined), 6=I_C03_STWHL_SW_STAT3_INI (INI) (Initializing), 7=I_C03_STWHL_SW_STAT3_SNA (SNA) (SNA value from data type)}
      lower-limit=0
      upper-limit=7
      invalid-value:
        integer literal c03_StWhl_Sw_Stat3: type=c03_StWhl_Sw_Stat3, value=7
    c03_Susp_Stat_AMG:  # 03_Susp_Stat_AMG
      base-type=uint8
      compu {0=I_C03_SUSP_STAT_AMG_NONE (NONE) (none), 1=I_C03_SUSP_STAT_AMG_COMFORT (COMFORT) (Comfort), 2=I_C03_SUSP_STAT_AMG_SPORT (SPORT) (Sport), 3=I_C03_SUSP_STAT_AMG_SPORTPLUS (SPORTPLUS) (Sport+), 4=I_C03_SUSP_STAT_AMG_RACE (RACE) (Race), 5=I_C03_SUSP_STAT_AMG_CARVING (CARVING) (Carving), 6=I_C03_SUSP_STAT_AMG_OFFROAD (OFFROAD) (Offroad), 7=I_C03_SUSP_STAT_AMG_SNA (SNA) (SNA value from data type)}
      lower-limit=0
      upper-limit=7
      invalid-value:
        integer literal c03_Susp_Stat_AMG: type=c03_Susp_Stat_AMG, value=7
    c03_TrafficFlow_Info_DS: base-type=uint8, compu {0=I_C03_TRAFFICFLOW_INFO_DS_NONE (NONE) (None), 1=I_C03_TRAFFICFLOW_INFO_DS_DRV_CITY (DRV_CITY) (Drive in City), 2=I_C03_TRAFFICFLOW_INFO_DS_DRV_SLOW (DRV_SLOW) (Drive Slow), 3=I_C03_TRAFFICFLOW_INFO_DS_TRAFFIC_HOLDUP (TRAFFIC_HOLDUP) (traffic holdup), 7=I_C03_TRAFFICFLOW_INFO_DS_SNA (SNA) (SNA value from data type)}, lower-limit=0, upper-limit=7  # 03_TrafficFlow_Info_DS
      invalid-value:
        integer literal c03_TrafficFlow_Info_DS: type=c03_TrafficFlow_Info_DS, value=7
    c03_TSL_Posn:  # 03_TSL_Posn
      base-type=uint8
      compu {0=I_C03_TSL_POSN_P (P) (Transmission selector lever in parking position), 1=I_C03_TSL_POSN_R (R) (Transmission selector lever in reverse position), 2=I_C03_TSL_POSN_N (N) (Transmission selector lever in neutral position), 4=I_C03_TSL_POSN_D (D) (Transmission selector lever in normal driving position), 7=I_C03_TSL_POSN_SNA (SNA) (SNA value from data type)}
      lower-limit=0
      upper-limit=7
      invalid-value:
        integer literal c03_TSL_Posn: type=c03_TSL_Posn, value=7
    c03_TSSR_Stat:  # 03_TSSR_Stat
      base-type=uint8
      compu {0=I_C03_TSSR_STAT_TSSR_CLS (TSSR_CLS) (Tilt/slide sunroof is closed), 1=I_C03_TSSR_STAT_TSSR_OPN (TSSR_OPN) (Tilt/slide sunroof is complete open), 2=I_C03_TSSR_STAT_LR_OPN (LR_OPN) (Lifting roof is open), 3=I_C03_TSSR_STAT_TSSR_RUN (TSSR_RUN) (Tilt/slide sunroof is running), 4=I_C03_TSSR_STAT_TSSR_AB (TSSR_AB) (Tilt/slide sunroof in anti-booming position), 5=I_C03_TSSR_STAT_TSSR_IP (TSSR_IP) (Sliding roof in intermediate position), 6=I_C03_TSSR_STAT_LR_IP (LR_IP) (Lifting roof in intermediate position), 7=I_C03_TSSR_STAT_SNA (SNA) (SNA value from data type)}
      lower-limit=0
      upper-limit=7
      invalid-value:
        integer literal c03_TSSR_Stat: type=c03_TSSR_Stat, value=7
    c03_TxLHOM_Stat_Rq_CPC: base-type=uint8, compu {0=I_C03_TXLHOM_STAT_RQ_CPC_NO_REQ (NO_REQ) (No request), 1=I_C03_TXLHOM_STAT_RQ_CPC_HOLD_GR (HOLD_GR) (Hold gear), 2=I_C03_TXLHOM_STAT_RQ_CPC_SHFT_NTRL (SHFT_NTRL) (Shift to neutral), 3=I_C03_TXLHOM_STAT_RQ_CPC_FREE (FREE) (Free)}, lower-limit=0, upper-limit=3  # 03_TxLHOM_Stat_Rq_CPC
    c03_TxMechStyle: base-type=uint8, compu {0=I_C03_TXMECHSTYLE_SMALL (SMALL) (Automatic Transmission small), 1=I_C03_TXMECHSTYLE_MIDDLE (MIDDLE) (Automatic Transmission middle), 2=I_C03_TXMECHSTYLE_LARGE (LARGE) (Automatic Transmission large), 7=I_C03_TXMECHSTYLE_SNA (SNA) (SNA value from data type)}, lower-limit=0, upper-limit=7  # 03_TxMechStyle
      invalid-value:
        integer literal c03_TxMechStyle: type=c03_TxMechStyle, value=7
    c04_perc_0_100_10_SNA: base-type=uint8, compu {phys=raw*10 for raw 0..10, 15=I_C04_PERC_0_100_10_SNA_SNA (SNA) (SNA value from data type); unit %}, lower-limit=0, upper-limit=15  # 04_%_0-100_10_SNA
      invalid-value:
        integer literal c04_perc_0_100_10_SNA: type=c04_perc_0_100_10_SNA, value=15
    c04_0_0k42_0k03: base-type=uint8, compu {phys=raw*0.03 for raw 0..14, 15=I_C04_0_0K42_0K03_SNA (SNA) (SNA value from data type)}, lower-limit=0, upper-limit=15  # 04_0-0,42_0,03
      invalid-value:
        integer literal c04_0_0k42_0k03: type=c04_0_0k42_0k03, value=15
    c04_0_15_1_SNA_na: base-type=uint8, compu {phys=raw for raw 0..15}, lower-limit=0, upper-limit=15  # 04_0-15_1_SNA=-
    c04_AWD_Err_Stat_V2:  # 04_AWD_Err_Stat_V2 | 04 AWD Err Stat V2
      base-type=uint8
      compu {0=I_C04_AWD_ERR_STAT_V2_DEACT (DEACT) (Deactivated), 1=I_C04_AWD_ERR_STAT_V2_INIT (INIT) (Initialization), 2=I_C04_AWD_ERR_STAT_V2_CALIB (CALIB) (Calilbration), 3=I_C04_AWD_ERR_STAT_V2_NORMAL (NORMAL) (Normal operation), 4=I_C04_AWD_ERR_STAT_V2_TMP_FAIL (TMP_FAIL) (Temporary failed), 5=I_C04_AWD_ERR_STAT_V2_FAIL (FAIL) (Failed), 6=I_C04_AWD_ERR_STAT_V2_FAIL_CLUTCH_OPN (FAIL_CLUTCH_OPN) (Failed - clutch open), 7=I_C04_AWD_ERR_STAT_V2_FAIL_POS_UNKWN (FAIL_POS_UNKWN) (Failed - position unknown), 15=I_C04_AWD_ERR_STAT_V2_SNA (SNA) (SNA value from data type)}
      lower-limit=0
      upper-limit=15
      invalid-value:
        integer literal c04_AWD_Err_Stat_V2: type=c04_AWD_Err_Stat_V2, value=15
    c04_Axl_DrvPosn: base-type=uint8, compu {0=I_C04_AXL_DRVPOSN_IDLE (IDLE) (Idle), 1=I_C04_AXL_DRVPOSN_D (D), 2=I_C04_AXL_DRVPOSN_N (N), 3=I_C04_AXL_DRVPOSN_R (R), 4=I_C04_AXL_DRVPOSN_P (P), 15=I_C04_AXL_DRVPOSN_SNA (SNA) (SNA value from data type)} "Achsfahrstufe", lower-limit=0, upper-limit=15  # 04_Axl_DrvPosn | 04 Axl Drv Posn Target Rq
      invalid-value:
        integer literal c04_Axl_DrvPosn: type=c04_Axl_DrvPosn, value=15
    c04_Axl_DrvPosn_TCM: base-type=uint8, compu {0=I_C04_AXL_DRVPOSN_TCM_IDLE (IDLE) (Idle), 1=I_C04_AXL_DRVPOSN_TCM_D (D), 2=I_C04_AXL_DRVPOSN_TCM_N (N), 3=I_C04_AXL_DRVPOSN_TCM_R (R), 4=I_C04_AXL_DRVPOSN_TCM_P (P), 5=I_C04_AXL_DRVPOSN_TCM_TEMP_N (TEMP_N) (Temporary N), 15=I_C04_AXL_DRVPOSN_TCM_SNA (SNA) (SNA value from data type)} "Achsfahrstufe", lower-limit=0, upper-limit=15  # 04_Axl_DrvPosn_TCM | 04 Axl Drv Posn Target Rq
      invalid-value:
        integer literal c04_Axl_DrvPosn_TCM: type=c04_Axl_DrvPosn_TCM, value=15
    c04_DPC_GlobalMd_Rq:  # 04_DPC_GlobalMd_Rq
      base-type=uint8
      compu {0=I_C04_DPC_GLOBALMD_RQ_COMFORT (COMFORT) (Comfort mode), 1=I_C04_DPC_GLOBALMD_RQ_SPORT (SPORT) (Sport mode), 2=I_C04_DPC_GLOBALMD_RQ_SPORT_PLUS (SPORT_PLUS) (Sport+ mode), 3=I_C04_DPC_GLOBALMD_RQ_ALLROAD (ALLROAD) (Allroad mode), 4=I_C04_DPC_GLOBALMD_RQ_ECO (ECO) (ECO mode), 5=I_C04_DPC_GLOBALMD_RQ_INDIVIDUAL (INDIVIDUAL) (Individual mode), 6=I_C04_DPC_GLOBALMD_RQ_MANUAL (MANUAL) (Manual mode), 7=I_C04_DPC_GLOBALMD_RQ_CURVEURBANCRUISEAMG (CURVEURBANCRUISEAMG) (Curve mode (not AMG) or Urban Cruise (only AMG)), 8=I_C04_DPC_GLOBALMD_RQ_SLIPPERY_WET (SLIPPERY_WET) (Slippery/wet mode), 9=I_C04_DPC_GLOBALMD_RQ_TERRAIN (TERRAIN) (Terrain mode), 10=I_C04_DPC_GLOBALMD_RQ_UPHILL (UPHILL) (Uphill mode), 11=I_C04_DPC_GLOBALMD_RQ_TRAILER (TRAILER) (Trailer mode), 12=I_C04_DPC_GLOBALMD_RQ_ROCKING_FREE (ROCKING_FREE) (Rocking free mode), 13=I_C04_DPC_GLOBALMD_RQ_TERRAIN_PLUS (TERRAIN_PLUS) (Terrain+ mode), 14=I_C04_DPC_GLOBALMD_RQ_NO_DPC (NO_DPC) (No driving program control), 15=I_C04_DPC_GLOBALMD_RQ_SNA (SNA) (SNA value from data type)}
      lower-limit=0
      upper-limit=15
      invalid-value:
        integer literal c04_DPC_GlobalMd_Rq: type=c04_DPC_GlobalMd_Rq, value=15
    c04_DPC_Md_ASX:  # 04_DPC_Md_ASX | DPC Md ASX
      base-type=uint8
      compu {0=I_C04_DPC_MD_ASX_INIT (INIT) (Initialization), 1=I_C04_DPC_MD_ASX_COMFORT (COMFORT) (Comfort), 2=I_C04_DPC_MD_ASX_SPORT (SPORT) (Sport), 3=I_C04_DPC_MD_ASX_SPORT_PLUS (SPORT_PLUS) (Sport+), 4=I_C04_DPC_MD_ASX_ECO (ECO), 5=I_C04_DPC_MD_ASX_OFF (OFF) (Off), 6=I_C04_DPC_MD_ASX_RACE (RACE) (Race), 15=I_C04_DPC_MD_ASX_SNA (SNA) (SNA value from data type)}
      lower-limit=0
      upper-limit=15
      invalid-value:
        integer literal c04_DPC_Md_ASX: type=c04_DPC_Md_ASX, value=15
    c04_DPC_Md_PT:  # 04_DPC_Md_PT
      base-type=uint8
      compu {1=I_C04_DPC_MD_PT_COMFORT (COMFORT) (Comfort mode), 2=I_C04_DPC_MD_PT_ECO (ECO) (ECO mode), 3=I_C04_DPC_MD_PT_SPORT (SPORT) (Sport mode), 4=I_C04_DPC_MD_PT_SPORT_PLUS (SPORT_PLUS) (Sport+ mode), 5=I_C04_DPC_MD_PT_MANUAL (MANUAL) (Manual mode), 6=I_C04_DPC_MD_PT_OFFROAD1 (OFFROAD1) (Offroad mode #1), 7=I_C04_DPC_MD_PT_OFFROAD2 (OFFROAD2) (Offroad mode #2), 8=I_C04_DPC_MD_PT_EDRIVE (EDRIVE) (Electric drive mode), 9=I_C04_DPC_MD_PT_RACE (RACE) (Race mode), 10=I_C04_DPC_MD_PT_BAT_LVL (BAT_LVL) (Battery level mode), 11=I_C04_DPC_MD_PT_URBANCRUISEAMG (URBANCRUISEAMG) (UrbanCruiseAMG mode), 12=I_C04_DPC_MD_PT_ALLROAD (ALLROAD) (Allroad mode), 15=I_C04_DPC_MD_PT_SNA (SNA) (SNA value from data type)}
      lower-limit=1
      upper-limit=15
      invalid-value:
        integer literal c04_DPC_Md_PT: type=c04_DPC_Md_PT, value=15
    c04_DPC_Md_PT_Rx_HU:  # 04_DPC_Md_PT_Rx_HU
      base-type=uint8
      compu {0=I_C04_DPC_MD_PT_RX_HU_INIT (INIT) (Initialization), 1=I_C04_DPC_MD_PT_RX_HU_COMFORT (COMFORT) (Comfort mode), 2=I_C04_DPC_MD_PT_RX_HU_ECO (ECO) (ECO mode), 3=I_C04_DPC_MD_PT_RX_HU_SPORT (SPORT) (Sport mode), 4=I_C04_DPC_MD_PT_RX_HU_SPORT_PLUS (SPORT_PLUS) (Sport+ mode), 5=I_C04_DPC_MD_PT_RX_HU_MANUAL (MANUAL) (Manual mode), 6=I_C04_DPC_MD_PT_RX_HU_OFFROAD1 (OFFROAD1) (Offroad mode #1), 7=I_C04_DPC_MD_PT_RX_HU_OFFROAD2 (OFFROAD2) (Offroad mode #2), 8=I_C04_DPC_MD_PT_RX_HU_EDRIVE (EDRIVE) (Electric drive mode), 9=I_C04_DPC_MD_PT_RX_HU_RACE (RACE) (Race mode), 10=I_C04_DPC_MD_PT_RX_HU_BAT_LVL (BAT_LVL) (Battery level mode), 11=I_C04_DPC_MD_PT_RX_HU_URBANCRUISEAMG (URBANCRUISEAMG) (UrbanCruiseAMG mode), 12=I_C04_DPC_MD_PT_RX_HU_ALLROAD (ALLROAD) (Allroad (AMG)), 15=I_C04_DPC_MD_PT_RX_HU_SNA (SNA) (SNA value from data type)}
      lower-limit=0
      upper-limit=15
      invalid-value:
        integer literal c04_DPC_Md_PT_Rx_HU: type=c04_DPC_Md_PT_Rx_HU, value=15
    c04_ElectricFuelPmp_Stat:  # 04_ElectricFuelPmp_Stat
      base-type=uint8
      compu {0=I_C04_ELECTRICFUELPMP_STAT_OFF (OFF) (El. Fuel pump is off), 1=I_C04_ELECTRICFUELPMP_STAT_START (START) (El. Fuel pump is starting), 2=I_C04_ELECTRICFUELPMP_STAT_DYNAMIC (DYNAMIC) (El. Fuel pump in dynamic control), 3=I_C04_ELECTRICFUELPMP_STAT_SETPOINT (SETPOINT) (El. Fuel pump at set point), 4=I_C04_ELECTRICFUELPMP_STAT_PRESSURE_HOLD (PRESSURE_HOLD) (El. Fuel pump in pressure hold function profil), 5=I_C04_ELECTRICFUELPMP_STAT_RES_5 (RES_5) (Reserved), 6=I_C04_ELECTRICFUELPMP_STAT_RES_6 (RES_6) (Reserved), 7=I_C04_ELECTRICFUELPMP_STAT_LIMP_HOME (LIMP_HOME) (El. Fuel pump in limp home mode), 8=I_C04_ELECTRICFUELPMP_STAT_LTD_SPEED (LTD_SPEED) (El. fuel pump is limited by speed), 9=I_C04_ELECTRICFUELPMP_STAT_LDT_CURR (LDT_CURR) (El. fuel pump is limited by current), 10=I_C04_ELECTRICFUELPMP_STAT_LDT_VOLT (LDT_VOLT) (El. fuel pump is limited by voltage), 11=I_C04_ELECTRICFUELPMP_STAT_LTD_FLOW (LTD_FLOW) (El. fuel pump is limited by flow), 12=I_C04_ELECTRICFUELPMP_STAT_LTD_PRESS (LTD_PRESS) (El. fuel pump is limited by pressure), 13=I_C04_ELECTRICFUELPMP_STAT_RES_13 (RES_13) (Reserved), 14=I_C04_ELECTRICFUELPMP_STAT_DIAG (DIAG) (El. fuel pump at set point by diagnostic), 15=I_C04_ELECTRICFUELPMP_STAT_SNA (SNA) (SNA value from data type)}
      lower-limit=0
      upper-limit=15
      invalid-value:
        integer literal c04_ElectricFuelPmp_Stat: type=c04_ElectricFuelPmp_Stat, value=15
    c04_EM_Trq_RecupGrdnt_Max: base-type=uint8, compu {phys=raw*100-100 for raw 1..14, 0=I_C04_EM_TRQ_RECUPGRDNT_MAX_IDLE (IDLE) (No limit), 15=I_C04_EM_TRQ_RECUPGRDNT_MAX_SNA (SNA) (SNA value from data type); unit Nm/s}, lower-limit=0, upper-limit=15  # 04_EM_Trq_RecupGrdnt_Max
      invalid-value:
        integer literal c04_EM_Trq_RecupGrdnt_Max: type=c04_EM_Trq_RecupGrdnt_Max, value=15
    c04_ESP_Oprtn_Stat_AS_V2:  # 04_ESP_Oprtn_Stat_AS_V2
      base-type=uint8
      compu {0=I_C04_ESP_OPRTN_STAT_AS_V2_NORM (NORM) (Normal operation), 1=I_C04_ESP_OPRTN_STAT_AS_V2_INIT (INIT) (Initialization), 2=I_C04_ESP_OPRTN_STAT_AS_V2_DIAG (DIAG) (Diagnostics), 3=I_C04_ESP_OPRTN_STAT_AS_V2_EMT (EMT) (Exhaust emission test), 4=I_C04_ESP_OPRTN_STAT_AS_V2_TBCC (TBCC) (Test bench cruise control mode), 5=I_C04_ESP_OPRTN_STAT_AS_V2_FLT (FLT) (Temporary or continously system error), 6=I_C04_ESP_OPRTN_STAT_AS_V2_ESP_ASR_CTRL_ACTV (ESP_ASR_CTRL_ACTV) (ESP or ASR control active), 7=I_C04_ESP_OPRTN_STAT_AS_V2_AMG_OFF (AMG_OFF) (AMG-Off mode (only AMG)), 8=I_C04_ESP_OPRTN_STAT_AS_V2_OFF_AMG_SPORT (OFF_AMG_SPORT) (ESP off mode (not AMG) or AMG-Sport mode (only AMG)), 9=I_C04_ESP_OPRTN_STAT_AS_V2_ABS_CTRL_ACTV (ABS_CTRL_ACTV) (ABS control active), 15=I_C04_ESP_OPRTN_STAT_AS_V2_SNA (SNA) (SNA value from data type)}
      lower-limit=0
      upper-limit=15
      invalid-value:
        integer literal c04_ESP_Oprtn_Stat_AS_V2: type=c04_ESP_Oprtn_Stat_AS_V2, value=15
    c04_EVC_HL_Style:  # 04_EVC_HL_Style
      base-type=uint8
      compu {0=I_C04_EVC_HL_STYLE_BI_XEN_RHT (BI_XEN_RHT) (614 BI-XENON LIGHT UNIT - HEADLAMP), 1=I_C04_EVC_HL_STYLE_BI_XEN_LHT (BI_XEN_LHT) (618 HEADLAMP UNIT: BI-XENON ASYM. LEFT-SIDE TRAFFIC), 2=I_C04_EVC_HL_STYLE_BI_XEN_ACURV_RHT (BI_XEN_ACURV_RHT) (615 BI-XENON HEADLICHT W.ACTIVE CURVELIGHT RIGHT-DRIVE), 3=I_C04_EVC_HL_STYLE_BI_XEN_ACURV_LHT (BI_XEN_ACURV_LHT) (616 BI-XENON HEADLICHT W.ACTIVE CURVELIGHT LEFT-DRIVE), 4=I_C04_EVC_HL_STYLE_BI_XEN_INTLGT_RHT (BI_XEN_INTLGT_RHT) (622 HEADLIGHT UNIT W.INTELLIGENT LIGHT SYSTEM RHT), 5=I_C04_EVC_HL_STYLE_BI_XEN_INTLGT_LHT (BI_XEN_INTLGT_LHT) (621 HEADLIGHT UNIT W.INTELLIGENT LIGHT SYSTEM LHT), 6=I_C04_EVC_HL_STYLE_LED_STAT_LHT (LED_STAT_LHT) (631 HEADLIGHT UNIT LED W. STATIC LIGHT SYSTEM LHT), 7=I_C04_EVC_HL_STYLE_LED_STAT_RHT (LED_STAT_RHT) (632 HEADLIGHT UNIT LED W. STATIC LIGHT SYSTEM RHT), 8=I_C04_EVC_HL_STYLE_LED_DYN_SAE_RHT (LED_DYN_SAE_RHT) (640 HEADLIGHT UNIT LED W DYNAMIC LIGHT SYSTEM SAE RHT), 9=I_C04_EVC_HL_STYLE_LED_DYN_LHT (LED_DYN_LHT) (641 HEADLIGHT UNIT LED W. DYNAMIC LIGHT SYSTEM LHT), 10=I_C04_EVC_HL_STYLE_LED_DYN_RHT (LED_DYN_RHT) (642 HEADLIGHT UNIT LED W. DYNAMIC LIGHT SYSTEM RHT), 11=I_C04_EVC_HL_STYLE_HEADLIGHT_LHT (HEADLIGHT_LHT) (613 HEADLIGHT UNIT - ASSYMETRICAL, LH TRAFFIC), 12=I_C04_EVC_HL_STYLE_HEADLIGHT_RHT (HEADLIGHT_RHT) (620 HEADLIGHT UNIT RHT), 15=I_C04_EVC_HL_STYLE_OTHER (OTHER) (none of listed variants)}
      lower-limit=0
      upper-limit=15
    c04_EVC_TxStyle:  # 04_EVC_TxStyle
      base-type=uint8
      compu {0=I_C04_EVC_TXSTYLE_MANUAL_6 (MANUAL_6) (411 MANUAL TRANSMISSION, 6-SPEED), 1=I_C04_EVC_TXSTYLE_AUTOM_5 (AUTOM_5) (423 AUTOMATIC TRANSMISSION 5-SPEED), 2=I_C04_EVC_TXSTYLE_AUTOM_7 (AUTOM_7) (427 AUTOMATIC TRANSMISSION 7-SPEED), 3=I_C04_EVC_TXSTYLE_AUTOM_9 (AUTOM_9) (421 AUTOMATIC TRANSMISSION 9-SPEED), 4=I_C04_EVC_TXSTYLE_MANUAL_6_NSG2 (MANUAL_6_NSG2) (425 MANUAL TRANSMISSION 6-SPEED (NSG2)), 5=I_C04_EVC_TXSTYLE_AUTOM_7_DCT (AUTOM_7_DCT) (429 AUTOMATIC DCT TRANSMISSION 7-SPEED), 6=I_C04_EVC_TXSTYLE_AUTOM_9_DCT (AUTOM_9_DCT) (426 AUTOMATIC DCT TRANSMISSION 9-SPEED), 15=I_C04_EVC_TXSTYLE_OTHER (OTHER) (none of listed variants)}
      lower-limit=0
      upper-limit=15
    c04_Gr:  # 04_Gr
      base-type=uint8
      compu {0=I_C04_GR_N (N) (Actual gear "N"), 1=I_C04_GR_D1 (D1) (Actual gear "1"), 2=I_C04_GR_D2 (D2) (Actual gear "2"), 3=I_C04_GR_D3 (D3) (Actual gear "3"), 4=I_C04_GR_D4 (D4) (Actual gear "4"), 5=I_C04_GR_D5 (D5) (Actual gear "5"), 6=I_C04_GR_D6 (D6) (Actual gear "6"), 7=I_C04_GR_D7 (D7) (Actual gear "7"), 8=I_C04_GR_D8 (D8) (Actual gear "8"), 9=I_C04_GR_D9 (D9) (Actual gear "9"), 11=I_C04_GR_R (R) (Actual gear "R"), 12=I_C04_GR_R2 (R2) (Actual gear "R2"), 13=I_C04_GR_P (P) (Actual gear "P"), 14=I_C04_GR_PWRFREE (PWRFREE) (Power free), 15=I_C04_GR_SNA (SNA) (SNA value from data type)}
      lower-limit=0
      upper-limit=15
      invalid-value:
        integer literal c04_Gr: type=c04_Gr, value=15
    c04_Gr_Target:  # 04_Gr_Target
      base-type=uint8
      compu {0=I_C04_GR_TARGET_N (N) (Target gear "N"), 1=I_C04_GR_TARGET_D1 (D1) (Target gear "1"), 2=I_C04_GR_TARGET_D2 (D2) (Target gear "2"), 3=I_C04_GR_TARGET_D3 (D3) (Target gear "3"), 4=I_C04_GR_TARGET_D4 (D4) (Target gear "4"), 5=I_C04_GR_TARGET_D5 (D5) (Target gear "5"), 6=I_C04_GR_TARGET_D6 (D6) (Target gear "6"), 7=I_C04_GR_TARGET_D7 (D7) (Target gear "7"), 8=I_C04_GR_TARGET_D8 (D8) (Target gear "8"), 9=I_C04_GR_TARGET_D9 (D9) (Target gear "9"), 11=I_C04_GR_TARGET_R (R) (Target gear "R"), 12=I_C04_GR_TARGET_R2 (R2) (Target gear "R2"), 13=I_C04_GR_TARGET_P (P) (Target gear "P"), 14=I_C04_GR_TARGET_ABORT (ABORT) (Gear shift abortion), 15=I_C04_GR_TARGET_SNA (SNA) (SNA value from data type)}
      lower-limit=0
      upper-limit=15
      invalid-value:
        integer literal c04_Gr_Target: type=c04_Gr_Target, value=15
    c04_Gr_Target_Disp_Rq_V2:  # 04_Gr_Target_Disp_Rq_V2
      base-type=uint8
      compu {0=I_C04_GR_TARGET_DISP_RQ_V2_BLANK (BLANK) (Blank (" ")), 1=I_C04_GR_TARGET_DISP_RQ_V2_G1 (G1) (Gear "1"), 2=I_C04_GR_TARGET_DISP_RQ_V2_G2 (G2) (Gear "2"), 3=I_C04_GR_TARGET_DISP_RQ_V2_G3 (G3) (Gear "3"), 4=I_C04_GR_TARGET_DISP_RQ_V2_G4 (G4) (Gear "4"), 5=I_C04_GR_TARGET_DISP_RQ_V2_G5 (G5) (Gear "5"), 6=I_C04_GR_TARGET_DISP_RQ_V2_G6 (G6) (Gear "6"), 7=I_C04_GR_TARGET_DISP_RQ_V2_G7 (G7) (Gear "7"), 8=I_C04_GR_TARGET_DISP_RQ_V2_G8 (G8) (Gear "8"), 9=I_C04_GR_TARGET_DISP_RQ_V2_G9 (G9) (Gear "9"), 10=I_C04_GR_TARGET_DISP_RQ_V2_F (F) (Fault label "F"), 15=I_C04_GR_TARGET_DISP_RQ_V2_SNA (SNA) (SNA value from data type)}
      lower-limit=0
      upper-limit=15
      invalid-value:
        integer literal c04_Gr_Target_Disp_Rq_V2: type=c04_Gr_Target_Disp_Rq_V2, value=15
    c04_Gr_Target_Disp_Rq:  # 04_Gr_Target_Rq
      base-type=uint8
      compu {0=I_C04_GR_TARGET_DISP_RQ_BLANK (BLANK) (Blank (" ")), 1=I_C04_GR_TARGET_DISP_RQ_G1 (G1) (Gear "1"), 2=I_C04_GR_TARGET_DISP_RQ_G2 (G2) (Gear "2"), 3=I_C04_GR_TARGET_DISP_RQ_G3 (G3) (Gear "3"), 4=I_C04_GR_TARGET_DISP_RQ_G4 (G4) (Gear "4"), 5=I_C04_GR_TARGET_DISP_RQ_G5 (G5) (Gear "5"), 6=I_C04_GR_TARGET_DISP_RQ_G6 (G6) (Gear "6"), 7=I_C04_GR_TARGET_DISP_RQ_G7 (G7) (Gear "7"), 8=I_C04_GR_TARGET_DISP_RQ_GN (GN) (Gear "N"), 9=I_C04_GR_TARGET_DISP_RQ_G8 (G8) (Gear "8"), 10=I_C04_GR_TARGET_DISP_RQ_G9 (G9) (Gear "9"), 15=I_C04_GR_TARGET_DISP_RQ_SNA (SNA) (SNA value from data type)}
      lower-limit=0
      upper-limit=15
      invalid-value:
        integer literal c04_Gr_Target_Disp_Rq: type=c04_Gr_Target_Disp_Rq, value=15
    c04_GrMax_Rq_v2:  # 04_GrMax_Rq_V2
      base-type=uint8
      compu {0=I_C04_GRMAX_RQ_V2_PASSIVE (PASSIVE) (Passive value), 1=I_C04_GRMAX_RQ_V2_G1 (G1) (Requested gear, upper limit = 1), 2=I_C04_GRMAX_RQ_V2_G2 (G2) (Requested gear, upper limit = 2), 3=I_C04_GRMAX_RQ_V2_G3 (G3) (Requested gear, upper limit = 3), 4=I_C04_GRMAX_RQ_V2_G4 (G4) (Requested gear, upper limit = 4), 5=I_C04_GRMAX_RQ_V2_G5 (G5) (Requested gear, upper limit = 5), 6=I_C04_GRMAX_RQ_V2_G6 (G6) (Requested gear, upper limit = 6), 7=I_C04_GRMAX_RQ_V2_G7 (G7) (Requested gear, upper limit = 7), 8=I_C04_GRMAX_RQ_V2_G8 (G8) (Requested gear, upper limit = 8), 9=I_C04_GRMAX_RQ_V2_G9 (G9) (Requested gear, upper limit = 9)}
      lower-limit=0
      upper-limit=9
    c04_GrMin_Rq_v2:  # 04_GrMin_Rq_V2
      base-type=uint8
      compu {0=I_C04_GRMIN_RQ_V2_PASSIVE (PASSIVE) (Passive value), 1=I_C04_GRMIN_RQ_V2_G1 (G1) (Requested gear, lower limit = 1), 2=I_C04_GRMIN_RQ_V2_G2 (G2) (Requested gear, lower limit = 2), 3=I_C04_GRMIN_RQ_V2_G3 (G3) (Requested gear, lower limit = 3), 4=I_C04_GRMIN_RQ_V2_G4 (G4) (Requested gear, lower limit = 4), 5=I_C04_GRMIN_RQ_V2_G5 (G5) (Requested gear, lower limit = 5), 6=I_C04_GRMIN_RQ_V2_G6 (G6) (Requested gear, lower limit = 6), 7=I_C04_GRMIN_RQ_V2_G7 (G7) (Requested gear, lower limit = 7), 8=I_C04_GRMIN_RQ_V2_G8 (G8) (Requested gear, lower limit = 8), 9=I_C04_GRMIN_RQ_V2_G9 (G9) (Requested gear, lower limit = 9)}
      lower-limit=0
      upper-limit=9
    c04_HDC_Md_Rq_EM:  # 04_HDC_Md_Rq_EM
      base-type=uint8
      compu {0=I_C04_HDC_MD_RQ_EM_IDLE (IDLE) (Idle), 1=I_C04_HDC_MD_RQ_EM_TORQUE (TORQUE) (Torque mode), 2=I_C04_HDC_MD_RQ_EM_TORQUE_SYNC (TORQUE_SYNC) (Synchronized torque), 3=I_C04_HDC_MD_RQ_EM_VOLT_EXCT (VOLT_EXCT) (Voltage exact mode), 4=I_C04_HDC_MD_RQ_EM_VOLT_COMF (VOLT_COMF) (Voltage comfort mode), 5=I_C04_HDC_MD_RQ_EM_SPEED_EXCT (SPEED_EXCT) (Speed exact mode), 6=I_C04_HDC_MD_RQ_EM_SPEED_COMF (SPEED_COMF) (Speed comfort mode), 7=I_C04_HDC_MD_RQ_EM_SPEED_TCM_ADAPT (SPEED_TCM_ADAPT) (Speed TCM adaptation), 14=I_C04_HDC_MD_RQ_EM_TPS (TPS) (Three phase short), 15=I_C04_HDC_MD_RQ_EM_SNA (SNA) (SNA value from data type)}
      lower-limit=0
      upper-limit=15
      invalid-value:
        integer literal c04_HDC_Md_Rq_EM: type=c04_HDC_Md_Rq_EM, value=15
    c04_HybDrv_Md:  # 04_HybDrv_Md
      base-type=uint8
      compu {0=I_C04_HYBDRV_MD_NDEF0 (NDEF0) (not defined (don't complain if this makes problems!)), 1=I_C04_HYBDRV_MD_LOAD_VOLT_REG (LOAD_VOLT_REG) (Loading by voltage regulation), 2=I_C04_HYBDRV_MD_LOAD_TRQ_REG (LOAD_TRQ_REG) (Loading by torque regulation), 3=I_C04_HYBDRV_MD_EXT_SYS (EXT_SYS) (External system), 4=I_C04_HYBDRV_MD_BOOST (BOOST) (Boost), 5=I_C04_HYBDRV_MD_RECUP (RECUP) (Recuperation), 6=I_C04_HYBDRV_MD_ELS (ELS), 7=I_C04_HYBDRV_MD_NO_IGN (NO_IGN) (No Ignition), 8=I_C04_HYBDRV_MD_IDC_STALL (IDC_STALL) (IDC stall prevention), 10=I_C04_HYBDRV_MD_ENG_START (ENG_START) (Engine start request), 11=I_C04_HYBDRV_MD_DOA_DIS (DOA_DIS) (DOA disable), 12=I_C04_HYBDRV_MD_SHIFT_DWN_RQ_DOA_DIS (SHIFT_DWN_RQ_DOA_DIS) (Shift down request + DOA disable), 13=I_C04_HYBDRV_MD_SHIFT_DWN_RQ (SHIFT_DWN_RQ) (Shift down request), 14=I_C04_HYBDRV_MD_NO_SHIFT (NO_SHIFT) (Shift denied), 15=I_C04_HYBDRV_MD_SNA (SNA) (SNA value from data type)}
      lower-limit=0
      upper-limit=15
      invalid-value:
        integer literal c04_HybDrv_Md: type=c04_HybDrv_Md, value=15
    c04_l_per_min_0_14_1: base-type=uint8, compu {phys=raw for raw 0..14, 15=I_C04_L_PER_MIN_0_14_1_SNA (SNA) (SNA value from data type); unit l/min}, lower-limit=0, upper-limit=15  # 04_l/min-0-14_1
      invalid-value:
        integer literal c04_l_per_min_0_14_1: type=c04_l_per_min_0_14_1, value=15
    c04_LDC_DTR_Stat:  # 04_LDC_DTR_Stat
      base-type=uint8
      compu {0=I_C04_LDC_DTR_STAT_DTR_CC_OFF (DTR_CC_OFF) (Distronic and cruise control off), 1=I_C04_LDC_DTR_STAT_DTR_ON (DTR_ON) (Distronic on (working)), 2=I_C04_LDC_DTR_STAT_DTR_DEF (DTR_DEF) (Distronic defective), 3=I_C04_LDC_DTR_STAT_DTR_OFF_GPS (DTR_OFF_GPS) (Distronic off due to blocked GPS position), 4=I_C04_LDC_DTR_STAT_DTR_OFF_RADAR (DTR_OFF_RADAR) (Distronic off due to disabled radar sensor), 5=I_C04_LDC_DTR_STAT_DTR_PSV (DTR_PSV) (Distronic passive), 6=I_C04_LDC_DTR_STAT_CC_ON (CC_ON) (Cruise control on (working)), 7=I_C04_LDC_DTR_STAT_CC_DEF (CC_DEF) (Cruise control defective), 8=I_C04_LDC_DTR_STAT_CC_OVRRUN (CC_OVRRUN) (Cruise control deceleration insufficient), 15=I_C04_LDC_DTR_STAT_SNA (SNA) (SNA value from data type)}
      lower-limit=0
      upper-limit=15
      invalid-value:
        integer literal c04_LDC_DTR_Stat: type=c04_LDC_DTR_Stat, value=15
    c04_PARK_DrvDir_Rq_EBS:  # 04_PARK_DrvDir_Rq_ESP
      base-type=uint8
      compu {0=I_C04_PARK_DRVDIR_RQ_EBS_IDLE (IDLE) (No direction request active), 5=I_C04_PARK_DRVDIR_RQ_EBS_D (D) (Forward driving), 6=I_C04_PARK_DRVDIR_RQ_EBS_N (N) (Neutral requested), 7=I_C04_PARK_DRVDIR_RQ_EBS_R (R) (Reverse driving), 8=I_C04_PARK_DRVDIR_RQ_EBS_P (P) (Park position requested), 15=I_C04_PARK_DRVDIR_RQ_EBS_SNA (SNA) (SNA value from data type)}
      lower-limit=0
      upper-limit=15
      invalid-value:
        integer literal c04_PARK_DrvDir_Rq_EBS: type=c04_PARK_DrvDir_Rq_EBS, value=15
    c04_PARK_DrvDir_Stat_EBS:  # 04_PARK_DrvDir_Stat
      base-type=uint8
      compu {0=I_C04_PARK_DRVDIR_STAT_EBS_IDLE (IDLE) (No direction request active), 4=I_C04_PARK_DRVDIR_STAT_EBS_ENABLE (ENABLE) (Request driving direction enable), 7=I_C04_PARK_DRVDIR_STAT_EBS_DEACT (DEACT) (Driving direction control returned to transmission), 8=I_C04_PARK_DRVDIR_STAT_EBS_COM_FLT (COM_FLT) (Communication fault detected), 9=I_C04_PARK_DRVDIR_STAT_EBS_LOG_FLT (LOG_FLT) (Logic fault (e. g. plausibility checks failed)), 10=I_C04_PARK_DRVDIR_STAT_EBS_INT_FLT (INT_FLT) (Internal fault), 12=I_C04_PARK_DRVDIR_STAT_EBS_CONTROL (CONTROL) (Driving direction control activ), 15=I_C04_PARK_DRVDIR_STAT_EBS_SNA (SNA) (SNA value from data type)}
      lower-limit=0
      upper-limit=15
      invalid-value:
        integer literal c04_PARK_DrvDir_Stat_EBS: type=c04_PARK_DrvDir_Stat_EBS, value=15
    c04_PN14_GenStyle: base-type=uint8, compu {0=I_C04_PN14_GENSTYLE_XS (XS), 1=I_C04_PN14_GENSTYLE_S (S), 2=I_C04_PN14_GENSTYLE_M (M), 3=I_C04_PN14_GENSTYLE_L (L), 4=I_C04_PN14_GENSTYLE_XL1 (XL1), 5=I_C04_PN14_GENSTYLE_XL2 (XL2), 6=I_C04_PN14_GENSTYLE_XXL (XXL), 7=I_C04_PN14_GENSTYLE_XL3 (XL3), 15=I_C04_PN14_GENSTYLE_SNA (SNA) (SNA value from data type)}, lower-limit=0, upper-limit=15  # 04_PN14_GenStyle
      invalid-value:
        integer literal c04_PN14_GenStyle: type=c04_PN14_GenStyle, value=15
    c04_ShftChrDsp_Rq:  # 04_ShftChrDsp_Rq
      base-type=uint8
      compu {0=I_C04_SHFTCHRDSP_RQ_SKL0 (SKL0) (Shift characteristic displacement "0"), 1=I_C04_SHFTCHRDSP_RQ_SKL1 (SKL1) (Shift characteristic displacement "1"), 2=I_C04_SHFTCHRDSP_RQ_SKL2 (SKL2) (Shift characteristic displacement "2"), 3=I_C04_SHFTCHRDSP_RQ_SKL3 (SKL3) (Shift characteristic displacement "3"), 4=I_C04_SHFTCHRDSP_RQ_SKL4 (SKL4) (Shift characteristic displacement "4"), 5=I_C04_SHFTCHRDSP_RQ_SKL5 (SKL5) (Shift characteristic displacement "5"), 6=I_C04_SHFTCHRDSP_RQ_SKL6 (SKL6) (Shift characteristic displacement "6"), 7=I_C04_SHFTCHRDSP_RQ_SKL7 (SKL7) (Shift characteristic displacement "7"), 8=I_C04_SHFTCHRDSP_RQ_SKL8 (SKL8) (Shift characteristic displacement "8"), 9=I_C04_SHFTCHRDSP_RQ_SKL9 (SKL9) (Shift characteristic displacement "9"), 10=I_C04_SHFTCHRDSP_RQ_SKL10 (SKL10) (Shift characteristic displacement "10"), 11=I_C04_SHFTCHRDSP_RQ_SKL11 (SKL11) (Shift characteristic displacement "11"), 12=I_C04_SHFTCHRDSP_RQ_SKL12 (SKL12) (Shift characteristic displacement "12"), 13=I_C04_SHFTCHRDSP_RQ_SKL13 (SKL13) (Shift characteristic displacement "13"), 14=I_C04_SHFTCHRDSP_RQ_SKL14 (SKL14) (Shift characteristic displacement "14"), 15=I_C04_SHFTCHRDSP_RQ_SKL15 (SKL15) (Shift characteristic displacement "15")}
      lower-limit=0
      upper-limit=15
    c04_SPCR_Md:  # 04_SPCR_Md
      base-type=uint8
      compu {0=I_C04_SPCR_MD_IDLE (IDLE) (Normal operation), 1=I_C04_SPCR_MD_HOLD (HOLD) (Hold mode active), 2=I_C04_SPCR_MD_GO (GO) (Go mode active), 4=I_C04_SPCR_MD_SLP (SLP) (Vehicle slips), 8=I_C04_SPCR_MD_SPCR_ACTV (SPCR_ACTV) (Stop coordinator active), 9=I_C04_SPCR_MD_SPCR_ACTV_HOLD (SPCR_ACTV_HOLD) (SPCR in activity and hold mode active), 10=I_C04_SPCR_MD_SPCR_ACTV_GO (SPCR_ACTV_GO) (SPCR in activity and go mode active), 12=I_C04_SPCR_MD_SPCR_ACTV_SLP (SPCR_ACTV_SLP) (SPCR in activity and vehicle slips), 15=I_C04_SPCR_MD_SPCR_PSV (SPCR_PSV) (SPCR passive)}
      lower-limit=0
      upper-limit=15
    c04_TCM_TxShift:  # 04_TCM_TxShift
      base-type=uint8
      compu {0=I_C04_TCM_TXSHIFT_NO_RQ (NO_RQ) (No request), 1=I_C04_TCM_TXSHIFT_DOWN_SHIFT_RJCT (DOWN_SHIFT_RJCT) (Downshift not possible/rejected), 2=I_C04_TCM_TXSHIFT_UP_SHIFT_RJCT (UP_SHIFT_RJCT) (Upshift not possible/rejected), 3=I_C04_TCM_TXSHIFT_DOWN_SHIFT_RCMND (DOWN_SHIFT_RCMND) (Downshift recomended), 4=I_C04_TCM_TXSHIFT_UP_SHIFT_RCMND (UP_SHIFT_RCMND) (Upshift recomended), 15=I_C04_TCM_TXSHIFT_SNA (SNA) (SNA value from data type)}
      lower-limit=0
      upper-limit=15
      invalid-value:
        integer literal c04_TCM_TxShift: type=c04_TCM_TxShift, value=15
    c04_TSL_Posn:  # 04_TSL_Posn
      base-type=uint8
      compu {5=I_C04_TSL_POSN_D (D) (Transmission selector lever in position "D"), 6=I_C04_TSL_POSN_N (N) (Transmission selector lever in position "N"), 7=I_C04_TSL_POSN_R (R) (Transmission selector lever in position "R"), 8=I_C04_TSL_POSN_P (P) (Transmission selector lever in position "P"), 9=I_C04_TSL_POSN_PLUS (PLUS) (Transmission selector lever in position "+"), 10=I_C04_TSL_POSN_MINUS (MINUS) (Transmission selector lever in position "-"), 11=I_C04_TSL_POSN_N_ZW_D (N_ZW_D) (Transmission selector lever in intermediate position "N-D"), 12=I_C04_TSL_POSN_R_ZW_N (R_ZW_N) (Transmission selector lever in intermediate position "R-N"), 13=I_C04_TSL_POSN_P_ZW_R (P_ZW_R) (Transmission selector lever in intermediate position "P-R"), 15=I_C04_TSL_POSN_SNA (SNA) (SNA value from data type)}
      lower-limit=5
      upper-limit=15
      invalid-value:
        integer literal c04_TSL_Posn: type=c04_TSL_Posn, value=15
    c04_TSL_Posn_Rq:  # 04_TSL_Posn_Rq
      base-type=uint8
      compu {0=I_C04_TSL_POSN_RQ_IDLE (IDLE) (Transmission selector lever request passive), 5=I_C04_TSL_POSN_RQ_D (D) (Transmission selector lever request "D"), 6=I_C04_TSL_POSN_RQ_N (N) (Transmission selector lever request "N"), 7=I_C04_TSL_POSN_RQ_R (R) (Transmission selector lever request "R"), 8=I_C04_TSL_POSN_RQ_P (P) (Transmission selector lever request "P"), 15=I_C04_TSL_POSN_RQ_SNA (SNA) (SNA value from data type)}
      lower-limit=0
      upper-limit=15
      invalid-value:
        integer literal c04_TSL_Posn_Rq: type=c04_TSL_Posn_Rq, value=15
    c04_TSL_Posn_Target:  # 04_TSL_Posn_Target
      base-type=uint8
      compu {0=I_C04_TSL_POSN_TARGET_IDLE (IDLE) (Passive (no request by assistance system)), 5=I_C04_TSL_POSN_TARGET_D (D) (Transmission selector lever target position "D"), 6=I_C04_TSL_POSN_TARGET_N (N) (Transmission selector lever target position "N"), 7=I_C04_TSL_POSN_TARGET_R (R) (Transmission selector lever target position "R"), 8=I_C04_TSL_POSN_TARGET_P (P) (Transmission selector lever target position "P"), 15=I_C04_TSL_POSN_TARGET_SNA (SNA) (SNA value from data type)}
      lower-limit=0
      upper-limit=15
      invalid-value:
        integer literal c04_TSL_Posn_Target: type=c04_TSL_Posn_Target, value=15
    c04_TSL_RND_Posn_StW:  # 04_TSL_RND_Posn_StW
      base-type=uint8
      compu {0=I_C04_TSL_RND_POSN_STW_IDLE (IDLE) (Transmission selector lever in idle position), 1=I_C04_TSL_RND_POSN_STW_R (R) (Transmission selector lever in position "R"), 2=I_C04_TSL_RND_POSN_STW_N_UP (N_UP) (Transmission selector lever in position "N up"), 4=I_C04_TSL_RND_POSN_STW_N_DOWN (N_DOWN) (Transmission selector lever in position "N down"), 6=I_C04_TSL_RND_POSN_STW_INI (INI) (Transmission selector lever not initialized), 8=I_C04_TSL_RND_POSN_STW_D (D) (Transmission selector lever in position "D"), 15=I_C04_TSL_RND_POSN_STW_SNA (SNA) (SNA value from data type)}
      lower-limit=0
      upper-limit=15
      invalid-value:
        integer literal c04_TSL_RND_Posn_StW: type=c04_TSL_RND_Posn_StW, value=15
    c04_TxHybDrvMd_Rq_V2:  # 04_TxHybDrvMd_Rq_V2
      base-type=uint8
      compu {0=I_C04_TXHYBDRVMD_RQ_V2_PT_DISENGG (PT_DISENGG) (powertrain disengaged), 1=I_C04_TXHYBDRVMD_RQ_V2_C0_TCC_CTRL_PT_CLS (C0_TCC_CTRL_PT_CLS) (C0 and TCC controlled by CPC, powertrain closed), 2=I_C04_TXHYBDRVMD_RQ_V2_C0_CTRL_TCC_AND_PT_OPEN (C0_CTRL_TCC_AND_PT_OPEN) (C0 controlled by CPC, TCC and powertrain open), 3=I_C04_TXHYBDRVMD_RQ_V2_EM_DRV_TCC_CLOSE_C0_OPEN (EM_DRV_TCC_CLOSE_C0_OPEN) (Electric motor drive TCC closed, C0 open), 4=I_C04_TXHYBDRVMD_RQ_V2_HYB_DRV_C0_CLS_TCC_CTRL_TCM (HYB_DRV_C0_CLS_TCC_Ctrl_TCM) (Engine and electric motor drive, C0 closed, TCC controlled by TCM), 5=I_C04_TXHYBDRVMD_RQ_V2_EM_DRV_TCC_OPEN (EM_DRV_TCC_OPEN) (Electric motor drive TCC open, C0 open), 6=I_C04_TXHYBDRVMD_RQ_V2_EM_DRV_TCC_CONTROL (EM_DRV_TCC_CONTROL) (Electric motor drive TCC controlled by CPC, C0 open), 7=I_C04_TXHYBDRVMD_RQ_V2_NDEF (NDEF) (not defined), 8=I_C04_TXHYBDRVMD_RQ_V2_NDEF2 (NDEF2) (not defined), 9=I_C04_TXHYBDRVMD_RQ_V2_NDEF3 (NDEF3) (not defined), 10=I_C04_TXHYBDRVMD_RQ_V2_C0_TCC_CTRL_PT_SHIFTUP (C0_TCC_CTRL_PT_SHIFTUP) (C0 and TCC controlled by CPC, Powertrain performing Upshift), 11=I_C04_TXHYBDRVMD_RQ_V2_C0_TCC_CTRL_PT_SHIFTDWN (C0_TCC_CTRL_PT_SHIFTDWN) (C0 and TCC controlled by CPC, Powertrain performing Downshift or Transmission slipping), 15=I_C04_TXHYBDRVMD_RQ_V2_SNA (SNA) (SNA value from data type)}
      lower-limit=0
      upper-limit=15
      invalid-value:
        integer literal c04_TxHybDrvMd_Rq_V2: type=c04_TxHybDrvMd_Rq_V2, value=15
    c04_TxHybMd_V2:  # 04_TxHybMd_V2
      base-type=uint8
      compu {0=I_C04_TXHYBMD_V2_PT_DISENGG (PT_DISENGG) (powertrain disengaged), 1=I_C04_TXHYBMD_V2_C0_TCC_CTRL_PT_CLS (C0_TCC_CTRL_PT_CLS) (C0 and TCC controlled by CPC, powertrain closed), 2=I_C04_TXHYBMD_V2_C0_CTRL_TCC_AND_PT_OPEN (C0_CTRL_TCC_AND_PT_OPEN) (C0 controlled by CPC, TCC and powertrain open), 3=I_C04_TXHYBMD_V2_EM_DRV_TCC_CLOSE_C0_OPEN (EM_DRV_TCC_CLOSE_C0_OPEN) (Electric motor drive TCC closed, C0 open), 4=I_C04_TXHYBMD_V2_HYB_DRV_C0_CLS_TCC_CTRL_TCM (HYB_DRV_C0_CLS_TCC_CTRL_TCM) (Engine and electric motor drive, C0 closed, TCC controlled by TCM), 5=I_C04_TXHYBMD_V2_EM_DRV_TCC_OPEN (EM_DRV_TCC_OPEN) (Electric motor drive TCC open, C0 open), 6=I_C04_TXHYBMD_V2_EM_DRV_TCC_CONTROL (EM_DRV_TCC_CONTROL) (Electric motor drive TCC controlled by CPC, C0 open), 7=I_C04_TXHYBMD_V2_NDEF (NDEF) (not defined), 8=I_C04_TXHYBMD_V2_FLT (FLT) (Transmission has detected a fault), 9=I_C04_TXHYBMD_V2_NDEF2 (NDEF2) (not defined), 10=I_C04_TXHYBMD_V2_C0_TCC_CTRL_PT_SHIFTUP (C0_TCC_CTRL_PT_SHIFTUP) (C0 and TCC controlled by CPC, Powertrain performing Upshift), 11=I_C04_TXHYBMD_V2_C0_TCC_CTRL_PT_SHIFTDWN (C0_TCC_CTRL_PT_SHIFTDWN) (C0 and TCC controlled by CPC, Powertrain performing Downshift or Transmission slipping), 15=I_C04_TXHYBMD_V2_SNA (SNA) (SNA value from data type)}
      lower-limit=0
      upper-limit=15
      invalid-value:
        integer literal c04_TxHybMd_V2: type=c04_TxHybMd_V2, value=15
    c04_TxInertia_EngStrt_Idx:  # 04_TxInertia_EngStrt_Idx
      base-type=uint8
      compu {0=I_C04_TXINERTIA_ENGSTRT_IDX_IDLE (IDLE) (Idle), 1=I_C04_TXINERTIA_ENGSTRT_IDX_INERTIA_IDX_1 (INERTIA_IDX_1) (Inertia Class 1 scheduled), 2=I_C04_TXINERTIA_ENGSTRT_IDX_INERTIA_IDX_2 (INERTIA_IDX_2) (Inertia Class 2 scheduled), 3=I_C04_TXINERTIA_ENGSTRT_IDX_INERTIA_IDX_3 (INERTIA_IDX_3) (Inertia Class 3 scheduled), 4=I_C04_TXINERTIA_ENGSTRT_IDX_INERTIA_IDX_4 (INERTIA_IDX_4) (Inertia Class 4 scheduled), 5=I_C04_TXINERTIA_ENGSTRT_IDX_INERTIA_IDX_5 (INERTIA_IDX_5) (Inertia Class 5 scheduled), 6=I_C04_TXINERTIA_ENGSTRT_IDX_INERTIA_IDX_6 (INERTIA_IDX_6) (Inertia Class 6 scheduled), 7=I_C04_TXINERTIA_ENGSTRT_IDX_INERTIA_IDX_7 (INERTIA_IDX_7) (Inertia Class 7 scheduled), 8=I_C04_TXINERTIA_ENGSTRT_IDX_INERTIA_IDX_8 (INERTIA_IDX_8) (Inertia Class 8 scheduled), 9=I_C04_TXINERTIA_ENGSTRT_IDX_INERTIA_IDX_9 (INERTIA_IDX_9) (Inertia Class 9 scheduled), 10=I_C04_TXINERTIA_ENGSTRT_IDX_INERTIA_IDX_10 (INERTIA_IDX_10) (Inertia Class 10 scheduled), 11=I_C04_TXINERTIA_ENGSTRT_IDX_NDEF1 (NDEF1) (Not Defined), 12=I_C04_TXINERTIA_ENGSTRT_IDX_NDEF2 (NDEF2) (Not Defined), 13=I_C04_TXINERTIA_ENGSTRT_IDX_NDEF3 (NDEF3) (Not Defined), 14=I_C04_TXINERTIA_ENGSTRT_IDX_NDEF4 (NDEF4) (Not Defined), 15=I_C04_TXINERTIA_ENGSTRT_IDX_SNA (SNA) (SNA value from data type)}
      lower-limit=0
      upper-limit=15
      invalid-value:
        integer literal c04_TxInertia_EngStrt_Idx: type=c04_TxInertia_EngStrt_Idx, value=15
    c04_TxLHOM2_Stat_Clutch:  # 04_TxLHOM2_Stat_Clutch
      base-type=uint8
      compu {0=I_C04_TXLHOM2_STAT_CLUTCH_NO_ERR (NO_ERR) (No Error), 1=I_C04_TXLHOM2_STAT_CLUTCH_CLT0_NOT_ENGG (CLT0_NOT_ENGG) (Clutch 0 does not engage), 2=I_C04_TXLHOM2_STAT_CLUTCH_CLT0_NOT_DISENGG (CLT0_NOT_DISENGG) (Clutch 0 does not disengage), 3=I_C04_TXLHOM2_STAT_CLUTCH_CLT0_CLS_ILLEGAL (CLT0_CLS_ILLEGAL) (Clutch 0 closes illegally), 4=I_C04_TXLHOM2_STAT_CLUTCH_CLT0_OPN_ILLEGAL (CLT0_OPN_ILLEGAL) (Clutch 0 open illegally), 5=I_C04_TXLHOM2_STAT_CLUTCH_CLT1_NOT_ENGG (CLT1_NOT_ENGG) (Clutch 1 does not engage), 6=I_C04_TXLHOM2_STAT_CLUTCH_CLT1_NOT_DISENGG (CLT1_NOT_DISENGG) (Clutch 1 does not disengage), 7=I_C04_TXLHOM2_STAT_CLUTCH_CLT1_CLS_ILLEGAL (CLT1_CLS_ILLEGAL) (Clutch 1 closes illegally), 8=I_C04_TXLHOM2_STAT_CLUTCH_CLT1_OPN_ILLEGAL (CLT1_OPN_ILLEGAL) (Clutch 1 open illegally), 9=I_C04_TXLHOM2_STAT_CLUTCH_CLT2_NOT_ENGG (CLT2_NOT_ENGG) (Clutch 2 does not engage), 10=I_C04_TXLHOM2_STAT_CLUTCH_CLT2_NOT_DISENGG (CLT2_NOT_DISENGG) (Clutch 2 does not disengage), 11=I_C04_TXLHOM2_STAT_CLUTCH_CLT2_CLS_ILLEGAL (CLT2_CLS_ILLEGAL) (Clutch 2 closes illegally), 12=I_C04_TXLHOM2_STAT_CLUTCH_CLT2_OPN_ILLEGAL (CLT2_OPN_ILLEGAL) (Clutch 2 open illegally), 13=I_C04_TXLHOM2_STAT_CLUTCH_NDEF13 (NDEF13) (not defined), 14=I_C04_TXLHOM2_STAT_CLUTCH_NDEF14 (NDEF14) (not defined), 15=I_C04_TXLHOM2_STAT_CLUTCH_NDEF15 (NDEF15) (not defined)}
      lower-limit=0
      upper-limit=15
    c04_TxSelVlvPos_Actl:  # 04_TxSelVlvPos_Actl
      base-type=uint8
      compu {5=I_C04_TXSELVLVPOS_ACTL_D (D) (Actual selector valve position "D"), 6=I_C04_TXSELVLVPOS_ACTL_N (N) (Actual selector valve position "N"), 7=I_C04_TXSELVLVPOS_ACTL_R (R) (Actual selector valve position "R"), 8=I_C04_TXSELVLVPOS_ACTL_P (P) (Actual selector valve position "P"), 11=I_C04_TXSELVLVPOS_ACTL_N_ZW_D (N_ZW_D) (Actual selector valve position "N-D"), 12=I_C04_TXSELVLVPOS_ACTL_R_ZW_N (R_ZW_N) (Actual selector valve position "R-N"), 13=I_C04_TXSELVLVPOS_ACTL_P_ZW_R (P_ZW_R) (Actual selector valve position "P-R"), 15=I_C04_TXSELVLVPOS_ACTL_SNA (SNA) (SNA value from data type)}
      lower-limit=5
      upper-limit=15
      invalid-value:
        integer literal c04_TxSelVlvPos_Actl: type=c04_TxSelVlvPos_Actl, value=15
    c04_VehDrvProg_V3:  # 04_VehDrvProg_V3
      base-type=uint8
      compu {0=I_C04_VEHDRVPROG_V3_SPORT (SPORT) (Sport (Standard)), 1=I_C04_VEHDRVPROG_V3_COMFORT (COMFORT) (Comfort), 2=I_C04_VEHDRVPROG_V3_SPORT_PLUS (SPORT_PLUS) (Sport Plus), 3=I_C04_VEHDRVPROG_V3_RACE (RACE) (Race (only AMG)), 4=I_C04_VEHDRVPROG_V3_ECO (ECO), 5=I_C04_VEHDRVPROG_V3_ALLROAD (ALLROAD) (Allroad), 6=I_C04_VEHDRVPROG_V3_OFFROAD (OFFROAD) (Offroad), 7=I_C04_VEHDRVPROG_V3_MANUAL (MANUAL) (Manual (not AMG)), 15=I_C04_VEHDRVPROG_V3_SNA (SNA) (SNA value from data type)}
      lower-limit=0
      upper-limit=15
      invalid-value:
        integer literal c04_VehDrvProg_V3: type=c04_VehDrvProg_V3, value=15
    c04_WDC_Stat:  # 04_WDC_Stat
      base-type=uint8
      compu {0=I_C04_WDC_STAT_STOP (STOP) (WDC is in stopped mode), 1=I_C04_WDC_STAT_CREEP (CREEP) (WDC is in creeping mode), 2=I_C04_WDC_STAT_DRV_AWAY (DRV_AWAY) (WDC is in drive away mode), 3=I_C04_WDC_STAT_SLIP (SLIP) (WDC is in slip control mode), 4=I_C04_WDC_STAT_HYB (HYB) (WDC is in hybrid mode), 5=I_C04_WDC_STAT_FULL_CONNECT (FULL_CONNECT) (WDC is in full connection mode), 6=I_C04_WDC_STAT_MON (MON) (WDC is in monitoring mode), 7=I_C04_WDC_STAT_OTHER (OTHER) (Other), 15=I_C04_WDC_STAT_SNA (SNA) (SNA value from data type)}
      lower-limit=0
      upper-limit=15
      invalid-value:
        integer literal c04_WDC_Stat: type=c04_WDC_Stat, value=15
    c05_0_31_1_SNA_na: base-type=uint8, compu {phys=raw for raw 0..31}, lower-limit=0, upper-limit=31  # 05_0-31_1_SNA=-
    c05_DPC_Md_Susp_V2:  # 05_DPC_Md_Susp_V2
      base-type=uint8
      compu {1=I_C05_DPC_MD_SUSP_V2_ONROAD1URBANCRUISEAMG (ONROAD1URBANCRUISEAMG) (Onroad mode #1 (Eco (not AMG) or Urban-Cruise (only AMG))), 2=I_C05_DPC_MD_SUSP_V2_ONROAD2 (ONROAD2) (Onroad mode #2 (Curve)), 3=I_C05_DPC_MD_SUSP_V2_ONROAD3 (ONROAD3) (Onroad mode #3), 4=I_C05_DPC_MD_SUSP_V2_ONROAD4 (ONROAD4) (Onroad mode #4), 5=I_C05_DPC_MD_SUSP_V2_ONROAD5 (ONROAD5) (Onroad mode #5), 6=I_C05_DPC_MD_SUSP_V2_ONROAD6 (ONROAD6) (Onroad mode #6), 7=I_C05_DPC_MD_SUSP_V2_ONROAD7 (ONROAD7) (Onroad mode #7), 8=I_C05_DPC_MD_SUSP_V2_ONROAD8 (ONROAD8) (Onroad mode #8), 9=I_C05_DPC_MD_SUSP_V2_ONROAD9 (ONROAD9) (Onroad mode #9 (Comfort)), 10=I_C05_DPC_MD_SUSP_V2_ONROAD10 (ONROAD10) (Onroad mode #10), 11=I_C05_DPC_MD_SUSP_V2_ONROAD11 (ONROAD11) (Onroad mode #11), 12=I_C05_DPC_MD_SUSP_V2_ONROAD12 (ONROAD12) (Onroad mode #12), 13=I_C05_DPC_MD_SUSP_V2_ONROAD13 (ONROAD13) (Onroad mode #13), 14=I_C05_DPC_MD_SUSP_V2_ONROAD14 (ONROAD14) (Onroad mode #14), 15=I_C05_DPC_MD_SUSP_V2_ONROAD15 (ONROAD15) (Onroad mode #15), 16=I_C05_DPC_MD_SUSP_V2_ONROAD16 (ONROAD16) (Onroad mode #16), 17=I_C05_DPC_MD_SUSP_V2_ONROAD17 (ONROAD17) (Onroad mode #17 (Sport)), 18=I_C05_DPC_MD_SUSP_V2_ONROAD18 (ONROAD18) (Onroad mode #18), 19=I_C05_DPC_MD_SUSP_V2_ONROAD19 (ONROAD19) (Onroad mode #19), 20=I_C05_DPC_MD_SUSP_V2_ONROAD20 (ONROAD20) (Onroad mode #20), 21=I_C05_DPC_MD_SUSP_V2_ONROAD21 (ONROAD21) (Onroad mode #21 (Race)), 22=I_C05_DPC_MD_SUSP_V2_ONROAD22 (ONROAD22) (Onroad mode #22), 23=I_C05_DPC_MD_SUSP_V2_ONROAD23 (ONROAD23) (Onroad mode #23), 24=I_C05_DPC_MD_SUSP_V2_ONROAD24 (ONROAD24) (Onroad mode #24), 25=I_C05_DPC_MD_SUSP_V2_ONROAD25 (ONROAD25) (Onroad mode #25 (Sport+)), 26=I_C05_DPC_MD_SUSP_V2_OFFROAD1 (OFFROAD1) (Offroad mode #1 (Offroad)), 27=I_C05_DPC_MD_SUSP_V2_OFFROAD2 (OFFROAD2) (Offroad mode #2 (Offroad+)), 28=I_C05_DPC_MD_SUSP_V2_OFFROAD3 (OFFROAD3) (Offroad mode #3), 29=I_C05_DPC_MD_SUSP_V2_ALLROAD (ALLROAD) (Allroad mode), 31=I_C05_DPC_MD_SUSP_V2_SNA (SNA) (SNA value from data type)}
      lower-limit=1
      upper-limit=31
      invalid-value:
        integer literal c05_DPC_Md_Susp_V2: type=c05_DPC_Md_Susp_V2, value=31
    c05_EVC_BodyStyle:  # 05_EVC_BodyStyle
      base-type=uint8
      compu {0=I_C05_EVC_BODYSTYLE_FW (FW) (FW - SEDAN), 1=I_C05_EVC_BODYSTYLE_FV (FV) (FV - SEDAN ELONGATED), 2=I_C05_EVC_BODYSTYLE_FC (FC) (FC - COUPE), 3=I_C05_EVC_BODYSTYLE_FS (FS) (FS - STATION WAGON), 4=I_C05_EVC_BODYSTYLE_FA (FA) (FA - CABRIOLET), 5=I_C05_EVC_BODYSTYLE_FR (FR) (FR - ROADSTER), 6=I_C05_EVC_BODYSTYLE_FCL (FCL) (FCL - COMPACT LIMOUSINE), 7=I_C05_EVC_BODYSTYLE_FVV (FVV) (FVV - SEDAN EXTREMELY LONG), 8=I_C05_EVC_BODYSTYLE_FVF (FVF) (FVF - ELONGATED CHASSIS), 9=I_C05_EVC_BODYSTYLE_FF (FF) (FF - CHASSIS), 10=I_C05_EVC_BODYSTYLE_FB (FB) (FB - G-CLASS STATION WAGON WIDE), 12=I_C05_EVC_BODYSTYLE_FT (FT) (FT - TOURER (VAN)), 13=I_C05_EVC_BODYSTYLE_FX (FX) (FX - SPECIAL VERSION), 14=I_C05_EVC_BODYSTYLE_FCLA (FCLA) (FCLA - KOMPAKT-LIMOUSINE-CABRIOLET), 15=I_C05_EVC_BODYSTYLE_FH (FH) (FH - HATCHBACK), 16=I_C05_EVC_BODYSTYLE_FZ (FZ) (FZ - SPECIAL VERSION), 17=I_C05_EVC_BODYSTYLE_FN (FN) (FN - SONDERAUSFUEHRUNG), 31=I_C05_EVC_BODYSTYLE_OTHER (OTHER) (none of listed variants)}
      lower-limit=0
      upper-limit=31
    c05_EVC_HU_Style:  # 05_EVC_HU_Style
      base-type=uint8
      compu {0=I_C05_EVC_HU_STYLE_CMD_APS (CMD_APS) (531 COMAND APS NTG5), 1=I_C05_EVC_HU_STYLE_AUDIO_20 (AUDIO_20) (522 RADIO AUDIO 20 NTG5 POSSIBLE FOR NAVIGATE), 2=I_C05_EVC_HU_STYLE_HU_USB (HU_USB) (520 RADIO WITH USB INTERFACE NTG5 (AUDIO 20)), 3=I_C05_EVC_HU_STYLE_HU_USB_NTG45 (HU_USB_NTG45) (516 HEADUNIT WITH USB-INTERFACE NTG 4.5 (AUDIO 5)), 31=I_C05_EVC_HU_STYLE_OTHER (OTHER) (none of listed variants)}
      lower-limit=0
      upper-limit=31
    c05_EVC_VehLineYear: base-type=uint8, compu {phys=raw+2000 for raw 0..30, 31=I_C05_EVC_VEHLINEYEAR_SNA (SNA) (SNA value from data type)}, lower-limit=0, upper-limit=31  # 05_EVC_VehLineYear
      invalid-value:
        integer literal c05_EVC_VehLineYear: type=c05_EVC_VehLineYear, value=31
    c05_l_per_min_0_15_0k5: base-type=uint8, compu {phys=raw*0.5 for raw 0..30, 31=I_C05_L_PER_MIN_0_15_0K5_SNA (SNA) (SNA value from data type); unit l/min}, lower-limit=0, upper-limit=31  # 05_l/min-0-15_0,5
      invalid-value:
        integer literal c05_l_per_min_0_15_0k5: type=c05_l_per_min_0_15_0k5, value=31
    c05_LDC_MsgDisp_Rq:  # 05_LDC_MsgDisp_Rq
      base-type=uint8
      compu {0=I_C05_LDC_MSGDISP_RQ_IDLE (IDLE) (No request), 1=I_C05_LDC_MSGDISP_RQ_MSG1_24B_250 (MSG1_24B_250) (Message "Distronic off"), 2=I_C05_LDC_MSGDISP_RQ_MSG2_24E_24F (MSG2_24E_24F) (Message "Distronic on/set speed"), 3=I_C05_LDC_MSGDISP_RQ_MSG3_1ED (MSG3_1ED) (Message "Distronic off" with beep), 4=I_C05_LDC_MSGDISP_RQ_MSG4_24E_252 (MSG4_24E_252) (Message "Distronic maloperation"), 5=I_C05_LDC_MSGDISP_RQ_MSG5_24C_251 (MSG5_24C_251) (Message "Distronic system passive"), 6=I_C05_LDC_MSGDISP_RQ_MSG6_365_386 (MSG6_365_386) (User confirmation message "Not available"), 7=I_C05_LDC_MSGDISP_RQ_MSG7_381_37F (MSG7_381_37F) (User confirmation message "No function"), 8=I_C05_LDC_MSGDISP_RQ_MSG8_369_367 (MSG8_369_367) (User confirmation message "Radar soiled"), 9=I_C05_LDC_MSGDISP_RQ_MSG9_3AD (MSG9_3AD) (User confirmation message "Radar GPS off"), 10=I_C05_LDC_MSGDISP_RQ_MSG10_38A (MSG10_38A) (User confirmation message "Radar off"), 11=I_C05_LDC_MSGDISP_RQ_MSG11_1F8 (MSG11_1F8) (Message "Limiter on/set speed"), 12=I_C05_LDC_MSGDISP_RQ_MSG12 (MSG12) (Message "Limiter off"), 13=I_C05_LDC_MSGDISP_RQ_MSG13_246 (MSG13_246) (Message "Limiter off" with beep), 14=I_C05_LDC_MSGDISP_RQ_MSG14_247 (MSG14_247) (Message "Limiter maloperation"), 15=I_C05_LDC_MSGDISP_RQ_MSG15 (MSG15) (Message "Limiter function active at the moment"), 16=I_C05_LDC_MSGDISP_RQ_MSG16_249 (MSG16_249) (Message "Cruise control off"), 17=I_C05_LDC_MSGDISP_RQ_MSG17_1F7 (MSG17_1F7) (Message "Cruise control on/set speed"), 18=I_C05_LDC_MSGDISP_RQ_MSG18_445 (MSG18_445) (Message "Cruise control off" with beep), 19=I_C05_LDC_MSGDISP_RQ_MSG19_24A (MSG19_24A) (Message "Cruise control maloperation"), 20=I_C05_LDC_MSGDISP_RQ_MSG20_366_36A (MSG20_366_36A) (User confirmation message "Not available"), 21=I_C05_LDC_MSGDISP_RQ_MSG21 (MSG21) (Message "Cruise control deceleration insufficient"), 22=I_C05_LDC_MSGDISP_RQ_MSG22 (MSG22) (Message "Limiter passive"), 23=I_C05_LDC_MSGDISP_RQ_MSG23 (MSG23) (Message "Radar sensor soiled"), 24=I_C05_LDC_MSGDISP_RQ_MSG24 (MSG24) (Message "Desired distance changed"), 31=I_C05_LDC_MSGDISP_RQ_SNA (SNA) (SNA value from data type)}
      lower-limit=0
      upper-limit=31
      invalid-value:
        integer literal c05_LDC_MsgDisp_Rq: type=c05_LDC_MsgDisp_Rq, value=31
    c05_LDC_MsgDisp_Rq_RDU:  # 05_LDC_MsgDisp_Rq_RDU
      base-type=uint8
      compu {0=I_C05_LDC_MSGDISP_RQ_RDU_IDLE (IDLE) (No request), 1=I_C05_LDC_MSGDISP_RQ_RDU_MSG1_24B_250 (MSG1_24B_250) (Message "Distronic off"), 2=I_C05_LDC_MSGDISP_RQ_RDU_MSG2_24E_24F (MSG2_24E_24F) (Message "Distronic on/set speed"), 3=I_C05_LDC_MSGDISP_RQ_RDU_MSG3_1ED (MSG3_1ED) (Message "Distronic off" with beep), 4=I_C05_LDC_MSGDISP_RQ_RDU_MSG4_24E_252 (MSG4_24E_252) (Message "Distronic maloperation"), 5=I_C05_LDC_MSGDISP_RQ_RDU_MSG5_24C_251 (MSG5_24C_251) (Message "Distronic system passive"), 6=I_C05_LDC_MSGDISP_RQ_RDU_MSG6_365_386 (MSG6_365_386) (User confirmation message "Not available"), 7=I_C05_LDC_MSGDISP_RQ_RDU_MSG7_381_37F (MSG7_381_37F) (User confirmation message "No function"), 8=I_C05_LDC_MSGDISP_RQ_RDU_MSG8_369_367 (MSG8_369_367) (Message "Temporary not available"), 9=I_C05_LDC_MSGDISP_RQ_RDU_MSG9_3AD (MSG9_3AD) (User confirmation message "Radar GPS off"), 10=I_C05_LDC_MSGDISP_RQ_RDU_MSG10_38A (MSG10_38A) (User confirmation message "Radar off"), 11=I_C05_LDC_MSGDISP_RQ_RDU_MSG11_1F8 (MSG11_1F8) (Message "Limiter on/set speed"), 12=I_C05_LDC_MSGDISP_RQ_RDU_MSG12 (MSG12) (Message "Limiter off"), 13=I_C05_LDC_MSGDISP_RQ_RDU_MSG13_246 (MSG13_246) (Message "Limiter off" with beep), 14=I_C05_LDC_MSGDISP_RQ_RDU_MSG14_247 (MSG14_247) (Message "Limiter maloperation"), 15=I_C05_LDC_MSGDISP_RQ_RDU_MSG15 (MSG15) (Message "Limiter function active at the moment"), 16=I_C05_LDC_MSGDISP_RQ_RDU_MSG16_249 (MSG16_249) (Message "Cruise control off"), 17=I_C05_LDC_MSGDISP_RQ_RDU_MSG17_1F7 (MSG17_1F7) (Message "Cruise control on/set speed"), 18=I_C05_LDC_MSGDISP_RQ_RDU_MSG18_445 (MSG18_445) (Message "Cruise control off" with beep), 19=I_C05_LDC_MSGDISP_RQ_RDU_MSG19_24A (MSG19_24A) (Message "Cruise control maloperation"), 20=I_C05_LDC_MSGDISP_RQ_RDU_MSG20_366_36A (MSG20_366_36A) (User confirmation message "Not available"), 21=I_C05_LDC_MSGDISP_RQ_RDU_MSG21 (MSG21) (Message "Cruise control deceleration insufficient"), 22=I_C05_LDC_MSGDISP_RQ_RDU_MSG22 (MSG22) (Message "Limiter passive"), 23=I_C05_LDC_MSGDISP_RQ_RDU_MSG23 (MSG23) (Message "Radar sensor soiled"), 24=I_C05_LDC_MSGDISP_RQ_RDU_MSG24 (MSG24) (Message "Desired distance changed"), 25=I_C05_LDC_MSGDISP_RQ_RDU_MSG25 (MSG25) (Message "Distronic on/ set SLA speed"), 26=I_C05_LDC_MSGDISP_RQ_RDU_MSG26 (MSG26) (Message "Radar sensor soiled“ icon view), 31=I_C05_LDC_MSGDISP_RQ_RDU_SNA (SNA) (SNA value from data type)}
      lower-limit=0
      upper-limit=31
      invalid-value:
        integer literal c05_LDC_MsgDisp_Rq_RDU: type=c05_LDC_MsgDisp_Rq_RDU, value=31
    c05_TCM_Dir_Stat:  # 05_TCM_Dir_Stat
      base-type=uint8
      compu {0=I_C05_TCM_DIR_STAT_IDLE (IDLE) (No driving position enabled), 1=I_C05_TCM_DIR_STAT_D (D) (D enabled), 2=I_C05_TCM_DIR_STAT_N (N) (N enabled), 3=I_C05_TCM_DIR_STAT_D_N (D_N) (D and N enabled), 4=I_C05_TCM_DIR_STAT_R (R) (R enabled), 5=I_C05_TCM_DIR_STAT_D_R (D_R) (D and R enabled), 6=I_C05_TCM_DIR_STAT_N_R (N_R) (N and R enabled), 7=I_C05_TCM_DIR_STAT_D_N_R (D_N_R) (D, N and R enabled), 8=I_C05_TCM_DIR_STAT_P (P) (P enabled), 9=I_C05_TCM_DIR_STAT_D_P (D_P) (D and P enabled), 10=I_C05_TCM_DIR_STAT_N_P (N_P) (N and P enabled), 11=I_C05_TCM_DIR_STAT_D_N_P (D_N_P) (D, N and P enabled), 12=I_C05_TCM_DIR_STAT_R_P (R_P) (R and P enabled), 13=I_C05_TCM_DIR_STAT_D_R_P (D_R_P) (D, R and P enabled), 14=I_C05_TCM_DIR_STAT_N_R_P (N_R_P) (N, R and P enabled), 15=I_C05_TCM_DIR_STAT_D_N_R_P (D_N_R_P) (D, N, R and P enabled), 31=I_C05_TCM_DIR_STAT_SNA (SNA) (SNA value from data type)}
      lower-limit=0
      upper-limit=31
      invalid-value:
        integer literal c05_TCM_Dir_Stat: type=c05_TCM_Dir_Stat, value=31
    c05_TCM_TxLED:  # 05_TCM_TxLED
      base-type=uint8
      compu {0=I_C05_TCM_TXLED_LED_OFF (LED_OFF) (all LEDs off), 1=I_C05_TCM_TXLED_LED_1_ON (LED_1_ON) (LED 1 on), 2=I_C05_TCM_TXLED_LED_1_TO_2_ON (LED_1_TO_2_ON) (LED 1 to 2 on), 3=I_C05_TCM_TXLED_LED_1_TO_3_ON (LED_1_TO_3_ON) (LED 1 to 3 on), 4=I_C05_TCM_TXLED_LED_1_TO_4_ON (LED_1_TO_4_ON) (LED 1 to 4 on), 5=I_C05_TCM_TXLED_LED_1_TO_5_ON (LED_1_TO_5_ON) (LED 1 to 5 on), 6=I_C05_TCM_TXLED_LED_1_TO_6_ON (LED_1_TO_6_ON) (LED 1 to 6 on), 7=I_C05_TCM_TXLED_LED_1_TO_7_ON (LED_1_TO_7_ON) (LED 1 to 7 on), 8=I_C05_TCM_TXLED_LED_1_TO_8_ON (LED_1_TO_8_ON) (LED 1 to 8 on), 9=I_C05_TCM_TXLED_LED_1_TO_9_ON (LED_1_TO_9_ON) (LED 1 to 9 on), 15=I_C05_TCM_TXLED_LED_YLW_ON (LED_YLW_ON) (All yellow LEDs on), 16=I_C05_TCM_TXLED_LED_RED_ON (LED_RED_ON) (All red LEDs on), 17=I_C05_TCM_TXLED_LED_YLW_RED_ON (LED_YLW_RED_ON) (All yellow and red LEDs on), 18=I_C05_TCM_TXLED_LED_2_ON (LED_2_ON) (LED 2 on), 19=I_C05_TCM_TXLED_LED_3_ON (LED_3_ON) (LED 3 on), 20=I_C05_TCM_TXLED_LED_4_ON (LED_4_ON) (LED 4 on), 21=I_C05_TCM_TXLED_LED_5_ON (LED_5_ON) (LED 5 on), 22=I_C05_TCM_TXLED_LED_6_ON (LED_6_ON) (LED 6 on), 23=I_C05_TCM_TXLED_LED_7_ON (LED_7_ON) (LED 7 on), 24=I_C05_TCM_TXLED_LED_8_ON (LED_8_ON) (LED 8 on), 25=I_C05_TCM_TXLED_LED_9_ON (LED_9_ON) (LED 9 on), 31=I_C05_TCM_TXLED_SNA (SNA) (SNA value from data type)} "Transmission LED display request"
      lower-limit=0
      upper-limit=31
      invalid-value:
        integer literal c05_TCM_TxLED: type=c05_TCM_TxLED, value=31
    c06_perc_0_100_2: base-type=uint8, compu {phys=raw*2 for raw 0..50, 63=I_C06_PERC_0_100_2_SNA (SNA) (SNA value from data type); unit %}, lower-limit=0, upper-limit=63  # 06_%_0-100_2
      invalid-value:
        integer literal c06_perc_0_100_2: type=c06_perc_0_100_2, value=63
    c06_perc_0_31_3k22581: base-type=uint8, compu {phys=raw*3.225806452 for raw 0..31, 63=I_C06_PERC_0_31_3K22581_SNA (SNA) (SNA value from data type); unit %}, lower-limit=0, upper-limit=63  # 06_%_0-31_3,22581
      invalid-value:
        integer literal c06_perc_0_31_3k22581: type=c06_perc_0_31_3k22581, value=63
    c06_0_310_5: base-type=uint8, compu {phys=raw*5 for raw 0..62, 63=I_C06_0_310_5_SNA (SNA) (SNA value from data type)}, lower-limit=0, upper-limit=63  # 06_0-310_5
      invalid-value:
        integer literal c06_0_310_5: type=c06_0_310_5, value=63
    c06_0_63_1_SNA_na: base-type=uint8, compu {phys=raw for raw 0..63}, lower-limit=0, upper-limit=63  # 06_0-63_1_SNA=-
    c6_a_0_62_1: base-type=uint8, compu {phys=raw for raw 0..62, 63=I_C6_A_0_62_1_SNA (SNA) (SNA value from data type); unit A}, lower-limit=0, upper-limit=63  # 06_A_0-62_1
      invalid-value:
        integer literal c6_a_0_62_1: type=c6_a_0_62_1, value=63
    c06_EVC_VehLine:  # 06_EVC_VehLine
      base-type=uint8
      compu {1=I_C06_EVC_VEHLINE_BR231 (BR231), 2=I_C06_EVC_VEHLINE_BR212 (BR212), 4=I_C06_EVC_VEHLINE_BR222 (BR222), 6=I_C06_EVC_VEHLINE_BR205 (BR205), 8=I_C06_EVC_VEHLINE_BR166 (BR166), 9=I_C06_EVC_VEHLINE_BR207 (BR207), 10=I_C06_EVC_VEHLINE_BR463 (BR463), 11=I_C06_EVC_VEHLINE_BR217 (BR217), 12=I_C06_EVC_VEHLINE_BR232 (BR232), 13=I_C06_EVC_VEHLINE_BR213 (BR213), 14=I_C06_EVC_VEHLINE_BR238 (BR238), 18=I_C06_EVC_VEHLINE_BR173 (BR173), 19=I_C06_EVC_VEHLINE_BR167 (BR167), 20=I_C06_EVC_VEHLINE_BR177 (BR177), 21=I_C06_EVC_VEHLINE_BR190 (BR190), 23=I_C06_EVC_VEHLINE_BR257 (BR257), 32=I_C06_EVC_VEHLINE_BR218 (BR218), 34=I_C06_EVC_VEHLINE_BR290 (BR290), 38=I_C06_EVC_VEHLINE_BR447 (BR447), 39=I_C06_EVC_VEHLINE_BR253 (BR253), 40=I_C06_EVC_VEHLINE_BR292 (BR292), 41=I_C06_EVC_VEHLINE_BR252 (BR252), 42=I_C06_EVC_VEHLINE_BR247 (BR247), 43=I_C06_EVC_VEHLINE_BR118 (BR118), 44=I_C06_EVC_VEHLINE_BR907 (BR907), 45=I_C06_EVC_VEHLINE_BR910 (BR910), 46=I_C06_EVC_VEHLINE_BR470 (BR470), 47=I_C06_EVC_VEHLINE_BR293 (BR293), 63=I_C06_EVC_VEHLINE_OTHER (OTHER) (none of listed variants)}
      lower-limit=1
      upper-limit=63
    c06_rpm_0_6200_100: base-type=uint8, compu {phys=raw*100 for raw 0..62, 63=I_C06_RPM_0_6200_100_SNA (SNA) (SNA value from data type); unit rpm}, lower-limit=0, upper-limit=63  # 06_rpm_0-6200_100
      invalid-value:
        integer literal c06_rpm_0_6200_100: type=c06_rpm_0_6200_100, value=63
    c06_s_0_6d2_0d1: base-type=uint8, compu {phys=raw*0.1 for raw 0..62, 63=I_C06_S_0_6D2_0D1_SNA (SNA) (SNA value from data type); unit s}, lower-limit=0, upper-limit=63  # 06_s_0-6,2_0,1
      invalid-value:
        integer literal c06_s_0_6d2_0d1: type=c06_s_0_6d2_0d1, value=63
    c02_SpdCtrlLvr_Stat_V3:  # 06_SpdCtrlLvr_Stat_V3
      base-type=uint8
      compu {0=I_C02_SPDCTRLLVR_STAT_V3_IDLE (IDLE) (Speed control lever not pressed), 1=I_C02_SPDCTRLLVR_STAT_V3_FWD (FWD) (Speed control lever pushed forward ("Off")), 2=I_C02_SPDCTRLLVR_STAT_V3_RWD (RWD) (Speed control lever pulled backward ("Resume")), 4=I_C02_SPDCTRLLVR_STAT_V3_UP_2ND (UP_2ND) (Speed control lever pushed upward to 2nd step("+ 10 km/h")), 8=I_C02_SPDCTRLLVR_STAT_V3_DN_2ND (DN_2ND) (Speed control lever pushed downward to 2nd step ("- 10 km/h")), 16=I_C02_SPDCTRLLVR_STAT_V3_UP_1ST (UP_1ST) (Speed control lever pushed upward to 1st step ("+ 1 km/h")), 32=I_C02_SPDCTRLLVR_STAT_V3_DN_1ST (DN_1ST) (Speed control lever pushed downward to 1st step ("- 1 km/h")), 63=I_C02_SPDCTRLLVR_STAT_V3_SNA (SNA) (SNA value from data type)}
      lower-limit=0
      upper-limit=63
      invalid-value:
        integer literal c02_SpdCtrlLvr_Stat_V3: type=c02_SpdCtrlLvr_Stat_V3, value=63
    c06_VehAccel_X_AS_Actv:  # 06_VehAccel_X_AS_Actv
      base-type=uint8
      compu {0=I_C06_VEHACCEL_X_AS_ACTV_IDLE (IDLE) (no assistance system is braking/accelerating), 1=I_C06_VEHACCEL_X_AS_ACTV_NDEF1 (NDEF1) (not defined), 2=I_C06_VEHACCEL_X_AS_ACTV_NDEF2 (NDEF2) (not defined), 3=I_C06_VEHACCEL_X_AS_ACTV_NDEF3 (NDEF3) (not defined), 4=I_C06_VEHACCEL_X_AS_ACTV_ADTR_ACTV (ADTR_ACTV) (Advanced distronic is active), 5=I_C06_VEHACCEL_X_AS_ACTV_BAS_PLUS_ACTV (BAS_PLUS_ACTV) (Brake assist plus is active), 6=I_C06_VEHACCEL_X_AS_ACTV_BAS_PLUS_P_ACTV (BAS_PLUS_P_ACTV) (Brake assist plus pedestrian is active), 7=I_C06_VEHACCEL_X_AS_ACTV_DSR_ACTV (DSR_ACTV) (Downhill speed regulation is active), 8=I_C06_VEHACCEL_X_AS_ACTV_CMS_ES1_ACTV (CMS_ES1_ACTV) (Collision mitigation system partial brake is active), 9=I_C06_VEHACCEL_X_AS_ACTV_CMS_ES2_ACTV (CMS_ES2_ACTV) (Collision mitigation system full brake is active), 10=I_C06_VEHACCEL_X_AS_ACTV_BPQ_ACTV (BPQ_ACTV) (Advanced brake assist plus Q is active), 11=I_C06_VEHACCEL_X_AS_ACTV_CMSQ_ES1_ACTV (CMSQ_ES1_ACTV) (Collision mitigation system Q is active (ES1)), 12=I_C06_VEHACCEL_X_AS_ACTV_CMS_REAR_ACTV (CMS_REAR_ACTV) (Collision mitigation system Rear is active), 13=I_C06_VEHACCEL_X_AS_ACTV_CMSQ_ES2_ACTV (CMSQ_ES2_ACTV) (Collision mitigation system Q is active (ES2)), 14=I_C06_VEHACCEL_X_AS_ACTV_CMS_P_ES1_ACTV (CMS_P_ES1_ACTV) (Collision mitigation system pedestrian is active (ES1)), 15=I_C06_VEHACCEL_X_AS_ACTV_CMS_P_ES2_ACTV (CMS_P_ES2_ACTV) (Collision mitigation system pedestrian is active (ES2)), 16=I_C06_VEHACCEL_X_AS_ACTV_NDEF16 (NDEF16) (not defined), 17=I_C06_VEHACCEL_X_AS_ACTV_CC_ACTV (CC_ACTV) (Cruise control is active), 18=I_C06_VEHACCEL_X_AS_ACTV_LIM_ACTV (LIM_ACTV) (Limiter is active), 19=I_C06_VEHACCEL_X_AS_ACTV_WTSL_ACTV (WTSL_ACTV) (Winter tire speed limiter is active), 20=I_C06_VEHACCEL_X_AS_ACTV_TRANS_MD_LIM_ACTV (TRANS_MD_LIM_ACTV) (Transport mode limiter is active), 21=I_C06_VEHACCEL_X_AS_ACTV_REM_PARK_ACTV (REM_PARK_ACTV) (Remote park assist is active), 22=I_C06_VEHACCEL_X_AS_ACTV_PARK_SC_ACTV (PARK_SC_ACTV) (Park system with speed control mode is active), 23=I_C06_VEHACCEL_X_AS_ACTV_PARK_LIM_ACTV (PARK_LIM_ACTV) (Park system with limit mode is active), 24=I_C06_VEHACCEL_X_AS_ACTV_CTA_ACTV (CTA_ACTV) (Crossing traffic assist is active), 25=I_C06_VEHACCEL_X_AS_ACTV_DRV_AWAY_ACTV (DRV_AWAY_ACTV) (Drive away assist is active), 26=I_C06_VEHACCEL_X_AS_ACTV_PARK_PLUS_BRK_ACTV (PARK_PLUS_BRK_ACTV) (Parktronic Plus Brake is active), 27=I_C06_VEHACCEL_X_AS_ACTV_TBCC_LO_ACCEL_ACTV (TBCC_LO_ACCEL_ACTV) (TBCC acceleration low prio is active), 28=I_C06_VEHACCEL_X_AS_ACTV_TBCC_HI_ACCEL_ACTV (TBCC_HI_ACCEL_ACTV) (TBCC acceleration high prio is active), 29=I_C06_VEHACCEL_X_AS_ACTV_TBCC_HI_TRQ_ACTV (TBCC_HI_TRQ_ACTV) (TBCC torque high prio is active), 30=I_C06_VEHACCEL_X_AS_ACTV_TBCC_LO_TRQ_ACTV (TBCC_LO_TRQ_ACTV) (TBCC torque low prio is active), 63=I_C06_VEHACCEL_X_AS_ACTV_SNA (SNA) (SNA value from data type)}
      lower-limit=0
      upper-limit=63
      invalid-value:
        integer literal c06_VehAccel_X_AS_Actv: type=c06_VehAccel_X_AS_Actv, value=63
    c06_Week_0_60_1: base-type=uint8, compu {phys=raw for raw 0..60, 63=I_C06_WEEK_0_60_1_SNA (SNA) (SNA value from data type); unit Week}, lower-limit=0, upper-limit=63  # 06_Week_0-60_1
      invalid-value:
        integer literal c06_Week_0_60_1: type=c06_Week_0_60_1, value=63
    c07_perc_0_100_1: base-type=uint8, compu {phys=raw for raw 0..100, 127=I_C07_PERC_0_100_1_SNA (SNA) (SNA value from data type); unit %}, lower-limit=0, upper-limit=127  # 07_%_0-100_1
      invalid-value:
        integer literal c07_perc_0_100_1: type=c07_perc_0_100_1, value=127
    c07_per_0to100_1_SNA: base-type=uint8, compu {phys=raw for raw 0..100, 127=I_C07_PER_0TO100_1_SNA_SNA (SNA) (SNA value from data type); unit %}, lower-limit=0, upper-limit=127  # 07_%_0-100_1_SNA
      invalid-value:
        integer literal c07_per_0to100_1_SNA: type=c07_per_0to100_1_SNA, value=127
    c07_0_126_1_SNA: base-type=uint8, compu {phys=raw for raw 0..126, 127=I_C07_0_126_1_SNA_SNA (SNA) (SNA value from data type)}, lower-limit=0, upper-limit=127  # 07_0-126_1_SNA
      invalid-value:
        integer literal c07_0_126_1_SNA: type=c07_0_126_1_SNA, value=127
    c07_0_127_1: base-type=uint8, compu {phys=raw for raw 0..127}, lower-limit=0, upper-limit=127  # 07_0-127_1
    c07_ESP_BrkMsg_Disp_Rq:  # 07_ESP_BrkMsg_Disp_Rq
      base-type=uint8
      compu {0=I_C07_ESP_BRKMSG_DISP_RQ_IDLE (IDLE) (No request), 1=I_C07_ESP_BRKMSG_DISP_RQ_BRK_DEF_STOP (BRK_DEF_STOP) (Red "Brake defective, STOP"), 2=I_C07_ESP_BRKMSG_DISP_RQ_RED_PWR_ENG (RED_PWR_ENG) (Red "Reduced braking power, start engine"), 3=I_C07_ESP_BRKMSG_DISP_RQ_BRK_HOT (BRK_HOT) (Red "Brake overheated"), 5=I_C07_ESP_BRKMSG_DISP_RQ_RED_PWR_SRV (RED_PWR_SRV) (Red "Reduced braking power, seek service soon"), 6=I_C07_ESP_BRKMSG_DISP_RQ_SRV_MAN (SRV_MAN) (Yellow "Service, see manual"), 7=I_C07_ESP_BRKMSG_DISP_RQ_BRK_DEF_STOP_DIAG (BRK_DEF_STOP_DIAG) (Red "Brake defective, STOP, diagnostics active"), 8=I_C07_ESP_BRKMSG_DISP_RQ_BRK_DISC_WEAR_SRV (BRK_DISC_WEAR_SRV) (Yellow "Brake-disc wear, seek service soon" (only AMG)), 9=I_C07_ESP_BRKMSG_DISP_RQ_TX_P_DEF (TX_P_DEF) (Red "Parking lock defective, use parking brake" (only AMG)), 127=I_C07_ESP_BRKMSG_DISP_RQ_SNA (SNA) (SNA value from data type)}
      lower-limit=0
      upper-limit=127
      invalid-value:
        integer literal c07_ESP_BrkMsg_Disp_Rq: type=c07_ESP_BrkMsg_Disp_Rq, value=127
    c07_ESP_VDC_Msg_Disp_Rq:  # 07_ESP_VDC_Msg_Disp_Rq
      base-type=uint8
      compu {0=I_C07_ESP_VDC_MSG_DISP_RQ_IDLE (IDLE) (No request), 1=I_C07_ESP_VDC_MSG_DISP_RQ_ESP_DEF_SRV (ESP_DEF_SRV) (Yellow "ESP defective, seek service"), 2=I_C07_ESP_VDC_MSG_DISP_RQ_ESP_NA_MAN (ESP_NA_MAN) (Yellow "ESP not available, see manual"), 4=I_C07_ESP_VDC_MSG_DISP_RQ_BAS_DEF_SRV (BAS_DEF_SRV) (Yellow "BAS defective, seek service"), 13=I_C07_ESP_VDC_MSG_DISP_RQ_ESP_BAS_DEF_SRV (ESP_BAS_DEF_SRV) (Yellow "ESP+BAS defective, seek service"), 16=I_C07_ESP_VDC_MSG_DISP_RQ_ALL_DEF_SRV (ALL_DEF_SRV) (Yellow "ABS+ESP defective, seek service"), 17=I_C07_ESP_VDC_MSG_DISP_RQ_ALL_DEF_BPD_SRV (ALL_DEF_BPD_SRV) (Yellow/Red "ABS+ESP+BPD defective, seek service"), 19=I_C07_ESP_VDC_MSG_DISP_RQ_ALL_NA_DIAG (ALL_NA_DIAG) (Yellow "ABS+ESP not available, diag. test station"), 20=I_C07_ESP_VDC_MSG_DISP_RQ_ALL_NA_BPD_DIAG (ALL_NA_BPD_DIAG) (Yellow "ABS+ESP+BPD not available, diag. test station"), 22=I_C07_ESP_VDC_MSG_DISP_RQ_ALL_NA_MAN (ALL_NA_MAN) (Yellow "ABS+ESP not available, see manual"), 23=I_C07_ESP_VDC_MSG_DISP_RQ_ALL_NA_BPD (ALL_NA_BPD) (Yellow/Red "ABS+ESP+BPD not available"), 25=I_C07_ESP_VDC_MSG_DISP_RQ_ALL_TBCC (ALL_TBCC) (Yellow "Diagnost./Test Rig, Vehicle not roadworthy"), 30=I_C07_ESP_VDC_MSG_DISP_RQ_DIFF_LOCK_ACTV_ABS_ESP_NA (DIFF_LOCK_ACTV_ABS_ESP_NA) (Yellow/Red “Diff Lock active, ABS+ESP not available"), 31=I_C07_ESP_VDC_MSG_DISP_RQ_DIFF_LOCK_ACTV_ESP_NA (DIFF_LOCK_ACTV_ESP_NA) (Yellow/Red “Diff Lock active, ESP not available”), 127=I_C07_ESP_VDC_MSG_DISP_RQ_SNA (SNA) (SNA value from data type)}
      lower-limit=0
      upper-limit=127
      invalid-value:
        integer literal c07_ESP_VDC_Msg_Disp_Rq: type=c07_ESP_VDC_Msg_Disp_Rq, value=127
    c08_perc_0_100_0k3922_nSNA: base-type=uint8, compu {phys=raw*0.3921568627; unit %}, lower-limit=0, upper-limit=255  # 08_%_0-100_0,3922_w/o_SNA
    c08_perc_0_100_0k4: base-type=uint8, compu {phys=raw*0.4 for raw 0..250, 255=I_C08_PERC_0_100_0K4_SNA (SNA) (SNA value from data type); unit %}, lower-limit=0, upper-limit=255  # 08_%_0-100_0,4
      invalid-value:
        integer literal c08_perc_0_100_0k4: type=c08_perc_0_100_0k4, value=255
    c08_perc_0_100_0k5: base-type=uint8, compu {phys=raw*0.5 for raw 0..200, 255=I_C08_PERC_0_100_0K5_SNA (SNA) (SNA value from data type); unit %}, lower-limit=0, upper-limit=255  # 08_%_0-100_0,5
      invalid-value:
        integer literal c08_perc_0_100_0k5: type=c08_perc_0_100_0k5, value=255
    c08_perc_0_100_1: base-type=uint8, compu {phys=raw for raw 0..100, 255=I_C08_PERC_0_100_1_SNA (SNA) (SNA value from data type); unit %}, lower-limit=0, upper-limit=255  # 08_%_0-100_1
      invalid-value:
        integer literal c08_perc_0_100_1: type=c08_perc_0_100_1, value=255
    c08_0k5_3_0k01: base-type=uint8, compu {phys=raw*0.01+0.5 for raw 0..250, 255=I_C08_0K5_3_0K01_SNA (SNA) (SNA value from data type)}, lower-limit=0, upper-limit=255  # 08_0,5-3_0,01
      invalid-value:
        integer literal c08_0k5_3_0k01: type=c08_0k5_3_0k01, value=255
    c08_0_1k98_0k0078: base-type=uint8, compu {phys=raw*0.007795275591 for raw 0..254, 255=I_C08_0_1K98_0K0078_SNA (SNA) (SNA value from data type)}, lower-limit=0, upper-limit=255  # 08_0-1,98_0,0078
      invalid-value:
        integer literal c08_0_1k98_0k0078: type=c08_0_1k98_0k0078, value=255
    c08_0_200_1: base-type=uint8, compu {phys=raw for raw 0..200, 255=I_C08_0_200_1_SNA (SNA) (SNA value from data type)}, lower-limit=0, upper-limit=255  # 08_0-200_1
      invalid-value:
        integer literal c08_0_200_1: type=c08_0_200_1, value=255
    c08_0_254_1: base-type=uint8, compu {phys=raw for raw 0..254, 255=I_C08_0_254_1_SNA (SNA) (SNA value from data type)}, lower-limit=0, upper-limit=255  # 08_0-254_1
      invalid-value:
        integer literal c08_0_254_1: type=c08_0_254_1, value=255
    c08_0_255_1_SNA_na: base-type=uint8, compu {phys=raw}, lower-limit=0, upper-limit=255  # 08_0-255_1_SNA=-
    c08_1_6_0k01969: base-type=uint8, compu {phys=raw*0.01968503937+1 for raw 0..254, 255=I_C08_1_6_0K01969_SNA (SNA) (SNA value from data type)}, lower-limit=0, upper-limit=255  # 08_1-6_0,01969
      invalid-value:
        integer literal c08_1_6_0k01969: type=c08_1_6_0k01969, value=255
    c08_A_0_12k7_0k05: base-type=uint8, compu {phys=raw*0.05 for raw 0..254, 255=I_C08_A_0_12K7_0K05_SNA (SNA) (SNA value from data type); unit A}, lower-limit=0, upper-limit=255  # 08_A_0-12,7_0,05
      invalid-value:
        integer literal c08_A_0_12k7_0k05: type=c08_A_0_12k7_0k05, value=255
    c08_A_0_15_0k06: base-type=uint8, compu {phys=raw*0.06 for raw 0..250, 255=I_C08_A_0_15_0K06_SNA (SNA) (SNA value from data type); unit A}, lower-limit=0, upper-limit=255  # 08_A_0-15_0,06
      invalid-value:
        integer literal c08_A_0_15_0k06: type=c08_A_0_15_0k06, value=255
    c08_A_0_30d1_0d15: base-type=uint8, compu {phys=raw*0.15 for raw 0..254, 255=I_C08_A_0_30D1_0D15_SNA (SNA) (SNA value from data type); unit A}, lower-limit=0, upper-limit=255  # 08_A_0-38,1_0,15
      invalid-value:
        integer literal c08_A_0_30d1_0d15: type=c08_A_0_30d1_0d15, value=255
    c08_bar_0_10_0k05: base-type=uint8, compu {phys=raw*0.05 for raw 0..200, 255=I_C08_BAR_0_10_0K05_SNA (SNA) (SNA value from data type); unit bar}, lower-limit=0, upper-limit=255  # 08_bar_0-10_0,05
      invalid-value:
        integer literal c08_bar_0_10_0k05: type=c08_bar_0_10_0k05, value=255
    c08_CRC_woSNA: base-type=uint8, lower-limit=0, upper-limit=255  # 08_CRC_w/oSNA
