VERSION ""

NS_ :

BS_:

BU_: PDCM EPB LBMS GW ExternalTool

CM_ "Version:V1.0.0,Date:2023/1/4,Author:汤枝子,Review:,Approval:,Description:(ALL)First Release——基于H56b项目H56b_Matrix_总表_V4.0.2进行修改;
Version:V1.0.0,Date:2023/11/22,Author:汤枝子,Review:,Approval:,Description:(MDC/EPS)【CR0001】临时版，ADCU,EPS新增ADAS相关功能
1、ADCU新增发送报文：ADAS_LatAngCtrl（0x0D0）：ADAS_EPS_AngleCtrSts，ADAS_EPS_AngleReq，ADAS_EPS_AngleCtrValid，ADAS_EPSStrWarnReq，ADAS_AngCtrl_TrqUpprLim，ADAS_AngCtrl_TrqLowrLim，链路:ADCU—EPS(CHACANFD）
2、EPS新增发送报文：EPS_state2（0x0D1）：EPS_AngleCtrlSts，EPS_AngleCtrlAbortFeedback，EPS_AngRqOvrlDltTrqDlrd，EPS_ADAS_ControlMode，EPS_ADAS_Controlstatus，链路:EPS—ADCU(CHACANFD）;
Version:V1.0.0,Date:2023/12/29,Author:汤枝子,Review:,Approval:,Description:(MDC/EPS)【CR0001】临时版，ADCU,EPS新增ADAS相关功能——变更需求，删除本次新增内容
1、ADCU取消发送报文：ADAS_LatAngCtrl（0x0D0）：ADAS_EPS_AngleCtrSts，ADAS_EPS_AngleReq，ADAS_EPS_AngleCtrValid，ADAS_EPSStrWarnReq，ADAS_AngCtrl_TrqUpprLim，ADAS_AngCtrl_TrqLowrLim，链路:ADCU—EPS(CHACANFD）
2、EPS取消发送报文：EPS_state2（0x0D1）：EPS_AngleCtrlSts，EPS_AngleCtrlAbortFeedback，EPS_AngRqOvrlDltTrqDlrd，EPS_ADAS_ControlMode，EPS_ADAS_Controlstatus，链路:EPS—ADCU(CHACANFD）;
Version:V1.0.0,Date:2023/12/29,Author:汤枝子,Review:,Approval:,Description:(MDC/EPS)【CR0002】临时版，ADCU,EPS新增ADAS相关功能
1、EPS新增发送信号：EPS_state（0x124）：EPS_FltSts，发送方：EPS，接收方：ADCU，链路:EPS—ADCU(CHACANFD）
2、EPS备注信号：EPS_SAS（0x144）：eps_pinionAngle，备注仅N1~N4适用，发送方：EPS，接收方：GW，ASC，ADCU，EDC ，PDCM，IPB，MPC，RCR_L，链路:CHACANFD,接收方：T_BOX，链路：CHACANFD—DiagCAN
3、ADCU新增发送报文：ADAS_LateralControlSts（0x0D0）：ADS_SteerAgReq，ADS_SteerAgVld，ADS_SteerAgEna，ADS_SteerGainLevel
，ADS_SteerTqReq，ADS_SteerTqVld，ADS_SteerTqMod，ADS_SteerTqEna，ADS_LdwWarningCmd，ADS_LdwWarningCmdVld，RollingCounter0D4，Checksum0D4，备注仅N3+,N4+适用，链路:ADCU—EPS(CHACANFD）
4、EPS新增发送报文：EPS_state2（0x0D1）：EPS_TorsionBarTorqueFlt，EPS_TorsionBarTorqueFltVld,EPS_AgCtrlAvl，EPS_AgCtrlSts，EPS_TqCtrlAvl，EPS_TqCtrlSts，EPS_LdwWarnSts，EPS_SteerDrvrOvrd，EPS_SteerDrvrOvrdVld，EPS_HandsOnSts，EPS_HandsOnStsVld，EPS_AdsReqErrorFb，EPS_AbortFb，EPS_SteerMod，RollingCounter0D1，Checksum0D1，备注仅N3+,N4+适用，链路:EPS—ADCU(CHACANFD）
5、EPS新增发送报文：EPS_state3（0x0D2）：EPS_AsscMotCrtTq，EPS_AsscMotCrtTqVld，EPS_Tq1，EPS_Tq2，RollingCounter0D2，Checksum0D2，备注仅N3+,N4+适用，链路:EPS—ADCU(CHACANFD）
6、EPS新增发送报文：EPS_Pinionangle（0x0D3）：EPS_SteerPinionAg，EPS_SteerPinionAgVld，EPS_SteerPinionAgRate，EPS_SteerPinionAgRateVld，RollingCounter0D3，Checksum0D3，备注仅N3+,N4+适用，链路:EPS—ADCU(CHACANFD）;
Version:V1.0.0,Date:2024/1/9,Author:汤枝子,Review:,Approval:,Description:(MDC/EPS)【CR0003】临时版，EPS新增ADAS相关功能
1、EPS部分信号区分高低配：EPS_state（0x124）：EPS_Ctrl_AVAILABLE，EPS_TOI_ACTIVE，EPS_TOI_TorFeedback，EPS_TOI_FAULT，EPS_LDW_Vibration_status，EPS_ApaControlSts，EPS_ApaControlFaultSts，以上信号仅低配适用，华为高配版不适用，发送方：EPS，接收方：ADCU，链路:EPS—ADCU(CHACANFD）
2、EPS新增信号：EPS_state2（0x0D1）：EPS_LdwWarnAvl，报文备注为仅高配适用，发送方：EPS，接收方：ADCU，链路:CHACANFD,接收方：T_BOX，链路：CHACANFD
3、EPS更改信号名：EPS_state2（0x0D1）：EPS_TorsionBarTorqueFlt，EPS_TorsionBarTorqueFltVld,信号名改为EPS_STR_TQR_SEN_Flt，EPS_STR_TQR_SEN_FltVld，发送方：EPS，接收方：ADCU，链路:CHACANFD
4、EPS保留信号：EPS_SAS（0x144）：eps_pinionAngle，信号备注仅低配适用，发送方：EPS，接收方：GW，ASC，ADCU，EDC ，PDCM，IPB，MPC，RCR_L，链路:CHACANFD,接收方：T_BOX，链路：CHACANFD—DiagCAN
5、EPS报文新增备注，修改信号值描述：EPS_state3（0x0D2）：EPS_Tq1，信号修改信号值描述，报文备注仅高配适用，发送方：EPS，接收方：ADCU，链路:CHACANFD
6、EPS报文新增备注，EPS_Pinionangle（0x0D3）：ALL，报文备注仅高配适用，发送方：EPS，接收方：ADCU，链路:CHACANFD;
Version:V1.0.0,Date:2024/1/12,Author:汤枝子,Review:,Approval:,Description:(MDC/IPB/GW/PDCM)【CR0004】临时版，ADAS新增相关功能——ADCU新增接收信号
1、ADCU新增接收信号：PDCM51（0x101）：PDCM_FAWhlTqReq，PDCM_FAWhlTqReqValid，PDCM_FAWhlTqActValid，PDCM_FAWhlTqAct，PDCM_frontMotorRpmValid，PDCM_frontMotorRpm，PDCM_RAWhlTqReq，PDCM_RAWhlTqReqValidPDCM_RAWhlTqActValid，PDCM_RAWhlTqAct，PDCM_rearMotRpmValid，PDCM_rearMotRpm，PDCM_AccelPedal_Virtual_Valid，PDCM_AccelPedal_Virtual，PDCM_FAWhlTqRegenMax，PDCM_FAWhlTqRegenMaxValid，PDCM_RAWhlTqRegenMaxValid，PDCM_RAWhlTqRegenMax，发送方：PDCM，接收方：ADCU，链路:PDCM—ADCU(CHACANFD）
3、ADCU新增接收信号：PDCM_IVI（0x31D）：PDCM_RemainingMileage_Standard，发送方：PDCM，接收方：ADCU，链路:PDCM—ADCU(CHACANFD）
4、ADCU新增接收信号：PDCM10（0x2C8）：PDCM_Gear_intervention，发送方：PDCM，接收方：ADCU，链路:PDCM—ADCU(CHACANFD）
5、ADCU新增接收信号：GSM1（0x309）：gsm_gearSelectorPos，gsm_gearSelectorPosValid，gsm_faultLevel，RollingCounter309，Checksum309，发送方：GSM，接收方：ADCU，链路:GSM—PDCM—ADCU(SPTCAN2—CHACANFD）
PDCM新增报文路由：GSM1（0x309）：SPTCAN2—CHACANFD（在CR0001变更中已体现）
6、ADCU新增接收信号：IPB1（0x232）：IPB_torqueIncrReqFront ，IPB_torqueIncrReqFrontSts ，IPB_torqueRedReqFrontSts ，IPB_torqueRedReqFront ，IPB_torqueIncrReqRear，IPB_torqueIncrReqRearSts，IPB_torqueRedReqRearSts，IPB_torqueRedReqRear，IPB_rbsMbRgnTgTotalValid，IPB_rbsMbRgnTgt_Total ，RollingCounter232，Checksum232，发送方：IPB，接收方：ADCU，链路:IPB—ADCU(CHACANFD）
7、ADCU新增接收信号：IPB7（0x0A0）：IPB_absFault，IPB_avhAvailable ，IPB_BDWActive ，发送方：IPB，接收方：ADCU，链路:IPB—ADCU(CHACANFD）
8、新增备注：IPB8（0x2A2）：略 ，备注仅适用低配方案，发送方：IPB，接收方：ADCU，链路:IPB—ADCU(CHACANFD）
9、ADCU新增接收信号：IPB9（0x272）：IPB_vehicleDirection，发送方：IPB，接收方：ADCU，链路:IPB—ADCU(CHACANFD）
10、ADCU新增接收信号：IPB12（0x214）：ipb_FWAWarning，IPB_BrkFricTqTotAtWhls，发送方：IPB，接收方：ADCU，链路:IPB—ADCU(CHACANFD）;
Version:V1.0.0,Date:2024/1/12,Author:汤枝子,Review:,Approval:,Description:(MDC/EPB/IPB/PDCM)【CR0004】【CR00012】临时版，ADAS新增相关功能——ADCU新增发送报文
1、ADCU新增发送报文：ADCU_VlcCtrl1（0x0D7）：
ADS_ACC_Ax，ADS_BrkTarTq，ADS_BrkTarTqVld，ADS_BrkTarTqEna，ADS_BrkTarTqMod，ADS_BrakeFxActuation，ADS_AebBrkTarTq，ADS_AebBrkTarTqVld，ADS_AebBrkTarTqEna，ADS_AEBAxCtrlReq，ADS_AEB_BrkTarAxVld，ADS_AEB_BrkTarAx，ADS_AebPreFillEna，ADS_AwbActvEna，ADS_ElecBrkFnSwitch，ADS_dycEscTarTq，ADS_dycEscTarTqfactor，ADS_dycEscTarTqVld，ADS_dycEscTarTqEna，ADS_BrkHoldReq，ADS_EpbModReq，ADS_EpbModena，ADS_EpbModReqVld，ADS_RWUena，ADS_RWUVLD，RollingCounter0D7，Checksum0D7，仅高配适用，发送方：ADCU，接收方：EPB,IPB，链路:ADCU—EPB,IPB(CHACANFD）
2、ADCU新增发送报文：ADCU_VlcCtrl2（0x0D8）：ADS_DrvTarTq，ADS_DrvTarTqVld，ADS_DrvTarTqEna，ADS_DrvTarTqMod，ADS_Total Ref Torque，ADS_RapidRespEna，ADS TarGearReq，ADS_TarGearReqVld，ADS GearCtrlEna，ADAS_FctSts，ADS MotTarSpd，ADS MotSpdCtrlEna，ADS MotCtrlTar，ADS MotTarMod，ADS MotTqLimMin，ADS_MotTqLimMax，ADS_MotTqRateLimMin，ADS_MotTqRateLimMax，ADS_TqUnloadEna，ADS_TqUnloadRate，ADS_MotTarSpdSvValid，ADS_ElecBrkFnSwitch，RollingCounter0D8，Checksum0D8，
仅高配适用，发送方：ADCU，接收方：PDCM，链路:ADCU—PDCM(CHACANFD）;
Version:V1.0.0,Date:2024/1/12,Author:汤枝子,Review:,Approval:,Description:(IPB/PDCM/MDC)【CR0004】临时版，ADAS新增相关功能——PDCM,IPB新增发送信号
1、PDCM新增发送报文：PDCM62（0x0D4）：PDCM_DriverTorqueDesired，PDCM_VehWhlActTq，PDCM_VehWhlActTqVldPDCM_VehWhlReqTq，PDCM_VehWhlReqTqVld，PDCM_PtRgnTqMax，PDCM_PtRgnTqMaxVld，PDCM_PtElecTqMax，PDCM_PtElecTqMaxVld，PDCM_GearShiftAvl，PDCM_PtTqAvl，PDCM_PtTqActvSts，PDCM_MCUModActvSt，PDCM_MCUBlkSt，PDCM_SpdSvModAvl，PDCM_MCUStandstill，PDCM_MCUSpdSVModFlt，PDCM_MCUVehSldSt，PDCM_MCUReqTq，PDCM_ErrorFb，RollingCounter0D4，Checksum0D4，发送方：PDCM，接收方：ADCU，链路:PDCM—ADCU(CHACANFD）——此报文仅高配适用
2、新增备注：IPB8（0x2A2）：略 ，备注仅适用低配方案，发送方：IPB，接收方：ADCU，链路:IPB—ADCU(CHACANFD）
3、IPB新增发送报文：IPB14（0x0D5）：IPB_BrkTqCtrlAvlDriving，IPB_BrkTqCtrlAvlParking，IPB_BrkTqCtrlActv，IPB_AebBrkTqAvl，IPB_AebBrkTqActv，IPB_DrvrBrkOvrd，IPB_DrvrBrkOvrdVld，IPB_errorFb，RollingCounter0D5，Checksum0D5，发送方：IPB，接收方：ADCU，链路:IPB—ADCU(CHACANFD）
4、IPB新增发送报文：IPB15（0x0D6）：IPB_DrvrTqDes，IPB_HydBrkReqTq，IPB_BrkActvTq，IPB_dycEscTarTqCtrlAvl，IPB_dycEscTarTqActv，RollingCounter0D6，Checksum0D6，发送方：IPB，接收方：ADCU，链路:IPB—ADCU(CHACANFD）
5、新增备注：IPB_apaSet（0x242）：略 ，备注仅适用低配方案，发送方：IPB，接收方：ADCU，链路:IPB—ADCU(CHACANFD）;
Version:V1.0.0,Date:2024/1/12,Author:汤枝子,Review:,Approval:,Description:(MDC/EPB)【CR0004】临时版，ADAS新增相关功能——EPB新增发送信号
1、EPB新增发送信号：EPBM_state（0x12A）：EPB_EcdActvSts，EPB_RwuAvl，EPB_EpbAvl，仅高配适用，发送方：EPB，接收方：ADCU，链路:EPB—ADCU(CHACANFD）;
Version:V1.0.0,Date:2024/1/12,Author:汤枝子,Review:,Approval:,Description:(MDC/EPB)【CR0005】临时版，ADAS新增相关功能——PDCM新增发送报文
1、PDCM新增发送报文：PDCM63（0x1AB）：
PDCM_MCURTqLimMin，PDCM_MCURTqLimMax，PDCM_MCURTqRateLimMin，PDCM_MCURTqRateLimMax，PDCM_MCURTqUnloadRate，PDCM_MCURTqUnloadEna，PDCM_MCURTarSpdSvValid，RollingCounter1AB，Checksum1AB，
，仅高配适用，发送方：PDCM，接收方：MCUR，链路:PDCM—MCUR(SPTCAN2）;
Version:V1.0.0,Date:2024/1/17,Author:汤枝子,Review:,Approval:,Description:(PDCM/MDC/IPB/EPB)【CR0006】临时版，ADAS新增相关功能——校对修改部分问题
1、PDCM修改信号：PDCM62（0x0D4）：略，部分信号修改信号值描述，新增单位等，发送方：PDCM，接收方：ADCU，链路:PDCM—ADCU(CHACANFD）——此报文仅高配适用

2、ADCU新增接收信号：GSM1（0x309）：gsm_lever_position,发送方：GSM，接收方：ADCU，链路:GSM—PDCM—GW—ADCU(SPTCAN2—PTCAN—CHACANFD）同上，路由链路待定
3、IPB修改信号内容：IPB14（0x0D5）：略，修改部分信号信号长度，信号描述，信号值描述，起始位等，发送方：IPB，接收方：ADCU，链路:IPB—ADCU(CHACANFD）
4、PDCM新增接收信号：EPBM_state（0x12A）：EPBM_BrakeSwInfo，发送方：EPB，接收方：ADCU，链路：EPB—ADCU（CHACANFD）
5、ADCU修改信号内容：ADCU_VlcCtrl1（0x0D7）：修改部分信号信号长度，信号起始位，信号值描述，删除信号ADS_ACC_Ax，ADS_dycEscTarTqfactor，新增信号ADS_DriverPresent，发送方：ADCU，接收方：EPB,IPB，链路:ADCU—EPB,IPB(CHACANFD）
6、ADCU修改信号内容：ADCU_VlcCtrl2（0x0D8）：修改部分信号信号长度，信号值描述，发送方：ADCU，接收方：EPB,IPB，链路:ADCU—EPB,IPB(CHACANFD）;
Version:V1.0.0,Date:2024/1/17,Author:汤枝子,Review:,Approval:,Description:(PDCM/MCUR)【CR0007】临时版，ADAS新增相关功能——校对修改部分问题
1、PDCM修改信号：PDCM63（0x1AB）：PDCM_MCURTqLimMax，PDCM_MCURTqRateLimMax,修改信号描述与初始值，发送方：PDCM，接收方：MCUR，链路:PDCM—MCUR(SPTCAN2）;
Version:V1.0.0,Date:2024/1/17,Author:汤枝子,Review:,Approval:,Description:(MDC/EPS)【CR0008】临时版，ADAS新增相关功能——EPS校对修改部分问题
1、PDCM修改信号：EPS_state2（0x0D1）：EPS_AdsReqErrorFb,修改信号值描述，发送方：EPS，接收方：ADCU，链路:EPS—ADCU(CHACANFD）;
Version:V1.0.0,Date:2024/1/17,Author:汤枝子,Review:,Approval:,Description:(MDC/IPB)【CR0009】临时版，ADAS新增相关功能——校对修改部分问题
1、ADCU修改信号：ADCU_VlcCtrl1（0x0D1）：ADS_dycEscTarTq，信号描述改为ESC目标横摆力矩（从车顶向下，逆时针为正），发送方：ADCU，接收方：IPB，链路:ADCU—IPB(CHACANFD）
2、IPB删除信号：IPB15（0x0D6）：删除信号IPB_HydBrkReqTq，发送方：IPB，接收方：ADCU，链路：IPB—ADCU（CHACANFD）
3、IPB修改信号内容：IPB15（0x0D6）：修改信号IPB_DrvrTqDes，IPB_BrkActvTq偏移量及范围，发送方：IPB，接收方：ADCU，链路：IPB—ADCU（CHACANFD）;
Version:V1.0.0,Date:2024/1/18,Author:汤枝子,Review:,Approval:,Description:(MDC/IPB/EPS)【CR00010】临时版，ADAS新增相关功能——校对修改部分问题
1、ADCU新增信号：IPB7（0x0A0）：IPB_ebdFault ，IPB_ebd_active，发送方：IPB，接收方：ADCU，链路:IPB—ADCU（CHACANFD）
2、ADCU新增信号：IPB9（0x272）：IPB_sumOfEdgeFLWSS ，IPB_sumOfEdgeFRWSS，IPB_sumOfEdgeFLWSSValid，IPB_sumOfEdgeFRWSSValid，发送方：IPB，接收方：ADCU，链路:IPB—ADCU（CHACANFD）
3、ADCU新增信号：IPB10（0x282）：IPB_sumOfEdgeRLWSS，IPB_sumOfEdgeRRWSS，IPB_sumOfEdgeRLWSSValid，IPB_sumOfEdgeRRWSSValid发送方：IPB，接收方：ADCU，链路:IPB—ADCU（CHACANFD）
4、IPB修改信号内容：IPB14（0x0D5）：修改信号IPB_AebBrkTqActv，信号长度，物理最大值，发送方：IPB，接收方：ADCU，链路：IPB—ADCU（CHACANFD）
5、ADCU修改信号：ADCU_VlcCtrl1（0x0D7）：ADS_AebBrkTarTq，信号描述修改，发送方：ADCU，接收方：IPB，链路:ADCU—IPB(CHACANFD）
6、ADCU修改信号：ADAS_LateralControlSts（0x0D0）：ADS_SteerGainLevel，总线最大值更改，发送方：ADCU，接收方：EPS，链路:ADCU—EPS(CHACANFD）;
Version:V1.0.0,Date:2024/1/23,Author:汤枝子,Review:,Approval:,Description:(MDC/IPB/EPS)【CR00011】临时版，ADAS新增相关功能
1、ADCU新增接收信号：PDCM51（0x101）：PDCM_FAWhlTqMax，PDCM_RAWhlTqMax，发送方：PDCM，接收方：ADCU，链路:PDCM—ADCU(CHACANFD）
2、PDCM新增发送信号并更改报文长度：PDCM62（0x0D4）：PDCM_TotalWhlTqMax，PDCM_TotalWhlTqMaxVld，PDCM_TotalWhlTqRegenMax，PDCM_TotalWhlTqRegenMaxVld，报文长度由16改为32，CRC信号位置更改，发送方：PDCM，接收方：ADCU，链路:PDCM—ADCU(CHACANFD）;
Version:V1.0.0,Date:2024/2/4,Author:汤枝子,Review:H56C全配置,Approval:,Description:(PDCM/GW/SWM/MDC)【CR0005】怀挡方案，GSM，SWM合并为SWM
1、PDCM新增报文路由：SWM_Set（0x320）：SPTCAN2—PTCANFD
2、GW新增报文路由：SWM_Set（0x320）：PTCANFD—BDCAN
3、PDCM新增报文路由：DiagReq_SWM（0x719）：PTCANFD—SPTCAN2
4、GW新增报文路由：DiagReq_SWM（0x719）：DiagCAN—PTCANFD
5、PDCM新增报文路由：DiagResp_SWM（0x799）：SPTCAN2—PTCANFD
6、GW新增报文路由：DiagResp_SWM（0x799）：PTCANFD—DiagCAN
2、GW新增信号路由：SWM_Set（0x320）—SWM_Set（0x319）：PTCANFD—CHACANFD，PTCANFD—INFOCAN
7、SWM新增发送信号：GSM1（0x309）：SWM_GearShiftLvlPosn，SWM_PBtnSts，发送方：SWM，接收方：MDC，链路:SWM—MDC（SPTCAN2—CHACANFD）;
Version:V1.0.0,Date:2024/2/5,Author:汤枝子,Review:H56C全配置,Approval:,Description:(MDC/IPB/EPB/PDCM/AVM/T_BOX/SWM/IVI/GW)【CR00001】EPBM需求—CHACANFD
1、EPB删除发送信号：EPBM_state（0x12A）：EPBM_BrakeSwInfo，发送方：EPB，接收方：MDC，PDCM，IPB，链路:EPB—MDC,PDCM,IPB,AVM,T_BOX,(CHACANFD/INFOCAN/DiagCAN）
2、EPB新增发送信号：EPBM_state（0x12A）：EPBM_IGNStatus，EPBM_RollerBenchActive ，EPBM_MotorCurrentLeft，EPB_RwuAvl，EPB_EpbAvl，EPBM_MotorCurrentLeft，发送方：EPB，接收方：MDC，链路:EPB—MDC(CHACANFD)
2、IVI新增发送报文：IVI_chassisSet2（0x278）：ivi_EPBSwitchSet，发送方：IVI，接收方：EPB，链路:IVI—EPB(INFOCAN—CHACANFD）
3、GW新增报文路由：IVI_chassisSet2（0x278）：INFOCAN—CHACANFD
4、SWM新增发送信号：GSM1（0x309）：swm_epb_switch，swm_epb_switch_status，发送方：SWM，接收方：EPB，链路:SWM—EPB（SPTCAN2—CHACANFD）
5、PDCM新增报文路由：GSM1（0x309）：SPTCAN2—CHACANFD;
Version:V1.0.0,Date:2024/2/5,Author:汤枝子,Review:H56C全配置,Approval:,Description:(MDC/IPB/EPB/PDCM/AVM/T_BOX/SWM/GW/IVI)【CR00002】EPBS需求—PTCANFD
1、EPB删除发送信号：EPBS_state（0x12C）：EPBS_BrakeSwInfo，发送方：EPB，接收方：MDC，PDCM，IPB，链路:EPB—MDC,PDCM,IPB,AVM,T_BOX,(PTCANFD/INFOCAN/DiagCAN）
2、EPB新增发送信号：EPBS_state（0x12C）：EPBS_SupplyVoltageRight，EPBS_IGNStatus ，EPBS_RollerBenchActive ，EPBS_EcdActvSts，EPBS_RwuAvl，EPBS_EpbAvl，EPBS_ApplyReleaseRuqest，EPBS_MotorCurrentRight，发送方：EPB，接收方：无，链路:无
2、EPB新增接收信号：IVI_chassisSet2（0x278）：ivi_EPBSwitchSet，发送方：IVI，接收方：EPB，链路:IVI—EPB(INFOCAN—PTCANFD）
3、GW新增报文路由：IVI_chassisSet2（0x278）：INFOCAN—PTCANFD
4、SWM新增发送信号：GSM1（0x309）：swm_epb_switch，swm_epb_switch_status，发送方：SWM，接收方：EPB，链路:SWM—EPB（SPTCAN2—PTCANFD）;
Version:V1.0.0,Date:2024/2/5,Author:汤枝子,Review:H56C全配置,Approval:,Description:(IVI/ISC)【CR00003】ISC需求
1、IVI新增发送信号：IVI_chassisSet2（0x278）：IVI_ASC_SpedAjustSet，发送方：IVI，接收方：ISC，链路:IVI—ISC(INFOCAN—CHACANFD）
2、ASC新增发送信号：ASC_state1（0x341）：ASC_SpedAjustSetFb，ASC_SusTempUnadjustableReason ，发送方：ASC，接收方：IVI，链路:ASC—IVI（CHACANFD—INFOCAN）;
Version:V1.0.0,Date:2024/2/5,Author:汤枝子,Review:H56C全配置,Approval:,Description:(PDCM/GW/AC/T-BOX)【CR00006】PDCM水冷需求
1、PDCM取消发送信号：PDCM2（0x368）：TM_Pump4_ActFlowRate，发送方：PDCM，接收方：AC，T_BOX，链路:PDCM—AC,T_BOX(PTCANFD—CFCAN/DiagCAN）——H56系列全系取消发送
2、PDCM新增发送信号：PDCM2（0x368）：TM_3WayValve3_status，发送方：PDCM，接收方：T_BOX，链路:PDCM—T_BOX(PTCANFD—DiagCAN）
3、IVI新增发送信号：IVI_chassisSet2（0x278）：IVI_8295ChipTemp，发送方：IVI，接收方：PDCM，T_BOX，链路:IVI—PDCM,T_BOX(INFOCAN—PTCANFD/DiagCAN）
4、GW新增报文路由：IVI_chassisSet2（0x278）：INFOCAN—DiagCAN;
Version:V1.0.0,Date:2024/2/5,Author:汤枝子,Review:H56C全配置,Approval:,Description:(LBMS/PDCM/T-BOX/GW)【CR00007】新增节点LBMS
1、LBMS新增发送报文：LBMS_State1（0x345），LBMS_State1（0x345），LBMS_State2（0x346），LBMS_WakeupState（0x580），LBMS_FaultState1（0x581），LBMS_FaultState2（0x582），NM_LBMS（0x66A），发送方：LBMS，接收方：PDCM，链路：LBMS—PDCM（PTCANFD）
2、LBMS新增发送报文：DiagResp_LBMS（0x7CE），发送方：LBMS，接收方：T_BOX，链路：LBMS—T_BOX（PTCANFD—DiagCAN）
3、T_BOX新增发送报文：DiagReq_LBMS（0x74E），发送方：T_BOX，接收方：LBMS，链路：T_BOX—LBMS（DiagCAN—PTCANFD）
4、GW新增报文路由：DiagResp_LBMS（0x7CE）：PTCANFD—DiagCAN
5、GW新增报文路由：DiagReq_LBMS（0x74E）：DiagCAN—PTCANFD
6、PDCM新增报文路由：OBC7（0x2E6）：SPTCAN1—PTCANFD
7、GW新增报文路由：ACU_state（0x380）：CHACANFD—PTCANFD
8、LBMS新增接收报文：DiagReq_FUN（0x7DF），IPB7（0x0A0），BCM_peps（0x2C1），OBC7（0x2E6），BMS9（0x2D7），ACU_state（0x380），IVI_timeAndGPS（0x3FE），链路：PTCAN;
Version:V1.0.0,Date:2024/2/6,Author:汤枝子,Review:H56C全配置,Approval:,Description:(BCM/MDC/GW)【CR00008】BCM新增MDC需求
1、BCM新增发送信号：BCM_state4（0x422）：bcm_hazardLight_SW_Sts，发送方：BCM，接收方：MDC，链路：BCM—GW—MDC（BDCAN—CHACANFD）
2、GW新增信号路由：BCM_state4（0x422）—GW_BCM_DCU_CHA：bcm_hazardLight_SW_Sts，BDCAN—CHACANFD
取消此变更;
Version:V1.0.0,Date:2024/2/6,Author:汤枝子,Review:H56C全配置,Approval:,Description:(EMS/IVI)【CR00009】EMS新增油量阻值需求
1、EMS新增发送信号：EMS9（0x46C）：EMS_FuelResistanceValue，发送方：EMS，接收方：IVI，链路：EMS—GW—IVI（SPTCAN2—PTCANFD—INFOCAN）;
Version:V1.0.0,Date:2024/2/6,Author:汤枝子,Review:H56C全配置,Approval:,Description:(AC/MMB)【CR00011】新增节点冰箱—MMB
1、AC新增发送报文：AC_Fridge_Req（0x41D）：略，发送方：AC，接收方：MMB，链路：AC—MMB（CFCAN）
2、MMB新增发送报文：MMB_Fridge_St（0x41E）：略，发送方：MMB，接收方：AC，链路：MMB—AC（CFCAN）;
Version:V1.0.0,Date:2024/2/6,Author:汤枝子,Review:H56C全配置,Approval:,Description:(GW/MDC)【CR00012】新增降雨强度信号
1、GW新增发送信号：GW_LIN_CHA（0x3EA）：RLS_RainfallLevel，发送方：RLS(GW)，接收方：MDC，链路：RLS—MDC（GWLIN2—CHACANFD）(删除此链路，改为PTCAN接收);
Version:V1.0.0,Date:2024/2/6,Author:汤枝子,Review:H56C全配置,Approval:,Description:(ISC)【拓扑差异】ASC和EDC合并为ISC
1、EDC收发的信号和报文，改为ASC发送;
Version:V1.0.0,Date:2024/2/6,Author:汤枝子,Review:H56C全配置,Approval:,Description:(GW/T_BOX)【CR0013】T_BOX新增接收KL15信号
1、T_BOX新增接收信号：PDCM1（0x285）：PDCM_KL15DelayAllow，发送节点：PDCM，接收节点：T_BOX，链路:PDCM—GW—T_BOX(PTCAN—DiagCAN)
2、T_BOX新增接收信号：BCM_peps（0x2C1）：BCM_KL15RelayReq，发送节点：BCM，接收节点：T_BOX，链路BCM—GW—PDCM(BDCAN—DiagCAN);
Version:V1.0.0,Date:2024/2/6,Author:汤枝子,Review:,Approval:,Description:(MPC/IVI/ISC/T_BOX)【拓扑变更】删除MPC
1、删除报文MPC1（0x33B）：ALL，发送方：MPC，接收方：IVI，链路：CHACANFD—INFOCAN
2、删除报文MPC2（0x09D）：ALL，发送方：MPC，接收方：ISC，链路：CHACANFD
3、删除报文DiagResp_MPC（0x7AA）：ALL，发送方：MPC，接收方：T_BOX，链路：CHACANFD—DiagCAN
4、删除报文DiagResp_FRM（0x791）：ALL，发送方：MPC，接收方：T_BOX，链路：CHACANFD—DiagCAN
5、删除报文DiagReq_MPC（0x72A）：ALL，发送方：T_BOX，接收方：MPC，链路：DiagCAN—CHACANFD
6、删除报文DiagReq_FRM（0x711）：ALL，发送方：T_BOX，接收方：MPC，链路：DiagCAN—CHACANFD
7、删除报文路由：MPC1（0x33B）：CHACANFD—INFOCAN
8、删除报文路由：DiagResp_MPC（0x7AA）：CHACANFD—DiagCAN
9、删除报文路由：DiagResp_FRM（0x791）：CHACANFD—DiagCAN
10、删除报文路由：DiagReq_MPC（0x72A）：DiagCAN—CHACANFD
11、删除报文路由：DiagReq_FRM（0x711）：DiagCAN—CHACANFD;
Version:V1.0.0,Date:2024/2/6,Author:汤枝子,Review:,Approval:,Description:(IVI/GW/T_BOX/RCR_L/DCU_FR/DCU_FL/AVM/APA)【拓扑变更】删除RCR_L
1、删除报文RCR_Control_01（0x293）：ALL，发送方：RCR_L，接收方：IVI，BCM,DCU,AVM,APA，链路：CHACANFD—INFOCAN/BDCAN
2、删除报文DiagResp_RCR_L（0x794）：ALL，发送方：RCR_L，接收方：T_BOX，链路：CHACANFD—DiagCAN
3、删除报文DiagReq_RCR_L（0x714）：ALL，发送方：T_BOX，接收方：MPC，链路：DiagCAN—CHACANFD
4、删除报文路由：RCR_Control_01（0x293）：CHACANFD—INFOCAN/BDCAN/DiagCAN
5、删除报文路由：DiagResp_RCR_L（0x794）：CHACANFD—DiagCAN
6、删除报文路由：DiagReq_RCR_L（0x714）：DiagCAN—CHACANFD;
Version:V1.0.0,Date:2024/2/6,Author:汤枝子,Review:,Approval:,Description:(ADCU/GW/T_BOX)【拓扑变更】删除ADCU，新增MDC
1、删除接收报文Navi_Information1（0x308）,Navi_Information2（0x30A）,Navi_Information3（0x30D）：ALL，发送方：IVI，接收方：ADCU，链路：INFOCANFD—INFOCAN
2、删除报文DiagResp_ADCU（0x7B6）：ALL，发送方：ADCU，接收方：T_BOX，链路：CHACANFD—DiagCAN
3、删除报文DiagReq_ADCU（0x736）：ALL，发送方：ADCU，接收方：MPC，链路：DiagCAN—CHACANFD
5、删除报文路由：DiagResp_ADCU（0x7B6）：CHACANFD—DiagCAN
6、删除报文路由：DiagReq_ADCU（0x736）：DiagCAN—CHACANFD;
Version:V1.0.0,Date:2024/2/6,Author:汤枝子,Review:,Approval:,Description:(ADCU/GW/T_BOX)【拓扑变更】IVI挪动PTCANFD上，更名为CDC
1、IVI发送报文挪动到PTCAN上:ICM_state（0x3A9），ICM_Response：（0x3AB ），IVI_control：（0x075）,IVI_pwrSet：（0x0A5），IVI_chassisSet：（0x1BE），IVI_chassisSet2：（0x278），IVI_ACHCMCtrl：（0x1D7），IVI_SCUCtrl：（0x1D8），IVI_SCUCtrl2：（0x419），IVI_MemrySet1（0x1D9）， IVI_MemrySet2（0x1DA），IVI_MemrySet3（0x1DB）,IVI_BodySet1（0x1DC），IVI_BodySet2（0x1DD），IVI_infoSet（0x0C5），IVI_icmSet（0x105），IVI_AVMSet（0x10E），IVI_ampSet（0x11E），IC_state（0x2FE），IC_state1 0x482），IC_state2 （0x492），IC_info （0x3F3），IC_info1 （0x3F4），IC_TripInfo（0x4F0），IC_SinceLastInfor （0x4F1），IC_PowerConsumInfo（0x3F5），IVI_timeAndGPS （0x3FE），IVI_StatusAndNotify（0x495），Navi_Information1 （0x308），Navi_Information2 （0x30A），Navi_Information3 （0x30D），NM_IVI:（0x625），NM_ICM:（0x609）DiagReq_IVI:（0x725），DiagResp_IVI:(0x7A5），DiagResp_ICM:(0x789)，再删除和PTCAN上重复的部分
2、新增报文路由，IVI所接收报文如在PTCAN上没有，新增到PTCAN上的路由——GW Rounting Table
3、调整IVI报文路由的源网段，IVI发送报文的源网段由INFOCAN改为PTCAN——GW Rounting Table
4，原INFOCAN上删除IVI节点及其发送报文，接收报文暂时保留，路由也保留（PPC阶段预留）;
Version:V1.0.0,Date:2024/2/7,Author:汤枝子,Review:,Approval:,Description:(MDC/GW)【CR00025】【CR00036】MDC接收需求—BCM——MDC接收信号改为PTCAN接收，并报文路由
1、MDC新增接收信号：BCM_state1（0x2A3）：bcm_hoodSts，bcm_antiTheftSts，bcm_hazardLightSts，bcm_lowBeamSts，bcm_highBeamSts，bcm_rearFogLampSts，BCM_AutolightSts，BCM_StoplampSts，发送方：BCM，接收方：MDC，链路:BCM—MDC(BDCAN—PTCANFD）
2、MDC新增接收信号：BCM_state（0x2A1）：BCM_LeftTurnLampReq，BCM_RightTurnLampReq，发送方：BCM，接收方：MDC，链路:BCM—MDC(BDCAN—PTCANFD）
3、MDC新增接收报文：BCM_tpms（0x411）：略，发送方：BCM，接收方：MDC，链路:BCM—MDC(BDCAN—PTCANFD）
4、MDC新增接收报文：BCM_tpms1（0x421）：略，发送方：BCM，接收方：MDC，链路:BCM—MDC(BDCAN—PTCANFD）
5、MDC新增信号报文：BCM_peps（0x2C1）：bcm_pepsPowerMode，发送方：BCM，接收方：MDC，链路:BCM—MDC(BDCAN—PTCANFD）
6、 新增BDCAN—PTCAN的路由：
BCM_state1（0x2A3）,BCM_state（0x2A1）,BCM_tpms（0x411）,BCM_tpms1（0x421）;
Version:V1.0.0,Date:2024/2/7,Author:汤枝子,Review:,Approval:,Description:(MDC/GW)【CR00025】【CR00036】MDC接收需求—DCU
1、MDC新增接收信号：DCU_FL1（0x3E7）：DCU_FL_doorFLSts，发送方：DCU，接收方：MDC，链路:DCU—MDC(BDCAN—PTCAN）
2、MDC新增接收信号：DCU_FR（0x3E9）：DCU_FR_doorFRSts，DCU_FR_FRWindowStatus，DCU_FR_MirrorFold_UnfoldSts，发送方：DCU，接收方：MDC，链路:DCU—MDC(BDCAN—PTCAN）
3、MDC新增接收信号：DCU_FL2（0x3E8）：DCU_FL_FLWindowStatus，DCU_FL_MirrorFold_UnfoldSts，发送方：DCU，接收方：MDC，链路:DCU—MDC(BDCAN—PTCAN））
4、MDC新增接收信号：DCU_RL（0x3F7）：DCU_RL_RLWindowStatus，发送方：DCU，接收方：MDC，链路:DCU—MDC(BDCAN—PTCAN）
5、MDC新增接收信号：DCU_RR（0x3F9）：DCU_RR_RRWindowStatus，发送方：DCU，接收方：MDC，链路:DCU—MDC(BDCAN—PTCAN）
6、新增BDCAN—PTCAN的路由：
DCU_FL1（0x3E7），DCU_FR（0x3E9），DCU_FL2（0x3E8），DCU_RL（0x3F7），DCU_RR（0x3F9），;
Version:V1.0.0,Date:2024/2/7,Author:汤枝子,Review:,Approval:,Description:(MDC/GW)【CR00025】【CR00036】MDC接收需求—BLE
1、MDC新增接收信号：BLE_info（0x2D0）：ble_phoneLocation，发送方：BLE，接收方：MDC，链路:BLE—MDC(BDCAN—PTCAN）
2、新增BDCAN—PTCAN的路由：BLE_info（0x2D0）;
Version:V1.0.0,Date:2024/2/7,Author:汤枝子,Review:,Approval:,Description:(MDC/GW)【CR00025】【CR00036】MDC接收需求—POT
1、MDC新增接收信号：POT_state（0x394）：pot_tailgateOpenSts，发送方：POT，接收方：MDC，链路:POT—MDC(BDCAN—PTCAN）;
Version:V1.0.0,Date:2024/2/7,Author:汤枝子,Review:,Approval:,Description:(MDC/GW)【CR00025】【CR00036】MDC接收需求—PSD_R
1、MDC新增接收信号：PSD_R（0x3FB）：PSD_R_RRDoor_St，发送方：PSD_R，接收方：MDC，链路:PSD_R—MDC(BDCAN—PTCAN）;
Version:V1.0.0,Date:2024/2/7,Author:汤枝子,Review:,Approval:,Description:(MDC/GW)【CR00025】【CR00036】MDC接收需求—PSD_L
1、MDC新增接收信号：PSD_L（0x3EB）：PSD_L_RLDoor_St，发送方：PSD_L，接收方：MDC，链路:PSD_L—MDC(BDCAN—PTCAN）;
Version:V1.0.0,Date:2024/2/7,Author:汤枝子,Review:,Approval:,Description:(MDC/GW)【CR00025】【CR00036】MDC接收需求—HCM_L
1、MDC新增接收信号：HCM_L（0x100）：HCM_LeftLowBeamFault,HCM_LeftHighBeamFault,HCM_LeftTurnLampFault,，发送方：HCM_L，接收方：MDC，链路:HCM_L—MDC(CFCAN—PTCAN）
2、新增CFCAN—PTCAN的路由：HCM_L（0x100）;
Version:V1.0.0,Date:2024/2/7,Author:汤枝子,Review:,Approval:,Description:(MDC/GW)【CR00025】【CR00036】MDC接收需求—RLM_L
1、MDC新增接收信号：RLM_L（0x107）：RLM_LeftRearfogLampFault，RLM_LeftTurnLampFault，RLM_LeftStopLampFault，发送方：RLM_L，接收方：MDC，链路:RLM_L—MDC(CFCAN—PTCAN）
2、新增CFCAN—PTCAN的路由：RLM_L（0x107）;
Version:V1.0.0,Date:2024/2/7,Author:汤枝子,Review:,Approval:,Description:(MDC/GW)【CR00025】【CR00036】MDC接收需求—RLM_M
1、MDC新增接收信号：RLM_M2（0x109）：RLM_MidRightTurnLampFault,RLM_MidRightStopLampFault,RLM_MidBHighStopLampFault,发送方：RLM_M2，接收方：MDC，链路:RLM_M—MDC(CFCAN—PTCAN）
2、MDC新增接收信号：RLM_M1（0x108）：RLM_MidLeftStopLampFault,发送方：RLM_M，接收方：MDC，链路:RLM_M—MDC(CFCAN—PTCAN）
3、新增CFCAN—PTCAN的路由：RLM_M2（0x109），RLM_M1（0x108）;
Version:V1.0.0,Date:2024/2/7,Author:汤枝子,Review:,Approval:,Description:(MDC/GW)【CR00025】【CR00036】MDC接收需求—HCM_R
1、MDC新增接收信号：HCM_R（0x110）：HCM_RightLowBeamFault,HCM_RightHighBeamFault,HCM_RightTurnLampFault，发送方：HCM_L，接收方：MDC，链路:HCM_R—MDC(CFCAN—PTCAN）
2、新增CFCAN—PTCAN的路由：HCM_R（0x110）;
Version:V1.0.0,Date:2024/2/7,Author:汤枝子,Review:,Approval:,Description:(MDC/GW)【CR00025】【CR00036】MDC接收需求—RLM_R
1、MDC新增接收信号：RLM_R（0x117）：RLM_RightRearfogLampFault,RLM_RightStopLampFault,发送方：RLM_R，接收方：MDC，链路:RLM_R—MDC(CFCAN—PTCAN）
2、新增CFCAN—PTCAN的路由：RLM_R（0x117）;
Version:V1.0.0,Date:2024/2/7,Author:汤枝子,Review:,Approval:,Description:(MDC/GW)【CR00025】【CR00036】MDC接收需求—AC
1、MDC新增接收信号：AC1（0x36B）：AC_ambientTempValid,AC_ambientTemp,发送方：AC，接收方：MDC，链路:AC—MDC(CFCAN—PTCAN）
2、MDC新增接收信号：AC2（0x3A6）：AC_CabinTemp,发送方：AC，接收方：MDC，链路:AC—MDC(CFCAN—PTCAN）;
Version:V1.0.0,Date:2024/2/7,Author:汤枝子,Review:,Approval:,Description:(MDC/GW)【CR00025】【CR00036】MDC接收需求—SWM,SWS
1、MDC新增接收信号：SWS_Set（0x319）：SWM_FrontWiperSwitch,SWS_ACCRESorAdd，SWS_ACCSETorSub，SWS_ACCIntervalSub，SWS_ACCIntervalAdd，SWS_nvsSwitch，发送方：SWM/SWS，接收方：MDC，链路:GW—MDC(LIN—PTCAN）
2、MDC新增接收信号：SWM_Set（0x320）：swm_turnSW，swm_changeLaneSW，SWM_FrontWiperSwitch，链路：SWM—PDCM—MDC（SPTCAN2—PTCAN）;
Version:V1.0.0,Date:2024/2/7,Author:汤枝子,Review:,Approval:,Description:(MDC/GW)【CR00025】【CR00036】MDC接收需求—LIN需求
1、MDC新增接收信号：GW_LIN_BODY（0x3E2）：rls_WiperSpeed,srm_srPosition,rls_lightSWReason，发送方：rls，ssm，接收方：MDC，链路:GW—MDC(LIN—PTCANFD）
2、MDC新增接收信号：GW_rsm（0x3D1）：rls_windowTemp，rls_relHumidity，rls_FwBrightness，rls_AmbBrightness，rls_IRBrightness，，发送方：LIN，接收方：MDC，链路:GW—MDC(LIN—PTCAN）
3、GW新增信号路由：GW_rsm（0x3D1）见LIN_CAN路由表;
Version:V1.0.0,Date:2024/2/7,Author:汤枝子,Review:,Approval:,Description:(MDC/GW)【CR00025】【CR00036】MDC接收需求—PDCM
1、MDC新增接收信号：PDCM1（0x285）：PDCM_SOC，发送方：PDCM，接收方：MDC，链路:PDCM—MDC(PTCAN）
2、MDC新增接收信号：PDCM_IVI（0x31D）：PDCM_RemainingMileage_Real，发送方：PDCM，接收方：MDC，链路:PDCM—MDC(PTCAN）
3、MDC新增接收信号：PDCM5（0x2AA）：HVCM_ChargeState，发送方：PDCM，接收方：MDC，链路:PDCM—MDC(CHACANFD）
4、MDC新增接收信号：PDCM2（0x368）：TM_Pump1_CtrlStatus，发送方：PDCM，接收方：MDC，链路:PDCM—MDC(PTCANFD）
4、MDC新增接收信号：PDCM38（0x46F）：TM_Temp_senser_1，发送方：PDCM，接收方：MDC，链路:PDCM—MDC(PTCANFD）
3、MDC新增接收信号：PDCM6（0x2AE）：HVCM_Plug_Status，发送方：PDCM，接收方：MDC，链路:PDCM—MDC(PTCAN）;
Version:V1.0.0,Date:2024/2/7,Author:汤枝子,Review:,Approval:,Description:(MDC/GW)【CR00025】【CR00036】MDC接收需求—IC
1、MDC新增接收信号：IC_state（0x2FE）：ic_totalMileage，ic_vehicleSpeedDisp，发送方：PDCM，接收方：MDC，链路:PDCM—MDC(PTCANFD）;
Version:V1.0.0,Date:2024/2/7,Author:汤枝子,Review:,Approval:,Description:(MDC)【CR00025】【CR00036】MDC接收需求—OBC
1、MDC新增接收信号：OBC7（0x2E6）：DCDC_status，发送方：OBC，接收方：MDC，链路:OBC—PDCM—MDC(SPTCAN2—PTCANFD）;
Version:V1.0.0,Date:2024/2/7,Author:汤枝子,Review:,Approval:,Description:(MDC)【CR00025】【CR00036】MDC接收需求—ACU
1、MDC新增接收信号：ACU_state（0x380）：acu_warningLampSts,acu_driverSeatBeltStsValid,acu_driverSeatBeltSts ,acu_passengerSeatBeltSts ,acu_passengerSeatBeltStsValid ,acu_secondLeftSeatBeltSts ,acu_secondMiddleSeatBeltSts ,acu_secondRightSeatBeltSts ,acu_passengerSts ,acu_crashOutputSts ，发送方：ACU，接收方：MDC，链路:ACU—PDCM—MDC(INFOCAN—PTCAN）;
Version:V1.0.0,Date:2024/2/7,Author:汤枝子,Review:,Approval:,Description:(MDC/ISC/BLE/GW)【CR00026】MDC发送需求—ISC,BLE
1、MDC新增发送报文：MDC_ISC（0x1AE）：略，发送方：MDC，接收方：ISC，链路:MDC—ISC(CHACANFD）
2、ISC新增发送信号：ASC_state1（0x341）：ASC_OverallStatus，ASC_HeightWarning，ASC_NoAdjust，发送方：ISC，接收方：MDC，链路:ISC—MDC(CHACANFD）
3、ISC新增发送报文：ASC_state3（0x1AF）：ASC_ADSCtrlAvl，ASC_ADSCtrlRespSts，发送方：ISC，接收方：MDC，链路:ISC—MDC(CHACANFD）
4、ISC新增接收信号：BLE_APA（0x135）：BLE_PowerModeReq，发送方：BLE，接收方：ISC，链路：BLE—GW—ISC（BDCAN—CHACANFD）
5、GW新增报文路由：BLE_APA（0x135）：BDCAN—CHACANFD;
Version:V1.0.0,Date:2024/2/7,Author:汤枝子,Review:,Approval:,Description:(EPS/MDC)【CR00024】EPS补充信号初始值
1、EPS补充信号初始值：EPS_state（0x124）：详见矩阵，发送方：EPS，接收方：MDC，链路:EPS—MDC(CHACANFD）
2、EPS补充信号初始值：EPS_state2（0x0D1）：详见矩阵，发送方：EPS，接收方：MDC，链路:EPS—MDC(CHACANFD）
3、EPS补充信号初始值：EPS_state3（0x0D2）：详见矩阵，发送方：EPS，接收方：MDC，链路:EPS—MDC(CHACANFD）
4、EPS补充信号初始值：EPS_Pinionangle（0x0D3）：详见矩阵，发送方：EPS，接收方：MDC，链路:EPS—MDC(CHACANFD）;
Version:V1.0.0,Date:2024/2/7,Author:汤枝子,Review:,Approval:,Description:(BLE/MDC/GW/PDCM)【CR00027】MDC发送需求—BLE,PDCM
1、MDC新增发送报文：MDC_BLE_0（0x271）：略，发送方：MDC，接收方：PDCM，BLE,链路:MDC—PDCM/BLE(PTCANFD—BDCAN）
2、MDC新增发送报文：MDC_BLE_1（0x275）~MDC_BLE_26（0x4B6）：略，发送方：MDC，接收方：PDCM，BLE,链路:MDC—PDCM/BLE(PTCANFD—BDCAN）
3、BLE新增发送报文：BLE_MDC_1（0x4B7），BLE_MDC_2（0x4B8）：略，发送方：BLE，接收方：MDC，链路：BLE—GW—MDC（BDCAN—PTCANFD）
4、MDC新增接收信号：BCM_state2（0x3C0）：BCM_CentralLockSts，发送方：BCM，接收方：MDC,链路:BCM—MDC(BDCAN—PTCAN）
5、BLE新增接收信号：EPS_SAS（0x144）：eps_sasSteeringAngle，发送方：EPS，接收方：BLE，链路：EPS—GW—BLE（CHACANFD—BDCAN）
6、GW新增报文路由：MDC_BLE_0（0x271）~MDC_BLE_26（0x4B6）：PTCANFD—BDCAN
7、GW新增报文路由：BLE_MDC_1（0x4B7），BLE_MDC_2（0x4B8）：BDCAN—PTCANFD
8、GW新增报文路由：EPS_SAS（0x144）：CHACANFD—BDCAN;
Version:V1.0.0,Date:2024/2/7,Author:汤枝子,Review:,Approval:,Description:(T_BOX/BCM)【CR00027】MDC发送需求—T_BOX,BCM
1、T_BOX修改信号值描述：TBOX_remoteCmd（0x271）：tbox_remotePowerCtrlReq，发送方：T_BOX，接收方：BCM,链路:T_BOX—BCM(DiagCAN—BDCAN）;
Version:V1.0.0,Date:2024/2/7,Author:詹浩,Review:,Approval:,Description:(MDC/CDC)【CR0028】Body需求—MDC
1、MDC新增发送信号：Mdc_AdsWarning(0x17A)，发送方：PTCANFD-MDC，接收方PTCANFD-CDC，
2、MDC新增发送信号：Mdc_AdsRadarWarning(0x280)，发送方：PTCANFD-MDC，接收方PTCANFD-CDC，
3、MDC新增发送信号：Mdc_Ads_ActSafety(0x21D)，发送方：PTCANFD-MDC，接收方PTCANFD-CDC，;
Version:V1.0.0,Date:2024/2/7,Author:詹浩,Review:,Approval:,Description:(MDC/CDC/AMP/T_BOX/DCU_FL/DCU_FR)【CR0029】HMI需求
1、MDC新增发送信号：MDC_bodyCtl(0x286)，发送方：PTCANFD-MDC
2、MDC新增发送信号：MDC_PwrCtl(0x276)，发送方：PTCANFD-MDC
3、GW新增报文路由：MDC_bodyCtl(0x286) PTCANFD->BDCAN
4、GW新增报文路由：MDC_PwrCtl(0x276) PTCANFD->BDCAN
5、GW新增信号路由：PTCANFD：MDC_bodyCtl(0x286):MDC_AVAS_Req 路由至INFOCAN：GW_PT_INFO(0x388)：MDC_AVAS_Req，INFO-AMP接收
6、GW新增信号路由：PTCANFD：MDC_PwrCtl(0x276):MDC_SysState 路由至DiagCAN：PDCM_MCU_RTM_1(0x375)：MDC_SysState，Diag-T_BOX接收——需补充接收网段内容——已修改
7、BD-BCM、DCU_FR、DCU_FL以及PTCANFD_CDC新增接收MDC_bodyCtl(0x286);
Version:V1.0.0,Date:2024/2/7,Author:汤枝子,Review:,Approval:,Description:(MDC/GW/DCU_FL/DCU_FR)【CR00028】MDC发送需求—DCU_FL,DCU_FR
1、DCU_FL,DCU_FR新增接收信号：ADCU_VlcCtrl2（0x0D8）：ADAS_FctSts，发送方：MDC，接收方：DCU_FL,DCU_FR,链路:MDC—GW—DCU_FL,DCU_FR(CHACANFD—BDCAN）
2、GW新增信号路由：ADCU_VlcCtrl2（0x0D8）—GW_MDC_BD（0x404）：ADAS_FctSts，CHACANFD—BDCAN;
Version:V1.0.0,Date:2024/2/20,Author:汤枝子,Review:,Approval:,Description:(SWM/GW/MDC)【CR0030】SWM需求
1、SWM删除信号：GSM1（0x309）：SWM_GearShiftLvlPosn，发送方：SWM，接收方：MDC,链路:SWM—GW—MDC(SPTCAN2—CHACANFD）
2、SWM删除报文DiagReq_GSM（0x729），发送方：T_BOX，接收方：SWM，链路：T_BOX—GW—SWM(Diagcan—SPTCAN2）
3、SWM删除报文DiagResp_GSM（0x7A9），发送方：SWM，接收方：T_BOX，链路：SWM—GW—T_BOX(SPTCAN2—Diagcan)
4、GW删除报文路由：DiagReq_GSM（0x729）：Diagcan—SPTCAN2
5、GW删除报文路由：DiagResp_GSM（0x7A9）：SPTCAN2—Diagcan;
Version:V1.0.0,Date:2024/2/20,Author:汤枝子,Review:,Approval:,Description:(EPB/GW)【CR0031】EPBM,EPBS需求
1、EPBS新增接收报文：ADCU_VlcCtrl1（0x0D7）：略，发送方：MDC，接收方：EPB，链路:ADCU—EPB(CHACANFD—PTCAN）
2、GW新增报文路由：ADCU_VlcCtrl1（0x0D7）：CHACANFD—PTCAN;
Version:V1.0.0,Date:2024/2/20,Author:汤枝子,Review:,Approval:,Description:(IPB/EPB/PDCM/GW/T_BOX)【CR0032】IPB需求
1、IPB删除报文：IPB8（0x2A2）：略，发送方：IPB，接收方：GW,PDCM,EPB,T_BOX，链路:ADCU—GW,PDCM,EPB,T_BOX（CHACANFD—DiagCAN）
2、GW删除信号路由：IPB8（0x2A2）：IPB_vlcTorqReq，IPB_vlcTorqReqActive，IPB_vlcError，IPB_vlcAvalible，IPB_vlcActive，链路：CHACANFD—DiagCAN
3、IPB删除报文：IPB_apaSet（0x242）：略，发送方：IPB，接收方：GW,PDCM,EPB,T_BOX，APA,链路:ADCU—GW,PDCM,EPB,T_BOX（CHACANFD—DiagCAN/INFOCAN）
4、GW删除信号路由：IPB_apaSet（0x242）：IPB_ParkLSMAvl，IPB_LSMCtrlFaultSts，IPB_LSMMode，IPB_LSMBrakeMode，IPB_LSMHandshake，IPB_LSMComfortAvl，IPB_LSMEmergencyAvl，IPB_ActiveHold，IPB_targetGearReq,链路：CHACANFD—DiagCAN
5、GW取消报文路由：IPB_apaSet（0x242）：CHACANFD—INFOCAN;
Version:V1.0.0,Date:2024/2/20,Author:汤枝子,Review:,Approval:,Description:(MDC/CDC/APA/ACU/EPS/BCM)【CR0033】MDC需求
1、MDC删除发送报文：MMB_Fridge_St（0x41E）：ADCU_LgtCtrl 0x09C，ADCU_LatCtrl 0x09E，ADCU_Obj_1 0x19E，ADCU_Obj_2：（0x198），ADCU_Obj_3：（0x199），ADCU_Obj_4：（0x19A），ADCU_LgtState：（0x19B），ADCU_LatState_1：（0x29E），ADCU_LatState_2：（0x29F），ADCU_HWAState：（0x19F），ADCU_SystemState ：（0x29C），
2、MDC取消接收报文：APA_control1：（0x153），APA_RPASts：（0x155），APA_Slot_Sts：（0x157），APA_control2：（0x159），APA_avmState：（0x203），APA_PDCState：（0x1A3），APA_PDCState1：（0x283），AVM_state：（0x208），PDC_State：（0x1A0），PDC_State1：（0x284），发送方：ADCU，接收方：GW，链路:略;
Version:V1.0.0,Date:2024/2/20,Author:汤枝子,Review:H56C全配置,Approval:,Description:(MMB/AC)【CR0034】MMB需求
1、MMB更改信号内容与格式：MMB_Fridge_St（0x41E）：略，发送方：MMB，接收方：AC，链路:MMB—AC(CFCAN）;
Version:V1.0.0,Date:2024/2/20,Author:汤枝子,Review:,Approval:,Description:(ISC/MDC/T_BOX)【CR0035】ISC需求—飞书沟通（新增信号挪位置）
1、ISC删除报文：ASC_state3（0x1AF）：ASC_ADSCtrlAvl，ASC_ADSCtrlRespSts，发送方：ISC，接收方：MDC，链路:ISC—MDC(CHACANFD）
2、ISC新增信号并更改报文周期：EDC_state（0x342）：ASC_ADSCtrlAvl，ASC_ADSCtrlRespSts，周期由100ms改为10ms，发送方：ISC，接收方：MDC，T_BOX，链路:ISC—MDC，T_BOX(CHACANFD—DiagCAN）
3、ISC删除报文DiagReq_EDC（0x716），发送方：T_BOX，接收方：ISC，链路：T_BOX—GW—ISC(Diagcan—CHACANFD）
4、ISC删除报文DiagResp_EDC（0x796），发送方：ISC，接收方：T_BOX，链路：ISC—GW—T_BOX(CHACANFD—Diagcan)
4、ISC删除报文ISC_TESTMSG1（0x588），ISC_TESTMSG2（0x589），发送方：ISC，接收方：无，链路：无
4、GW删除报文路由：DiagReq_EDC（0x716）：DiagCAN—CHACANFD
5、GW删除报文路由：DiagResp_EDC（0x796）：CHACANFD—DiagCAN;
Version:V1.0.0,Date:2024/2/20,Author:汤枝子,Review:H56C全配置,Approval:,Description:(MDC/CDC/GW)【CR0036】MDC需求
1、MDC新增发送信号：IVI_icmSet（0x105）：IHBC_Mainswitch，发送方：IVI，接收方：MDC，链路：IVI-GW-MDC（INFOCAN—PTCAN）
2、MDC新增接收信号：SWS_Set（0x319）：SWS_nvsSwitch，发送方：SWS，接收发：MDC，链路：SWS—GW—MDC（LIN—PTCAN）
3、GW新增发送信号：GW_LIN_BODY（0x3E2）：RLS_RainfallLevel，发送方：RLS(GW)，接收方：MDC，链路：RLS—MDC（GWLIN2—PTCAN）——同步更改LIN_CAN路由表
1、BCM新增发送信号：BCM_state4（0x422）：bcm_hazardLight_SW_Sts，发送方：BCM，接收方：MDC，链路：BCM—GW—MDC（BDCAN—PTCANFD）
2、GW新增报文路由：BCM_state4（0x422）—BCM_state4（0x422），BDCAN—PTCANFD;
Version:V1.0.0,Date:2024/2/20,Author:汤枝子,Review:,Approval:,Description:(MDC/CDC/GW)【CR0037】MDC需求_HOD
1、MDC新增接收报文：GW_HOD(0X27D):略，发送方：HOD，接收方：MDC，链路：GW_LIN1—PTCAN，同步更新CAN_LIN路由表;
Version:V1.0.1,Date:2024/2/29,Author:汤枝子,Review:,Approval:,Description:(APA/GW/BLE/BCM/T_BOX)【CR0038】拓扑变更_删掉APA
1、APA删除报文：APA_control1（0x153），APA_RPASts（0x155），APA_Slot_Sts（0x157），APA_control2（0x159），APA_avmState（0x203），APA_PDCState（0x1A3），APA_PDCState1（0x283），NM_APA（0x648），DiagReq_APA（0x743），DiagResp_APA（0x7C3），APA_TBOX1（0x338），
2、GW删除路由：APA_control1（0x153），APA_RPASts（0x155）：INFOCAN—BDCAN/CHACANFD/DiagCAN
3、GW删除路由：APA_Slot_Sts（0x157）：INFOCAN—BDCAN
4、GW删除路由：APA_control2（0x159）：INFOCAN—BDCAN/PTCAN，以及信号路由APA_control2（0x159）——APA_TBOX1（0x338）：INFOCAN—DiagCAN
5、GW删除路由：APA_avmState（0x203），APA_PDCState（0x1A3）：INFOCAN—DiagCAN
6、GW删除路由：DiagReq_APA（0x743），DiagResp_APA（0x7C3）：INFOCAN—DiagCAN;
Version:V1.0.1,Date:2024/2/29,Author:汤枝子,Review:H56C全配置,Approval:,Description:(AVM/T_BOX/GW)【CR0038】拓扑变更_删掉AVM
1、AVM删除报文：AVM_state（0x208），NM_AVM（0x624），DiagReq_AVM（0x724），DiagResp_AVM（0x7A4）
2、GW删除路由：AVM_state（0x208）：INFOCAN—DiagCAN
3、GW删除路由：DiagReq_AVM（0x724），DiagResp_AVM（0x7A4）：INFOCAN—DiagCAN;
Version:V1.0.1,Date:2024/2/29,Author:汤枝子,Review:,Approval:,Description:(PDCM/GW)【CR0039】问题校验—董昭
1、PT网段新增报文：DiagReq_SWM（0x719），DiagResp_SWM（0x799）;
Version:V1.0.1,Date:2024/2/29,Author:汤枝子,Review:,Approval:,Description:(CDC/MDC/T_BOX/BCM/ISC/EPB)【CR0020】哨兵模式_周平杰—陈奎老师周期修改
1、IVI新增发送信号：IVI_chassisSet2（0x278）：SENTRY_SwitchSts，发送方：IVI，接收方：T_BOX,MDC，链路：IVI—MDC/GW—T_BOX(PTCANFD—DiagCAN)
2、IVI新增发送信号：IVI_chassisSet2（0x278）：SENTRY_ShakeSts，发送方：IVI，接收方：T_BOX,BCM，链路：IVI—GW—T_BOX,BCM(PTCANFD—BDCANDiagCAN)
3、T_BOX新增发送信号：TBOX_chargeSet（0x07E）：SENTRY_VedioSwitchSet，发送方：T_BOX，接收方：IVI，链路：T_BOX—GW—IVI(DiagCAN—PTCAN)
4、GW新增路由：IVI_chassisSet2（0x278）：INFOCAN—BDCAN
5、报文更改快发周期：IVI_chassisSet2（0x278）：快发周期由20 3 20改为100 3 100，影响方：ISC,EPB,CDC;
Version:V1.0.1,Date:2024/2/29,Author:汤枝子,Review:,Approval:,Description:(MCUR)【CR0040】问题校验—管谍
1、MCUR新增接收信号：PDCM63（0x1AB）：PDCM_MCURTqRateLimMax，发送方：PDCM，接收方：MCUR，链路：SPTCAN2;
Version:V1.0.1,Date:2024/2/29,Author:汤枝子,Review:,Approval:,Description:(MDC/IPB/EPB/GW/PDCM/EPS/ISC)【CR0042】新增需求—任志刚
1、MDC修改报文ID：ADCU_VlcCtrl1（0x0D7）报文名改为MDC_VlcCtrl1，发送方：MDC，接收方：EPB,IPB，GW链路：CHACANFD—PTCAN
2、MDC修改报文ID：ADCU_VlcCtrl2（0x0D8）报文名改为MDC_VlcCtrl2，发送方：MDC，接收方：PDCM,IPB，GW,链路：CHACANFD—同步修改路由表报文名
3、MDC修改报文ID：ADAS_LateralControlSts（0x0D0）报文名改为MDC_LateralCtrlSts，发送方：MDC，接收方：EPS，链路：CHACANFD
4、PDCM新增接收信号：MDC_VlcCtrl1（0x0D7）；ADS_AebBrkTarTq，ADS_AebBrkTarTqVld，ADS_AebBrkTarTqEna，发送方：MDC，接收方：PDCM，链路：CHACANFD
5、IPB新增接收信号：IPB14（0x0D5）；IPB_AebBrkTqAvl，IPB_AebBrkTqActv，发送方：IPB，接收方：PDCM，链路：CHACANFD
6、IPB修改信号描述：IPB15（0x0D6）；IPB_BrkActvTq，发送方：IPB，接收方：MDC，链路：CHACANFD
7、ISC新增发送信号：ASC_state1（0x341）；ASC_Overhealt，发送方：ISC，接收方：MDC，链路：CHACANFD;
Version:V1.0.1,Date:2024/2/29,Author:汤枝子,Review:,Approval:,Description:(BCM/MDC/CDC)【CR0043】新增需求—BCM
1、BCM新增发送信号：BCM_state3（0x062）：bcm_driverSts，发送方：BCM，接收方：MDC,CDC，链路：BDCAN—PTCAN
2、GW新增报文路由：BCM_state3（0x062）：BDCAN—PTCAN;
Version:V1.0.1,Date:2024/3/1,Author:汤枝子,Review:,Approval:,Description:(BCM/MDC/GW)【CR0044】新增需求—MDC
1、MDC修改信号值描述：MDC_bodyCtl（0x286）：Mdc_TopWinCtrl，发送方：MDC，接收方：BCM，链路：PTCAN—BDCAN;
Version:V1.0.1,Date:2024/3/6,Author:汤枝子,Review:,Approval:,Description:(T_BOX/IVI)【内容调整】哨兵信号
1、T_BOX调整信号位置：TBOX_chargeSet（0x07E）：SENTRY_VedioSwitchSet，起始位由60改为61，发送方：T_BOX，接收方：IVI，链路：T_BOX—GW—IVI(DiagCAN—PTCAN)
T_BOX和CDC矩阵需修改;
Version:V1.0.1,Date:2024/3/6,Author:汤枝子,Review:,Approval:,Description:(GW/T_BOX)【CR0045】GW降低路由周期_同步H56B
1、GW调整路由周期：BMS7（0x2D3），BMS14（0x371），BMS27（0x39B），路由周期由100ms/500ms/100ms改为1000ms，链路:PTCAN—DiagCAN;
Version:V1.0.1,Date:2024/3/8,Author:汤枝子,Review:,Approval:,Description:(PDCM/IVI/T_BOX/GCU/MCUF)【CR0046】HVCM新增信号值描述
1、PDCM新增信号值描述：PDCM5（0x2AA）：HVCM_RestchargingTime，新增信号值描述内容，发送方：PDCM，接收方：GW,IVI,T_BOX,GCU,MCUF,链路:CHCACNFD—SPTCAN2/INFOCAN/DiagCAN;
Version:V1.0.1,Date:2024/3/8,Author:汤枝子,Review:,Approval:,Description:(PDCM/IVI)同步H56A/H56B
1、IVI修改信号内容：IVI_control（0x075）：IVI_SOCmodeSet，修改信号值描述，发送方：IVI，接收方：PDCM，链路:INFOCAN—PTCAN;
Version:V1.0.1,Date:2024/3/8,Author:汤枝子,Review:,Approval:,Description:(BMS)【CR0047】BMS新增预留信号-同步其他车型
1、BMS新增发送报文：BMS62（0x450），BMS63（0x455），发送方：BMS，接收方：略，链路：无;
Version:V1.0.1,Date:2024/3/8,Author:汤枝子,Review:,Approval:,Description:(T_BOX)【CR0048】T_BOX新增接收信号
1、T_BOX新增接收信号：BMS1（0x161）：BMS_AssistVolt，发送方：BMS，接收方：T_BOX，链路：BMS—PDCM—GW—T_BOX（SPTCAN1—PTCAN—DiagCAN）
2、T_BOX新增接收信号：PDCM_IVI（0x31D）：PDCM_HVCM_ChargeSocket_Warn，发送方：PDCM，接收方：T_BOX，链路：PDCM—GW—T_BOX（PTCAN—DiagCAN）
3、T_BOX新增接收信号：PDCM1（0x285）：PDCM_KL15offReq，PDCM_KL15DelayAllow，发送方：PDCM，接收方：T_BOX，链路：PDCM—GW—T_BOX（PTCAN—DiagCAN）
4、T_BOX新增接收信号：BCM_peps（0x2C1）：BCM_KL15RelayReq，发送方：BCM，接收方：T_BOX，链路：BCM—GW—T_BOX（BDCAN—DiagCAN）;
Version:V1.0.2,Date:2024/3/12,Author:汤枝子,Review:,Approval:,Description:(MDC)【CR0063】MDC取消接收信号
1、MDC取消接收报文：IVI_chassisSet（0x1BE），IC_state（0x2FE），IVI_timeAndGPS（0x3FE），GW_LIN_CHA（0x3EA），BCM_peps（0x2C1），DCU_FL1（0x3E7），DiagReq_FUN（0x7DF），DiagResp_ADCU（0x7B6），ADCU_TESTMSG1（0x5CC），TBOX_VehicleMode（0x4FE）发送方：略，接收方：MDC，链路：略
2、MDC取消接收报文：DiagResp_ADCU（0x7B6），ADCU_TESTMSG1（0x5CC），发送方：MDC，接收方：无，链路：略
3、MDC新增接收报文：TBOX_VehicleMode（0x4FE）：略，发送方：T_BOX，接收方：MDC，链路：T_BOX—GW—MDC（DiagCAN—PTCAN）
4、MDC接收信号调整：IC_state（0x2FE）：取消接收信号ic_vehicleSpeedDispValid，新增接收信号ic_vehicleSpeedDisp，发送方：CDC，接收方：MDC，链路：CDC—MDC（PTCAN）;
Version:V2.0.0,Date:2024/3/13,Author:汤枝子,Review:,Approval:PS,Description:(ACU/AMP/ETC/GW)【拓扑差异】ACU,AMP,ETC由INFOCAN改到PassivsaftySafetyCAN——PSCAN到其他网段
  新增PSCAN—BDCAN报文路由：
1、ACU_IMU_2（0x3E）
2、ACU_state（0x380）
  新增PSCAN—CHACANFD报文路由：
3、ACU_IMU_1（0x3D）
4、ACU_IMU_2（0x3E）
5、ACU_state（0x380）
  新增PSCAN—CFCAN报文路由：
6、ACU_IMU_2（0x3E）
7、ACU_state（0x380）
  新增PSCAN—DiagCAN报文路由：
8、ACU_IMU_1（0x3D）
9、ACU_IMU_2（0x3E）
10、ACU_state（0x380）
11、DiagResp_ETC（0x7C1）
12、DiagResp_AMP（0x7C9）
13、DiagResp_ACU（0x7F9）
  新增PSCAN—INFOCAN报文路由：
14、ACU_IMU_1（0x3D）
15、ACU_IMU_2（0x3E）
16、ACU_state（0x380）
17、ETC_Amount（0x402）
18、ETC_Time（0x403）
19、ETC_Status（0x3F6）
20、AMP_state（0x406）
21、AMP_Response（0x405）;
Version:V2.0.0,Date:2024/3/13,Author:汤枝子,Review:,Approval:PS,Description:(ACU/AMP/ETC/GW)【拓扑差异】ACU,AVM,ETC由INFOCAN改到PassivsaftySafetyCAN——其他网段到PSCAN
  新增INFOCAN—PSCAN报文路由：
1、IVI_infoSet（0x0C5）
2、IVI_ampSet（0x11E）
3、IC_state（0x2FE）
4、IVI_timeAndGPS（0x3FE）
5、ICM_state（0x3A9）
  新增CANCANFD—PSCAN报文路由：
6、EMS1（0x83）
7、IPB7（0xA0）
8、ACU_IMU_1（0x3D）
9、ACU_IMU_2（0x3E）
10、IPB6（0x102）
11、EPBM_state（0x12A）
12、EPS_SAS（0x144）
13、DiagResp_ACU（0x7F9）
14、IPB12（0x214）
15、PDCM5（0x2AA）
16、PDCM10（0x2C8）
17、PDCM_EBS1（0x3E3）
  新增BDCAN—PSCAN报文路由
18、BLE_request（0x10）
19、BCM_state1（0x2A3）
20、BCM_peps（0x2C1）
21、BCM_state2（0x3C0）
22、BCM_tpms（0x411）
23、BCM_tpms1（0x421）;
Version:V2.0.0,Date:2024/3/13,Author:汤枝子,Review:,Approval:PS,Description:(ACU/AMP/ETC/GW)【拓扑差异】ACU,AVM,ETC由INFOCAN改到PassivsaftySafetyCAN——其他网段到PSCAN
  新增INCOCANFD—PSCAN信号路由：
1、MDC_bodyCtl（0x286）——GW_PT_INFO（0x388）：MDC_AVAS_Req
  新增PTCAN—PSCAN信号路由：
2、SWM_Set（0x320）——GW_PT_INFO（0x319）：swm_highbeam，swm_overtakingLight，swm_turnSW，swm_changeLaneSW，swm_frontWashing，SWM_FrontWiperSwitch，SWM_RearWiper，SWM_RearWashing，SWM_Sensitivity，RollingCounter319，Checksum319，
  新增PTCAN—PSCAN报文路由：
3、EPBS_state（0x12C）
4、PDCM1（0x285）
5、PDCM61（0x31B）
  新增PTCAN—PSCAN报文路由：
6、TBOX_VehicleMode（0x4FE）
7、DiagReq_ETC（0x741）
8、DiagReq_AMP（0x749）
9、DiagReq_FUN（0x7DF）
10、DiagReq_ACU（0x7F1）
  新增GW信号路由：GW_VIN1;
Version:V2.0.0,Date:2024/3/13,Author:汤枝子,Review:,Approval:INFO,DIAG,Description:(PDC/GW/T_BOX)【拓扑变更】删除PDC
1、PDC删除报文：PDC_State（0x1A0），PDC_State1（0x284），DiagResp_PDC（0x797），DiagReq_PDC（0x717）
2、GW删除路由：DiagResp_PDC（0x797），DiagReq_PDC（0x717）：INFOCAN—DiagCAN,DiagCAN—INFOCAN;
Version:V2.0.0,Date:2024/3/13,Author:汤枝子,Review:,Approval:INFO,DIAG,Description:(NVS/GW/T_BOX)【拓扑变更】删除NVS
1、NVS删除报文：NVS_state（0x306），DiagReq_NVS（0x73A），DiagResp_NVS（0x7BA）,接收方：T_BOX
2、GW删除路由：NVS_state（0x306），DiagReq_NVS（0x73A），DiagResp_NVS（0x7BA）：INFOCAN—DiagCAN,DiagCAN—INFOCAN;
Version:V2.0.0,Date:2024/3/13,Author:汤枝子,Review:,Approval:info,DIAG,Description:(VSP/T_BOX/GW)【拓扑变更】删除VSP
1、VSP删除报文：VSP_state（0x3A0），DiagReq_VSP（0x710），DiagResp_VSP（0x790）,接收方：T_BOX
2、GW删除路由：DiagReq_VSP（0x710），DiagResp_VSP（0x790）：INFOCAN—DiagCAN,DiagCAN—INFOCAN;
Version:V2.0.0,Date:2024/3/13,Author:汤枝子,Review:,Approval:INFO,Description:(CDC/ICM)【拓扑变更】ICM集成到CDC中
1、ICM所接收发送报文改为CDC发送;
Version:V2.0.0,Date:2024/3/13,Author:汤枝子,Review:,Approval:INFO,Description:(GW)【拓扑变更】INFOCAN升级为INFOCANFD;
Version:V2.0.0,Date:2024/3/13,Author:汤枝子,Review:,Approval:INFO,Description:(CDC/GW)【拓扑变更】CDC从PTCAN挪到INFOCAN
1、删除ET阶段临时路由：各网段路由到PTCAN以供给CDC使用的
2、CDC新增发送信号挪动到INFOCANFD发送：
IVI_icmSet（0x105）：IHBC_Mainswitch，发送方：CDC，接收方：MDC，链路：IVI-MDC（INFOCANFD）
3、CDC新增接收信号改为在INFOCANFD上接收：
（1），Mdc_AdsWarning(0x17A)，Mdc_AdsRadarWarning(0x280)，Mdc_Ads_ActSafety(0x21D)，发送方：MDC，接收方：CDC，链路：MDC—CDC（INFOCANFD）
（2），BCM_state3（0x062）：bcm_driverSts，发送方：BCM，接收方：MDC,CDC，链路：BDCAN—PTCAN;
Version:V2.0.0,Date:2024/3/13,Author:汤枝子,Review:,Approval:INFO,Description:(MDC/GW)【拓扑变更】MDC从PTCAN挪到INFOCAN——MDC发送部分
1、删除ET阶段临时路由：MDC从PTCAN给各网段的路由
2、MDC在PTCAN上新增发送信号挪动到INFOCANFD发送：
 （1）MDC_BLE_0（0x271）~MDC_BLE_26（0x4B6），接收方：PDCM,BLE
 （2）Mdc_AdsWarning（0x17A），Mdc_AdsRadarWarning（0x280），Mdc_Ads_ActSafety（0x21D），接收节点：CDC
 （3）MDC_bodyCtl（0x286），接收节点：CDC,BCM,DCU_FL,DCU_FR,AMP
 （4）MDC_PwrCtl（0x276），接收节点：CDC,PDCM,T_BOX
3、GW新增报文路由：INFOCANFD—BDCAN：MDC_BLE_0（0x271）~MDC_BLE_26（0x4B6），MDC_bodyCtl（0x286），MDC_PwrCtl（0x276）
4、GW新增报文路由：INFOCANFD—PTCAN：MDC_BLE_0（0x271），MDC_PwrCtl（0x276）
5、GW新增信号路由：INFOCANFD—DiagCAN：MDC_PwrCtl（0x276）—PDCM_MCU_RTM_1（0x375）：MDC_SysState;
Version:V2.0.0,Date:2024/3/13,Author:汤枝子,Review:,Approval:INFO,Description:(MDC/GW)【拓扑变更】MDC从PTCAN挪到INFOCAN——MDC接收部分
1、删除ET阶段临时路由：各网段路由到PTCAN以供给MDC使用的
2、MDC在PTCAN上接收信号挪动到INFOCANFD上接收
3、GW新增报文路由：CHACANFD—INFOCANFD：OBC7（0x2E6），PDCM6（0x2AE），
4、GW删除信号路由：CHACANFD—INFOCANFD：
（1） OBC7（0x2E6）—GW_PT_CHA（0x38E）：DCDC_status
（2）PDCM6（0x2AE）—GW_PT_CHA（0x38E）：HVCM_Plug_Status，HVCM_ChargeProcess_State，HVCM_ChargeFormSts
5、GW新增报文路由：PTCAN—INFOCANFD：PDCM2（0x368），PDCM38（0x46F），SWM_Set（0x320）
6、GW新增报文路由：BDCAN—INFOCANFD：BLE_MDC_1（0x4B7），BLE_MDC_2（0x4B8）
7、GW删除信号路由：PTCAN—INFOCANFD：SWM_Set（0x320）—SWS_Set（0x319）：swm_highbeam，swm_overtakingLight，swm_turnSW，swm_changeLaneSW，swm_frontWashing，SWM_FrontWiperSwitch，SWM_RearWiper，SWM_RearWashing，SWM_Sensitivity
8、GW新增报文路由：CFCAN—INFOCANFD：AC1（0x36B），AC2（0x3A6），HCM_L（0x100），RLM_L（0x107），RLM_M2（0x109），RLM_M1（0x108），HCM_R（0x110），RLM_R（0x117）
9、GW删除信号路由：CFCAN—INFOCANFD：
 （1）AC1（0x36B）—GW_AC（0x36B）：AC_ambientTempValid，AC_EDC_PowerReqLevel，AC_EDC_Power，AC_EDC_PowerReq， AC_HvThermSysSt，AC_ambientTemp，，
  （2）AC2（0x3A6）—GW_AC（0x36B）：AC_Superheat，AC_TM_FanSpeedReq，AC_HV_Req，AC_CabinTemp，
  （3）HCM_L（0x100）—GW_HCM_RLM（0x140）：HCM_LeftpositionLampFault，HCM_LeftDRLFault，HCM_middleLeftPositionLampFault，HCM_LeftLowBeamFault，HCM_LeftHighBeamFault，HCM_hcmHeightSetLt，HCM_LeftTurnLampFault，HCM_L_hcmHeightAdjustSet_Rsp，
  （4）RLM_L（0x107）—GW_HCM_RLM（0x140）：RLM_LeftPositionLampFault，RLM_LeftRearfogLampFault，RLM_LeftReversingLampFault，RLM_LeftStopLampSts，RLM_LeftTurnLampFault，RLM_LeftStopLampFault，
  （5）RLM_M1（0x108）—GW_HCM_RLM（0x140）：RLM_MidApositionLampFault，RLM_MidLeftTurnLampFault，
  （6）RLM_M2（0x109）—GW_HCM_RLM（0x140）：RLM_MidBpositionLampFault，RLM_MidRightTurnLampFault，
  （7）HCM_R（0x110）—GW_HCM_RLM（0x140）：HCM_RightpositionLampFault，HCM_RightDRLFault，HCM_middleRightPositionLampFault，
HCM_RightLowBeamFault，HCM_RightHighBeamFault，HCM_hcmHeightSetRt，HCM_RightTurnLampFault，HCM_R_hcmHeightAdjustSet_Rsp，
  （8）RLM_R（0x117）—GW_HCM_RLM（0x140）：RLM_RightPositionLampFault，RLM_RightRearfogLampFault，RLM_RightReversingLampFault，RLM_RightTurnLampFault，RLM_RightStopLampFault，;
Version:V2.0.0,Date:2024/3/14,Author:汤枝子,Review:,Approval:PSCAN,Description:(GW)【拓扑变更】新增网段PSCAN
1、GW新增发送NM报文：NM_GW_PS（0x61F），发送方：GW;
Version:V2.0.0,Date:2024/3/12,Author:孙志刚,Review:,Approval:INFO，DIAG,Description:(MDC/T_BOX/GW)【CR0049】刘元栋MDC
1、INFOCAN新增MDC节点，INFOCAN升为CANFD
2、TBOX新增接收信号：MDC_DTC（0x555）。发送方：MDC；接收方：TBOX，链路：MDC-GW-TBOX（INFOCAN-DiagCAN）.GW新增路由
3、TBOX新增接收信号：Mdc_status（0x556）。发送方：MDC；接收方：TBOX，链路：MDC-GW-TBOX（INFOCAN-DiagCAN）.GW新增路由拆分为0x558~0x55F的8个CAN标准帧
4、TBOX新增接收信号：Mdc_alarm（0x557）。发送方：MDC；接收方：TBOX，链路：MDC-GW-TBOX（INFOCAN-DiagCAN）.GW新增路由拆分为0x540~0x547的8个标准帧;
Version:V2.0.0,Date:2024/3/12,Author:孙志刚,Review:,Approval:DIAG,BD,INFO,Description:(T_BOX/GW/BCM/MDC/CDC)【CR0050】李讌斌
1、TBOX_remoteCmd（0x058）新增发送信号：TBOX_ShieldKeyDetection，起始位21，替代原有的tbox_HazardLightReq信号，发送方：TBOX；接收方：BCM，链路：TBOX-GW-BCM（DiagCAN-BDCAN），GW新增路由
2、BCM_state4(0x422)新增发送信号：BCM_ShieldKeyDetection，发送方：BCM；接收方：TBOX，链路：BCM-GW-TBOX（BDCAN-DiagCAN）
3、BCM_state4(0x422)新增发送信号：BCM_ADS_turnSW,发送方：BCM；接收方：MDC，链路：BCM-GW-MDC（BDCAN-INFOCAN）
4、BCM_state4(0x422)新增发送信号：BCM_ADS_changeLaneSW,发送方：BCM；接收方：MDC，链路：BCM-GW-MDC（BDCAN-INFOCAN）
5、新增INFOCAN节点CDC，CDC新增接收BCM_peps（0x2C1）报文BCM_lampswitchfdb信号
6、BCM_state3（0x062）新增发送信号：bcm_driverSts，发送方：GW；接收方：MDC、CDC;
Version:V2.0.0,Date:2024/3/13,Author:孙志刚,Review:,Approval:BDCAN,Description:(BCM)【CR0051】孙欢
BCM新增在BDCAN接收MDC_BLE_0（0x271）信号：ADAS_MdcRPAOnlineOrNot;
Version:V2.0.0,Date:2024/3/13,Author:孙志刚,Review:,Approval:CHACAN,INFO,PTCAN,Description:(PDCM/MDC/IPB/GW/EPB)【CR0052】任志刚
1、PDCM新增在CHACAN接收MDC_VlcCtrl1(0x0D7)信号：RollingCounter0D7、Checksum0D7
2、PDCM新增在CHACAN接收IPB14（0x0D5）信号：RollingCounter0D5、Checksum0D5
3、MDC_VlcCtrl1（0x0D7）报文ADS_AEB_BrkTarAxVld信号起始位由109改为70，相关方：IPB
4、MDC_VlcCtrl1（0x0D7）新增发送信号：ADSLimTqFactorK，发送方：MDC；接收方：PDCM
5、MDC_VlcCtrl1（0x0D7）新增发送信号：ADSLimTqEnable，发送方：MDC；接收方：PDCM
6、新增发送报文MDC_VlcCtrlBak（0x0CC）及信号，发送方：MDC；接收方：EPB。链路：MDC-GW-EPB（INFOCAN-PTCAN），GW新增路由,已有信号，删除
7、MDC取消接收IPB6（0x102）信号：IPB_cddActive 、IPB_cddAvailable 、IPB_cddError 、IPB_cddTempOff 、IPB_abaActive 、IPB_abaAvailable;
Version:V2.0.0,Date:2024/3/13,Author:孙志刚,Review:,Approval:INFO,Description:(GW/MDC/CDC)【CR0053】周昊夫
1、新增发送报文NM_MDC（0x66F），发送方：MDC，接收方：GW，CDC
2、NM_GW_INFO（0x61E）新增发送信号：GW_PNI、GW_RepeatSts、GW_VCM、GW_AD、GW_IVI、GW_ALLECU、GW_Diag、GW_BDComfort，发送方：GW，接收方：MDC、CDC
3、NM_IVI（0x625）新增发送信号IVI_PNI、IVI_RepeatSts、IVI_VCM、IVI_AD、IVI_IVI、IVI_ALLECU、IVI_Diag、IVI_BDComfort，发送方：CDC/IVI，接收方：MDC、GW;
Version:V2.0.0,Date:2024/3/13,Author:孙志刚,Review:,Approval:CHACAN,Description:(MDC/PDCM)【CR0054】曾柯
1、PDCM62（0x0D4）报文：PDCM_MCUSpdSVModFlt信号调整coding值，发送方：PDCM；接收方：MDC
2、PDCM62（0x0D4）报文：PDCM_ErrorFb信号调整coding值，发送方：PDCM；接收方：MDC;
Version:V2.0.0,Date:2024/3/13,Author:孙志刚,Review:,Approval:DIAG,INFO,Description:(T_BOX/GW/CDC/MDC)【CR0055】汪青
1、报文发送方改为T_BOX：IVI_timeAndGPS（0x3FE），原IVI发送改为T_BOX发送（当前已无IVI）
2、GW更改：IVI_timeAndGPS（0x3FE）原INFOCAN发送改为DiagCAN发送，取消：INFOCAN—BDCAN/CFCAN/CHACANFD/PTCAN/PSCAN，新增：DiagCAN—BDCAN/CFCAN/CHACANFD/PTCAN/PSCAN/INFOCAN;
Version:V2.0.0,Date:2024/3/13,Author:孙志刚,Review:,Approval:PT、INFO、SPTCAN2,Description:(ECU/PDCM/CDC/GW)【CR0056】张旭
1、EMS9（0x46C）报文新增发送信号：EMS_OilSensorResistance，发送方：EMS；接收方：PDCM，链路：EMS—PDCM-GW-CDC，GW新增路由
2、PDCM新增发送报文PDCM_EnergyInfo（0x4C4），发送方：PDCM；接收方：CDC，链路：PDCM-GW-CDC，GW新增路由
3、PDCM新增发送报文PDCM_RemMileage（0x4C5），发送方：PDCM；接收方：CDC，链路：PDCM-GW-CDC，GW新增路由
4、PDCM新增发送报文PDCM_TripInfo(0x4C6),发送方：PDCM；接收方：CDC，链路：PDCM-GW-CDC，GW新增路由
5、PDCM新增发送报文PDCM_totalMileageInfo1(0x4C7),发送方：PDCM；接收方：CDC，链路：PDCM-GW-CDC，GW新增路由
6、PDCM新增发送报文PDCM_CurrentTripInfo（0x4C8），发送方：PDCM；接收方：CDC，链路：PDCM-GW-CDC，GW新增路由
7、PDCM新增发送报文PDCM_SinceChargeInfo（0x4C9），发送方：PDCM；接收方：CDC，链路：PDCM-GW-CDC，GW新增路由
8、PDCM新增发送报文PDCM_SinceRefulInfo（0x4CA），发送方：PDCM；接收方：CDC，链路：PDCM-GW-CDC，GW新增路由
9、PDCM新增发送报文PDCM_EnergyConsump（0x4CB），发送方：PDCM；接收方：CDC，链路：PDCM-GW-CDC，GW新增路由
10、PDCM新增发送报文PDCM_SelfCharging(0x4CC)，发送方：PDCM；接收方：CDC，链路：PDCM-GW-CDC，GW新增路由
11、PDCM新增发送报文PDCM_SelfRefueling(0x4CD),发送方：PDCM；接收方：CDC，链路：PDCM-GW-CDC，GW新增路由
12、PDCM新增发送报文PDCM_SubtotalMileage（0x4CE），发送方：PDCM；接收方：CDC，链路：PDCM-GW-CDC，GW新增路由
13、PDCM新增发送报文PDCM_DailyEnergyConsu（0x4CF），发送方：PDCM；接收方：CDC，链路：PDCM-GW-CDC，GW新增路由
14、PDCM新增发送报文PDCM_InstanEnergyConsu（0x4D0），发送方：PDCM；接收方：CDC，链路：PDCM-GW-CDC，GW新增路由
15、PDCM新增发送报文PDCM_totalMileageInfo2（0x4D1），发送方：PDCM；接收方：CDC，链路：PDCM-GW-CDC，GW新增路由
16、PDCM新增接收报文IVI_timeAndGPS（0x3FE），发送方：GW；接收方：PDCM;
Version:V2.0.0,Date:2024/3/13,Author:孙志刚,Review:,Approval:INFO、BDCAN,Description:(BCM/GW/CDC/MDC)【CR0057】李讌斌
1、新增发送报文IVI_BodySet3（0x4D2）及信号：IVI_autoWiper，发送方：CDC；接收方：BCM，链路：CDC-GW-BCM（INFOCAN-BDCAN），新增路由
2、CDC、MDC新增接收报文BCM_state4（0x422）及信号：BCM_autoWipersta;
Version:V2.0.0,Date:2024/3/13,Author:孙志刚,Review:,Approval:SPTCAN1,Description:(PDCM/BMS)【CR0058】李奇琛
BMS7（0x2D3）报文新增发送信号SOC_Calibrated_Flag，发送方：BMS；接收方：PDCM;
Version:V2.0.0,Date:2024/3/13,Author:孙志刚,Review:,Approval:info,Description:(MDC)【CR0059】孙欢
MDC新增接收报文SWS_Set（0x319）及信号SWS_ACCRESorAddValid、SWS_ACCSETorSubValid、SWS_ACCIntervalSubValid、SWS_ACCIntervalAddValid、SWS_phone、SWS_userdefined;
Version:V2.0.0,Date:2024/3/13,Author:孙志刚,Review:,Approval:DIAG、INFO,Description:(MDC/T_BOX/GW)【CR0060】陈楼
1、新增报文DiagReq_MDC_SoC（0x771），发送方：TBOX；接收方：MDC，链路：TBOX-GW-MDC（DiagCAN-GW-INFOCAN），新增路由
2、新增报文DiagReq_MDC_MCU（0x736），发送方：TBOX；接收方：MDC，链路：TBOX-GW-MDC（DiagCAN-GW-INFOCAN），新增路由
3、新增报文DiagResp_MDC_SoC（0x779），发送方：MDC；接收方：TBOX，链路：MDC-GW-TBOX（INFOCAN-GW-DiagCAN），新增路由
4、新增报文DiagResp_MDC_MCU（0x7B6），发送方：MDC；接收方：TBOX，链路：MDC-GW-TBOX（INFOCAN-GW-DiagCAN），新增路由
5、MDC新增接收报文DiagReq_FUN（0x7DF）
6、MDC新增接收报文BCM_peps（0x2C1）及信号bcm_pepsPowerMode、bcm_12VBatterySOC
7、MDC新增接收报文PDCM_EBS1(0x3E3)及信号ebs_U_BATT
8、MDC新增接收报文IC_state(0x2FE)及信号ic_totalMileage
9、MDC新增接收报文IPB7（0x0A0）及信号IPB_vehicleSpeed
10、MDC新增接收报文EMS1（0x83）及信号EMS_EngSpd
11、MDC新增接收报文PDCM10(0x2C8)及信号PDCM_DriveReady
12、MDC新增接收报文PDCM1(0x285)及信号PDCM_SOC;
Version:V2.0.0,Date:2024/3/13,Author:孙志刚,Review:,Approval:CHACAN,INFO,Description:(CDC/PDCM)【CR0062】张中
PDCM5报文（0x2AA）新增发送信号PDCM_SocModeSuggest,发送方：PDCM；接收方：IVI/CDC;
Version:V2.0.0,Date:2024/3/13,Author:孙志刚,Review:,Approval:INFO,PT,Description:(CDC/PDCM)【CR0066】MDC孙欢
1、删除信号MDC_bodyCtl（0x286）：Mdc_LeFrntDowWarning，Mdc_RiFrntDowWarning，Mdc_LeReDowWarning，Mdc_RiReDowWarning，发送方：MDC，接收方：CDC
2、MDC新增接收PDCM_RemMileage（0x4C5）：PDCM_remainingMileageOil_Real;
Version:V2.0.0,Date:2024/3/15,Author:孙志刚,Review:,Approval:PS、INFO,Description:(CDC/AMP/GW)【CR0067】魏来
IVI_ampSet（0x11E）报文周期调整为20ms;
Version:V2.0.0,Date:2024/3/18,Author:孙志刚,Review:,Approval:CHACAN、INFO,Description:(MDC)【CR0068】周火星
1、MDC新增CHACANFD接收EPBM_state（0x12A）信号：EPBM_Sts_LR
2、MDC新增INFOCANFD接收EPBS_state（0x12C）报文及信号：EPBS_Sts、EPBS_FailStatus、EPBS_EcdActvSts、EPBS_RwuAvl、EPBS_EpbAvl、RollingCounter12C、Checksum12C;
Version:V2.0.0,Date:2024/3/20,Author:汤枝子,Review:,Approval:,Description:(MDC)【CR0070】孙欢
1、MDC取消INFOCANFD接收信号PDCM_EBS1（0x3E3）：ebs_U_BATT
2、MDC取消INFOCANFD接收信号IPB7（0x0A0）：IPB_vehicleSpeed
3、MDC取消INFOCANFD接收信号EMS1（0x83）：EMS_EngSpd
4、MDC取消INFOCANFD接收信号PDCM10（0x2C8）：PDCM_DriveReady
5、MDC调整诊断报文ID：DiagReq_MDC_MCU：ID由0x736改为0x774
6、MDC调整诊断报文ID：DiagResp_MDC_MCU：ID由0x7B6改为0x77C;
Version:V2.0.0,Date:2024/3/21,Author:汤枝子,Review:,Approval:,Description:(MDC/T_BOX/GW)【问题修复】孙欢，刘元栋
1、MDC取消部分信号信号值描述Mdc_status（0x556）：ADAS_CANTRACE_Volt0Val~ADAS_CANTRACE_DomainTemp3L
2、Mdc_status1(0x558)~Mdc_status8(0x55F),Mdc_alarm1(0x540)~Mdc_alarm8(0x547),具体信号不做定义，黑盒方式上传，MDC做数据分析适用，自行解析;
Version:V3.0.0,Date:2024/4/17,Author:孙志刚,Review:,Approval:,Description:(CDC)CRCAN240325232
CDC在infocan新增接收DCU_FL2（0x3E8）报文DCU_FL_MirrorFold_UnfoldSts信号;
Version:V3.0.0,Date:2024/4/17,Author:孙志刚,Review:,Approval:,Description:(CDC/T_BOX/GW)CRCAN240325233
调整TBOX_infoCtrl（0x0A8）报文tbox_dvrTakePicCtrl 信号coding值定义，0x3值由DMS photo改为AVM photo，0x6值由DMS VIdeo改为AVM VIdeo;
Version:V3.0.0,Date:2024/4/17,Author:孙志刚,Review:,Approval:,Description:(CDC/GW)CRCAN240326243
PDCM_IVI（0x31D）报文新增在INFOCAN发送PDCM_oilRemainingAlarmLamp信号，CDC接收;
Version:V3.0.0,Date:2024/4/17,Author:孙志刚,Review:,Approval:,Description:(CRF/GW/AC/ACP/HCM_L/HCM_R/SCU_F/SCU_RL/SCU_RR/SCU_FR/RLM_L/RLM_M1/RLM_M2/RLM_R)CRCAN240327272、CRCAN240327273
1、MMB改名为CRF，新增CRF发送NM报文0x670
2、CRF新增接收其他节点NM报文;
Version:V3.0.0,Date:2024/4/17,Author:孙志刚,Review:,Approval:,Description:(SCU_TR/SCU_F/GW/SCU_RL/SCU_RR)CRCAN240328407、CRCAN240328408、CRCAN240328409、CRCAN240328411、CRCAN240328413、CRCAN240328415、CRCAN240328416、CRCAN240328417、CRCAN240328418、CRCAN240328419、CRCAN240328420、CRCAN240328421、CRCAN240328422、CRCAN240328423、CRCAN240328424、CRCAN240328427、CRCAN240328429、CRCAN240328431
1、新增节点SCU_TR
2、SCU_RL新增发送报文SCU_RL2（0x501）及信号SCU_RL_2ndLinkageRequest，接收节点：SCU_F，SCU_TR，GW，ACP_RL（链路CFCAN-GW-PTCAN），路由表新增
3、SCU_RL新增发送SCU_RL2（0x501）信号SCU_RL_2ndMoveForbiddenReason、SCU_RL_SeatSts、SCU_RL_SeatlnlockPos、SCU_RL_SeatTiltPos、SCU_RL_SeatLegFBPos，接收节点：GW,SCU_TR,SCU_F
4、SCU_RL新增发送SCU_RL3（0x502）报文及信号SCU_RL_SeatSlideMotorCurrents、SCU_RL_SeatUnlockMotorCurrents、SCU_RL_SeatReclineMotorCurrents、SCU_RL_SeatTiltLMotorCurrents、SCU_RL_SeatTiltRMotorCurrents、SCU_RL_SeatLegUDMotorCurrents、SCU_RL_SeatLegFBMotorCurrents，GW接收
5、SCU_RR新增发送SCU_RR2（0x503）报文及信号SCU_RR_2ndLinkageRequest、SCU_RR_SeatSts、SCU_RR_SeatUnlockPos、SCU_RR_SeatTiltPos、SCU_RR_SeatLegFBPos。接收方：SCU_TR、SCU_F、GW,链路CFCAN-GW-PTCAN，路由表新增
6、ACP_RR新增接收SCU_RR2（0x503）报文及信号SCU_RR_LumberSupportSts
7、ACP_RL新增接收SCU_RL2（0x501）报文及信号SCU_RL_LumberSupportSts;
Version:V3.0.0,Date:2024/4/17,Author:孙志刚,Review:,Approval:,Description:(SCU_RR/GW)CRCAN240328432、CRCAN240328433、CRCAN240328434、CRCAN240328435、CRCAN240328436、CRCAN240328437、CRCAN240328438
1、SCU_RR新增发送SCU_RR3（0x504）报文及信号SCU_RR_SeatSlideMotorCurrents、SCU_RR_SeatUnlockMotorCurrents、SCU_RR_SeatReclineMotorCurrents、SCU_RR_SeatTiltLMotorCurrents、SCU_RR_SeatTiltRMotorCurrents、SCU_RR_SeatLegUDMotorCurrents、SCU_RR_SeatLegFBMotorCurrents，接收节点：GW;
Version:V3.0.0,Date:2024/4/17,Author:孙志刚,Review:,Approval:,Description:(OBC/PDCM)CRCAN240329444、CRCAN240329446【CRCAN2404182372】
PDCM4（0x2A7）报文SPTCAN1新增发送信号PDCM_OBC_Chag_Standard、PDCM_OBC_Mesg_Standard，接收方：OBC;
Version:V3.0.0,Date:2024/4/17,Author:孙志刚,Review:,Approval:,Description:(SCU_RL/SCU_RR/SCU_F)CRCAN240329472
SCU_F2(0x41A)报文CFCAN新增发送信号SCU_F_drvSeatWorkState，接收节点：SCU_RL、SCU_RR;
Version:V3.0.0,Date:2024/4/17,Author:孙志刚,Review:,Approval:,Description:(PDCM/LBMS/GW)CRCAN240329511
PDCM1（0x285）报文PTCAN新增发送信号PDCM_LvBatChargeFdbk，接收节点：GW，LBMS;
Version:V3.0.0,Date:2024/4/17,Author:孙志刚,Review:,Approval:,Description:(SCU_RR/SCU_FR)CRCAN240329514
SCU_FR(0x499)报文CFCAN新增发送信号SCU_FR_passSeatWorkState，接收节点：SCURR;
Version:V3.0.0,Date:2024/4/17,Author:孙志刚,Review:,Approval:,Description:(SCU_TR/SCU_RR/SCU_RL/GW/CDC)CRCAN240329515
SCU_TR新增发送报文SCU_TR（0x505）及信号SCU_TR_3LSeatBackPos、SCU_TR_3RSeatBackPos、SCU_TR_3LSeatSlidePos、SCU_TR_3RSeatSlidePos、SCU_TR_3LSeatHeatSts、SCU_TR_3RSeatHeatSts、SCU_TR_3RSeatSlideHallSnsrSts、SCU_TR_3LSeatSlideHallSnsrSts、SCU_TR_3RSeatBackrestPosMotSts、SCU_TR_3RSeatBackrestHallSnsrSts、SCU_TR_3LSeatBackrestPosMotSts、SCU_TR_3LSeatBackrestHallSnsrSts、SCU_TR_3RSeatSlidePosMotSts、SCU_TR_3LSeatSlidePosMotSts,接收节点：SCU_RR,SCU_RL,GW,CDC，链路CFCAN-GW-INFO，路由表新增;
Version:V3.0.0,Date:2024/4/17,Author:孙志刚,Review:,Approval:,Description:(CDC/GW/PDCM)CRCAN240401658、CRCAN240401659、CRCAN240401660、CRCAN240401661、CRCAN240401662、CRCAN240401663、CRCAN240401664、CRCAN240401665
1、CDC新增发送IVI_ChargingStationInfo（0x53C）报文及信号DestChargeDistance、DestChargeTime、DestFastChargeFreeNum、RoadSpeedListX0、RoadSpeedListY0、RoadSpeedListX1、RoadSpeedListY1、RoadSpeedListIndex，接收方：PDCM，链路INFO-GW-PT，路由表新增
2、PDCM_IVI（0x31D）新增发送信号PDCM_HvBatTemptAutoCtrlInfo，CDC接收，链路PT-GW-INFO;
Version:V3.0.0,Date:2024/4/17,Author:孙志刚,Review:,Approval:,Description:(SCU_TR/SCU_RR/SCU_RL/CDC/gw)CRCAN240401667
SCU-TR新增发送报文SCU_TR1（0x506）及信号SCU_TR_LSeatWorkState、SCU_TR_RSeatWorkState、SCU_TR_3LSeatFoldSts、SCU_TR_3RSeatFoldSts、SCU_TR_3LSeatUnfoldSts、SCU_TR_3RSeatUnfoldSts、SCU_TR_3LSeatfoldRequest、SCU_TR_3RSeatfoldRequest、SCU_TR_3LSeatSwitchStatus、SCU_TR_3RSeatSwitchStatus，接收节点：SCU_RR、SCU_RL、GW、CDC，链路CFCAN-GW-INFO，路由表新增;
Version:V3.0.0,Date:2024/4/17,Author:孙志刚,Review:,Approval:,Description:(PDCM/GW/CDC)CRCAN240401672
PDCM_RemMileage（0x4C5）报文PDCM_remainingMileageOil_Standard、PDCM_remainingMileageOil_Real的物理最大值改为2000，无效值和初始值调整;
Version:V3.0.0,Date:2024/4/17,Author:孙志刚,Review:,Approval:,Description:(SCU_TR)CRCAN240401679、CRCAN240401680、CRCAN240401882、CRCAN2404081153、CRCAN2404081160
1、SCU_TR新增接收PSD_L（0x3EB）PSD_L_RLDoor_St信号
2、SCU_TR新增接收PDCM1（0x285）PDCM_SOC信号
3、SCU_TR新增接收PDCM5（0x2AA）HVCM_ChargeState信号
4、SCU_TR新增接收PDCM10（0x2C8）PDCM_actualGearValid、PDCM_actualGear、PDCM_DriveReady、HV_Network_active信号
5、SCU_TR新增接收PDCM_EBS1（0x3E3）ebs_U_BATT信号
6、SCU_TR新增接收EMS1（0x083）EMS_EngSpdValid、EMS_EngSpd信号
7、SCU_TR新增接收EPBM_state（0x012A）EPBM_Sts信号
8、SCU_TR新增接收IPB7(0x0A0)IPB_vehicleSpeed、IPB_vehicleSpeedValid信号
9、SCU_TR新增接收IC_state（0x2FE）ic_totalMileage、ic_totalMileageValid信号
10、SCU_TR新增接收BCM_peps（0x2C1）bcm_pepsPowerMode
11、SCU_TR新增接收BCM_state3（0x062）BCM_3ndLeftSts、BCM_3ndRightSts
12、SCU_TR新增接收ACU_state（0x380）acu_secondLeftSts、acu_secondRightSts;
Version:V3.0.0,Date:2024/4/17,Author:孙志刚,Review:,Approval:,Description:(SCU_TR/GW)CRCAN2404071089、CRCAN2404071090、CRCAN2404071091、CRCAN2404071093、CRCAN2404071096、CRCAN2404071099、CRCAN2404071102、CRCAN2404071105、CRCAN2404071106、CRCAN2404071109、CRCAN2404071112、CRCAN2404071115、CRCAN2404071118、CRCAN2404071121
1、GW新增发送IVI_SCUCtrl2（0x419）ivi_3LSeatHeatOnOffSet、ivi_3RSeatHeatOnOffSet、ivi_3LSeatFoldSet、ivi_3RSeatFoldSet、ivi_3LSeatUnfoldSet、ivi_3RSeatUnfoldSet，SCU_TR新增接收
2、SCU_TR新增接收IVI_timeAndGPS（0x3FE）报文ivi_timeInfoSecond、ivi_timeInfoMinute、ivi_timeInfoHour、ivi_timeInfoDay、ivi_timeInfoMonth、ivi_timeInfoYear、ivi_timeValid、IVI_EetSceneModeSts
3、SCU_TR新增接收NM_GW_CMFT（0x63E）、NM_AC(0x626)、NM_SCU_F(0x605)、NM_SCU_FR(0x65A)、NM_SCU_RL(0x657)、NM_SCU_RR(0x658)、NM_HCML(0x621)、NM_HCMR(0x620)、NM_RLM_L（0x62A）、NM_RLM_M1（0x62B）、NM_RLM_M2（0x62C）、NM_RLM_R（0x62D）、NM_ACP(0x624);
Version:V3.0.0,Date:2024/4/17,Author:孙志刚,Review:,Approval:,Description:(PDCM/GW/CDC)CRCAN240315098
删除CHACAN、INFOCAN原有PDCM5（0x2AA）报文PDCM_SocModeSuggest，PDCM_IVI（0x31D）新增发送信号PDCM_SocModeSuggest，CDC接收;
Version:V3.0.0,Date:2024/4/17,Author:孙志刚,Review:,Approval:,Description:(CRF/GW/CDC)CRCAN240401898
1、更改0x41D报文名称，由AC_Fridge_Req改为IVI_Fridge_Req，报文由AC发送改为IVI发送,
2、更改此报文的所有信号名称
3、更改IVI_CrfOffLineTimeSet和IVI_CrfTempAdjReq两个信号长度
4、0x41D新增CRF接收，链路INFOCAN-GW-CFCAN，路由表新增;
Version:V3.0.0,Date:2024/4/17,Author:孙志刚,Review:,Approval:,Description:(MMB/AC/GW/T_BOX/CDC/ACP_RR/ACP_RL)CRCAN240401909
1、MMB_Fridge_St（0x41E）报文名字改为CRF_Fridge_St，GW新增接收此报文，CDC接收（链路CFCAN-GW-INFO）、TBOX接收（链路CFCAN-GW-DIAG）、ACP_RR和ACP_RL接收（链路CFCAN-GW-INFO），路由表新增
2、CrfTempAdjSt信号长度由8改为6
3、删除原有41E报文CrfTempActRsp、CrfFaultSt、RFCM_FridgeModeSt、Crf_SWVer、Crf_HWVer、RFCM_DoorsetSt、CrfDoorOnOffSt、CrfChildLockSt、Crf_TempUnitSt、CrfOnOffSt、CrfStznSt信号
4、41E报文新增发送Crf_FridgeModeSt、CrfOffLineTimeLeave、CRF_Fridge_St、CrfFaultSt、Crf_SWVer、RFCM_DoorsetSt、CrfDoorOnOffSt、CrfOffLineAPPMessage、CrfOnOffSt、CrfStznSt、CrfPwrModSt、CRF_DoorOpenWarn、CrfOffLineWorkSt、CrfChildLockSt、CrfOffLineTimeSetSt信号AC接收;
Version:V3.0.0,Date:2024/4/17,Author:孙志刚,Review:,Approval:,Description:(CRF)CRCAN240402987、CRCAN240402982、CRCAN240402988
1、CRF新增接收DCU_FL1（0x3E7）报文DCU_FL_doorFLSts信号
2、CRF新增接收BCM_peps(0x2C1)报文bcm_pepsPowerMode
3、CR新增接收TBOX_VehicleMode（0x4FE）报文tbox_vehicleMode;
Version:V3.0.0,Date:2024/4/17,Author:孙志刚,Review:,Approval:,Description:(CDC/GW/PDCM)CRCAN2404162282
PDCM_SubtotalMileage（0x4CE）报文原PDCM_SinceTripAELECnsPer信号名字改为PDCM_SinceTripAEVCnsPer;
Version:V3.0.0,Date:2024/4/17,Author:孙志刚,Review:,Approval:,Description:(GW/CDC/BCM/PDCM/SCU_F/SCU_RR/SCU_FR/SCU_RL/MDC)CRCAN2404111716【CRCAN2404182371】
1、CDC新增发送IVI_BodySet3（0x4D2）报文IVI_EetSceneModeSts、IVI_SceneModeExtenderSet、ivi_PowerHoldModeTime信号，BCM,PDCM,SCU_F,SCU_RR,SCU_FR,SCU_RL,MDC新增接收
2、新增0x4D2路由INFO至PT;
Version:V3.0.0,Date:2024/4/17,Author:孙志刚,Review:,Approval:,Description:(PDCM/EPB/GW)【CRCAN2404091275】~【CRCAN2404091286】PDCM 发送仪表信号
 1、PDCM新增发送报文：IC_state（0x4D6）、IC_state1 （0x4DA），IC_state2（0x4DB ），IC_info（0x4D7），IC_info1（0x4D3），IC_SinceLastInfor（0x4D4），IC_PowerConsumInfo（0x4D5），发送节点：PDCM，接收节点：GW，EPB
 2、GW新增报文路由：
 IC_state（0x4D6）——IC_state（0x2FE）：PTCAN—INFOCAN，PTCAN—BDCAN，PTCAN—CHACANFD，PTCAN—CFCAN，PTCAN—DiagCAN
 IC_state1（0x4DA）——IC_state1 （0x482）：PTCAN—DiagCAN
 IC_state2 （0x4DB）——IC_state2 （0x492）：PTCAN—DiagCAN
 IC_info（0x4D7）——IC_info（0x3F3）：PTCAN—DiagCAN
 IC_info1（0x4D3）——IC_info1（0x3F4）：PTCAN—DiagCAN
 IC_SinceLastInfor（0x4D4）——IC_SinceLastInfor（0x4F1）：PTCAN—DiagCAN
 IC_PowerConsumInfo（0x4D5）——IC_PowerConsumInfo（0x3F5）：PTCAN—DiagCAN;
Version:V3.0.0,Date:2024/4/17,Author:孙志刚,Review:,Approval:,Description:(MDC/PDCM)CRCAN240329471、CRCAN240329473、CRCAN240329494
1、MDC在CHACAN新增发送报文MDC_authorization（0x583）及信号MDC_AuthKeyData，PDCM接收
2、PDCM在CHACAN新增发送报文PDCM_authorization(0x56E)及信号PDCM_challengeFrame，MDC接收
3、MDC新增接收PDCM10（0x2C8）报文PDCM_authenticationResult;
Version:V3.0.0,Date:2024/4/17,Author:孙志刚,Review:,Approval:,Description:(CRF/ACP_RR/GW)CRCAN2404081126
ACP_RR_control1（0x508）报文ACP_RR_CrfDoorOnOffReq信号名字改为ACP_RR_CrfDoorOnOffSt，ACP_RR_CrfTempAdjReq名字改为ACP_RR_CRF_TempAdjSt，ACP_RR_CrfModAdjReq名字改为ACP_RR_CrfModAdjSt;
Version:V3.0.0,Date:2024/4/17,Author:方伟家,Review:,Approval:,Description:(GW/ACU)CRCAN2404071068-CRCAN2404071072、CRCAN2404071075、CRCAN2404071122
1.GW接收MdcAccFunctionStatus、MdcACCFuncFault、MdcAebWaning、MdcAebFault信号，（INFO）
2.GW新增报文GW_ADCULgtCtrlState，发出ADCU_AEB_state、ADCU_ACC_MODE信号，接收方：ACU（PS）;
Version:V3.0.0,Date:2024/4/17,Author:方伟家,Review:,Approval:,Description:(OBC/BMS/PDCM)CRCAN240329467、CRCAN240329468
1.0x2E2报文中OBC_HPC_Lock_Action信号所在位置替换成OBC_Message_standard，发送方：OBC;
Version:V3.0.0,Date:2024/4/17,Author:方伟家,Review:,Approval:,Description:(PDCM/GW)CRCAN2404172344
1.CDC新增EPS_ModeFb信号的接收；
CRCAN2404162287
1.CDC新增ASC_ISCModeFb信号的接收；
CRCAN2404172344、CRCAN2404172346、CRCAN2404172347
1.PDCM3报文新增信号PDCM_EpsModeSet，发送方：PDCM；接收方：EPS（CHACAN）
2.PDCM3报文新增信号PDCM_ISCModeSet，发送方：PDCM；接收方：ISC（CHACAN）
3.PDCM3报文新增信号PDCM_PropMode，发送方：PDCM；接收方：GW（PTCAN）
4.新增PDCM3报文从PT到info报文路由
CRCAN2404172348
1.PDCM_drivemode信号增加0x4和0x5定义，发送方：PDCM；接收方：CDC
CRCAN2404172349、CRCAN2404172351、CRCAN2404172354
1.PDCM新增IVI_EpsModeSet、IVI_IscModeSet、ivi_DvModeMemeb信号接收;
Version:V3.0.0,Date:2024/4/17,Author:方伟家,Review:,Approval:,Description:(BMS/PDCM/GW)CRCAN240318108
1.BMS7报文（0x2D3）新增发送信号SOC_Calibrated_Flag,发送方：BMS；接收方：PDCM,IVI
2.新增BMS7从PT到Info报文路由;
Version:V3.0.0,Date:2024/4/17,Author:方伟家,Review:,Approval:,Description:(IPB/MDC/EPB/PDCM/CDC/GCU/MCUF/TBOX)CRCAN240325225
1.IPB7报文（0x0A0）IPB_avhSts信号更改为IPB_avhModeWSts;
Version:V3.0.0,Date:2024/4/17,Author:方伟家,Review:,Approval:,Description:(SWM)CRCAN240327285
1.删除GSM诊断报文0x729和0x7A9
CRCAN240327288
1.SPT2上删除GSM网络管理报文0x63A，增加SWM网络管理报文0x619;
Version:V3.0.0,Date:2024/4/17,Author:方伟家,Review:,Approval:,Description:(AMP/CDC/GW)CRCAN240329541和CRCAN240329546
1.ivi_soundFieldSet增加信号值定义
CRCAN240329587、CRCAN240329592
1.amp_soundFieldSts增加信号值定义
CRCAN240329543、CRCAN240329531、CRCAN240329547、CRCAN240329548、CRCAN240329550、CRCAN240329554、CRCAN240329638、CRCAN2404112058、CRCAN240329551、CRCAN240329552、CRCAN240329553、CRCAN240329555、CRCAN240329556
1.新增报文IVI_infoSet1（0x41F），发送方CDC，接收方AMP
2.新增IVI_infoSet1从INFO到PS的报文路由
CRCAN240329594-CRCAN240329600、CRCAN2404112059、CRCAN240329601-CRCAN240329605
1.新增报文AMP_Response1（0x548），发送方AMP，接收方CDC
2.新增AMP_Response1从PS到INFO的报文路由;
Version:V3.0.0,Date:2024/4/17,Author:方伟家,Review:,Approval:,Description:(AMP/CDC/GW)CRCAN240329557、CRCAN240329559-CRCAN240329570、CRCAN2404091288-CRCAN2404091291
1.新增报文IVI_infoSet2（0x420），发送方CDC，接收方AMP
2.新增报文IVI_infoSet3（0x42E），发送方CDC，接收方AMP
3.新增IVI_infoSet2从INFO到PS的报文路由
4.新增IVI_infoSet3从INFO到PS的报文路由
CRCAN240329572-CRCAN240329580、CRCAN240329583
1.新增报文IVI_infoSet4（0x42F），发送方CDC，接收方AMP
2.新增IVI_infoSet4从INFO到PS的报文路由
CRCAN240329606-CRCAN240329618、CRCAN2404091296-CRCAN2404091299、CRCAN2404091300-CRCAN2404091316、CRCAN2404091318、CRCAN2404091321-CRCAN2404091336、CRCAN2404162310-CRCAN2404162320、CRCAN2404162340、CRCAN2404162321-CRCAN2404162326
1.新增报文AMP_Response2（0x549），发送方AMP，接收方CDC
2.新增报文AMP_Response3（0x54A），发送方AMP，接收方CDC
3.新增AMP_Response2从PS到INFO的报文路由
4.新增AMP_Response3从PS到INFO的报文路由
CRCAN240329619-CRCAN240329628
1.新增报文AMP_Response4（0x54B），发送方AMP，接收方CDC
2.新增AMP_Response4从PS到INFO的报文路由
CRCAN240329629-CRCAN240329637
1.新增报文AMP_Response5（0x54C），发送方AMP，接收方CDC;
Version:V3.0.0,Date:2024/4/17,Author:方伟家,Review:,Approval:,Description:(RLM_L/RLM_M1/RLM_M2/RLM_R)CRCAN240401890、CRCAN240401897
1.后部灯光控制器增加接收0x2A1报文的E2E信号;
Version:V3.0.0,Date:2024/4/17,Author:方伟家,Review:,Approval:,Description:(CDC/ISC)CRCAN240402963
1.ASC_SusTempUnadjustableReason增加信号值定义,发送方ISC，接收方CDC;
Version:V3.0.0,Date:2024/4/17,Author:方伟家,Review:,Approval:,Description:(PDCM)CRCAN2404091275
1.报文IC_state从0x2FE更改为0x4D6，发送方为PDCM，接收方LBMS，GW
2.新增从PT到BD、CF、CHA、INFO、PS、Diag的报文路由;
Version:V3.0.0,Date:2024/4/17,Author:方伟家,Review:,Approval:,Description:(EPB)CRCAN2404091274
1.EPB增加接收0x4D6报文的PDCM_totalMileage和PDCM_totalMileageValid信号;
Version:V3.0.0,Date:2024/4/17,Author:方伟家,Review:,Approval:,Description:(LBMS/PDCM)CRCAN240401683-CRCAN240401712
1.新增报文LBMS_State1（0x345），发送方LBMS，接收方PDCM
CRCAN240401714-CRCAN240401739
1.新增报文LBMS_State2（0x346），发送方LBMS，接收方PDCM
CRCAN240401744-CRCAN240401762
1.新增报文LBMS_WakeupState（0x580），发送方LBMS，接收方PDCM
CRCAN240401764-CRCAN240401791、CRCAN2404101360
1.新增报文LBMS_FaultState1（0x581），发送方LBMS，接收方PDCM
CRCAN240401793-CRCAN240401801
1.新增报文LBMS_FaultState2（0x582），发送方LBMS，接收方PDCM
CRCAN240401803-CRCAN240401806
1.新增报文LBMS_Debug（0x56B），发送方LBMS
CRCAN240401808-CRCAN240401817、CRCAN240401819、CRCAN240401820、CRCAN240401822、CRCAN240401823、CRCAN240401825、CRCAN240401826
1.新增NM报文NM_LBMS（0x66A）和诊断报文，发送方LBMS
CRCAN240401828-CRCAN240401832、CRCAN240401834-CRCAN240401837、CRCAN240401839-CRCAN240401843、CRCAN240401845-CRCAN240401848、CRCAN240401850-CRCAN240401852、CRCAN240401854-CRCAN240401856、CRCAN240401858-CRCAN240401862、CRCAN240401864-CRCAN240401872、CRCAN240401874-CRCAN240401877、CRCAN2404021037-CRCAN2404021041、CRCAN2404101361
1.新增LBMS接收信号
CRCAN2404182364、CRCAN2404182365
1.LBMS_State1（0x345）新增信号LBMS_PackExtU，发送方LBMS，接收方PDCM
2.LBMS_State2（0x346）新增信号LBMS_SOC，发送方LBMS，接收方PDCM;
Version:V3.0.0,Date:2024/4/17,Author:方伟家,Review:,Approval:,Description:(LBMS/GW/TBOX)CRCAN2404152158-CRCAN2404152208
1.新增LBMS发送的从PT到Diag的信号路由;
Version:V3.0.0,Date:2024/4/17,Author:方伟家,Review:,Approval:,Description:(LBMS/GW)CRCAN240401740、CRCAN240401741
1.报文PDCM_EBS1（0x3E3）的发送方从GW改为LBMS，增加接收方GW
2.删除从CHA到其他网段的报文路由
3.新增从PT到BD、CF、Diag、CHA、PS的报文路由
CRCAN240401742、CRCAN240401743
1.新增报文PDCM_EBS2（0x3E4），发送方LBMS，接收方GW
2.删除从CHA到其他网段的报文路由
3.新增从PT到BD、CF、Diag、CHA的报文路由;
Version:V3.0.0,Date:2024/4/17,Author:詹浩,Review:,Approval:,Description:(BCM)CRCAN240327276
新增接收信号：BD-BCM新增接收EPS_SAS(0x144)：eps_sasSteeringAngle信号;
Version:V3.0.0,Date:2024/4/17,Author:詹浩,Review:,Approval:,Description:(CDC/WCM_RL/T_BOX/GW)【CRCAN240327302】~【CRCAN240327320】新增节点副驾WCM_FR、二排左WCM_RL、二排右WCM_RR
 1、新增节点WCM_RL—BDCAN
 2、WCM_RL新增发送报文：WCM_RL_state（0x4C1）：略，发送方：WCM_RL，接收方：CDC，链路:BDCAN—INFOCAN
 3、新增接收信号PSD_L（0x3EB）：PSD_L_RLDoor_St，发送方：PSD_L，接收方：WCM_RL
 4、新增接收信号ACU_state（0x380）：acu_secondLeftSts，发送方：ACU，接收方：WCM_RL
 5、WCM_RL新增接收诊断报文：DiagReq_WCM_RL(0x75E)，发送方：T_BOX，接收方：WCM_RL，链路：T_BOX—GW—WCM_RL（DiagCAN—BDCAN）
 6、WCM_RL新增发送诊断报文：DiagResp_WCM_RL(0x7DE)，发送方：WCM_RL，接收方：T_BOX，链路：WCM_RL—GW—T_BOX（BDCAN—DiagCAN）
 7、IVI新增发送信号：IVI_BodySet3（0x4D2）：ivi_wcmROnOffSet ，接收方：WCM_RL,WCM_RR（INFOCAN——BDCAN/CFCAN）
 8、GW新增报文路由：DiagReq_WCM_RL(0x762)：DiagCAN—BDCAN
DiagResp_WCM_RL(0x76A)：BDCAN—DiagCAN
 9、GW新增报文路由：WCM_RL_state（0x4C1）：BDCAN—INFOCAN;
Version:V3.0.0,Date:2024/4/17,Author:詹浩,Review:,Approval:,Description:(CDC/WCM_FR/T_BOX/GW)【CRCAN240327298】~【CRCAN240327301】新增节点副驾WCM_FR、二排左WCM_RL、二排右WCM_RR
 1、新增节点WCM_FR—CFCAN
 2、WCM_FR新增发送报文：WCM_FR_state（0x4C2）：略，发送方：WCM_FR，接收方：CDC，链路:CFCAN—INFOCAN
 3、新增接收信号DCU_FR（0x3E9）：DCU_FR_doorFRSts，发送方：DCU_R，接收方：WCM_FR
 4、新增接收信号ACU_state（0x380）：acu_passengerSts，发送方：ACU，接收方：WCM_FR
 5、WCM_FR新增接收诊断报文：DiagReq_WCM_FR(0x746)，发送方：T_BOX，接收方：WCM_FR，链路：T_BOX—GW—WCM_FR（DiagCAN—BDCAN）
 6、WCM_FR新增发送诊断报文：DiagResp_WCM_FR(0x7C6)，发送方：WCM_FR，接收方：T_BOX，链路：WCM_FR—GW—T_BOX（BDCAN—DiagCAN）
 8、GW新增报文路由：DiagReq_WCM_FR(0x765)：DiagCAN—BDCAN
DiagResp_WCM_FR(0x76D)：BDCAN—DiagCAN
 9、GW新增报文路由：IVI_BodySet2（0x1DD）：INFOCAN—CFCAN
10、GW新增报文路由：WCM_FR_state（0x4C2）：CFCAN—INFOCAN;
Version:V3.0.0,Date:2024/4/17,Author:詹浩,Review:,Approval:,Description:(CDC/WCM_RR/T_BOX/GW)【CRCAN240327306】~【CRCAN240327323】新增节点副驾WCM_FR、二排左WCM_RL、二排右WCM_RR
 1、新增节点WCM_RR—CFCAN
 2、WCM_RR新增发送报文：WCM_RR_state（0x4C3）：略，发送方：WCM_RR，接收方：CDC，链路:CFCAN—INFOCAN
 3、新增接收信号PSD_R（0x3FB）：PSD_R_RRDoor_St，发送方：PSD_R，接收方：WCM_RR
 4、新增接收信号ACU_state（0x380）：acu_secondRightSts，发送方：ACU，接收方：WCM_RR
 5、WCM_RR新增接收诊断报文：DiagReq_WCM_RR(0x75F)，发送方：T_BOX，接收方：WCM_RR，链路：T_BOX—GW—WCM_RR（DiagCAN—BDCAN）
 6、WCM_RR新增发送诊断报文：DiagResp_WCM_RR(0x7DF)，发送方：WCM_RR，接收方：T_BOX，链路：WCM_RR—GW—T_BOX（BDCAN—DiagCAN）
 7、GW新增报文路由：DiagReq_WCM_RR(0x763)：DiagCAN—BDCAN
 8、GW新增报文路由：DiagResp_WCM_RR(0x76B)：BDCAN—DiagCAN
 9、GW新增报文路由：WCM_RR_state（0x4C3）：CFCAN—INFOCAN;
Version:V3.0.0,Date:2024/4/17,Author:詹浩,Review:,Approval:,Description:(T_BOX/SCU_TR/BCM/CRF)【CRCAN240331639】【CRCAN240401655】
 1、TBOX_remoteCmd（0x058）新增发送信号：TBOX_GlassHeatReq，发送方：TBOX；接收方：BCM，链路：TBOX-GW-BCM（DiagCAN-BDCAN）
 2、T_BOX新增发送信号：TBOX_remoteCmdMMB（0x53B）: tbox_remote3LSeatHeatReq，tbox_remote3RSeatHeatReq，，tbox_Crf_Re_Sw ，发送方：T_BOX，接收方：SCU_TR，链路：T_BOX—GW—SCU_TR（DiagCAN—CFCAN）
 3、T_BOX新增发送信号：TBOX_remoteCmdMMB（0x53B）: tbox_Crf_Re_Temp，tbox_Crf_Re_Run_Mode，tbox_Crf_Re_RUNMin，发送方：T_BOX，接收方：CRF，链路：T_BOX—GW—CRF（DiagCAN—CFCAN）
 7、GW新增报文路由：DiagCAN—CFCAN：TBOX_remoteCmdMMB（0x53B）;
Version:V3.0.0,Date:2024/4/17,Author:詹浩,Review:,Approval:,Description:(GW/ACP_RR/ACP_RL/SCU_RR/SCU_RL/CDC)CRCAN240401948、CRCAN240401956、CRCAN240402989-CRCAN2404021036
1、新增报文ACP_RR_SCU_RR_adjust(0x507)、ACP_RR_control1(0x508)、ACP_RR_IVI(0x509)、ACP_RL_SCU_RL_adjust(0x50A)、ACP_RL_control1(0x50B)、ACP_RL_IVI(0x50C)
2、新增ACP_RR、ACP_RL的诊断及网管报文
3、GW新增报文路由：
INFOCAN—CFCAN：ACP_RL_SCU_RL_adjust，ACP_RL_control1
PTCANFD—INFOCAN：ACP_RL_IVI
4、GW新增报文路由：
INFOCAN—CFCAN：ACP_RR_SCU_RR_adjust，ACP_RR_control1
PTCANFD—INFOCAN：ACP_RR_IVI;
Version:V3.0.0,Date:2024/4/17,Author:詹浩,Review:,Approval:,Description:(GW/T_BOX)【CRCAN2404051045】~【CRCAN2404051056】PDCM信号上传
 1、PDCM新增信号上传需求：PDCM_EnergyInfo（0x4C4）：PDCM_oilRemainingValue，
 PDCM_RemMileage（0x4C5）：PDCM_remainingMileageOil_Standard，
 PDCM_CurrentTripInfo（0x4C8）：ALL，
 PDCM_InstanEnergyConsu（0x4D0）：PDCM_ConsumpRatioInstantDrv，PDCM_FuelConsumpDrv，
 PDCM_totalMileageInfo2（0x4D1）：PDCM_totalMileage，发送方：PDCM，接收方：T_BOX，链路：PDCM—GW—T_BOX（PTCANFD—DiagCAN）
 2、GW新增信号路由：
 PTCANFD—DiagCAN：
 PDCM_EnergyInfo（0x4C4）：PDCM_oilRemainingValue——GW_PDCM_EnergyInfo（0x43D），
 PDCM_RemMileage（0x4C5）：PDCM_remainingMileageOil_Standard——GW_PDCM_EnergyInfo（0x43D），
 PDCM_InstanEnergyConsu（0x4D0）：PDCM_ConsumpRatioInstantDrv，PDCM_FuelConsumpDrv，——GW_PDCM_InstanEnergyConsu（0x43E），
 PDCM_totalMileageInfo2（0x4D1）：PDCM_totalMileage，——GW_PDCM_InstanEnergyConsu（0x43E），
 3、GW新增报文路由：
 PTCANFD—DiagCAN：PDCM_CurrentTripInfo（0x4C8）;
Version:V3.0.0,Date:2024/4/17,Author:詹浩,Review:,Approval:,Description:(BCM/MDC/CDC/GW)【CRCAN240315095】【CRCAN2404031043】【CRCAN2404081123】BCM雨刮灵敏度-李讌斌
 1、BCM新增发送信号BCM_state4（0x422）：BCM_HMAStatus，发送方：BCM；接收方：CDC，MDC,链路：BCM-GW-CDC/MDC（BDCAN-INFOCAN）;
Version:V3.0.0,Date:2024/4/17,Author:詹浩,Review:,Approval:,Description:(BCM/T_BOX)CRCAN2404101394
新增发送信号BCM_tbox_failCode(0x51):bcm_VehUnlockedWarning、bcm_VehUnClosedWarning，T_BOX接收;
Version:V3.0.0,Date:2024/4/17,Author:詹浩,Review:,Approval:,Description:(T_BOX)CRCAN2404101396-CRCAN2404101398、CRCAN2404101406、CRCAN2404101407
1、T_BOX新增接收报文:AC3（0x39D），AC—GW—T_BOX（CFCAN—DiagCAN）
2、GW新增报文路由：AC3（0x39D）：CFCAN—DiagCAN
3、T_BOX新增上传信号：PDCM_ultrasocengStartReq、PDCM_EBSLowSOCWarn;
Version:V3.0.0,Date:2024/4/17,Author:詹浩,Review:,Approval:,Description:(T_BOX/PDCM)CRCAN2404101435
1、T_BOX新增发送TBOX_chargeSet(0x07E)：tbox_ultrasocengStartCmd，PDCM接收;
Version:V3.0.0,Date:2024/4/18,Author:詹浩,Review:,Approval:,Description:(ACP_RR/ACP_RL/GW)CRCAN2404101436-CRCAN2404101447
1、ACP_RR,ACP_RL新增座椅状态反馈信号;
Version:V3.0.0,Date:2024/4/18,Author:詹浩,Review:,Approval:,Description:(ACP_RR/ACP_RL/GW)CRCAN2404101448-CRCAN2404101451
1、ACP_RR、ACP_RL新增接收遮阳帘信号;
Version:V3.0.0,Date:2024/4/18,Author:詹浩,Review:,Approval:,Description:(ACP_RR/ACP_RL)CRCAN2404111690-CRCAN2404111697、CRCAN2404111698-CRCAN2404111707
1、ACP_RL、ACP_RR新增接收冰箱和空调信号;
Version:V3.0.0,Date:2024/4/18,Author:詹浩,Review:,Approval:,Description:(TBOX)CRCAN240401650 CRCAN240401892
1、TBOX新增接收三排座椅加热信号
2、GW新增报文路由：CFCAN->DaigCAN SCU_TR(0x4CD);
Version:V3.0.0,Date:2024/4/19,Author:詹浩,Review:,Approval:,Description:(BLE/MDC)CRCAN240329496-CRCAN240329503
1、MDC修改目标车位ADAS_ParkChkSrc_Posn1~ADAS_ParkChkSrc_Posn8的信号大小及预留，BLE接收;
Version:V3.0.0,Date:2024/4/19,Author:詹浩,Review:,Approval:,Description:(MDC/ISC)CRCAN240402966-CRCAN240402972、CRCAN2404071066、CRCAN2404071067、CRCAN2404081136、CRCAN2404081145
1、新增报文0x1AE的 E2E校验，MDC发送，ISC接收
2、MDC新增接收SWM_set(0x320)：swm_highbeam、swm_overtakingLight
3、MDC在CHACANFD上删除接收PDCM_RemainingMileage_Standard信号，已经在INFOCANFD上接收
4、MDC新增接收DCU_FL_doorFLLockSts信号
5、修改MdcNicaReminderAcoustic信号值描述，CDC接收
6、MDC新增接收SWS_PilotSW、SWS_PilotSWValid
7、MDC新增接收PDCM_ExhibitionSts、BCM_SelfCarWashSts信号;
Version:V3.0.0,Date:2024/4/19,Author:詹浩,Review:,Approval:,Description:(MDC/TBOX/CDC)CRCAN2404091279-CRCAN2404091280、CRCAN2404101352-CRCAN2404101353、CRCAN2404162341
1、MDC删除接收SENTRY_SwitchSts、SENTRY_ShakeSts,CDC不再发送两个信号
2、MDC新增接收BCM_lampswitchfdb、bcm_frontWiperSts
3、TBOX新增发送TBOX_chargeSet(0x07E):TBOX_FuncReq_SentryMod MDC接收;
Version:V3.0.0,Date:2024/4/19,Author:詹浩,Review:,Approval:,Description:(BCM/CDC)修改BCM_autoWipersta的信号值描述  CDC接收;
Version:V3.0.0,Date:2024/4/9,Author:汤枝子,Review:H56C全配置,Approval:,Description:(CDC/IPB)【CRCAN240327274】IVI—架构李晨
 1、IVI新增发送信号：IVI_chassisSet2（0x278）：ivi_AVHModeSet ，发送方：CDC，接收方：IPB，链路：CDC—GW—IPB（INFOCAN—CHACANFD）
 2、IPB申请调换信号位置：ivi_AVHModeSet（IVI_chassisSet2）与ivi_IPBModeSet（IVI_chassisSet）调换信号位置;
Version:V3.0.0,Date:2024/4/9,Author:汤枝子,Review:H56C全配置,Approval:,Description:(ACP_RL/ACP_RR/CDC)【CRCAN240327277】【CRCAN240327280】ACP_RL/ACP_RR—架构李晨
 1、新增节点ACP_RL/ACP_RR——PTCANFD
 2、IVI新增发送信号：IVI_chassisSet2（0x278）：IVI_ACPLRLOCK ，发送方：CDC，接收方：ACP_RL/ACP_RR，链路：CDC—GW—ACP_RL/ACP_RR（INFOCAN—PTCANFD）;
Version:V3.0.0,Date:2024/4/9,Author:汤枝子,Review:H56C全配置,Approval:,Description:(CDC/GW/BCM)【CRCAN240327281】BCM/IVI—架构李晨
 1、IVI修改信号及报文发送方式：IVI_BodySet3（0x4D2）：IVI_autoWiper，报文改为CE，信号改为OnChange，发送方：CDC；接收方：BCM，链路：IVI-GW-BCM（INFOCAN-BDCAN）;
Version:V3.0.0,Date:2024/4/9,Author:汤枝子,Review:H56C全配置,Approval:,Description:(CDC/GW/BCM)【CRCAN240327289】【CRCAN240327291】【CRCAN240327293】【CRCAN240327317】【CRCAN240327321】BCM/IVI—架构李晨，香氛控制
 1、CDC新增发送信号：IVI_BodySet3（0x4D2）：ivi_fcmSwiResp，ivi_fragTaste，ivi_fragConcentrationReq，ivi_ambientLightOnOffSet，ivi_ambientLightColorSet，ivi_ambientLightLumiLvSet，IVI_IAL_MusicFrequency，发送方：CDC；接收方：BCM，链路：CDC-GW-BCM（INFOCAN-BDCAN）;
Version:V3.0.0,Date:2024/4/17,Author:汤枝子,Review:H56C全配置,Approval:,Description:(CDC/GW/BCM)【CRCAN2404172343】
 1、CDC新增发送信号：IVI_BodySet3（0x4D2）：IVI_IAL_ColorMode，发送方：CDC，接收方：BCM，链路：CDC—BCM（INFOCAN—BDCAN）;
Version:V3.0.0,Date:2024/4/9,Author:汤枝子,Review:H56C全配置,Approval:,Description:(CDC/BCM)【CRCAN240327322】~【CRCAN240327341】BCM/IVI—架构李晨，音乐频率
 1、CDC新增发送报文：IVI_IAL_Frequency（0x4C0）：IVI_IAL_FirstFrequency，IVI_IAL_SecondFrequency，IVI_IAL_ThirdFrequency，IVI_IAL_ForthFrequency，IVI_IAL_FifthFrequency，IVI_IAL_SixthFrequency，IVI_IAL_SeventhFrequency，IVI_IAL_EighthFrequency，发送方：CDC；接收方：BCM，链路：CDC-GW-BCM（INFOCAN-BDCAN）
 2、GW新增报文路由：INFOCAN-BDCAN：IVI_IAL_Frequency（0x4C0）;
Version:V3.0.0,Date:2024/4/9,Author:汤枝子,Review:H56C全配置,Approval:,Description:(CDC/BCM)【CRCAN240328367】【CRCAN240328366】【CRCAN2404091319】BCM/IVI—架构李晨，香氛控制
 1、CDC新增发送信号：IVI_BodySet3（0x4D2）：IVI_PSDEnadbleSet，发送方：CDC；接收方：PSD_L,PSD_R，链路：CDC-GW-PSD_L,PSD_R（INFOCAN-BDCAN）
 2、CDC新增发送信号：IVI_BodySet3（0x4D2）：IVI_PSDEnadbleSet，ivi_Externallightswitch，发送方：CDC；接收方：BCM，链路：CDC-GW-BCM（INFOCAN-BDCAN）
 3、CDC新增发送信号：IVI_BodySet2（0x1DD）：ivi_ rearFogLampSwitch，发送方：CDC；接收方：BCM，链路：CDC-GW-BCM（INFOCAN-BDCAN）;
Version:V3.0.0,Date:2024/4/9,Author:汤枝子,Review:H56C全配置,Approval:,Description:(CDC/SCU_TR)【CRCAN240328373】【CRCAN240328374】【CRCAN240328376】【CRCAN240328377】【CRCAN240328379】【CRCAN240328381】SCU_TR新增信号
 1、新增节点SCU_TR——CFCAN
 2、CDC新增发送信号：IVI_SCUCtrl2（0x419）：ivi_3LSeatHeatOnOffSet，ivi_3RSeatHeatOnOffSet，ivi_3LSeatFoldSet，ivi_3RSeatFoldSet，ivi_3LSeatUnfoldSet，ivi_3RSeatUnfoldSet，发送方：CDC，接收方：SCU_TR，链路:INFOCAN—CFCAN;
Version:V3.0.0,Date:2024/4/17,Author:汤枝子,Review:H56C全配置,Approval:,Description:(PDCM/CDC/T_BOX)【CRCAN2404152216】【CRCAN2404172356】
 1、CDC新增发送信号：IVI_control（0x075）：IVI_SREVSOCset，发送节点：CDC，接收节点：PDCM，链路:CDC—GW—PDCM(INFOCAN—PTCAN）
 2、CDC新增信号：IVI_SCUCtrl1（0x1D8）：ivi_dsmGetMemoryReq，新增0x7：STOP，发送方：CDC，接收方：SCU_FR,SCU_F，链路:INFOCAN—CFCAN;
Version:V3.0.0,Date:2024/4/11,Author:汤枝子,Review:H56C全配置,Approval:,Description:(SCU_RL/SCU_RR)【CRCAN2404101369】【CRCAN2404101374】RLM新增接收信号
 1、SCU_RL新增信号枚举值：SCU_RL（0x3D6）：SCU_RL_RL_3ndLeftSts，发送方：SCU_RL，接收方：CDC，
 2、SCU_RR新增信号枚举值：SCU_RR（0x3E6）：SCU_RR_RR_3ndRightSts，发送方：SCU_RR，接收方：CDC，;
Version:V3.0.0,Date:2024/4/17,Author:汤枝子,Review:H56C全配置,Approval:,Description:(CDC/GW/PSD_L/PSD_R)【CRCAN2404172343】
 1、PSD_L新增发送信号：PSD_L（0x3EB）：PSD_L_PSDEnadbleSta，发送方：PSD_L，接收方：CDC，链路：PSD_L—CDC（BDCAN—INFOCAN）
 2、PSD_L新增发送信号：PSD_R（0x3FB）：PSD_R_PSDEnadbleSta，发送方：PSD_R，接收方：CDC，链路：PSD_L—CDC（BDCAN—INFOCAN）;
Version:V3.0.0,Date:2024/4/17,Author:汤枝子,Review:H56C全配置,Approval:,Description:(CDC/ACP_RL/ACP_RR/GW)【CRCAN2404152156】吸顶屏需求
 1、CDC新增信号IVI_chassisSet2（0x278）：IVI_CeilingScreenONOFFSts，发送方：CDC，接收方：ACP_RL,ACP_RR，链路：INFOCAN——PTCAN;
Version:V3.0.0,Date:2024/4/17,Author:汤枝子,Review:H56C华为,Approval:,Description:(MDC/CDC/PDCM)【CRCAN2404182368】【CRCAN2404192373】【CRCAN2404192374】【CRCAN2404192375】MDC
 1、MDC修改信号初始值MDC_PwrCtl（0x276）：MDC_SysState，发送方：MDC，接收方：T_BOX，链路：INFOCAN——DiagCAN
2、MDC新增接收CRC信号：BCM_state1（0x2A3）:RollingCounter2A3,Checksum2A3
3、PDCM_drivemode信号取消0x4和0x5定义，发送方：PDCM；接收方：CDC
4、新增信号PDCM_driveMode_HW，发送方PDCM：，接收方：CDC;
Version:V3.0.0,Date:2024/4/17,Author:汤枝子,Review:H56C华为,Approval:,Description:(CDC/PDCM/GW)【CRCAN2404172345】——李晨
 1、CDC新增信号IVI_control（0x075）：IVI_SREVSOCset_HW，发送方：CDC，接收方：PDCM，链路：INFOCAN——PTCAN;
Version:V3.0.0,Date:2024/4/23,Author:汤枝子,Review:H56C华为,Approval:,Description:(GW)【问题反馈】——董昭
 1、删除报文路由：0x105，0x308,0x30A，0x30D，链路：INFOCAN——CHACANFD
 2、删除报文路由：0x122，0x142，0x198，0x199，0x19A，0x341，链路：CHACANFD——DiagCAN
 3、删除报文路由：0x5E7，0x5EE，0x5F3，0x5F4，0x5F5，0x5F6，0x5FB，链路：PTCAN——DiagCAN
 4、删除报文路由：0x741，0x749，0x7F1，链路：DiagCAN——INFOCAN
 5、删除报文路由：0x7C1，0x7C9，0x7F9，链路：INFOCAN——DiagCAN;
Version:V3.0.0,Date:2024/4/23,Author:汤枝子,Review:H56C华为,Approval:,Description:(CDC/GW/AMP)【问题反馈】——魏来
 1、AMP更改报文周期：IVI_ampSet（0x11E），周期由20ms改为100ms，链路：CDC—GW—AMP（INFOCAN——PSCAN）
 2、AMP更改信号值：IVI_infoSet1（0x41F）：ivi_vspOnOffSet2，物理最大值，总校最大值更改，链路：CDC—GW—AMP（INFOCAN——PSCAN）
 3、AMP更改信号值：IVI_ampSet（0x11E）：ivi_soundFieldSet，链路：CDC—GW—AMP（INFOCAN——PSCAN）
 4、AMP更改信号值：IVI_infoSet1（0x41F）：IVI_RegisterPositionStatus，链路：CDC—GW—AMP（INFOCAN——PSCAN）
 5、AMP更改信号值：AMP_Response1（0x548）：amp_ICCEnable，链路：AMP—GW—CDC（PSCAN——INFOCAN）
 6、AMP删除信号：IVI_infoSet（0x0C5）：ivi_vspOnOffSet ，ivi_weightlowFrqSet，链路：CDC—GW—AMP（INFOCAN——PSCAN）
 7、AMP删除信号：IVI_ampSet（0x11E）： ivi_highFrqSet，ivi_midFrqSet，ivi_amp_dyaudioSoundFeature，ivi_lowFrqSet，链路：CDC—GW—AMP（INFOCAN——PSCAN）
 8、AMP删除信号：AMP_Response（0x405）：amp_weightlowFrqSetSts ，链路：AMP—GW—CDC（PSCAN——INFOCAN）
 9、AMP删除信号：AMP_state（0x406）：amp_highFrqSetSts ，amp_midFrqSetSts ，amp_lowFrqSetSts，amp_dyaudioSoundFeatureSts，链路：AMP—GW—CDC（PSCAN——INFOCAN）;
Version:V3.0.0,Date:2024/4/23,Author:汤枝子,Review:H56C华为,Approval:,Description:(CDC/GW/AMP)【CRCAN240329584】同步H77——魏来
 1、CDC新增发送报文及信号：IVI_infoSet6（0x1C5）：ivi_SlotModeSet，链路：CDC—GW—AMP（INFOCAN——PSCAN）
2、GW新增报文路由：INFOCAN——PSCAN：IVI_infoSet6（0x1C5）;
Version:V3.0.0,Date:2024/4/23,Author:汤枝子,Review:H56C华为,Approval:,Description:(BCM/MDC)【新增需求】孙欢
 1、MDC修改信号值描述：MDC_bodyCtl（0x286）：MdcFrontWiperReq，0x1改为预留，链路：MDC—GW—BCM（INFOCAN——BDCAN）;
Version:V3.0.0,Date:2024/4/25,Author:汤枝子,Review:H56C全配置,Approval:,Description:(CDC/AC)【CR0056】AC新增需求——同步H56B
1、AC新增发送信号：AC_AirQuality（0x2F1）：AC_BackRowACAutoSta，AC_DORmodeSts，AC_BackRowComfortEnableSta，AC_ACDryingandOdorRemovalSts，发送方：AC，接收方：CDC，链路：AC-GW-CDC（CFCAN—INFOCAN）
2、IVI新增发送信号：IVI_ACHCMCtrl（0x1D7）：IVI_ACDryingandOdorRemoval，IVI_ACDORmode，IVI_BackRowACAutoSet，IVI_BackRowComfortEnable，发送方：CDC，接收方：AC，链路：CDC-GW-AC（INFOCAN—CFCAN）
3、AC新增接收信号：ACU_state（0x380）：acu_passengerSts，acu_secondLeftSts，acu_secondRightSts，发送方：ACU，接收方：AC，链路：ACU-GW-AC（INFOCAN—CFCAN）;
Version:V3.0.0,Date:2024/4/25,Author:汤枝子,Review:H56C全配置,Approval:,Description:(BCM/GW/AC)【CR0056】AC新增接收除冰雪信号_同步H56B
1、AC新增接收信号：BCM_state4（0x422）:BCM_GlassHeatSta，发送节点：BCM，接收节点：AC，链路:BCM—GW—AC(BDCAN—CFCAN）
2、GW新增路由：BCM_state4（0x422），链路:BDCAN—CFCAN;
Version:V3.0.0,Date:2024/4/25,Author:汤枝子,Review:H56C华为,Approval:,Description:(BCM/MPC)【问题反馈】周火星
1、删除报文MPC3：略，发送节点：MPC，接收节点：BCM，链路:MPC—GW—BCM(CHACANFD—BDCAN）;
Version:V3.0.0,Date:2024/4/25,Author:汤枝子,Review:H56C华为,Approval:,Description:(CDC/CRF/T_BOX)【问题反馈】武东培
1、更改信号枚举值：IVI_Fridge_Req（0x41D）：IVI_CrfOnOffReq，发送节点：CDC，接收节点：CRF，链路:CDC—GW—CRF(INFOCANFD—CFCAN）
2、更改信号枚举值：IVI_Fridge_Req（0x41D）：IVI_CrfOffLineTimeSet，IVI_CrfTempAdjReq，发送节点：CDC，接收节点：CRF，链路:CDC—GW—CRF(INFOCANFD—CFCAN）
3、更改信号物理最小值：IVI_Fridge_Req（0x41D）：IVI_CrfTempAdjReq，CRF_Fridge_St（0x41E）：CrfTempAdjSt，物理最小值由-6改为-7，发送节点：CDC，接收节点：CRF，链路:CDC—GW—CRF(INFOCANFD—CFCAN）
4、更改信号枚举值：CRF_Fridge_St（0x41E）：CrfOffLineTimeLeave，CrfOffLineTimeSetSt，发送节点：CDC，接收节点：CRF，链路:CDC—GW—CRF(INFOCANFD—CFCAN）
5、更改信号枚举值：ACP_RR_control1（0x508）：ACP_RR_CRF_TempAdjReq，发送节点：ACP_RR，接收节点：CRF，链路:ACP_RR—GW—CRF(PTCAN—CFCAN）
6、更改信号枚举值：ACP_RL_control1（0x50B）：ACP_RL_CRF_TempAdjReq，发送节点：ACP_RL，接收节点：CRF，链路:ACP_RL—GW—CRF(PTCAN—CFCAN）
7、更改信号枚举值：TBOX_remoteCmdMMB（0x53B）：tbox_Crf_Re_Temp，tbox_Crf_Re_RUNMin，发送节点：ACP_RL，接收节点：CRF，链路:ACP_RL—GW—CRF(PTCAN—CFCAN）
8、删除原有41E报文CrfTempActRsp、CrfFaultSt、RFCM_FridgeModeSt、Crf_SWVer、Crf_HWVer、RFCM_DoorsetSt、CrfDoorOnOffSt、CrfChildLockSt、Crf_TempUnitSt、CrfOnOffSt、CrfStznSt信号
9、41E报文新增发送Crf_FridgeModeSt、CrfOffLineTimeLeave、CRF_Fridge_St、CrfFaultSt、Crf_SWVer、RFCM_DoorsetSt、CrfDoorOnOffSt、CrfOffLineAPPMessage、CrfOnOffSt、CrfStznSt、CrfPwrModSt、CRF_DoorOpenWarn、CrfOffLineWorkSt、CrfChildLockSt、CrfOffLineTimeSetSt信号AC接收
10、CDC更改信号物理最大值总线值：IVI_Fridge_Req(0x41D):IVI_CrfOffLineTimeSet,IVI_CrfTempAdjReq,发送方：CDC，接收方：CRF，链路：CDC—GW—CRF（INFOCAN—CFCAN）
11、T_BOX更改信号偏移量：TBOX_remoteCmdMMB（0x53B）：tbox_Crf_Re_Temp，发送方：T_BOX，接收方：CRF，链路：DiagCAN——CFCAN;
Version:V3.0.0,Date:2024/4/25,Author:汤枝子,Review:H56C全配置,Approval:,Description:(BCM/GW)【非华为同步】
1、BCM接收信号方式由报文路由改为信号路由EPS_SAS（0x144）：ALL，发送方：EPS；接收方：BCM，链路：EPS—GW—BCM（CHACANFD—BDCAN）
2、GW新增信号路由CHACANFD——BDCAN：EPS_SAS（0x144）——GW_BDCAN（0x4E4）：eps_sasSteeringAngle;
Version:V3.0.0,Date:2024/4/25,Author:汤枝子,Review:H56C全配置,Approval:,Description:(PDCM/CDC/MDC)【CRCAN202404232424】——陈剑立
1、PDCM修改信号长度：PDCM_RemMileage（0x4C5）:PDCM_remainingMileageOil_Real，PDCM_remainingMileageOil_Standard，信号长度由10改为11bit，同时更改信号长度，发送方：PDCM，接收方：CDC,MDC，链路：PDCM—GW—CDC（PTCAN——INFOCANFD）;
Version:V3.0.0,Date:2024/4/25,Author:汤枝子,Review:H56C全配置,Approval:,Description:(PDCM/EMS)【问题反馈】——张旭
1、EMS修改信号单位：EMS9（0x46C）:EMS_FuelResistanceValue，PDCM_remainingMileageOil_Standard，信号单位由%改为Ω，发送方：EMS，接收方：PDCM，链路：EMS—PDCM—CDC（SPTCAN2—PTCAN—INFOCANFD）;
Version:V3.0.0,Date:2024/4/25,Author:汤枝子,Review:H56C全配置,Approval:,Description:(PDCM)【问题反馈】——曾柯，梅琦
1、PDCM新增接收信号：EPS_state（0x124）:EPS_ModeFb，发送方：EPS，接收方：PDCM，链路：EPS—PDCM（CHACANFD）
2、PDCM新增接收信号：ASC_state1（0x341）:ASC_ISCModeFb，发送方：ISC，接收方：PDCM，链路：ISC—PDCM（CHACANFD）
3、PDCM新增发送信号：PDCM_IVI（0x31D）：PDCM_EVonlymode，发送方：PDCM，接收方：CDC，链路:PDCM—CDC(PTCAN——INFOCAN）;
Version:V3.0.0,Date:2024/4/25,Author:汤枝子,Review:H56C全配置,Approval:,Description:(ISC/MDC)【CRCAN2404232430】【CRCAN2404232432】——周火星
1、ISC新增发送信号：ASC_state1（0x341）：ASC_FrontSts，ASC_RearSts，发送方：ISC，接收方：MDC，链路：ISC—MDC（CHACANFD）;
Version:V3.0.0,Date:2024/4/25,Author:汤枝子,Review:H56C全配置,Approval:,Description:(MDC)【CRCAN2404232433】【CRCAN2404232434】——汪沛伟
1、MDC新增接收信号：BLE_request（0x10）：ble_rke_lockCtrlReq，发送方：BLE，接收方：MDC，链路：BLE—MDC（BDCAN—INFOCAN）
2、MDC新增接收信号：BLE_APA（0X135）：BLE_PowerModeReq，发送方：BLE，接收方：MDC，链路：BLE—MDC（BDCAN—INFOCAN）;
Version:V3.0.0,Date:2024/4/25,Author:汤枝子,Review:H56C全配置,Approval:,Description:(MDC/T_BOX/GW)【CRCAN2404242435】——孙欢，无ICM节点
1、删除NM报文：NM_ICM（0x609）：略，发送方：ICM，接收方：MDC，CDC
2、删除ICM诊断报文及其路由：DiagReq_ICM（0x709），DiagResp_ICM（0x789），影响方：T_BOX，GW;
Version:V3.0.0,Date:2024/4/25,Author:汤枝子,Review:H56C全配置,Approval:,Description:(PDCM/CDC/GW)【CRCAN2404242436】——谢忠原
1、PDCM取消发送信号：IC_state（0x4D6）：ic_vehicleSpeedDisp，ic_vehicleSpeedDispValid，发送方：PDCM，接收方：GW
2、CDC新增发送信号：IVI_chassisSet2（0x278），发送方：CDC，接收方：PDCM,MDC，链路：CDC—GW/MDC—PDCM（INFOCAN—CHACANFD）;
Version:V3.0.0,Date:2024/4/25,Author:汤枝子,Review:H56C华为,Approval:,Description:(ACP_RL/ACP_RR/GW)【拓扑差异】——李晨，ACP_RL,ACP_RR网段由PTCAN挪动到INFOCANFD
1、GW新增报文路由：CFCAN——INFOCAN：SCU_RR2（0x503），SCU_RL2（0x501）
2、GW删除报文路由：CFCAN——PTCAN：SCU_RR（0x3E6），SCU_RR2（0x503），SCU_RL（0x3D6），SCU_RL2（0x501），CRF_Fridge_St（0x41E），
3、新增ACP_RR、ACP_RL的诊断报文路由地点由PTCAN变为INFOCAN：DiagReq_ACP_RR(0x738)，DiagResp_ACP_RR(0x7B8)，DiagReq_ACP_RL(0x723)，DiagResp_ACP_RL(0x7A3)
3、GW更改报文路由源，由PTCANFD—CFCAN改为INFOCAO——CFCAN：ACP_RL_SCU_RL_adjust，ACP_RL_control1，ACP_RR_SCU_RR_adjust，ACP_RR_control1
4、取消报文路由PTCANFD—INFOCAN：ACP_RL_IVI，ACP_RR_IVI;
Version:V3.0.1,Date:2024/4/28,Author:汤枝子,Review:H56C华为,Approval:,Description:(MDC/CDC)【CRCAN2404282724】
1、MDC新增发送信号：MDC_PwrCtl（0x276）：MDC_FuncReq_SentryModWarn，发送方：MDC，接收方：CDC，链路：MDC—CDC（INFOCAN）;
Version:V3.0.1,Date:2024/4/28,Author:汤枝子,Review:H56C华为,Approval:,Description:(ISC/CDC)【同步H53调整】
1、IVI更删除信号：IVI_chassisSet（0x1BE）：ivi_EasyPackSet：发送节点：IVI，接收节点：ISC，链路:IVI—GW—CDC(INFOCAN—CHACANFD)
2、IVI新增信号：IVI_chassisSet（0x278）：ivi_EasyPackSet，发送节点：IVI，接收节点：ISC，链路:IVI—GW—CDC（INFOCAN—CHACANFD);
Version:V3.0.1,Date:2024/4/28,Author:汤枝子,Review:H56C华为,Approval:,Description:(CDC/BCM)【CRCAN240329447】~【CRCAN240329466】BCM
1、BCM新增发送报文BCM_FCM（0x50D）：略，发送方：BCM，接收方：IVI，链路：BDCAN—INFOCAN
2、GW新增报文路由：BDCAN—INFOCAN：BCM_FCM（0x50D）;
Version:V3.0.1,Date:2024/4/28,Author:汤枝子,Review:H56C华为,Approval:,Description:(CDC)【问题反馈】AC
1、CDC取消接收报文AC_TESTMSG11（0x5FD）：略，发送方：AC，接收方：CDC，链路：CFCAN—INFOCAN;
Version:V3.0.1,Date:2024/4/28,Author:汤枝子,Review:H56C华为,Approval:,Description:(CDC)【问题反馈】CDC更改接收方向盘加热信号
1、CDC取消接收信号：GW_LIN_BODY（0x3E2）：SWH_SteerWheelHeatgSts，
2、CDC新增接收信号：GW_HOD（0x27D）：HOD_SteerWheelHeatgSts，发送方：GW（HOD），接收方：CDC，链路：GWLIN1—INFOCAN;
Version:V3.0.1,Date:2024/4/28,Author:汤枝子,Review:H56C全配置,Approval:,Description:(PDCM/CDC/GW)【问题反馈】PDCM 修改燃油信号报文ID
1、CDC修改报文ID：IVI_ChargingStationInfo，ID由0x35C改为0x53C，发送方：CDC，接收方：PDCM，链路：CDC—GW—PDCM;
Version:V3.0.1,Date:2024/4/28,Author:汤枝子,Review:H56C全配置,Approval:,Description:(PDCM/ISC/EPS/CDC)CRCAN2404172344、CRCAN2404172346、CRCAN2404172347
1.PDCM更改信号位置及周期：PDCM_EpsModeSet，所在报文由PDCM3改为PDCM1，周期由500ms改100ms，发送方：PDCM；接收方：EPS（CHACAN）
2.PDCM更改信号位置及周期：PDCM_ISCModeSet，所在报文由PDCM3改为PDCM1，周期由500ms改100ms，发送方：PDCM；接收方：ISC（CHACAN）
3.PDCM更改信号位置及周期：PDCM_PropMode，所在报文由PDCM3改为PDCM1，周期由500ms改100ms，发送方：PDCM；接收方：CDC（PTCAN—INFOCANFD）;
Version:V3.0.1,Date:2024/5/11,Author:汤枝子,Review:H56C全配置,Approval:,Description:(GW/T_BOX)【CRCAN202404232424】——陈剑立
1、PDCM修改信号长度：GW_PDCM_EnergyInfo（0x43D）:PDCM_remainingMileageOil_Standard，信号长度由10改为11bit，同时更改信号长度，发送方：PDCM，接收方：T_BOX，链路：PDCM—GW—T_BOX（PTCAN——DiagCAN）
2、GW同步更改信号路由位置;
Version:V3.0.2,Date:2024/5/13,Author:汤枝子,Review:H56C全配置,Approval:,Description:(BCM)【CRCAN202404081273】——BCM问题反馈
1、BCM新增接收报文：MDC_bodyCtl（0x286）：略，BCM新增接收此报文全部信号，链路:MDC—GW—BCM（INFOCAN—BDCAN）;
Version:V3.0.2,Date:2024/5/20,Author:汤枝子,Review:H56C全配置,Approval:,Description:(SCU_TR/CRF/WCM_RR/WCM_RL/ACP_RR/T_BOX/GW)1、更改诊断ID报文：DiagReq_WCM_RR(0x740)，DiagResp_WCM_RR(0x7C0)，DiagReq_WCM_RL(0x730)，DiagResp_WCM_RL(0x7C0)，DiagReq_SCU_TR(0x73C)，DiagResp_SCU_TR(0x7BC)，DiagReq_CRF(0x0x732)，DiagResp_CRF(0x7B2)，DiagReq_ACP_RR(0x738)，DiagResp_ACP_RR(0x7B8),DiagReq_ACP_RL(0x723),DiagResp_ACP_RL(0x7A3)
2,GW新增路由：DiagReq_ACP_RR(0x764)，DiagResp_ACP_RR(0x76C),DiagReq_ACP_RL(0x723),DiagResp_ACP_RL(0x7A3),DiagReq_CRF(0x0x732)，DiagResp_CRF(0x7B2);
Version:V3.0.3,Date:2024/6/3,Author:汤枝子,Review:H56C华为,Approval:,Description:(AMP/CDC/GW)【CRCAN2405283634】~【CRCAN2405283649】【CRCAN2405283675】——IVI AMP临时需求：SLOT信号拆分
1、AMP修改信号：IVI_infoSet6（0x1C5）：ivi_SlotModeSet拆分为15个信号，发送：CDC，接收：AMP，链路：CDC—GW—AMP（INFOCANFD—PSCAN）
2、AMP新增发送信号：IVI_infoSet6（0x1C5）：WarningpositionSet,，发送：CDC，接收：AMP，链路：CDC—GW—AMP（INFOCANFD—PSCAN）;
Version:V3.0.3,Date:2024/6/3,Author:汤枝子,Review:H56C华为,Approval:,Description:(MDC/EPB)【CRCAN2405283682】【CRCAN2405283683】【CRCAN2405283684】【CRCAN2405283685】——MDC临时需求
1、MDC新增接收信号：MDC_VlcCtrl2（0x0D8）：ADS_DrvTarTqEna、ADS_DrvTarTqMod、RollingCounter0D8、Checksum0D8，发送方：MDC，接收方：EPB，链路：CHACANFD;
Version:V4.0.0,Date:2024/5/20,Author:汤枝子,Review:H56C华为,Approval:,Description:(IC/BCM/GW/CDC)【CRCAN2405153318】~【CRCAN2405153365】——张南辉
1、新增IC节点—INFOCANFD
2、IC新增发送报文：IC_Report_HWVer（0x439），IC_Report_SWVer（0x43A），IC_Report_Status（0x43B），IC_Report_Heartbeat（0x43C），IC_Report_Temp（0x441），IC_Report_Light（0x453），IC_Report_Log（0x457），IC_Report_Apr_Log（0x458），IC_Report_Event（0x459），发送方：IC，接收方：CDC，链路：IC—CDC（INFOCANFD）
3、CDC新增发送报文：IC_Recv_Backlight（0x456），发送方：CDC，接收方：IC，链路：CDC——IC
3、IC新增发送报文：IC_Report_Light100（0x454），发送方：IC，接收方：BCM，链路：IC—GW—BCM
4、GW新增信号路由：IC_Report_Light100（0x454）：IC_Backlight_Status_100——GW_BDCAN（0x4E4）：IC_Backlight_Status_100;
Version:V4.0.0,Date:2024/6/4,Author:汤枝子,Review:H56C全配置,Approval:,Description:(BCM/T_BOX)【CR20240401655】
1、T_BOX新增接收信号：BCM_state4（0x422）:BCM_GlassHeatSta，发送节点：BCM，接收节点：T_BOX，链路:BCM—GW—T_BOX(BDCAN—DiagCAN）;
Version:V4.0.0,Date:2024/6/4,Author:汤枝子,Review:H56C全配置,Approval:,Description:(MDC/PDCM)【问题反馈】
1、MDC修改信号物理最大值：MDC_VlcCtrl1（0x0D7）:ADSLimTqFactorK，发送节点：MDC，接收节点：PDCM，链路:MDC—GW—PDCM(CHACANFD）;
Version:V4.0.0,Date:2024/6/20,Author:汤枝子,Review:H56C华为,Approval:,Description:(CDC)【问题反馈】
1、CDC新增接收信号：HCM_R（0x110）：HCM_RightpositionLampFault、HCM_RightDRLFault、HCM_hcmHeightSetRt 、发送方：HCM_R，接收方：CDC
2、CDC新增接收信号：AC1：（0x36B）：AC_ambientTempValid，发送方：AC，接收方：CDC;
Version:V4.0.0,Date:2024/6/21,Author:汤枝子,Review:H56C全配置,Approval:,Description:(PDCM/BCM/GW)【CRCAN2404282715】PDCM
1、PDCM新增发送信号：PDCM6（0x2AE）：PDCM_BrakelightRequest,发送方：PDCM,接收方：BCM,链路：PDCM—GW—BCM（PTCAN—BDCAN）;
Version:V4.0.0,Date:2024/6/21,Author:汤枝子,Review:H56C全配置,Approval:,Description:(CDC/T_BOX/BCM)【CRCAN2404282730】【CRCAN2404292778】【CRCAN2404292779】【CRCAN2404302782】【CRCAN2405082800】——架构
1、CDC新增发送信号：IVI_infoSet（0x0C5）：IVI_SelfChargingStationLink,发送方：CDC,接收方：T_BOX,链路：CDC—GW—T_BOX（INFOCAN—DiagCAN）
2、CDC新增发送信号：IVI_BodySet3（0x4D2）：IVI_RearLogoLampSet,发送方：CDC,接收方：BCM,链路：CDC—GW—BCM（INFOCAN—BDCAN）
3、BCM新增发送信号：：BCM_state4（0x422）：BCM_RearLogoLampSta,发送方：BCM,接收方：CDC,链路：BCM—GW—CDC（BDCAN—INFOCAN）
4、CDC更改信号值文字描述：IVI_BodySet3（0x4D2）：IVI_IAL_ColorMode,发送方：CDC,接收方：BCM,链路：CDC—GW—BCM（INFOCAN—BDCAN）;
Version:V4.0.0,Date:2024/6/21,Author:汤枝子,Review:H56C全配置,Approval:,Description:(CDC/T_BOX/PDCM/DCU_FL/DCU_FR/DCU_RL/DCU_RR)【CRCAN2405072792】~【CRCAN2405072796】——架构
1、CDC新增发送信号：IVI_chassisSet2（0x278）：IVI_remainingMileageswitch,发送方：CDC,接收方：PDCM,T_BOX,链路：CDC—GW—PDCM,T_BOX（INFOCAN—PTCAN/DiagCAN）
2、CDC新增发送报文IVI_BodySet4（0x431），信号IVI_FLWindowHorizontalReq，IVI_FRWindowHorizontalReq，IVI_RLWindowHorizontalReq,IVI_RRWindowHorizontalReq，链路：CDC—GW—DCU_FL,DCU_FR,DCU_RL,DCU_RR（INFOCAN—BDCANN）
3、GW新增报文路由：INFOCAN—BDCAN：IVI_BodySet4（0x431）;
Version:V4.0.0,Date:2024/6/21,Author:汤枝子,Review:H56C全配置,Approval:,Description:(T_BOX/BCM/BLE/DCU_FL/DCU_FR/DCU_RL/DCU_RR/POT/PSD_L/PSD_R/SWM/WCM/WCM_RL/AC/CRF/WCM_FR/WCM_RR/ISC/ADCU/EPB/EPS/MPC/RCR_L/APA/PDCM/LBMS/ACU/PDC/CDC/ICM/ETC/VSP/AMP/BMS/TCU/EMS/GCU/MCUF/MCUR/MDC)【CRCAN2405092813】——架构
1、T_BOX新增信号值定义：IVI_chassisSet2（0x278）：TBOX_VehicleMode,0x2：Factorymode删除Reserved,发送方：T_BOX,接收方：BCM,BLE,DCU_FL,DCU_FR,DCU_RL,DCU_RR,POT,PSD_L,PSD_R,SWM,WCM,WCM_RL,AC,CRF,WCM_FR,WCM_RR,ISC,ADCU,EPB,EPS,MPC,RCR_L,APA,PDCM,EPB,LBMS,ACU,APA,,PDC,IVI,,ICM,ETC,VSP,AMP,BMS,TCU,EMS,GCU,MCUF,MCUR,MDC，实际使用0x2：PDCM,CDC,BCM,PSD_L,PSD_R;
Version:V4.0.0,Date:2024/6/21,Author:汤枝子,Review:H56C全配置,Approval:,Description:(BCM/PDCM/SCU_RL/SCU_RR/SCU_F/SCU_FR/DCU_FL/DCU_FR/AMP)【CRCAN2405143232】【CRCAN2405163379】~【CRCAN2405163388】【CRCAN2405163456】【CRCAN2405163462】【CRCAN2405163479】【CRCAN2405163499】【CRCAN2405163556】~【CRCAN2405163563】【CRCAN2405213665】【CRCAN2405213606】——架构初始值修改
1、CDC修改信号初始值：IVI_BodySet1（0x1DC）：ivi_followMeHomeSet,信号初始值修改为0x0,发送方：CDC,接收方：BCM,PDCM,链路：INFOCAN—PTCAN/BDCAN
2、CDC修改信号初始值：IVI_SCUCtrl（0x1D8）：IVI_RLSeatHeatLevelSet,IVI_RRSeatHeatLevelSet,IVI_RLSeatVentLevelSet,IVI_RRSeatVentLevelSet,IVI_DrSeatHeatLevelSet,IVI_PassSeatVentLevelSet,IVI_RLSeatMassLevelSet,IVI_RRSeatMassLevelSet,IVI_FLSeatMassLevelSet,信号初始值修改为0x0,发送方：CDC,接收方：SCU_RL,SCU_RR,SCU_F,SCU_FR,DCU_FL,DCU_FR,链路：INFOCAN—CFCAN/BDCAN
3、CDC修改信号初始值：IVI_SCUCtrl2（0x419）：IVI_FLSeatMassLevelSet,信号初始值修改为0x0,发送方：CDC,接收方：SCU_RL,SCU_RR,SCU_F,链路：INFOCAN—CFCAN
6、CDC修改信号初始值：IVI_ampSet（0x11E）：ivi_soundFieldSet,ivi_vehicleSpeedCompModeReq,信号初始值修改为0x0,发送方：CDC,接收方：AMP,链路：INFOCAN
7、CDC修改信号初始值：IVI_ampSet（0x11E）：ivi_languageSet改为0x3,ivi_unitSet改为0x2 ,发送方：CDC,接收方：APA,PDCM，链路：INFOCAN—CHANCAFD/PTCAN
8、CDC修改信号初始值：IVI_BodySet1（0x1DC）：ivi_antiTheftAlarmFormSet,信号初始值修改为0x3,发送方：CDC,接收方：BCM,链路：INFOCAN;
Version:V4.0.0,Date:2024/6/21,Author:汤枝子,Review:H56C全配置,Approval:,Description:(CDC/BCM/GW)【CRCAN2405173594】【CRCAN2405223617】——架构
1、BCM新增发送信号：BCM_state4（0x422）：BCM_PressurereliefSta,发送方：BCM,接收方：CDC,链路：BDCAN—INFOCAN
2、BCM新增接收信号：GW_BDCAN（0x4E4）：PDCM_oilPercent,发送方：PDCM，接收方：BCM，链路：PTCAN—BDCAN
3、GW新增信号路由：PDCM_EnergyInfo（0x4C4）——GW_BDCAN（0x4E4）：PDCM_oilPercent;
Version:V4.0.2,Date:2024/6/21,Author:汤枝子,Review:H56C全配置,Approval:,Description:(CDC/SCU_F/SCU_FR/ISC/DCU_FL/DCU_FR/DCU_RL/DCU_RR/GW)【CRCAN2406043787】【CRCAN2406053805】~【CRCAN2406053812】
1、CDC新增发送信号：IVI_SCUCtrl2(0x419):IVI_FrontNapSeat，发送方：CDC，接收方：SCU_F,SCU_FR，链路：CDC—GW—SCU_F,SCU_FR（INFOCAN——CFCAN）
2、CDC修改信号发送类型：IVI_chassisSet（0x1BE）：ivi_manualEasyOutSw，ivi_autoEasyEntrySet,ivi_ISCMaintainModeReq,发送类型由Cycle改为三帧清零，发送方：CDC，接收方：ISC，链路：CDC—GW—ISC（INFOCAN——CHACANFD）;
Version:V4.0.0,Date:2024/6/21,Author:汤枝子,Review:H56C全配置,Approval:,Description:(CDC/AC)【CRCAN2405072790】——IVI修改初始值
1、CDC修改信号初始值：IVI_ACHCMCtrl（0x1D7）：ivi_driverTempCSet、ivi_passengerTempCSet、ivi_RrTempCSet,初始值，由0x0改为0x1F，发送方：CDC,接收方：AC,链路：INFOCAN—CFCAN;
Version:V4.0.0,Date:2024/6/21,Author:汤枝子,Review:H56C全配置,Approval:,Description:(PDCM/GW/CDC)【CRCAN2405062783】【CRCAN2404252653】——陈剑立
1、PDCM，CDC修改信号发送方和位置：删除信号PDCM_TripInfo（0x4C6）：IVI_TripAResetReq,删除信号PDCM_TripInfo_2（0x4E2）：IVI_TripAResetReq
2、CDC新增发送信号：IVI_chassisSet2（0x278）：IVI_TripAResetReq，发送方：CDC,接收方：PDCM,链路：INFOCAN—PTCAN;
Version:V4.0.0,Date:2024/6/21,Author:汤枝子,Review:H56C全配置,Approval:,Description:(PDCM/CDC/GW/T_BOX)【CRCAN2405092801】~【CRCAN2405092804】【CRCAN2405153312】【CRCAN2405173599】——陈剑立
1、PDCM新增发送报文：PDCM_ChargingSpeed（0x4E5）：PDCM_ChargingSpeed_Standard，PDCM_ChargingSpeed_Real，PDCM_RemainingMileageIncrement_Standard，PDCM_RemainingMileageIncrement_Real，PDCM_SOCLowAlarmLamp，发送方：PDCM，接收方：CDC，T_BOX，链路：PTCAN——INFOCAN/DiagCAN
2、GW新增报文路由：PTCAN——INFOCAN：PDCM_ChargingSpeed（0x4E5），
PTCAN——DiagCAN：PDCM_ChargingSpeed（0x4E5）
3、PDCM新增发送信号：PDCM11（0x2C9）：PDCM_stDrvRdyEnterFailReason，PDCM_stDrvRdyExitReason，发送方：PDCM，接收方：T_BOX，链路：PTCAN——DiagCAN
4、PDCM新增发送信号：PDCM_IVI（0x31D）：PDCM_HvBatDrvPreheatState，发送方：PDCM，接收方：CDC，链路：PTCAN——INFOCAN;
Version:V4.0.0,Date:2024/6/21,Author:汤枝子,Review:H56C全配置,Approval:,Description:(CDC/PDCM/EMS)【CRCAN2405092812】~【CRCAN2405153309】【CRCAN2405153310】【CRCAN2405153311】——陈剑立
1、PDCM修改信号精度：IVI_ChargingStationInfo（0x53C）：RoadSpeedListX1，信号精度修改为100，发送方：CDC，接收方：PDCM，链路：INFOCAN——PTCAN
2、PDCM修改信号定义：PDCM_IVI（0x31D）：PDCM_TextInfo，发送方：PDCM，接收方：CDC，链路：PTCAN——INFOCAN
3、EMS更改信号位置及周期：EMS9（0x46C）：EMS_FuelResistanceValue,改为EMS7（0x307）：EMS_FuelResistanceValue，发送方：EMS,接收方：IVI,链路：EMS—GW—CDC（SPTCAN2—PTCANFD—INFOCAN）
4、EMS删除信号：EMS9（0x46C）EMS_OilSensorResistance,发送方：EMS；接收方：PDCM,链路：EMS—PDCM-GW-CDC;
Version:V4.0.0,Date:2024/6/21,Author:汤枝子,Review:H56C全配置,Approval:,Description:(CDC/T_BOX/GW)【CRCAN2404252696】——IVI修改诊断ID—集团协调件
1、CDC更改诊断ID，DiagReq_IVI 由0x725改为0x770，DiagResp_IVI 由0x7A5改为0x778，发送方：IVI/T_BOX，接收方：T_BOX，IVI，链路：INFOCAN——DiagCAN
2、GW同步更改报文路由ID：DiagReq_IVI 由0x725改为0x770，DiagResp_IVI 由0x7A5改为0x778;
Version:V4.0.0,Date:2024/6/21,Author:汤枝子,Review:H56C全配置,Approval:,Description:(CDC/GW/LBMS/T_BOX/PDCM)【CRCAN2404292776】【CRCAN2404292777】~【CRCAN2405143234】【CRCAN2405143235】【CRCAN2405143238】——LBMS
1、CDC新增接收信号：GW_PT_INFO（0x388）：LBMS_LoSocFlt，LBMS_SysFlt，发送方：LBMS，接收方：CDC，链路：PTCAN——INFOCAN
2、GW新增信号路由：PTCAN——INFOCAN：LBMS_FaultState1（0x581）——GW_PT_INFO（0x388）：LBMS_LoSocFlt，LBMS_SysFlt，
3、CDC新增接收信号：PDCM_EBS2（0x3E4）：ebs_SOC，发送方：LBMS，接收方：CDC，链路：PTCAN——INFOCAN
4、GW新增信号路由：PTCAN——INFOCAN：PDCM_EBS2（0x3E4）——GW_PT_INFO（0x388）：ebs_SOC
5、LBMS新增发送信号：LBMS_State1（0x345）：LBMS_DisMOSReq，发送方：LBMS，接收方：PDCM,T_BOX,CDC
6、GW新增信号路由：PTCAN——INFOCAN：LBMS_State1（0x345）——GW_PT_INFO（0x388）：LBMS_DisMOSReq
PTCAN——DiagCAN：LBMS_State1（0x345）——GW_LBMS_State_2（0x523）：LBMS_DisMOSReq;
Version:V4.0.0,Date:2024/6/21,Author:汤枝子,Review:H56C全配置,Approval:,Description:(CRF)【CRCAN2404292780】——CRF
1、CRF新增接收信号：AC2（0x3A6）：AC_CabinTemp，发送方：AC，接收方：CRF，链路：CFCAN;
Version:V4.0.0,Date:2024/6/21,Author:汤枝子,Review:H56C全配置,Approval:,Description:(SCU_RL/SCU_RR/ACP_RR/SCU_TR/SCU_FR/IVI)【CRCAN2404302781】【CRCAN2405153268】【CRCAN2405153275】~【CRCAN2405153279】【CRCAN2405153291】【CRCAN2405223611】【CRCAN2405223612】——SCU_RL,SCU_RR
1、SCU_RL新增接收信号：BCM_state3（0x062）：bcm_driverSts，发送方：BCM，接收方：SCU_RL，链路：BDCAN——CFCAN
2、SCU_RL新增接收信号：AC_AirQuality（0x2F1）：AC_BackRowACAutoSta，发送方：AC，接收方：SCU_RL，链路：CFCAN
3、SCU_RR删除信号：SCU_RR2（0x503）：SCU_RR_SeatUnlockPos，发送方：SCU_RR，接收方：SCU_FR，SCU_TR，链路：CFCAN
4、SCU_RR删除信号：SCU_RR（0x3E6）：SCU_RR_SeatLegPos，发送方：SCU_RR，接收方：无
5、SCU_RR删除信号：SCU_RR（0x3E6）：SCU_RR_RR_3ndRightSts，发送方：SCU_RR，接收方：ACP_RR,CDC
6、SCU_RL删除信号：SCU_RL（0x3D6）：SCU_RL_SeatLegPos，发送方：SCU_RL，接收方：无
7、SCU_RL删除信号：SCU_RL（0x3D6）：SCU_RL_SeatBackPos，发送方：SCU_RL，接收方：无
8、SCU_RL删除信号：SCU_RL（0x3D6）：SCU_RL_RL_3ndLeftSts，发送方：SCU_RL，接收方：CDC
9、SCU_RL新增信号定义：SCU_RL（0x3D6）：SCU_RL_2ndMoveForbiddenReason，新增0xC~0xF定义，发送方：SCU_RL，接收方：无
10、SCU_RR修改信号定义：SCU_RR2（0x503）：SCU_RR_2ndMoveForbiddenReason，0x3~0x5 左更改为右；0x6~0x8 主驾更改为副驾，发送方：SCU_RR，接收方：ACP_RR
11、SCU_RR删除信号：SCU_RR2（0x503）：SCU_RR_SeatBackPos，发送方：SCU_RR，接收方：SCU_F，SCU_TR，链路：CFCAN;
Version:V4.0.0,Date:2024/6/21,Author:汤枝子,Review:H56C全配置,Approval:,Description:(SCU_RL/SCU_RR/SCU_F/SCU_TR/SCU_FR)【CRCAN2405153269】~【CRCAN2405153274】 【CRCAN2405153282】~【CRCAN2405153287】【CRCAN2405293695】【CRCAN2405293696】——SCU_RL,SCU_RR新增排查报文
1、SCU_RL新增发送报文：SCU_RL4（0x4E8）：略，发送方：SCU_RL，接收方：无
2、SCU_RR新增发送报文：SCU_RR4（0x4E9）：略，发送方：SCU_RR，接收方：无
3、SCU_RL新增发送信号：SCU_RL（0x3D6）：SCU_RL_SeatSlidePos，发送方：SCU_RL，接收方：SCU_F，SCU_TR
4、SCU_RR新增发送信号：SCU_RR（0x3E6）：SCU_RR_SeatSlidePos，发送方：SCU_RR，接收方：SCU_FR，SCU_TR;
Version:V4.0.0,Date:2024/6/21,Author:汤枝子,Review:H56C全配置,Approval:,Description:(SCU_F/SCU_TR/T_BOX/SCU_FR/GW)【CRCAN2405092805】【CRCAN2405092806】【CRCAN2405092810】~【CRCAN2405102872】【CRCAN2405132881】【CRCAN2405133010】【CRCAN2405133011】【CRCAN2405143239】【CRCAN2405143252】【CRCAN2405163514】【CRCAN2405163515】——SCU_TR
1、SCU_F新增接收信号：IVI_SCUCtrl（0x1D8）：IVI_RLSeatResetReq，发送方：CDC，接收方：SCU_F，链路：INFOCAN——CFCAN
2、SCU_FR新增接收信号：IVI_SCUCtrl（0x1D8）：IVI_RRSeatResetReq，发送方：CDC，接收方：SCU_FR，链路：INFOCAN——CFCAN
3、SCU_F新增接收信号：BCM_state3（0x062）：bcm_driverSts，发送方：BCM，接收方：SCU_F，链路：INFOCAN——CFCAN
4、SCU_FR新增接收信号：ACU_state（0x380）：acu_passengerSts，发送方：ACU，接收方：SCU_FR，链路：INFOCAN——CFCAN
5、SCU_F,SCU_TR新增接收信号：AC_AirQuality（0x2F1）：AC_BackRowACAutoSta，发送方：AC，接收方：SCU_TR，SCU_F，链路：CFCAN
6、BCM新增接收信号：GW_BDCAN（0x4E4）：SCU_TR_3LSeatHeatSts,SCU_TR_3RSeatHeatSts，发送方：SCU_TR，接收方：BCM，链路：CFCAN—BDCAN
7、GW新增信号路由：CFCAN——BDCAN：SCU_TR（0x505）——GW_BDCAN（0x4E4）：SCU_TR_3LSeatHeatSts,SCU_TR_3RSeatHeatSts，
8、SCU_TR新增接收信号：ACU_state（0x380）：acu_secondLeftSts，发送方：ACU，接收方：SCU_FR，链路：INFOCAN——CFCAN
9、T_BOX修改信号值：TBOX_remoteCmdMMB（0x53B）：tbox_remote3LSeatHeatReq，tbox_remote3RSeatHeatReq，更改信号定义，发送方：T_BOX，接收方：SCU_TR，链路：DiagCAN——CFCAN
10、SCU_TR修改信号描述和信号定义：SCU_TR1（0x506）：SCU_TR_LSeatWorkState，SCU_TR_RSeatWorkState，SCU_TR_3LSeatFoldSts，SCU_TR_3RSeatFoldSts，SCU_TR_3LSeatUnfoldSts，SCU_TR_3RSeatUnfoldSts，SCU_TR_3LSeatSwitchStatus，SCU_TR_3RSeatSwitchStatus，，发送方：SCU_TR，接收方：无;
Version:V4.0.0,Date:2024/6/21,Author:汤枝子,Review:H56C全配置,Approval:,Description:(SCU_F/SCU_TR/T_BOX/SCU_FR/GW)【CRCAN2405133012】【CRCAN2405133013】【CRCAN2405133014】——BCM
1、BCM新增发送信号：BCM_state4(0x422):BCM_ATLRLReq，BCM_ATLRRReq，发送方：BCM，接收方：ATL，链路：BCM—GW—ATL，BDCAN—GWLIN2——同步更新CAN LIN路由表
2、BCM新增发送信号：BCM_tbox_failCode（0x51）：BCM_NoExitReadyWarning，发送方：BCM，接收方：T_BOX，链路：BCM—GW—T_BOX(BDCAN——DiagCAN);
Version:V4.0.0,Date:2024/6/21,Author:汤枝子,Review:H56C全配置,Approval:,Description:(T_BOX)【CRCAN2405163547】~【CRCAN2405092815】【CRCAN2405102877】【CRCAN2405213608】【CRCAN2405213609】【CRCAN2405223616】【CRCAN2405223619】——汪青
1、T_BOX新增接收信号：OBC1（0x2CA）：OBC_Phase_Mode，OBC_ACPlug_Status，发送方：OBC，接收方：T_BOX，链路：SPTCAN1——DiagCAN
2、T_BOX新增接收信号：BMS7（0x2D3）：BMS_SOH，BMS14(0x371):BpsPressureData，发送方：BMS，接收方：T_BOX，链路：SPTCAN1——DiagCAN;
Version:V4.0.0,Date:2024/6/21,Author:汤枝子,Review:H56C全配置,Approval:,Description:(ACP_RL/ACP_RR/CDC/SCU_FR)【CRCAN2405132883】【CRCAN2405132884】【CRCAN2405132887】【CRCAN2405132888】——ACP_RL,ACP_RR，肖健
1、ACP_RL新增发送信号：ACP_RL_IVI（0x50C）：ACP_RL_LockSta，发送方：ACP_RL，接收方：CDC，链路：PTCAN——INFOCAN
2、ACP_RL新增发送信号：ACP_RL_control1(0x50B)：ACP_RL_SCU_FR_SeatResetReq，发送方：ACP_RL，接收方：SCU_FR，链路：PTCAN——CFCAN
3、ACP_RR新增发送信号：ACP_RR_IVI（0x509C）：ACP_RR_LockSta，发送方：ACP_RR，接收方：CDC，链路：PTCAN——INFOCAN
4、ACP_RR新增发送信号：ACP_RR_control1(0x508)：ACP_RR_SCU_FR_SeatResetReq，发送方：ACP_RR，接收方：SCU_FR，链路：PTCAN——CFCAN
5、ACP_RL新增发送信号：ACP_RL_IVI（0x50C）：ACP_RL_IVIMedia_VOLReq，发送方：ACP_RL,接收方：CDC,链路:PTCAN——INFOCAN
6、ACP_RR新增发送信号：ACP_RR_IVI（0x509C）：ACP_RR_IVIMedia_VOLReq，发送方：ACP_RR,接收方：CDC,链路:PTCAN——INFOCAN;
Version:V4.0.0,Date:2024/6/21,Author:汤枝子,Review:H56C全配置,Approval:,Description:(ACP_RL/ACP_RR)【CRCAN2405132885】【CRCAN24051328846】【CRCAN2405132891】~【CRCAN2405132900】【CRCAN2404101448】【CRCAN2404101451】——ACP_RL,ACP_RR，肖健
1、ACP_RL，ACP_RR新增接收信号：SCU_FR（0x499）：SCU_FR_passSeatWorkState,发送方：SCU_FR,接收方：ACP_RL，ACP_RR,链路:CFCAN——INFOCANFD
2、GW新增报文路由：CFCAN——INFOCANFD：SCU_FR（0x499）
3、ACP_RL，ACP_RR新增接收报文：IVI_timeAndGPS（0x3FE）：略,发送方：T_BOX,接收方：ACP_RL，ACP_RR,链路:DiagCAN——INFOCANFD
4、ACP_RL，ACP_RR新增接收信号：PDCM_EBS1(0x3E3)：ebs_U_BATT，发送方：LBMS，接收方：ACP_RL，ACP_RR,链路：PTCAN——INFOCAN;
Version:V4.0.0,Date:2024/6/21,Author:汤枝子,Review:H56C全配置,Approval:,Description:(ACP_RL/ACP_RR/SCU_RL/SCU_RR/CDC)【CRCAN2405132901】【CRCAN2405132902】【CRCAN2405132904】【CRCAN2405132905】【CRCAN2405132907】~【CRCAN2405132912】——ACP_RL,ACP_RR，肖健
1、ACP_RL删除信号：ACP_RL_IVI（0x50C）：ACP_RL_IVITurnUPvol,ACP_RL_IVITurnDownVol，发送方：ACP_RL,接收方：CDC,链路:INFOCAN
2、ACP_RR删除信号：ACP_RR_IVI（0x509）：ACP_RR_IVITurnUPvol,ACP_RR_IVITurnDownVol，发送方：ACP_RR,接收方：CDC,链路:INFOCAN
3、ACP_RL修改信号初始值和发送类型：ACP_RL_IVI（0x50C）：ACP_RL_IVIProgressbar，发送方：ACP_RL,接收方：CDC,链路:INFOCAN
4、ACP_RR修改信号初始值和发送类型：ACP_RR_IVI（0x509）：ACP_RR_IVIProgressbar，发送方：ACP_RR,接收方：CDC,链路:INFOCAN
5、ACP_RL修改信号初始值：ACP_RL_SCU_RL_adjust（0x50A）：ACP_RL_RLSeatVentLevelSet，ACP_RL_RLSeatHeatLevelSet，发送方：ACP_RL,接收方：SCU_RL,链路:PTCAN——CFCAN
6、ACP_RR修改信号初始值：ACP_RR_SCU_RR_adjust（0x507）：ACP_RR_RRSeatVentLevelSet，ACP_RR_RRSeatHeatLevelSet，发送方：ACP_RR,接收方：SCU_RR,链路:PTCAN——CFCAN;
Version:V4.0.0,Date:2024/6/21,Author:汤枝子,Review:H56C全配置,Approval:,Description:(CDC/BCM/T_BOX/PDCM/AC)【CRCAN2405243620】【CRCAN2405273631】【CRCAN2405293688】【CRCAN2405303714】【CRCAN2405303716】——架构
1、CDC修改信号初始值：IVI_pwrSet（0x0A5）：ivi_maxChrgSocSet 初始值修改为0xFE：No Request，发送方：CDC,接收方：T_BOX,PDCM，链路:INFOCAN——DIAGCAN/CHACANFD
2、CDC修改信号定义：IVI_BodySet3（0x4D2）：ivi_ambientLightLumiLvSet修改信号定义，发送方：CDC,接收方：BCM，链路:INFOCAN——BDCAN
3、CDC新增发送信号：IVI_BodySet3（0x4D2）：ivi_hvacRecircModeSet,发送方：CDC,接收方：AC，链路:INFOCAN——CFCAN;
Version:V4.0.0,Date:2024/6/21,Author:汤枝子,Review:H56C全配置,Approval:,Description:(PDCM/CDC/LBMS/GW/BMS/T_BOX)【CRCAN2405243621】【CRCAN2405243622】【CRCAN2405273632】【CRCAN2405273633】【CRCAN2405283678】【CRCAN2405283679】【CRCAN2405283680】【CRCAN2405283681】【CRCAN2405293697】——PDCM
1、CDC修改信号值定义：IVI_pwrSet（0x0A5）：PDCM_LvBatChargeFdbk，发送方：CDC,接收方：LBMS，链路:PTCAN
2、PDCM更改信号名：PDCM_SelfCharging（0x4CC）：PDCM_SinceChargeELECnsPer有两个，一个是自充电电器能耗占比一个是自充电纯电工况占比，将自充电自充电纯电工况占比的命名改为PDCM_SinceChargeEVCnsPer，发送方：PDCM,接收方：CDC,T_BOX，链路:PDCM—GW—IVI
4、BMS新增接收信号：PDCM_totalMileageInfo2（0x4D1）：PDCM_totalMileageRev，发送方：PDCM,接收方：BMS，链路:SPTCAN1
5、PDCM新增发送信号：PDCM_IVI（0x31D）：PDCM_EvonlyPwrlimited，PDCM_EngServiceMode，发送方：PDCM，接收方：CDC，链路：PTCAN——INFOCAN
6、IVI新增发送信号：IVI_chassisSet2（0x278）：IVI_ChargeContinueSet，IVI_ChargeStart，发送方：CDC，接收方：T_BOX，链路：INFOCAN—DiagCAN
7、T_BOX新增发送信号：TBOX_chargeSet（0x07E）：TBOX_ChargeContinueSta，TBOX_ChargeStart,发送方：T_BOX，接收方：CDC，PDCM，链路：DiagCAN—INFOCAN/PTCAN;
Version:V4.0.0,Date:2024/6/21,Author:汤枝子,Review:H56C全配置,Approval:,Description:(AC/CDC)【CRCAN2405243623】【CRCAN2406123927】——AC
1、AC新增发送信号：AC_AirQuality（0x2F1）：AC_AnionGeneratorAutoStartRemind，发送方：AC，接收方：CDC，链路：AC—GW—CDC（CFCAN—INFOCAN）;
Version:V4.0.0,Date:2024/6/21,Author:汤枝子,Review:H56C全配置,Approval:,Description:(T_BOX/GW.HCM_L/HCM_R)【CRCAN2405283676】【CRCAN2405283677】【CRCAN2405293686】【CRCAN2405293687】
1、HCM_L，HCM_R删除诊断报文：DiagReq_HCM_L2，DiagResp_HCM_L2，DiagReq_HCM_R2，DiagResp_HCM_R2，相关方：T_BOX,HCM_L,HCM_R,GW
2、GW同步删除此报文路由：CFCAN——DiagCAN：DiagReq_HCM_L2，DiagResp_HCM_L2，DiagReq_HCM_R2，DiagResp_HCM_R2
3、HCM_L，HCM_R修改诊断报文名，GW同步更改此报文路由名称：：DiagReq_HCM_L1，DiagResp_HCM_L1，DiagReq_HCM_R1，DiagResp_HCM_R1，改为DiagReq_HCM_L，DiagResp_HCM_L，DiagReq_HCM_R，DiagResp_HCM_R，相关方：T_BOX,HCM_L,HCM_R,GW;
Version:V4.0.0,Date:2024/6/21,Author:汤枝子,Review:H56C全配置,Approval:,Description:(CDC/PDCM/T_BOX)【问题反馈】【CRCAN2405313744】——PDCM 张雅
1、CDC删除信号：IVI_chassisSet2(0x278):IVI_8295ChipTemp，实际不使用，发送方：CDC，接收方：PDCM，链路：CDC—GW—PDCM,T_BOX（INFOCAN—PTCAN/DiagCAN）;
Version:V4.0.0,Date:2024/6/21,Author:汤枝子,Review:H56C全配置,Approval:,Description:(PDCM)【CRCAN2405313745】【CRCAN2405313746】——PDCM 陈剑立
1、PDCM新增接收信号：SWS_Set(0x319):SWS_menu，SWS_OK，发送方：GW，接收方：PDCM，链路：SWS—GW—PDCM（CHACANFD）;
Version:V4.0.0,Date:2024/6/21,Author:汤枝子,Review:H56C全配置,Approval:,Description:(GW)【问题反馈】——GW
1、GW更改路由链路：删除路由CHACANFD——PTCAN/INFOCAN——BDCAN/INFOCAN——CFCAN/INFOCAN——DiagCAN/INFOCAN——CHACANFD：ACU_state(0x380)，新增路由：PSCAN——PTCAN：ACU_state(0x380);
Version:V4.0.2,Date:2024/6/21,Author:汤枝子,Review:H56C全配置,Approval:,Description:(OBC/BMS/PDCM/GW/T_BOX)【CRCAN2406033779】【CRCAN2406033780】【CRCAN2406033781】【CRCAN2406033782】
1、将OBC_TESTMSG3（0x5AC）：OBC_TESTMSG3的报文发送类型由event改为cycle，周期500ms，发送方：OBC，接收方：无
2、更改信号长度BMS18（0x37A）：BMS_ChargeEnergy_Total,BMS_ChargeCapacity_Total,信号进行扩容,长度由22bit，改为32bit，发送方：BMS，接收方：PDCM，T_BOX，链路：BMS—PDCM—GW—T_BOX（SPTCAN1—PTCAN—DiagCAN）;
Version:V4.0.2,Date:2024/6/21,Author:汤枝子,Review:H56C全配置,Approval:,Description:(CDC/PDCM/T_BOX/ACP_RL/ACP_RR)【CRCAN2406063817】【CRCAN2406063818】
1、CDC修改信号发送类型：IVI_pwrSet(0x0A5):ivi_ChargeCancel，发送方：CDC，接收方：PDCM，T_BOX，链路：CDC—GW—PDCM/T_BOX（INFOCAN——PTCAN/DiagCAN）
2、ACP_RL,ACP_RR新增接收信号：BCM_peps（0x2C1）：bcm_pepsPowerMode，发送方：BCM，接收方：ACP_RL，ACP_RR，链路：BCM—GW—ACP_RL，ACP_RR（BDCAN——PTCAN）;
Version:V4.0.2,Date:2024/6/21,Author:汤枝子,Review:H56C全配置,Approval:,Description:(CDC/PDCM/CRF/AC)【CRCAN2406073832】~【CRCAN2406073845】
1、CDC修改信号最大值：IVI_control(0x075):IVI_SOCmodeSet，IVI_ACHCMCtrl（0x1D7）：IVI_BackRowComfortEnable，IVI_BackRowACAutoSet，IVI_ACDORmode，IVI_ACDryingandOdorRemoval，IVI_Fridge_Req（0x41D）：IVI_CrfOffLineTimeSet，IVI_ChargingStationInfo（0x53C）：DestChargeDistance，发送方：CDC;
Version:V4.0.2,Date:2024/6/21,Author:汤枝子,Review:H56C全配置,Approval:,Description:(CDC/T_BOX/PDCM/BCM/GW)【CRCAN2406123863】【CRCAN2406123886】
1、BCM新增接收信号：GW_BDCAN(0x4E4)：LBMS_DisMOSReq，发送方：LBMS—GW—BCM
2、GW新增信号路由：PTCAN——BDCAN：LBMS_State1（0x345）——GW_BDCAN(0x4E4)：LBMS_DisMOSReq
3、CDC修改信号发送类型：IVI_pwrSet（0x0A5）：ivi_maxChrgSocSet改为Cycle型，实际发500ms有效值后回到No Request，发送方：CDC，接收方：T_BOX,PDCM(INFOCAN—DiagCAN/PTCAN);
Version:V4.0.2,Date:2024/6/21,Author:汤枝子,Review:H56C全配置,Approval:,Description:(T_BOX/CDC/PDCM)【问题反馈】
1、T_BOX修改信号起始位：TBOX_chargeSet（0x07E）：TBOX_ChargeContinueSta，TBOX_ChargeStart,更改信号起始位，起始位互换，发送方：T_BOX，接收方：CDC，PDCM，链路：DiagCAN—INFOCAN/PTCAN;
Version:V4.0.2,Date:2024/6/21,Author:汤枝子,Review:H56C全配置,Approval:,Description:(GW/SCU_TR/T_BOX)【问题反馈】
1、新增SCU_TR的诊断报文，DiagReq_SCU_TR(0x73C),DiagResp_SCU_TR(0x7BC)，同步新增GW报文路由：CFCAN——DiagCAN：DiagResp_SCU_TR(0x7BC),DiagCAN——CFCAN：DiagReq_SCU_TR(0x73C);
Version:V4.0.0,Date:2024/6/21,Author:汤枝子,Review:H56C全配置,Approval:,Description:(CDC)【CRCAN2406033783】【CRCAN2406033784】
1、CDC新增接收信号：PSD_L：(0x3EB）PSD_L_OpeningSignal，PSD_R（0x3FB）：PSD_R_OpeningSignal，发送方：PSD_L,PSD_R，接收方：CDC;
Version:V4.0.0,Date:2024/6/24,Author:汤枝子,Review:H56C全配置,Approval:,Description:(ACP_RL/ACP_RR/CDC)【CRCAN2406173945】【CRCAN2406173946】【CRCAN2406173947】
1、修改扶手屏控制吸顶屏信号定义：ACP_RL_IVI（0x50C）：ACP_RL_CeilingScreenONOFF，0x7: Invalid修改为0X7:level6，发送方：ACP_RL，接收方：CDC
2、修改扶手屏控制吸顶屏信号定义：ACP_RR_IVI（0x509）：ACP_RR_CeilingScreenONOFF，0x7: Invalid修改为0X7:level6，发送方：ACP_RL，接收方：CDC
3、修改扶手屏控制吸顶屏信号定义：IVI_chassisSet2（0x278）：IVI_CeilingScreenONOFFSts，0x7: Invalid修改为0X7:level6，发送方：CDC，接收方：ACP_RL,ACP_RR;
Version:V4.0.0,Date:2024/6/24,Author:汤枝子,Review:H56C全配置,Approval:,Description:(ACP_RL/ACP_RR/GW/T_BOX)【CRCAN2406204108】诊断
1、修改ACP_RL的诊断ID：由0x723,0x7A3改为：DiagReq_ACP_RL（0x700）、DiagResp_ACP_RL（0x780）;
Version:V4.0.0,Date:2024/6/24,Author:汤枝子,Review:H56C华为,Approval:,Description:(AMP/CDC/GW)【CRCAN2404282728】——AMP
1、AMP修改信号名车和描述：AMP_Response2（0x549）：信号amp_FLSpeakerDelaySts前左扬声器延时反馈改为amp_FL_TRE_BASS_SpeakerDelaySET前左高音/低音扬声器延时设置状态；amp_FRSpeakerDelaySts前右扬声器延时反馈改为amp_FR_TRE_BASS_SpeakerDelaySET前右高音/低音扬声器延时设置状态，发送方：AMP，接收方CDC，链路：AMP—GW—CDC（INFOCAN—PSCAN）；
2、IVI_infoSet2（0x420）：ivi_FLSpeakerDelaySet前左扬声器延时设置改为ivi_FL_TRE_BASS_SpeakerDelaySET前左高音/低音扬声器延时设置；ivi_FRSpeakerDelaySet前右扬声器延时设置改为ivi_FR_TRE_BASS_SpeakerDelaySET前右高音/低音扬声器延时设置，发送方：CDC，接收方：AMP，链路：CDC—GW—AMP（PSCAN—INFOCAN）;
Version:V4.0.0,Date:2024/6/24,Author:汤枝子,Review:H56C华为,Approval:,Description:(IC/BCM/GW/CDC)【CRCAN2406063819】~【CRCAN2406063828】——张南辉
1、IC,T_BOX新增发送诊断报文：DiagReq_IC（0x767），DiagResp_IC（0x76F）
2、IC新增接收报文：DiagReq_FUN（0x7DF），IVI_timeAndGPS（0x3FE）
3、GW新增报文路由：DiagCAN—INFOCAN：DiagReq_IC（0x767）
INFOCAN——DiagCAN：DiagResp_IC（0x76F）;
Version:V4.0.0,Date:2024/6/24,Author:汤枝子,Review:H56C华为,Approval:,Description:(MDC/CDC)【CRCAN2406113846】【CRCAN2406113847】【CRCAN2406133936】——MDC
1、MDC新增发送信号：Mdc_Ads_ActSafety（0x21D）：MdcEsaWaning，MdcAesWaning，发送方：MDC，接收方：CDC
2、MDC新增接收信号：BCM_PosLampSts （0x2A3）：BCM_PosLampSts ，发送方：BCM，接收方：MDC;
Version:V4.0.0,Date:2024/6/24,Author:汤枝子,Review:H56C华为,Approval:,Description:(CDC)【CRCAN2404282729】CDC更改接收方向盘加热信号
1、CDC取消接收信号：GW_LIN_BODY（0x3E2）：SWH_SteerWheelHeatgSts、SWH_SteerWheelHeatgErr
2、CDC新增接收信号：GW_HOD（0x27D）：HOD_SteerWheelHeatgSts、HOD_SteerWheelHeatgErr，发送方：GW（HOD），接收方：CDC，链路：GWLIN1—INFOCAN;
Version:V4.0.0,Date:2024/6/24,Author:汤枝子,Review:H56C华为,Approval:,Description:(CDC/PDCM)【CRCAN2405112878】H56c华为动力模式方案变更
1、CDC新增发送信号：IVI_control（0x075）：IVI_EVonlymodereq_HW，发送方：CDC，接收方：PDCM，链路：PTCAN;
Version:V4.0.0,Date:2024/6/24,Author:汤枝子,Review:H56C华为,Approval:,Description:(ISC/PDCM/MDC/T_BOX/BCM)【CRCAN2406113848】
1、BLE新增信号定义：BLE_APA（0X135）：BLE_PowerModeReq，新增0x2定义，发送方：BLE，接收方：PDCM,ISC,MDC,T_BOX,BCM;
Version:V4.0.0,Date:2024/6/24,Author:汤枝子,Review:H56C华为,Approval:,Description:(MDC/PDCM)【CRCAN2406143942】哨兵模式
1、MDC新增发送信号：MDC_PwrCtl（0x276）：SentryModeSt，发送方：MDC，接收方：PDCM;
Version:V4.0.0,Date:2024/6/24,Author:汤枝子,Review:H56C华为,Approval:,Description:(CDC/ACP_RL/ACP_RR)【CRCAN2406043788】【CRCAN2406043796】【CRCAN2406043802】【CRCAN2406073837】
1、CDC新增发送报文：IVI_Media（0x4E6），IVI_Media_InfoPackage（0x4E7），发送方：CDC，接收方：ACP_RL,ACP_RR，链路：INFOCAN
2、ACP_RL,ACP_RR接收报文：DiagReq_FUN（0x7DF）;
Version:V4.0.0,Date:2024/6/24,Author:汤枝子,Review:H56C华为,Approval:,Description:(SWM/PDCM/MDC/EPB/GW)【CRCAN2406254397】
1、SWM变更报文周期：GSM1（0x309）报文发送周期从50ms更改为20ms，PDCM路由至CHACAN网段按20ms路由（其他网段维持原有周期不变），只SPTCAN2，PTCAN，CHACANFD周期变为20ms，发送方：SWM，接收方：PTCAN，MDC，EPB,GW
2、GW的变周期报文路由，原始网段周期由50ms变为20ms：GSM1（0x309）：PTCAN——DiagCAN/INFOCAN;
Version:V4.0.1,Date:2024/5/20,Author:汤枝子,Review:H56C华为,Approval:INFOCAN，BDCAN,Description:(IC/BCM/GW/CDC)【问题反馈】——张南辉
1、IC更改信号发送类型：IC_Report_Status（0x43B），IC_Report_Heartbeat（0x43C），IC_Report_Temp（0x441），IC_Report_Light（0x453），IC_Report_Log（0x457），信号发送类型由on write变为cycle，发送方：IC，接收方：CDC，链路：IC—CDC（INFOCANFD）
2、IC更改信号发送类型：IC_Report_Light100（0x454），信号发送类型由on write变为cycle，发送方：IC，接收方：BCM，链路：IC—GW—BCM;
Version:V4.0.1,Date:2024/6/24,Author:汤枝子,Review:H56C全配置,Approval:PTCAN,Description:(PDCM/GW)【CRCAN2404242436】——谢忠原
1、PDCM继续发送信号：IC_state（0x4D6）：ic_vehicleSpeedDisp，ic_vehicleSpeedDispValid，发送方：PDCM，接收方：GW;
Version:V4.0.1,Date:2024/6/24,Author:汤枝子,Review:H56C全配置,Approval:PTCAN,DiagCAN，路由表,Description:(PDCM/CDC/GW/T_BOX)【CRCAN2406274865】【CRCAN2406274866】——陈剑立，谢忠原
1、CDC新增接收信号：BMS12（0x347）：BMS_Fault_Iso,发送方：BMS,接收方：IVI,链路：SPTCAN1——PTCAN—INFOCAN
2、GW新增信号路由：BMS12（0x347）——GW_PT_INFO（0x388）：BMS_Fault_Iso：PTCAN—INFOCAN
3、CDC新增接收信号：PDCM1（0x285）：PDCM_KL15offReq,发送方：PDCM,接收方：CDC,链路：PTCAN—INFOCAN
4、PDCM删除发送报文：IC_SinceLastInfor（0x4D4），IC_PowerConsumInfo（0x4D5）发送方：PDCM，接收方：T_BOX，链路：PDCM—GW—T_BOX
5、GW取消报文路由：IC_SinceLastInfor（0x4D4）——IC_SinceLastInfor（0x4F1）：PTCAN—DiagCAN
 IC_PowerConsumInfo（0x4D5）——IC_PowerConsumInfo（0x3F5）：PTCAN—DiagCAN;
Version:V4.0.1,Date:2024/6/24,Author:汤枝子,Review:H56C全配置,Approval:CFCAN,Description:(SCU_RL/SCU_TR/SCU_F/SCU_FR)【CRCAN2406264796】
1、SCU_RL新增发送信号SCU_RL2（0x501）：SCU_RL_LumberSupportSts，SCU_RL_SeatReclinePos，SCU_RL_SeatLeguDPos，接收节点：SCU_F，SCU_TR，（链路CFCAN）
2、SCU_RR新增发送信号SCU_RR2（0x503）：SCU_RR_SeatlnlockPos，SCU_RR_SeatReclinePos，SCU_RR_SeatLegUDPos，接收节点：SCU_FR，SCU_TR，（链路CFCAN）;
Version:V4.0.1,Date:2024/6/24,Author:汤枝子,Review:H56C全配置,Approval:CFCAN,Description:(SCU_FR/SCU_TR)【CRCAN2406264642】~【CRCAN2406264647】
1、SCU_FR新增发送信号：SCU_FR（0x499）：SCU_FR_seatFrontAdjust,SCU_FR_seatRearAdjust,SCU_FR_seatUpAdjust,SCU_FR_seatDownAdjust,SCU_FR_seatBackFrontAdjust，SCU_FR_seatBackRearAdjust,接收方：SCU_TR;
Version:V4.0.7,Date:2024/9/6,Author:汤枝子,Review:H56C全系,Approval:DiagCAN,Description:(T_BOX)【CRCAN24090318796】
1、T_BOX新增接收信号BCM_state4（0x422）：BCM_PowerHoldModeSta，发送方：BCM，接收方：T_BOX，链路：BCM—GW—T_BOX（BDCAN-DiagCAN）;
Version:V4.0.7,Date:2024/9/12,Author:汤枝子,Review:,Approval:路由表,Description:(GW)【问题反馈】
 1、GW删除报文路由：
 IC_info（0x3F3）——IC_info（0x3F3）：INFOCAN—DiagCAN，INFOCAN—PTCAN
 IC_info1（0x3F4）——IC_info1（0x3F4）：INFOCAN—DiagCAN
 IC_state1（0x482）——IC_state1 （0x482）：INFOCAN—DiagCAN
 IC_state2 （0x492）——IC_state2 （0x492）：INFOCAN—DiagCAN
 IC_SinceLastInfor（0x4F1）——IC_SinceLastInfor（0x4F1）：INFOCAN—DiagCAN
 IC_PowerConsumInfo（0x3F5）——IC_PowerConsumInfo（0x3F5）：INFOCAN—DiagCAN;
Version:V4.0.8,Date:2024/9/12,Author:汤枝子,Review:,Approval:BDCAN,INFOCAN,Description:(BCM/CDC)【CRCAN24071615546】【CRCAN24071615556】【CRCAN24071615557】【CRCAN24071615577】【CRCAN24071615578】【CRCAN24091119038】【CRCAN24091219048】
1、BCM新增发送信号：BCM_state4（0x422）：BCM_ambientLightOnOffSet，BCM_ambientLightColorSet ， BCM_ambientLightLumiLvSet，BCM_IAL_MusicFrequency，BCM_IAL_ColorMode  ，发送方：BCM，接收方：CDC，链路：BCM—GW—CDC（BDCAN-INFOCAN）
2、BCM修改信号枚举值：BCM_FCM（0x50D）：BCM_fcm_ch1_type，BCM_fcm_ch2_type，BCM_fcm_ch3_type，发送方：BCM，接收方：CDC，链路：BCM—GW—CDC（BDCAN-INFOCAN）;
Version:V4.0.8,Date:2024/9/12,Author:汤枝子,Review:,Approval:PTCAN,INFOCAN，DiagCAN，路由表,SPTCAN1,Description:(PDCM/CDC/GW/T_BOX/BMS/OBC)【CRCAN24091219406】~【CRCAN24091219413】、【CRCAN24091219442】
1、PDCM新增发送报文：PDCM_Discharge_V2X_1（0X317）：PDCM_DischargeCurrent，PDCM_DischargeVoltage，PDCM_DischargePower，PDCM_DischargeEnergy_Total，PDCM_DischargeOverCurrent_Warn，发送方：PDCM，接收方：CDC，T_BOX，链路：PDCM—GW—CDC/T_BOX（PTCAN-INFOCAN/DiagCAN）
2、PDCM新增发送报文：PDCM_Discharge_V2X_2（0X318）：PDCM_ExternalLoadPwr，发送方：PDCM，接收方：CDC，链路：PDCM—GW—CDC（PTCAN-INFOCAN）
3、GW新增报文路由：PTCAN-INFOCAN/DiagCAN：PDCM_Discharge_V2X_1（0X317），
PTCAN-INFOCAN：PDCM_Discharge_V2X_2（0X318）
4、PDCM新增信号枚举值：PDCM5（0x2AA）：HVCM_ChargeState，新增0xD，0xE，0xF定义，发送方：PDCM，接收方：BMS、OBC、IVI、TBOX，链路：PDCM—GW—BMS、OBC、CDC、TBOX（CHACANFD-SPTCAN1/INFOCAN/DiagCAN）
5、OBC新增接收信号：PDCM5（0x2AA）：HVCM_ChargeState，，发送方：PDCM，接收方：OBC，链路：PDCM—GW—OBC（CHACANFD-SPTCAN1）
6、CDC新增发送信号：IVI_pwrSet（0x0A5）：IVI_DischargeCancel，发送方：CDC，接收方：T_BOX，链路：CDC—GW—T_BOX（INFOCAN—DiagCAN）
7、T_BOX新增发送信号：TBOX_infoCtrl（0x0A8）：TBOX_DischargeCancel，发送方：T_BOX，接收方：CDC，链路：T_BOX—GW—CDC（INFOCAN—DiagCAN）;
Version:V4.0.8,Date:2024/9/12,Author:汤枝子,Review:,Approval:BD,INFO,Description:(BCM/GW/MDC)【CRCAN24091319838】
1、BCM更改报文周期：VIU_ML_VI_State1（0x15F），周期由20ms改为100ms，发送方：BCM，接收方：MDC，链路：BCM—GW—MDC（BDCAN——INFOCANFD）;
Version:V4.0.8,Date:2024/9/12,Author:汤枝子,Review:,Approval:INFO,Description:(IC)【CRCAN24090618885】~【CRCAN24090618892】
1、IC新增接收信号：IPB7（0x0A0）：IPB_vehicleSpeed，IPB_vehicleSpeedValid，发送方：IPB，接收方：IC，链路：IPB—GW—IC（CHACANFD——INFOCAN）
2、IC新增接收信号：PDCM10（0x2C8）：PDCM_actualGearValid，PDCM_actualGear，PDCM_DriveReady，HV_Network_active，发送方：PDCM，接收方：IC，链路：PDCM—GW—IC（PTCANFD——INFOCAN）
3、IC新增接收信号：EPBM_state（0x12A）：EPBM_Sts，发送方：EPB，接收方：IC，链路：EPB—GW—IC（CHACANFD——INFOCAN）;
Version:V5.1.0,Date:2024/12/6,Author:汤枝子,Review:H56C,Approval:PT,INFO,Description:(PDCM/CDC/GW)【CRCAN24112529003】【CRCAN24112529011】导航充电桩信息和车速片段 要拆开放两帧报文、距离精度从100m 改为 10m、距离范围从25.5km增加到655.35km
1、IVI修改拆分报文:IVI_ChargingStationInfo（0x53C）、IVI_DestinationInfo（0x5DD），更改精度，总线最大值，物理最大值，发送节点：IVI，接收节点：PDCM，链路：IVI—GW—PDCM（INFOCAN—PTCAN)
2、GW新增报文路由：INFOCAN—PTCAN：IVI_DestinationInfo（0x5DD）;
 ";

CM_ BO_ 731 "CVN码";
CM_ BO_ 747 "CAL ID码";
CM_ BO_ 748 "CAL ID码";
CM_ BO_ 1847 "OBC1/DCDC&OBC集成10kw";
CM_ BO_ 1975 "OBC1/DCDC&OBC集成10kw";
CM_ SG_ 97 bcm_AuthResponeSts "Authorities Respone Status.
0x00：PEPS钥匙认证已成功
0x5F：PEPS钥匙认证失败
0xF0：Busy. PEPS正在进行钥匙认证
0xF5：Busy. PEPS正在计算Response";
CM_ SG_ 97 bcm_challengeFrame "BCM challenge Frame.";
CM_ SG_ 705 bcm_pepsPowerMode "peps Power Mode.";
CM_ SG_ 705 bcm_IMMOReleaseIndication "IMMO Release Indication.";
CM_ SG_ 705 bcm_pepsKeyNotInCarInd "peps Key is not in car indication.";
CM_ SG_ 705 bcm_keyValid "key Valid.";
CM_ SG_ 705 bcm_pepsKeySerchFailInd "Search key failed warning.";
CM_ SG_ 705 bcm_pepsKeyCloserInd "peps Key Closer indication.";
CM_ SG_ 705 bcm_pepsFobLowBatWarning "peps Fob battery low warning.";
CM_ SG_ 705 bcm_pepsPowerRelayErrWarning "peps Power relay error warning.";
CM_ SG_ 705 bcm_IndicationPressBrake "提示请踩刹车启动";
CM_ SG_ 705 bcm_LowFrequencyAntennaFault "提示低频天线故障";
CM_ SG_ 705 BCM_RainWinowCloseWarning "下雨车窗未关提醒";
CM_ SG_ 705 BCM_KL15RelayReq "BCM请求上电KL15延时请求";
CM_ SG_ 705 bcm_remoteMode "Remote mode.";
CM_ SG_ 705 bcm_ble_response "ble response.";
CM_ SG_ 705 BCM_lampswitchfdb "外灯软开关点击反馈";
CM_ SG_ 705 BCM_RKEWindowCmd "RKEWindowCmd";
CM_ SG_ 705 bcm_srSsAndWindowsEnable "sunroof/sunshade and windows operation enable signal";
CM_ SG_ 705 bcm_rke_fuelPortCapOpenCtrl "加油口盖RKE控制";
CM_ SG_ 705 bcm_pepsKeyInCarInd "peps Key in car indication.";
CM_ SG_ 705 bcm_tbox_response "tbox_response.";
CM_ SG_ 705 bcm_approachingUnlockFedb "approaching unlock set feedback.";
CM_ SG_ 705 bcm_12VBatterySOC "12V Battery SOC.";
CM_ SG_ 705 BCM_sunroofGlassCmd "遥控天窗请求";
CM_ SG_ 705 bcm_followMeHomeFedb "Follow me home function set feedback .";
CM_ SG_ 705 bcm_awayLockFeedback "away lock control status.";
CM_ SG_ 705 bcm_PepsKeyIncarIndi "Key in car indication.";
CM_ SG_ 705 bcm_GearPUnlockFeedback "gear P unlock control status.";
CM_ SG_ 705 RollingCounter2C1 "Message counter for the message.";
CM_ SG_ 705 Checksum2C1 "CRC8, message checksum.";
CM_ SG_ 742 DCDC_status "DCDC System Status.";
CM_ SG_ 742 DCDC_Power_HV "DCDC Power of HV Side";
CM_ SG_ 742 DCDC_Temperatur_Alert_RTM "DCDC Temperture Alert of RTM";
CM_ SG_ 742 DCDC_Temperature "DCDC Temperatur";
CM_ SG_ 742 DCDC_Derating "DCDC Derating Status";
CM_ SG_ 742 DCDC_Fault_Status "DCDC Fault Status";
CM_ SG_ 742 RollingCounter2E6 "every message increments the counter.";
CM_ SG_ 742 Checksum2E6 "CRC8, checksum.";
CM_ SG_ 309 BLE_ParkOutDirection "Choose parking out direction";
CM_ SG_ 309 BLE_ParkingActiveReq "BLE request to activate the parking";
CM_ SG_ 309 BLE_ParkingActiveReqValid "BLE request to activate the parking valid state";
CM_ SG_ 309 BLE_Confirm "if driver click the 'confirm' buttom on BLE";
CM_ SG_ 309 BLE_BTStatus "BT connection status";
CM_ SG_ 309 BLE_WithinRangeOfBT "If the vehicle is in the BT control area";
CM_ SG_ 309 BLE_PowerModeReq "BLE request Power ON";
CM_ SG_ 309 BLE_RPA_Mode "BLE RPA Mode";
CM_ SG_ 309 BLE_APP_Sts "APP运行状态";
CM_ SG_ 309 RollingCounter135 "BLE_RollingCounter";
CM_ SG_ 309 Checksum135 "BLE_Checksum";
CM_ SG_ 800 swm_highbeam "High beam switch.";
CM_ SG_ 800 swm_overtakingLight "Overtaking light switch.";
CM_ SG_ 800 swm_turnSW "Left and right turn light switch.";
CM_ SG_ 800 swm_changeLaneSW "Left and right lane change light switch.";
CM_ SG_ 800 swm_frontWashing "Front washing switch.";
CM_ SG_ 800 SWM_FrontWiperSwitch "前雨刮开关状态";
CM_ SG_ 800 SWM_RearWiper "后雨刮工作状态";
CM_ SG_ 800 SWM_RearWashing "Rear washing switch.";
CM_ SG_ 800 SWM_Sensitivity "Rain sensor sensitivity level.";
CM_ SG_ 800 RollingCounter320 "Message counter for the message.";
CM_ SG_ 800 Checksum320 "CRC8, message checksum.";
CM_ SG_ 937 icm_dvrSts "DVR status.";
CM_ SG_ 937 icm_dvrPhotoSts "DVR Photo status.";
CM_ SG_ 937 icm_dvrSDcardSts "SD card status.";
CM_ SG_ 937 icm_dvrPhotoOutput "take pic status.";
CM_ SG_ 937 icm_dvrExitReq "exit request.";
CM_ SG_ 937 icm_roaSts "ROA status.";
CM_ SG_ 937 icm_roaDisplayRes "ROA display response.";
CM_ SG_ 937 icm_roaPassengerL "ROA passenger lift.";
CM_ SG_ 937 icm_roaPassengerM "ROA passenger middle.";
CM_ SG_ 937 icm_roaPassengerR "ROA passenger right.";
CM_ SG_ 937 icm_roaPassengerAge "ROA passenger age.";
CM_ SG_ 937 icm_roaPassengerMood "ROA passenger mood.";
CM_ SG_ 937 icm_ivipressphto "DVR请求车机传输照片";
CM_ SG_ 937 icm_dmsSts "DMS status.";
CM_ SG_ 937 icm_dmsCameraSts "DMS camera status.";
CM_ SG_ 937 icm_dmsWearySet "DMS weary set.";
CM_ SG_ 937 icm_dmsWearyAssisSet "DMS weary assis set.";
CM_ SG_ 937 icm_dmsWearyLeverSts "DMS weary lever status.";
CM_ SG_ 937 icm_dmsDrvBehaviorMon "DMS driving behavior monitor.";
CM_ SG_ 937 icm_dmsDistractLeverSts "DMS distract lever status.";
CM_ SG_ 937 icm_dmsSenSetRsp "sensitive set response";
CM_ SG_ 937 icm_roaRemind "ROA Remind";
CM_ SG_ 937 icm_dmsDriverMood "DMS driving mood.";
CM_ SG_ 937 icm_dmsDriver "DMS driver.";
CM_ SG_ 937 icm_dmsPassenger "DMS passenger.";
CM_ SG_ 937 icm_dmsFaceID "DMS face ID.";
CM_ SG_ 937 icm_dmsGestureID "DMS gesture ID.";
CM_ SG_ 937 icm_dmsVideoCallSts "DMS video call status.";
CM_ SG_ 937 icm_roaITLLightReq "ROA  requests to light ITL.";
CM_ SG_ 937 icm_dvrVideoOutput "DVR video output.";
CM_ SG_ 937 icm_roaCameraSts "ROA camera status.";
CM_ SG_ 994 rls_WiperSpeed "Requested wiper speed from Rain Sensor.";
CM_ SG_ 994 rls_rainSensorError "L_RS_RainSensorError
雨量传感器故障";
CM_ SG_ 994 ks_kickDetected "this signal is used to indicates KS has detected a complete kick.";
CM_ SG_ 994 srm_srPosition "sunroof position";
CM_ SG_ 994 rls_lowBeamOnReq "Low Beam ON Request
近光灯点亮请求";
CM_ SG_ 994 rls_positionLightOnReq "Position Light ON Request
位置灯点亮请求";
CM_ SG_ 994 RLS_RainIntensity "降雨强度";
CM_ SG_ 994 ITL_MainSw "顶灯总开关";
CM_ SG_ 994 ITL_DoorSw "door使能开关";
CM_ SG_ 994 ITL_FLReadLightSw "左前阅读灯开关";
CM_ SG_ 994 ITL_FRReadLightSw "右前阅读灯开关";
CM_ SG_ 994 ITL_RLReadLightSw "左后阅读灯开关";
CM_ SG_ 994 ITL_RRReadLightSw "右后阅读灯开关";
CM_ SG_ 994 ITL_ThirdRowLHReadLightSw "三排左侧阅读灯开关";
CM_ SG_ 994 ITL_ThirdRowRHReadLightSw "三排右侧阅读灯开关";
CM_ SG_ 994 ITL_DOORLightSts "选择DOOR档门开门时，以及按下阅读灯总开关时灯亮";
CM_ SG_ 994 ssm_ssMovement "sunshade movement status";
CM_ SG_ 994 SWH_SteerWheelHeatgSts "方向盘加热状态反馈";
CM_ SG_ 994 SWH_SteerWheelHeatgErr "方向盘加热系统故障";
CM_ SG_ 994 rls_lightSWReason "Light_Switch_Reason
光线传感器亮度级别";
CM_ SG_ 994 rls_windowCloseReq "RLS_Sunroof_Window_Close Request
天窗&车窗关闭请求";
CM_ SG_ 994 srm_srMovement "sunroof movement status";
CM_ SG_ 994 ITL_FLReadLightSts "左前阅读灯状态";
CM_ SG_ 994 ITL_FRReadLightSts "右前阅读灯状态";
CM_ SG_ 994 ITL_RLReadLightSts "左后阅读灯状态";
CM_ SG_ 994 ITL_RRReadLightSts "右后阅读灯状态";
CM_ SG_ 994 ITL_ThirdRowLHReadLightSts "三排左侧阅读灯状态";
CM_ SG_ 994 ITL_ThirdRowRHReadLightSts "三排右侧阅读灯状态";
CM_ SG_ 994 RLS_RainfallLevel "雨量大小13级信号（仅华为适用）";
CM_ SG_ 1058 bcm_LockTipsSts "锁车提示反馈状态信号";
CM_ SG_ 1058 BCM_PowerHoldModeSta "BCM离车不下电模式状态信号";
CM_ SG_ 1058 BCM_PowerHoldModewarning "BCM离车不下电模式提醒信号";
CM_ SG_ 1058 bcm_hazardLight_SW_Sts "危险报警灯开关状态";
CM_ SG_ 36 PDCM_challengeFrame "PDCM challenge Frame.";
CM_ SG_ 645 HVEM_ChargePower "充电功率信号";
CM_ SG_ 645 HVEM_HV_Req "HV request from HV energy management";
CM_ SG_ 645 PDCM_ISCModeSet "悬架模式设置";
CM_ SG_ 645 PDCM_EpsModeSet "转向模式设置";
CM_ SG_ 645 PDCM_PropMode "驱动模式反馈";
CM_ SG_ 645 HVEM_Power_Aux "the actual power of the Auxiliary Device";
CM_ SG_ 645 HVEM_Current_HVAux "the actual current of the Auxiliary Device";
CM_ SG_ 645 PDCM_SOC "Display SOC for IC and customer";
CM_ SG_ 645 PDCM_KL15DelayAllow "PDCM允许BCM上电KL15延时";
CM_ SG_ 645 PDCM_KL15offReq "动力电池电量低请求下电";
CM_ SG_ 645 PDCM_ultrasocengStartReq "请求APP授权启发动机";
CM_ SG_ 645 PDCM_EBSLowSOCWarn "蓄电池电量低APP报警";
CM_ SG_ 645 PDCM_LvBatChargeFdbk "PDCM反馈补电是否满足条件";
CM_ SG_ 1340 DestChargeDistance "自车到目的地（或下个途经点）充电站的距离（单位：m）";
CM_ SG_ 1340 DestChargeTime "自车到目的地（或下个途经点）充电站的时间（单位：s）";
CM_ SG_ 1340 DestFastChargeFreeNum "目的地（或下个途经点）充电站有空闲快充桩";
CM_ SG_ 1501 RoadSpeedListX0 "各路径点划分路段的平均速度序列第一段距离";
CM_ SG_ 1501 RoadSpeedListY0 "各路径点划分路段的平均速度序列第一段车速";
CM_ SG_ 1501 RoadSpeedListX1 "各路径点划分路段的平均速度序列第二段距离";
CM_ SG_ 1501 RoadSpeedListY1 "各路径点划分路段的平均速度序列第二段车速";
CM_ SG_ 1501 RoadSpeedListIndex "各路径点划分路段的平均速度序列索引";
CM_ SG_ 1501 ivi_UserBehavLearnForbid "a switch to allow users to activate car behavior self-learning";
CM_ SG_ 872 TM_CoolingLoop_RefuelActive "active flag: status of cooling loop refuel";
CM_ SG_ 872 TM_Pump3_CtrlStatus "the control status of pump3 for battery cooling loop";
CM_ SG_ 872 TM_Pump3_ActFlowRate "the actual flow rate  of the Pump3 at battery cooling loop";
CM_ SG_ 872 TM_Pump4_CtrlStatus "the control status of pump4 for battery cooling loop";
CM_ SG_ 872 TM_3WayValve3_status "the control status of the 3-way valve at MDC or 8295 cooling loop（仅H56C适用）";
CM_ SG_ 872 TM_Pump1_CtrlStatus "the control status of pump4 for HV-Componants cooling loop";
CM_ SG_ 872 TM_Pump1_ActFlowRate "the target flow rate  of the Pump4 at HV-Componants cooling loop";
CM_ SG_ 872 TM_3WayValve1_status "the control status of the 3-way valve at HV-Componants cooling loop";
CM_ SG_ 872 TM_4WayValve1_status "the control status of the 4-way valve at HV-Componants cooling loop";
CM_ SG_ 872 TM_HV_Req "TM Function request HV ON to HVEM";
CM_ SG_ 874 HVEM_DCDC_Voltage_Req "PDCM_LV_Voltage_Req";
CM_ SG_ 874 HVEM_DeratingStatus_Charge "derating level of the AC componants during charging
0 = 100% (keine Reduzierung)
1 = 75%
2 = 50%
3 = 25%
7 = Init";
CM_ SG_ 874 HVEM_AC_HVCurrent_Max "the max HV Current for AC";
CM_ SG_ 874 HVEM_DeratingReq_LV "HVEM request a derating of the power of LV network for a lange drive range";
CM_ SG_ 874 HVEM_EBS_funcSts "EBS function state";
CM_ SG_ 874 HVEM_LV_Power_Max "the maximal power for the LV side of DCDC";
CM_ SG_ 874 HVEM_MinPowerAux_Res "the min power reserved for high priority HV-function(f.e. battery cooling),";
CM_ SG_ 874 HVEM_LV_Charge_Status "the status of the charging for 12V battery through HV network";
CM_ SG_ 874 HVEM_EBS_HV_Req "HV request status from EBS Intelligent power supply function";
CM_ SG_ 874 HVEM_LowSOC_Warning "warning on Combi that  SOC is too low, please charge";
CM_ SG_ 874 PDCM_Vehicle_State "整车状态";
CM_ SG_ 874 PDCM_TowMode "拖车模式";
CM_ SG_ 874 PDCM_HV_Process "高压上电过程";
CM_ SG_ 679 HVCO_Precharge_active "system information, that the precharge process is active, only used for the precharge by DCDC";
CM_ SG_ 679 HVCO_ActiveDischarge_Req "Requirement for the active discharge of HV-Network during shutdown of the HV-Network";
CM_ SG_ 679 HVCO_BMS_StateCmd "required state to BMS";
CM_ SG_ 679 HVCO_DCDC_StateCmd "required state to DCDC";
CM_ SG_ 679 HVCO_EDC_Release "Release of the use of HV_compressor";
CM_ SG_ 679 HVCO_HV_Network_Warn "Requirement of the Warn/Fault lamp in the Combi,
0 :No_Warning/ Init
1: reqest yellow lamp in the combination
0x2: request red lamp in the combination
0x3: Warning that restart of the car impossible";
CM_ SG_ 679 HVCO_HVCM_Release "release  the charging function";
CM_ SG_ 679 HVCO_PTC_Release "release the use of PTC";
CM_ SG_ 679 HVCO_ChargeAllowed "information to the HV charging management, that the HV-SYSTEM is now allowed to charge";
CM_ SG_ 679 HVCO_EmergencyShutdown_Req "request for the emergency shutdown of  the HV-Network";
CM_ SG_ 679 HVCO_DCDC_Release "release the DCDC when the vehicle is not at drive ready";
CM_ SG_ 679 HVCO_AC_Release "release the aircondition function";
CM_ SG_ 679 HVCO_OBC_StateCmd "STATE commend to the OBC";
CM_ SG_ 679 PDCM_OBC_Chag_Standard "域控制器对OBC充电标准的指示信号";
CM_ SG_ 679 PDCM_OBC_Mesg_Standard "域控制器对OBC CAN报文发送的指示信号";
CM_ SG_ 679 RollingCounter2A7 "every message increments the counter.";
CM_ SG_ 679 Checksum2A7 "CRC8, checksum.";
CM_ SG_ 995 ebs_U_BATT "Battery voltage";
CM_ SG_ 995 ebs_I_RANGE "Battery current range";
CM_ SG_ 995 ebs_I_BATT "Battery current
备注：
1、ebs_I_RANGE信号值0x0，ebs_I_BATT对应精度为0.000977；
2、ebs_I_RANGE信号值0x1，ebs_I_BATT对应精度0.0078
3、ebs_I_RANGE信号值0x2，ebs_I_BATT对应精度0.0625";
CM_ SG_ 995 ebs_T_BATT "Battery temperature";
CM_ SG_ 995 ebs_IBATT_QUIESCNET "Battery quiescent current";
CM_ SG_ 995 ebs_Status_Current "currrent status";
CM_ SG_ 995 ebs_Status_Voltage "voltage status";
CM_ SG_ 995 ebs_Status_Temp "temperature status";
CM_ SG_ 995 ebs_ERROR_Calib "error in calibration data";
CM_ SG_ 995 ebs_ERROR_IDENT "error in ECU identification";
CM_ SG_ 995 ebs_FLAG_INCONSISTENCY "Battery inconsistency flag";
CM_ SG_ 996 ebs_SOC "State of Charge(H56C LBMS发送)";
CM_ SG_ 996 ebs_SOH_SUL "max. possible SOC, reduced by sulphation";
CM_ SG_ 996 ebs_SOFV_StopEnable "Battery voltage at cranking peak with predischarge";
CM_ SG_ 996 ebs_SOFV_Restart "Battery voltage at cranking peak without pre-discharge";
CM_ SG_ 996 ebs_SOH_LAM "State of health(Loss of active mass)";
CM_ SG_ 996 ebs_SOH_COR "State of health (corrosion)";
CM_ SG_ 996 ebs_SOC_STATE "SOC Status";
CM_ SG_ 996 ebs_SOH_SUL_STATE "SOH_SUL Status";
CM_ SG_ 996 ebs_SOFV_StopEnable_STATE "SOFV_StopEnable Status";
CM_ SG_ 996 ebs_SOFV_Restart_STATE "SOFV_Restart Status";
CM_ SG_ 996 ebs_SOH_LAM_STATE "SOH_LAM Status";
CM_ SG_ 996 ebs_SOH_COR_STATE "SOH_COR Status";
CM_ SG_ 1408 LBMS_SleepTime "休眠时长统计(一级/二级休眠时长统计)";
CM_ SG_ 1408 LBMS_WakeupByHwLine "本次唤醒为硬线唤醒";
CM_ SG_ 1408 LBMS_WakeupByRTC "本次唤醒为RTC唤醒";
CM_ SG_ 1408 LBMS_WakeupByCAN "本次唤醒源为CAN唤醒";
CM_ SG_ 1408 LBMS_WakeupByHelpE "本次唤醒为帮电唤醒";
CM_ SG_ 1408 LBMS_WakeupByCurrent "本次唤醒为电流唤醒";
CM_ SG_ 1408 LBMS_WakeupByCellOverU "本次唤醒源为过压唤醒";
CM_ SG_ 1408 LBMS_WakeupByHwOverCurrent "本次唤醒源为硬件过流(短路)唤醒";
CM_ SG_ 1408 LBMS_WakeupByCellOverT "本次唤醒源为过温唤醒";
CM_ SG_ 1408 LBMS_AppVersionFirst "软件版本号(第一位)";
CM_ SG_ 1408 LBMS_AppVersionSecond "软件版本号(第二位)";
CM_ SG_ 1408 LBMS_AppVersionThird "软件版本号(第三位)";
CM_ SG_ 1408 LBMS_BootVersionFirst "Boot版本号(第一位)";
CM_ SG_ 1408 LBMS_BootVersionSecond "Boot版本号(第二位)";
CM_ SG_ 1408 LBMS_BootVersionThird "Boot版本号(第三位)";
CM_ SG_ 1408 LBMS_HwVersion "硬件版本号";
CM_ SG_ 1408 RollingCounter580 "every message increments the counter.";
CM_ SG_ 1408 Checksum580 "CRC8, message checksum.";
CM_ SG_ 1409 LBMS_PackUnderTFlt "低温故障";
CM_ SG_ 1409 LBMS_PackOverTFlt "过温故障";
CM_ SG_ 1409 LBMS_CellUnderUFlt "单体欠压故障";
CM_ SG_ 1409 LBMS_CellOverUFlt "单体过压故障";
CM_ SG_ 1409 LBMS_PackUnderUFlt "总压欠压故障";
CM_ SG_ 1409 LBMS_PackOvVoltFlt "总压过压故障";
CM_ SG_ 1409 LBMS_DischrgOverCurrentFlt "放电过流故障";
CM_ SG_ 1409 LBMS_ChrgOverCurrentFlt "充电过流故障";
CM_ SG_ 1409 LvBatt_SohLowFault "SOH过低故障";
CM_ SG_ 1409 LBMS_LoSocFlt "SOC过低故障";
CM_ SG_ 1409 LBMS_MosFlt "MOS故障";
CM_ SG_ 1409 LBMS_AfeFlt "AFE故障";
CM_ SG_ 1409 LBMS_SbcFlt "SBC故障";
CM_ SG_ 1409 LvBatt_CellVoltOpenWireFault "电芯电压采样断线故障";
CM_ SG_ 1409 LvBatt_BuckFault "Buck电路故障";
CM_ SG_ 1409 LvBatt_ShortCircuitFault "短路故障";
CM_ SG_ 1409 LBMS_NtcFlt "NTC故障";
CM_ SG_ 1409 LBMS_EepromFlt "EEPROM数据校验故障";
CM_ SG_ 1409 LBMS_HwStuckFlt "硬线唤醒卡滞故障";
CM_ SG_ 1409 LBMS_ThermRunawayFlt "热失控故障";
CM_ SG_ 1409 LBMS_BusOffFlt "BusOff故障";
CM_ SG_ 1409 BMS_ReqChargeFailFault "补电失败标志位";
CM_ SG_ 1409 LBMS_ReqChargeFailCounter "请求补电失败计数值";
CM_ SG_ 1409 LBMS_SysFlt "低压电池故障状态（同时用作故障点灯信号）";
CM_ SG_ 1409 LBMS_SysFltLvl "低压电池故障等级（同时用作故障点灯信号）";
CM_ SG_ 1409 LBMS_SleepCurr "整车休眠电流";
CM_ SG_ 1409 RollingCounter581 "every message increments the counter.";
CM_ SG_ 1409 Checksum581 "CRC8, message checksum.";
CM_ SG_ 1410 LBMS_TotalFaultNum "当前故障总数";
CM_ SG_ 1410 LBMS_FrameIndex "帧序号";
CM_ SG_ 1410 LBMS_SupplierNum "供应商代码";
CM_ SG_ 1410 LBMS_FaultNum1 "故障列表1";
CM_ SG_ 1410 LBMS_FaultNum2 "故障列表2";
CM_ SG_ 1410 LBMS_FaultNum3 "故障列表3";
CM_ SG_ 1410 LBMS_FaultNum4 "故障列表4";
CM_ SG_ 1410 LBMS_FaultNum5 "故障列表5";
CM_ SG_ 1387 LBMS_DischrgMosCloseReason "放电Mos闭合原因";
CM_ SG_ 1387 LBMS_ChrgMosOpenReason "充电MOS断开原因";
CM_ SG_ 1387 LBMS_BuckCloseReason "Buck闭合的原因";
CM_ SG_ 259 PDCM_DrivingCycle "驾驶循环";
CM_ SG_ 259 PDCM_Dcy_valid "驾驶循环有效标志位";
CM_ SG_ 259 RollingCounter103 "Message counter for the message.";
CM_ SG_ 259 Checksum103 "CRC8, message checksum.";
CM_ SG_ 1411 NM_keep_source "网络保持唤醒源";
CM_ SG_ 1411 NM_wakeup_source "网络首次唤醒源";
CM_ SG_ 1411 NM_keep_NodeID "网络保持唤醒报文ID";
CM_ SG_ 1411 NM_wakeup_NodeID "网络首次唤醒报文ID";
CM_ SG_ 686 HVCM_Plug_Status "the status of the charge plug";
CM_ SG_ 686 HVCM_ChargeProcess_State "state of the charge process";
CM_ SG_ 686 HVCM_S2_Control "control signal for the S2 switch";
CM_ SG_ 686 HVCM_OBC_DCCurrent_Req "the required output current to OBC";
CM_ SG_ 686 HVCM_ChargeCap_control "request the charging cap to lock or unlock";
CM_ SG_ 686 HVCM_PlugLock_Control "control signal of the Plug lock";
CM_ SG_ 686 PDCM_BrakelightRequest "反馈滑行能量回收点亮制动灯请求";
CM_ SG_ 686 HVCM_ChargeFormSts "ChargeForm feedback for HMI display";
CM_ SG_ 686 HVCM_Charge_Current_Req "Charge Current Req from HVCM";
CM_ SG_ 686 HVCM_DCCharge_Step "当前DC充电详细状态";
CM_ SG_ 686 HVCM_CML_Status "CML接收标志位";
CM_ SG_ 686 HVCM_DC_StopCode "DC充电失败原因";
CM_ SG_ 686 PDCM_SelfheatingMode "整车处于自加热模式";
CM_ SG_ 686 HVCM_V2L_DisChrg_Limit "表示PDCM对V2L放电电流限值(DC侧）";
CM_ SG_ 710 PDCM_TM_status "热管理状态反馈";
CM_ SG_ 710 PDCM_EDrives_OverTempWarning "PDCM_EDrives_OverTempWarning";
CM_ SG_ 710 TM_fanspeed "风扇占空比";
CM_ SG_ 710 TM_AGS_DegreeStatus "AGS开度状态";
CM_ SG_ 710 TM_AGS_Faultstatus "AGS故障状态";
CM_ SG_ 710 TM_AGS_FaultLampReq "AGS故障报警灯";
CM_ SG_ 710 TM_AGS_SenserErr "AGS传感器故障";
CM_ SG_ 710 PDCM_TM_PassiveCapability "热管理被动能力";
CM_ SG_ 938 PDCM_Assembly_Stage "PDCM装车阶段信息";
CM_ SG_ 938 PDCM_SW_version "PDCM软件版本信息";
CM_ SG_ 938 PDCM_data_version "PDCM数据版本信息";
CM_ SG_ 938 PDCM_Vehicle_version "PDCM软件适配车型";
CM_ SG_ 938 PDCM_Faultcode "PDCM internal fault code";
CM_ SG_ 712 PDCM_actualGearValid "Actual gear valid signal.";
CM_ SG_ 712 PDCM_targetGearValid "Target gear valid .";
CM_ SG_ 712 PDCM_actualGear "Actual gear engaged.";
CM_ SG_ 712 PDCM_targetGear "Target gear.";
CM_ SG_ 712 PDCM_AccelPedal_Status "indicate the position of the accelerator pedal";
CM_ SG_ 712 PDCM_BrakePedal_Valid "valid flag for the signal PDCM_BrakePedal_Status";
CM_ SG_ 712 PDCM_BrakePedal_Status "indicate if the brake pedal has benn pressed or not";
CM_ SG_ 712 PDCM_BrakePedal_PressRemind "Remind of the Brake pedal for IC.用于提示驾驶员需要踩下制动踏板";
CM_ SG_ 712 PDCM_AccelPedal_Valid "valid flag for the signal PDCM_AccelPedal_Status";
CM_ SG_ 712 PDCM_APADrvAst_allow "PDCM ready for APA
VCU是否可以响应APA的扭矩请求";
CM_ SG_ 712 PDCM_ACCDrvAst_allow "PDCM ready for ACC
VCU是否可以响应ACC的扭矩请求";
CM_ SG_ 712 PDCM_Gear_intervention "PDCM表征用户是否正在干预挡位；";
CM_ SG_ 712 PDCM_DriveReady "indicate that the vehicle is now ready for drive, also used for the 'READY' symbol display in the combination";
CM_ SG_ 712 PDCM_EVMode_Status "indicate if the EV Mode is active or not";
CM_ SG_ 712 PDCM_VehicleSpeed "the vehicle speed from PDCM, if the ESC speed signal is valid, PDCM_Vehiclespeed will be equal to the esc speed; else, PDCM will caculate the speed according to the rotate speed of the Motor";
CM_ SG_ 712 PDCM_driveMode "Indicates the driving mode of the vehicle.";
CM_ SG_ 712 PDCM_driveMode_HW "Indicates the driving mode of the vehicle.";
CM_ SG_ 712 PDCM_authenticationResult "Authentication result.";
CM_ SG_ 712 HV_Network_active "indicate if the HV-Network is activ or not";
CM_ SG_ 712 HV_Network_Fault "indicate of a fault has been detected in the  HV Netowrk";
CM_ SG_ 712 RollingCounter2C8 "every message increments the counter.";
CM_ SG_ 712 Checksum2C8 "CRC8, checksum.";
CM_ SG_ 713 HVEM_Power_PTC1_Max "the MAX power for PTC1";
CM_ SG_ 713 HVEM_Power_PTC2_Max "the MAX power for PTC2";
CM_ SG_ 713 HVEM_Power_EDC_Max "the MAX power for EDC";
CM_ SG_ 713 HVEM_Power_AC_Max "the MAX power for Air condition";
CM_ SG_ 713 PDCM_stDrvRdyEnterFailReason "(仅H56C适用)";
CM_ SG_ 713 PDCM_stDrvRdyExitReason "(仅H56C适用)";
CM_ SG_ 178 PDCM_MCUF_AntiJerk "anti-Jerk request";
CM_ SG_ 178 PDCM_MCUF_TorqueReq "Torque request to the MCU";
CM_ SG_ 178 PDCM_MCUF_SpeedReq "speed request to MCU";
CM_ SG_ 178 PDCM_GCU_MaxPower_D "the max power for GUC that could be used for drive";
CM_ SG_ 178 PDCM_SelfheatingReq_MCUF "开启自加热命令";
CM_ SG_ 178 HVCO_MCUF_StateCmd "required state to MCUF";
CM_ SG_ 178 RollingCounter0B2 "message counter.";
CM_ SG_ 178 Checksum0B2 "message checksum.";
CM_ SG_ 181 PDCM_MCUR_AntiJerk "anti-Jerk request";
CM_ SG_ 181 PDCM_MCUR_TorqueReq "Torque request to the MCU";
CM_ SG_ 181 PDCM_MCUR_SpeedReq "speed request to MCU";
CM_ SG_ 181 PDCM_GCU_MaxPower_G "the max power for GCU  that could be used for regeneration";
CM_ SG_ 181 PDCM_SelfheatingReq_MCUR "开启自加热命令";
CM_ SG_ 181 HVCO_MCUR_StateCmd "required state to MCU";
CM_ SG_ 181 RollingCounter0B5 "Message counter for the message.";
CM_ SG_ 181 Checksum0B5 "CRC8, message checksum.";
CM_ SG_ 183 PDCM_engFlywhTrqFastCmd "VCU Request engine flywheel torque (quick).";
CM_ SG_ 183 PDCM_fuelInjectInhibitCmd "VCU make the engine starts the fuel injection suppression command.";
CM_ SG_ 183 PDCM_engStopCmd "engine Stop Request.";
CM_ SG_ 183 PDCM_engFlywhTrqSlowCmd "VCU Request engine flywheel torque (slow).";
CM_ SG_ 183 PDCM_IgAglRls "Ignition Angle Release.";
CM_ SG_ 183 PDCM_RampEngRq "Engine Ramp Request.";
CM_ SG_ 183 PDCM_IdleLoadTrq "Engine Idle Load(GCU Generation Torque,fly wheel level).";
CM_ SG_ 183 PDCM_FuelCutOff "Fuel Cut Off Request.";
CM_ SG_ 183 PDCM_engStartMode "Engine starting mode.";
CM_ SG_ 183 PDCM_EngIdleReq "Idle request from PDCM";
CM_ SG_ 183 PDCM_engStartCmd "engine Start Request.";
CM_ SG_ 183 RollingCounter0B7 "Message counter for the message.";
CM_ SG_ 183 Checksum0B7 "CRC8, message checksum.";
CM_ SG_ 983 PDCM_MCUF_MaxPower_D "the max power for front Motor that could be used for drive";
CM_ SG_ 983 PDCM_MCUF_MaxPower_G "the max power for front Motor that could be used for regeneration";
CM_ SG_ 983 PDCM_MCUR_MaxPower_D "the max power for rear Motor that could be used for drive";
CM_ SG_ 983 PDCM_MCUR_MaxPower_G "the max power for rear Motor that could be used for regeneration";
CM_ SG_ 983 RollingCounter3D7 "Message counter for the message.";
CM_ SG_ 983 CheckSum3D7 "CRC8, message checksum.";
CM_ SG_ 186 PDCM_GCU_TorqueReq "Torque request value.";
CM_ SG_ 186 PDCM_GCU_SpeedReq "Speed request value.";
CM_ SG_ 186 PDCM_GCU_Torque_Ref "Torque from PDCM to GCU, used for feedforward control";
CM_ SG_ 186 HVCO_GCU_StateCmd "GCU state command.";
CM_ SG_ 186 RollingCounter0BA "Message counter for the message.";
CM_ SG_ 186 Checksum0BA "CRC8, message checksum.";
CM_ SG_ 1135 TM_Temp_senser_1 "Tempertature of senser1";
CM_ SG_ 1135 TM_Temp_senser_2 "Tempertature of senser2";
CM_ SG_ 1135 RollingCounter46F "Message counter for the message.";
CM_ SG_ 1135 Checksum46F "CRC8, message checksum.";
CM_ SG_ 257 PDCM_MotRegenTrqInD_TotalVld "实际前后轴总的制动回收扭矩有效标志位";
CM_ SG_ 257 PDCM_FAWhlTqMax "该信号代表车辆驱动的最大能力(包含电池)；
与D/R档无关；符号为正；
扭矩层级：轮端";
CM_ SG_ 257 PDCM_vehicleTorqueMin "该信号代表系统可用的最小驱动扭矩能力,跟CRBS无关；当IPB请求一个减速度对应的较小扭矩时，为了避免发动机熄火，需要PDCM反馈一个PT系统最小可执行的正扭矩。
最小值为0；
扭矩层级:轮端；
PDCM可以保证发动机在IPB请求很小扭矩的情况下不熄火且能够响应，所以此信号PDCM一直发0";
CM_ SG_ 257 PDCM_RAWhlTqMax "该信号代表车辆后轴驱动的最大能力(包含电池)；
与D/R档无关；符号为正；
扭矩层级：轮端";
CM_ SG_ 257 PDCM_MotRegenTrqInD_Total "total motor actual regen torque in D gear. Always positive or 0. Only valid in D gear when total motor generates regen torque. Otherwise this value will be 0Nm.";
CM_ SG_ 257 PDCM_overrideSts "Indicating the torque demanded by the driver is higher than the torque demanded by ACC.";
CM_ SG_ 257 PDCM_epbReq "Request for controlling EPB";
CM_ SG_ 257 PDCM_FAWhlTqReq "该信号代表驾驶员和ADAS需求扭矩（前轴),经过滤波、过零处理，不包含CRBS和稳定性干涉；
正负号：车辆驱动为正，车辆拖滞为负；与D/R档无关；
扭矩层级:轮端；";
CM_ SG_ 257 PDCM_FAWhlTqReqValid "PDCM_FAWhlTqReq的有效标志位 Valid.";
CM_ SG_ 257 PDCM_FAWhlTqActValid "front Motor Torque Valid.";
CM_ SG_ 257 PDCM_FAWhlTqAct "PDCM反馈的实际前轴扭矩。主要用于稳定性功能（DTC,TCS,VDC等等）。
车辆驱动为正，车辆拖滞为负；与D/R档无关；
扭矩层级:轮端；";
CM_ SG_ 257 PDCM_frontMotorRpmValid "front Motor Rpm Valid.";
CM_ SG_ 257 PDCM_frontMotorRpm "前轴驱动源转速；
车辆驱动时，前轴前电机是一直有转速的且在并联情况下与发动机是强耦合的，所以该信号发送前电机实际转速；
正负号：车辆前进为正，后退为负";
CM_ SG_ 257 PDCM_RAWhlTqReq "该信号代表驾驶员和ADAS需求扭矩（后轴),经过滤波、过零处理，不包含CRBS和稳定性干涉；
正负号：车辆驱动为正，车辆拖滞为负；与D/R档无关；
扭矩层级:轮端；";
CM_ SG_ 257 PDCM_RAWhlTqReqValid "rear Motor Torque Requesd Valid.";
CM_ SG_ 257 PDCM_RAWhlTqActValid "rearMotor Torque Valid.";
CM_ SG_ 257 PDCM_RAWhlTqAct "PDCM反馈的实际后轴扭矩。主要用于稳定性功能（DTC,TCS,VDC等等）。
车辆驱动为正，车辆拖滞为负；与D/R档无关；
扭矩层级:轮端；";
CM_ SG_ 257 PDCM_rearMotRpmValid "rear Motor Rpm Valid.";
CM_ SG_ 257 PDCM_rearMotRpm "后轴驱动源转速；
车辆驱动时，前轴前电机是一直有转速的且在并联情况下与发动机是强耦合的，所以该信号发送前电机实际转速；
正负号：车辆前进为正，后退为负";
CM_ SG_ 257 PDCM_CR_TorReq_Front "ESC receive the coast regen troque request from PDCM, and then feedback the allowed regen troque";
CM_ SG_ 257 PDCM_CR_TorReq_Rear "ESC receive the coast regen troque request from PDCM, and then feedback the allowed regen troque";
CM_ SG_ 257 PDCM_AccelPedal_Virtual_Valid "Virtual Acceleration pedal position valid .";
CM_ SG_ 257 PDCM_AccelPedal_Virtual "Virtual acceleration pedal position.";
CM_ SG_ 257 PDCM_FAWhlTqRegenMax "该信号代表前轴可用的回收扭矩能力；(目前PDCM只能减去滑行请求扭矩，无法减去实际滑行扭矩)
与D/R档无关；(R档不做能量回收，此值发0)
目前仅有负值；最大值为0；
扭矩层级:轮端；";
CM_ SG_ 257 PDCM_FAWhlTqRegenMaxValid "该信号代表前轴可用的回收扭矩能力有效位";
CM_ SG_ 257 PDCM_RAWhlTqRegenMaxValid "该信号代表后轴可用的回收扭矩能力有效位";
CM_ SG_ 257 PDCM_RAWhlTqRegenMax "该信号代表后轴可用的回收扭矩能力；(目前PDCM只能减去滑行请求扭矩，无法减去实际滑行扭矩)
与D/R档无关；(R档不做能量回收，此值发0)
目前仅有负值；最大值为0；
扭矩层级:轮端；";
CM_ SG_ 257 RollingCounter101 "every message increments the counter.";
CM_ SG_ 257 Checksum101 "CRC8, message checksum.";
CM_ SG_ 795 PDCM_CruiseCtrlSetSpeed "定速巡航目标车速";
CM_ SG_ 795 PDCM_CruiseCtrlState "定速巡航状态";
CM_ SG_ 795 PDCM_RmtEngStartReq "PDCM请求用户远程启动发动机";
CM_ SG_ 795 PDCM_DcChgEnergy "表示单次快充充电累积电量";
CM_ SG_ 795 PDCM_DcdcPwrLmtLvl "低压用电限制等级";
CM_ SG_ 795 RollingCounter31B "Message counter for the message.";
CM_ SG_ 795 CheckSum31B "CRC8, message checksum.";
CM_ SG_ 711 PDCM_BatTM_Request "PDCM热管理请求";
CM_ SG_ 711 PDCM_BatTargetTemp_Inlet "the target inlet temperature of the Battery cooling calculated by PDCM";
CM_ SG_ 711 RollingCounter2C7 "Message counter for the message.";
CM_ SG_ 711 CheckSum2C7 "CRC8, message checksum.";
CM_ SG_ 797 PDCM_ExhibitionSts "Exhibition mode Status";
CM_ SG_ 797 PDCM_RemainingMileage_Real "Pure electric remaining mileage";
CM_ SG_ 797 PDCM_MaxFuelConsumptionModeSt "PDCM MaxFuelConsumption swtich feedback";
CM_ SG_ 797 PDCM_IVI_SelfHeatingReq "PDCM请求用户开启电池自加热";
CM_ SG_ 797 PDCM_TurtleLampReq "PDCM request to light the turtle lamp to indicate a drive power limitation situation.";
CM_ SG_ 797 PDCM_CRStatus "PDCM coast regeneration level feedback";
CM_ SG_ 797 PDCM_MaintenanceStatus "Indicate vehicle Maintenance status is avaliable or not";
CM_ SG_ 797 PDCM_TextInfo "Operation instruction for driver";
CM_ SG_ 797 PDCM_RemainingMileage_Standard "Pure electric remaining mileage for working condition of NEDC/WLTP";
CM_ SG_ 797 PDCM_SOCMode_Status "Powertrain mode setting feedback";
CM_ SG_ 797 PDCM_HybridSysErr "混动系统故障状态";
CM_ SG_ 797 PDCM_StandPreheatWarn "Power limitation indication due to preheat";
CM_ SG_ 797 PDCM_LowTempInhibitPowerUpWarn "Power up failure indication due to low temperature";
CM_ SG_ 797 PDCM_HVCM_ChargeSocket_Warn "AC/DC充电口过温状态";
CM_ SG_ 797 PDCM_EnergyFlow_status "Energy flow for IC display";
CM_ SG_ 797 PDCM_MILReqSts "PDCM request to light the MIL lamp in cluster";
CM_ SG_ 797 PDCM_EvonlyPwrlimited "强制纯电模式下动力受限提醒";
CM_ SG_ 797 PDCM_EngServiceMode "发动机30天自维护启动";
CM_ SG_ 797 PDCM_SmartModereq "采暖不足时模式切换请求";
CM_ SG_ 797 PDCM_HvBatDrvPreheatState "PDCM反馈在途预热功能的状态";
CM_ SG_ 797 PDCM_oilRemainingAlarmLamp "燃油低报警";
CM_ SG_ 797 PDCM_EVonlymode "强制纯电状态";
CM_ SG_ 797 PDCM_SREVSOCfdk "保电目标SOC反馈";
CM_ SG_ 797 PDCM_SocModeSuggest "动力模式智能推荐提醒";
CM_ SG_ 797 PDCM_HvBatTemptAutoCtrlInfo "智能电池温控开启指示(H56C)";
CM_ SG_ 899 PDCM_RegenPowerAct "Actual instant regeneration power for powertrain,  for display purpose in IC";
CM_ SG_ 899 PDCM_DrivePowerAct "Actual instant drive power for powertrain,  for display purpose in IC";
CM_ SG_ 899 PDCM_MaxDrivePowerAllowed "Maximum allowed drive power for powertrain, for display in IC.";
CM_ SG_ 899 PDCM_MaxRegenPowerAllowed "Maximum allowed regeneration power for powertrain, for display in IC.";
CM_ SG_ 901 MCUF_Actual_Voltage "the actual HV-Voltage of the MCU";
CM_ SG_ 901 PDCM_PartNumberMismatch "可充电储能系统不匹配报警";
CM_ SG_ 901 MCUF_ControllerTemp "驱动电机控制器温度";
CM_ SG_ 901 MCUF_MotorTemp "驱动电机定子温度";
CM_ SG_ 901 MCUF_Current_HV "the HV DC Current of the MCU";
CM_ SG_ 901 MCUF_State "the actual work mode of the Motor";
CM_ SG_ 901 MCUR_Actual_Voltage "the actual HV-Voltage of the MCU";
CM_ SG_ 901 MCUR_ControllerTemp "驱动电机控制器温度";
CM_ SG_ 901 MCUR_MotorTemp "驱动电机定子温度";
CM_ SG_ 901 MCUR_Current_HV "the HV DC Current of the MCU";
CM_ SG_ 901 MCUR_State "the actual work mode of the Motor";
CM_ SG_ 900 PDCM_CoPOM_stVehEngOnEna "发动机启动车辆使能信号";
CM_ SG_ 900 PDCM_CoPOM_stStrtEngEna "发动机启动使能信号";
CM_ SG_ 900 PDCM_CoPOM_stEngEnfOffReq "发动机禁止启动信号";
CM_ SG_ 900 PDCM_CoPOM_stEngOnDrvDmdReq "发动机强制启动请求信号";
CM_ SG_ 902 PDCM_CoPOM_stEngOnNormalReq "发动机正常启动请求信号";
CM_ SG_ 902 PDCM_CoPOM_flgStgyEngOnReq "发动机能量管理请求启动信号";
CM_ SG_ 902 PDCM_CoPOM_flgSpecModEngOn "特殊场景下发动机启动请求信号";
CM_ SG_ 793 SWS_Photo "Photo.";
CM_ SG_ 793 SWS_PilotSW "Pilot Swich.";
CM_ SG_ 793 SWS_PilotSWValid "Pilot Swich Valid.";
CM_ SG_ 793 SWS_ACCRESorAdd "ACC RES/+.";
CM_ SG_ 793 SWS_ACCRESorAddValid "ACC RES/+ Valid.";
CM_ SG_ 793 SWS_ACCSETorSub "ACC SET/-.";
CM_ SG_ 793 SWS_ACCSETorSubValid "ACC SET/-Valid.";
CM_ SG_ 793 SWS_ACCIntervalSub "ACC Interval- Swich.";
CM_ SG_ 793 SWS_ACCIntervalSubValid "ACC Interval- Swich Valid.";
CM_ SG_ 793 SWS_ACCIntervalAdd "ACC Interval+ Swich.";
CM_ SG_ 793 SWS_ACCIntervalAddValid "ACC Interval+ Swich Valid.";
CM_ SG_ 793 SWS_menu "menu.";
CM_ SG_ 793 SWS_OK "OK.";
CM_ SG_ 793 SWS_upAdd "up/ volume Add.";
CM_ SG_ 793 SWS_downMinus "down / volume minus";
CM_ SG_ 793 SWS_leftLast "left/Last.";
CM_ SG_ 793 SWS_rightNext "right/Next.";
CM_ SG_ 793 SWS_nvsSwitch "Night vision switch.";
CM_ SG_ 793 SWS_phone "Phone answer/end.";
CM_ SG_ 793 SWS_voice "voice recognition.";
CM_ SG_ 793 SWS_userdefined "user defined switch.";
CM_ SG_ 793 SWS_CCSwitch "CC Swich.";
CM_ SG_ 793 SWS_CCSwitchValid "CC Swich Valid.";
CM_ SG_ 793 RollingCounter319 "Message counter for the message.";
CM_ SG_ 793 Checksum319 "CRC8, message checksum.";
CM_ SG_ 134 EMS_FrictionTorque "发动机总摩擦扭矩";
CM_ SG_ 134 EMS_FuelcutAllowed "EMS断油允许";
CM_ SG_ 134 EMS_EngineFuelCutOff "断油标示";
CM_ SG_ 134 EMS_engIdleCtrlState "Engine idle speed control state (corresponding to the B_11 variable in ECU).";
CM_ SG_ 134 EMS_EngineSpeedLimitation "Engine Speed Limitation.";
CM_ SG_ 134 EMS_EngineOverSpeed "Engine Over Speed.";
CM_ SG_ 134 EMS_EngFlywh "发动机飞轮端扭矩";
CM_ SG_ 134 RollingCounter086 "Message counter for the message.";
CM_ SG_ 134 Checksum086 "CRC8, message checksum.";
CM_ SG_ 138 EMS_EngineMaximumTorque "发动机外特性扭矩(最大)";
CM_ SG_ 138 EMS_EngOptimdAngle_Torque "当前进气量最优点火角扭矩";
CM_ SG_ 138 EMS_EngMinRunCurrentAirTorque "当前气量最小点火角扭矩";
CM_ SG_ 138 EMS_EngineMinmumRunTorque "最小气量最小点火角扭矩";
CM_ SG_ 138 RollingCounter08A "Message counter for the message.";
CM_ SG_ 138 Checksum08A "CRC8, message checksum.";
CM_ SG_ 775 EMS_FuelResistanceValue "燃油液位阻值(仅H56C适用)";
CM_ SG_ 775 EMS_OBD_Lamp_Req "MIL indicator light.";
CM_ SG_ 775 EMS_fuelConsump100ms "fuel consumption during 100ms.";
CM_ SG_ 775 EMS_engintakeAirTemp "Engine intake air temperature sensor.";
CM_ SG_ 775 EMS_engStopTime "engine stop time.";
CM_ SG_ 775 RollingCounter307 "Message counter for the message.";
CM_ SG_ 775 Checksum307 "CRC8, message checksum.";
CM_ SG_ 151 TCU_MaxFrtMotPwr_Req "限制前轴驱动电机功率值";
CM_ SG_ 151 TCU_Fault_Reaction_Req "TCU故障处理请求";
CM_ SG_ 151 TCU_MaxGCUPwr_Req "限制前轴发电机功率值";
CM_ SG_ 151 RollingCounter097 "Message counter for the message.";
CM_ SG_ 151 Checksum097 "CRC8, message checksum.";
CM_ SG_ 1132 EMS_PressureRelief_Textinfo "EMS pressure relief failure reminder";
CM_ SG_ 1132 EMS_tankState "Fuel tank pressure state";
CM_ SG_ 1132 EMS_EngGPFStatus "发动机GPF状态";
CM_ SG_ 1132 EMS_OilPressureAlarmLamp "机油压力报警灯";
CM_ SG_ 1132 EMS_GPFSootLoad "GPF碳载量百分比";
CM_ SG_ 1132 RollingCounter46C "计数器";
CM_ SG_ 1132 Checksum46C "校验值";
CM_ SG_ 821 GCU_GeneratorDCVolt "发电机直流母线电压";
CM_ SG_ 821 GCU_GeneratorDCCurrent "发电机直流母线电流";
CM_ SG_ 821 GCU_GeneratorMaxSpd "发电机最大允许转速";
CM_ SG_ 821 GCU_GeneratorSt "发电机状态";
CM_ SG_ 821 GCU_Fault_PowerDerating "GCU limit the output power because of the internal fault";
CM_ SG_ 821 GCU_FaultCode "GCU故障码";
CM_ SG_ 821 GCU_Fault_ShutOff_HV_Req "GCU下高压请求";
CM_ SG_ 821 RollingCounter335 "Message counter for the message.";
CM_ SG_ 821 Checksum335 "CRC8, message checksum.";
CM_ SG_ 167 GCU_ActualTorque "发电机反馈扭矩";
CM_ SG_ 167 GCU_GeneratorSpd "发电机转速";
CM_ SG_ 167 GCU_GeneratorSpdValid "发电机转速有效位";
CM_ SG_ 167 GCU_State "发电机控制器运行状态";
CM_ SG_ 167 GCU_MotorPower "发电机功率";
CM_ SG_ 167 RollingCounter0A7 "Message counter for the message.";
CM_ SG_ 167 Checksum0A7 "CRC8, message checksum.";
CM_ SG_ 864 GCU_ControllerTemp "发电机控制器温度";
CM_ SG_ 864 GCU_MotorTemp "发电机本体温度";
CM_ SG_ 864 GCU_GeneratorFaultLamp "发电机系统故障灯请求";
CM_ SG_ 864 GCU_OBD_Lamp_Req "GCU OBD灯请求";
CM_ SG_ 864 GCU_ActiveDischargeState "Active Discharge State.";
CM_ SG_ 864 RollingCounter360 "Message counter for the message.";
CM_ SG_ 864 Checksum360 "CRC8, message checksum.";
CM_ SG_ 353 BMS_Fault_shutoff_Req "HV-Battery request to shut off the main relay because internal fault";
CM_ SG_ 353 BMS_Fault_PowerLimit "Fault: power capacity of HV-Battery is limmited, because of the fault, f.e. fault of sensors or fans or EXV";
CM_ SG_ 353 BMS_Fault_UrgentShutOff_Crash "Fault: safety related fault(Crash-recognition)
Battery's main relay has already been shuted off,  this signal will be recieved by PDCM, and immedieatly request active short ciruit and also active discharge to MCU";
CM_ SG_ 353 BMS_Faultstatus_HV_Relay "Fault status of the HV Relay in HV-Battery";
CM_ SG_ 353 BMS_HVIL_Status "indicate the status of HV-Interlock";
CM_ SG_ 353 BMS_Current "actual current of HV-Battery
充电为“-”
放电为“+”";
CM_ SG_ 353 BMS_Fault_UrgentShutOff "HV-Battery urgently shut off the main relay because seriously internal fault, without priviously inform PDCM";
CM_ SG_ 353 BMS_State "actuell work state of the HV-Battery";
CM_ SG_ 353 BMS_Voltage_HV_Network "actual voltage of HV-Network
Voltage at the HV-connector of HV-Battery";
CM_ SG_ 353 BMS_SelfheatingReq "电池系统请求运行自加热";
CM_ SG_ 353 BMS_AssistVolt "BMS上报A+电压范围";
CM_ SG_ 353 RollingCounter161 "every message increments the counter.";
CM_ SG_ 353 Checksum161 "CRC8, message checksum.";
CM_ SG_ 355 BMS_Max_DCchargeCurrent "电池快充请求电流";
CM_ SG_ 355 BMS_Max_ACchargeCurrent "电池慢充请求电流";
CM_ SG_ 355 BMS_BST_PackVoltage "达到总电压设定值";
CM_ SG_ 355 BMS_BST_CellVoltage "达到单体电压设定值";
CM_ SG_ 355 BMS_BST_PCBOverTemp "BMS元件连接器过温";
CM_ SG_ 355 BMS_BST_CellOverTemp "电池组温度过高故障";
CM_ SG_ 355 BMS_BST_ContactorFault "高压继电器故障";
CM_ SG_ 355 BMS_BST_CC2DetectedFault "检测点2电压检测故障";
CM_ SG_ 355 BMS_BST_PackOverCurrent "电池包充电电流过大故障";
CM_ SG_ 355 BMS_BST_OtherFault "电池包其他充电故障";
CM_ SG_ 355 BMS_Voltage "actual voltage of HV-Battery
Voltage before main relays and fuse";
CM_ SG_ 386 BMS_ChgModAllowed "BMS充电允许信号
BMS_ChgModAllowed
建议VCU命令BMS进入充电前使用，判断电池包是否允许充电";
CM_ SG_ 386 BMS_PositiveRelayDriverState "主正继电器驱动状态";
CM_ SG_ 386 BMS_PrechargeRelayDriverState "预充继电器驱动状态";
CM_ SG_ 386 BMS_DC_RelayDriverState "快充继电器驱动状态";
CM_ SG_ 386 BMS_NegtiveRelayDriverState "主负继电器驱动状态";
CM_ SG_ 386 BMS_Motor_HV_Active "电机回路上高压完成信号";
CM_ SG_ 386 BMS_DCCharge_HV_Active "快充回路上高压完成信号";
CM_ SG_ 386 BMS_HV_Active_Allowed "BMS高压连接允许信号
BMS_HV_Active_Allowed
建议VCU上高压前使用，判断电池包是否允许上高压，其他BMS信号都不用判断。";
CM_ SG_ 386 BMS_AuxBattVolt "辅助蓄电池电压";
CM_ SG_ 386 BMS_ISO_MesVal "绝缘阻值";
CM_ SG_ 386 RollingCounter182 "every message increments the counter.";
CM_ SG_ 386 Checksum182 "CRC8, message checksum.";
CM_ SG_ 722 BMS_MaxDischgPwr_sustain "BMS_Max_DischargePower_10s";
CM_ SG_ 722 BMS_MaxDischgCur_sustain "BMS_Max_DischargeCurrent_10s";
CM_ SG_ 722 BMS_MaxChgPwr_sustain "BMS_Max_ChargePower_10s";
CM_ SG_ 722 BMS_MaxChgCur_sustain "BMS_Max_ChargeCurrent_10s";
CM_ SG_ 723 BMS_SOC "the actual SOC of Battery(带窗口，带温度，寿命，平滑不跳变)
battery internal SOC, will not be used as display for driver.";
CM_ SG_ 723 BMS_SOC_Internal "the actual SOC of Battery internal";
CM_ SG_ 723 BMS_SOH "the actual SOH of Battery internal";
CM_ SG_ 723 SOC_Calibrated_Flag "SOC不可信，需满充修正标志位";
CM_ SG_ 725 BMS_targetFlowRate_Req "target flow rate of battery thermal management";
CM_ SG_ 725 BMS_ChargePreHeat_Req "HV-Battery request for the HV OFF, for preheat of the battery";
CM_ SG_ 725 BMS_CC2_Status_GBT "The status of the CC2 signal, from DC charge plug to BMS, used for recognition of the connection of the DC charge plug";
CM_ SG_ 725 BMS_CC1_LatchStatus_GBT "The status of the CC1 signal, from DC charge plug to BMS, used for recognition of the status of the latch at DC charge plug, i.e. the status of the machanical lock";
CM_ SG_ 725 BMS_Temp_DCInlet_Plus "Temperature of the DC Charge inlet at DC+";
CM_ SG_ 725 BMS_Temp_DCInlet_Minus "Temperature of the DC Charge inlet at DC-";
CM_ SG_ 725 BMS_AssistVolt_Status_GBT "the Status of the voltage between A+ and A-, which come from the DC charge station for assistant power supply";
CM_ SG_ 725 BMS_TM_Request "电池热管理请求";
CM_ SG_ 727 BMS_BattTempLamp "电池温度报警灯";
CM_ SG_ 727 BMS_ThrmlRunawaySt "热失控报警信号";
CM_ SG_ 727 BMS_ThrmlRunawayStValid "热失控报警信号有效位";
CM_ SG_ 727 BMS_RTM_FaultLevel "BMS-远程监控上报故障等级";
CM_ SG_ 727 BMS_TotalFaultNum "BMS故障总数";
CM_ SG_ 727 BMS_RTM_MaxTemp_ID "电池最高温度探针编号";
CM_ SG_ 727 BMS_RTM_MinTemp_ID "电池最低温度探针编号";
CM_ SG_ 727 BMS_Fault_Code "BMS故障码";
CM_ SG_ 727 BMS_RTM_MaxCellVolt_ID "最高单体电压电池编号";
CM_ SG_ 727 BMS_RTM_MinCellVolt_ID "最低单体电压电池编号";
CM_ SG_ 729 BMS_Charge_State "BMS充电状态";
CM_ SG_ 729 BMS_SlowChargeSt "充电状态（慢充）";
CM_ SG_ 729 BMS_FastChargeSt "充电状态（快充）";
CM_ SG_ 729 BMS_V2L_St "逆变放电状态";
CM_ SG_ 729 BMS_AC_Step "AC状态";
CM_ SG_ 729 BMS_DC_Step "DC状态";
CM_ SG_ 729 BMS_ChargeEnergy_Single "单次充电能量";
CM_ SG_ 729 BMS_ChargeCapacity_Single "单次充电容量";
CM_ SG_ 839 BMS_Fault_Iso "result of the isolation measurment BMS";
CM_ SG_ 839 BMS_temperature_highest "the current highest temperature in HV-Battery";
CM_ SG_ 839 BMS_temperature_lowest "the current lowest temperature in HV-Battery";
CM_ SG_ 839 BMS_CellVoltage_highest "the current highest cell voltage in HV-Battery";
CM_ SG_ 839 BMS_CellVoltage_lowest "the current lowest cell voltage in HV-Battery";
CM_ SG_ 880 BMS_Fault_interlock "fault flag of the HV-interlock that detected by BMS";
CM_ SG_ 880 BMS_Faultlamp_Req "request of the Fault lmap at IC";
CM_ SG_ 880 BMS_Capacity_available "available capacity of HV-Battery, consider of  the aging of the Battery, as well as the SOC-window";
CM_ SG_ 880 BMS_status_SD "Status of the SD, wether the SD has been disconnected or not.";
CM_ SG_ 880 BMS_OBD_Lamp_Req "Request MIL(MalfunctionIndicationLamp) from BMS, PDCM transmit the info to IC further";
CM_ SG_ 880 BMS_Status_Voltagefree "indicate if there are still voltage at HV-System";
CM_ SG_ 880 BMS_Energy_available "current available Energy of the HV-Battery, depends on the current SOC";
CM_ SG_ 880 BMS_Energy_Max "max energy of HV-Battery at 100% SOC, depends on the aging state and the SOC-window of the battery";
CM_ SG_ 881 BMS_Balancing_Req "BMS request to switch to the balancing mode";
CM_ SG_ 881 BMS_Balancing_Active "indicate if the battery is now at balancing state";
CM_ SG_ 881 BMS_Max_SOC "the max SOC of the SOC-Window in the operation strategy; the value can be changed during the lifecycle and aging of the battery.
After reach the max SOC, the battery cannot be charged any more";
CM_ SG_ 881 BMS_Min_SOC "the min SOC of the SOC-Window in the operation strategy; the value can be changed during the lifecycle and aging of the battery. Or  urgent request from customer.
After reach the min SOC, the battery cannot be discharged any more";
CM_ SG_ 881 ThermalRunAway_Condition1 "For thermal runaway alarm";
CM_ SG_ 881 ThermalRunAway_Condition2 "For thermal runaway alarm";
CM_ SG_ 881 ThermalRunAway_Condition3 "For thermal runaway alarm";
CM_ SG_ 881 ThermalRunAway_Condition4 "For thermal runaway alarm";
CM_ SG_ 881 ThermalRunAway_Condition5 "For thermal runaway alarm";
CM_ SG_ 881 ThermalRunAway_Condition6 "For thermal runaway alarm";
CM_ SG_ 881 ThermalRunAway_Condition7 "For thermal runaway alarm";
CM_ SG_ 881 ThermalRunAway_Condition8 "For thermal runaway alarm";
CM_ SG_ 881 ThermalRunAway_Condition9 "For thermal runaway alarm";
CM_ SG_ 881 ThermalRunAway_Condition10 "For thermal runaway alarm";
CM_ SG_ 881 ThermalRunAway_Condition11 "For thermal runaway alarm";
CM_ SG_ 881 ThermalRunAway_Condition12 "For thermal runaway alarm";
CM_ SG_ 881 ThermalRunAway_Condition13 "For thermal runaway alarm";
CM_ SG_ 881 ThermalRunAway_Condition14 "For thermal runaway alarm";
CM_ SG_ 881 ThermalRunAway_Condition15 "For thermal runaway alarm";
CM_ SG_ 881 BpsWakeupAbnFlg "Bps wake up signal abnormal";
CM_ SG_ 881 BpsOverAbsThresholdFlg "Over absolute threshold value flag";
CM_ SG_ 881 BpsOverSlopeThresholdFlg "Over slop threshold value flag";
CM_ SG_ 881 BpsInternalErrorFlag "Bps internal error flag";
CM_ SG_ 881 BpsPressureData "Battery pressure data";
CM_ SG_ 98 BCM_3ndLeftSts "第3排左占位状态";
CM_ SG_ 98 BCM_3ndMiddleSts "第3排中占位状态";
CM_ SG_ 98 BCM_3ndRightSts "第3排右占位状态";
CM_ SG_ 98 BCM_3ndMiddleSeatBeltSts "第3排中安全带状态";
CM_ SG_ 98 bcm_driverSts "主驾占位状态";
CM_ SG_ 882 BMS_ActualTemp_Outlet "Actual tmperature of the outlet of battery cooling";
CM_ SG_ 882 BMS_ActualTemp_Intlet "Actual tmperature of the Inlet of battery cooling";
CM_ SG_ 882 BMS_TargetTemp_Inlet "the target inlet temperature of the Battery cooling";
CM_ SG_ 882 BMS_Temp_average "the actual average temperature of the battery";
CM_ SG_ 882 BMS_HeatTempRate_Highest "最高温度电芯加热速率";
CM_ SG_ 882 BMS_HeatTempRate_Lowest "最低温度电芯加热速率";
CM_ SG_ 777 swm_epb_switch "epb switch active status(仅H56C适用)";
CM_ SG_ 777 swm_epb_switch_status "epb switch valid status(valid/invalid)(仅H56C适用)";
CM_ SG_ 777 gsm_gearSelectorPos "Gear selector position.";
CM_ SG_ 777 gsm_gearSelectorPosValid "Gear selector position valid signal.";
CM_ SG_ 777 gsm_faultLevel "GSM fault level.";
CM_ SG_ 777 gsm_warnInformation "warn informations";
CM_ SG_ 777 gsm_fault_code "GSM故障码";
CM_ SG_ 777 gsm_lever_position "GSM 挡杆位置";
CM_ SG_ 777 RollingCounter309 "Message counter for the message.";
CM_ SG_ 777 Checksum309 "CRC8, message checksum.";
CM_ SG_ 215 ADS_BrkTarTq "制动目标力矩";
CM_ SG_ 215 ADS_BrkTarTqVld "制动目标力矩有效";
CM_ SG_ 215 ADS_BrkTarTqEna "制动目标力矩使能";
CM_ SG_ 215 ADS_BrkTarTqMod "制动目标力矩模式";
CM_ SG_ 215 ADS_BrakeFxActuationType "Target brake force
type
目标制动类型";
CM_ SG_ 215 ADS_AebBrkTarTq "AEB制动目标力矩";
CM_ SG_ 215 ADS_AebBrkTarTqVld "AEB制动目标力矩有效";
CM_ SG_ 215 ADS_AebBrkTarTqEna "AEB制动目标力矩使能";
CM_ SG_ 215 ADS_AEBAxCtrlReq "Request for the AEB
deceleration control.";
CM_ SG_ 215 ADS_AebPreFillEna "AEB预加压使能";
CM_ SG_ 215 ADS_AwbActvEna "AEB短促制动激活使";
CM_ SG_ 215 ADS_dycEscTarTq "ESC目标横摆力矩（从车顶向下，逆时针为正）";
CM_ SG_ 215 ADS_dycEscTarTqVld "ESC目标横摆力矩有效";
CM_ SG_ 215 ADS_dycEscTarTqEna "ESC目标横摆力矩使能";
CM_ SG_ 215 ADS_BrkHoldReq "制动 AVH 请求";
CM_ SG_ 215 ADS_EpbModReq "ADS电子驻车请求";
CM_ SG_ 215 ADS_EpbModena "ADS电子驻车请求使能";
CM_ SG_ 215 ADS_EpbModReqVld "ADS电子驻车请求有效";
CM_ SG_ 215 ADS_RWUena "动态减速请求使能";
CM_ SG_ 215 ADS_RWUVLD "动态减速请求有效";
CM_ SG_ 215 ADS_DriverPresent "综合踏板等状态，判断主驾是否有人";
CM_ SG_ 215 ADS_AEB_BrkTarAxVld "AEB目标制动Ax有效位";
CM_ SG_ 215 ADS_AEB_BrkTarAx "AEB目标制动Ax（推荐发负
值代表减速度）";
CM_ SG_ 632 ivi_EPBSwitchSet "EPB开关设置信号";
CM_ SG_ 632 IVI_ASC_SpedAjustSet "悬架随速自动调节设置（仅H56C适用）";
CM_ SG_ 632 IVI_ACPLRLOCK "二排左右扶手屏锁开关（仅H56C适用）";
CM_ SG_ 632 IVI_CeilingScreenONOFFSts "吸顶屏开关状态反馈（仅H56C适用）";
CM_ SG_ 632 IVI_remainingMileageswitch "续航里程工况状态（仅H56C适用）";
CM_ SG_ 632 IVI_TripAResetReq "小计里程A清零信息";
CM_ SG_ 632 ic_vehicleSpeedDispValid "IC displayed vehicle speed valid signal.";
CM_ SG_ 632 ic_vehicleSpeedDisp "IC displayed vehicle speed.";
CM_ SG_ 625 ADAS_MdcRPAOnlineOrNot "RPA业务心跳消息";
CM_ SG_ 625 ADAS_RpaParkAuthn "RPA泊车授权";
CM_ SG_ 625 ADAS_ParkStMac "泊车状态机";
CM_ SG_ 625 ADAS_SeldParkID "选中的目标车位ID号";
CM_ SG_ 625 ADAS_VehParkMod "自车泊入方式";
CM_ SG_ 625 ADAS_ParkProgs "泊车进度";
CM_ SG_ 625 ADAS_ParkRmngDst "泊车剩余距离";
CM_ SG_ 1207 PKC_MnvreEnblInput "RPA泊车开关状态";
CM_ SG_ 1207 PKC_BlueThHeartBeatSig "手机蓝牙心跳";
CM_ SG_ 1207 Pkc_PhoneRPAOnlineOrNot "RPA业务心跳消息";
CM_ SG_ 1207 PKC_ParkAuthnCfm "RPA手机被授权确认";
CM_ SG_ 1207 PKC_PhnUsrSelTarParkID "手机端用户选中的目标车位ID号";
CM_ SG_ 1207 PKC_ParkDir "泊入方向";
CM_ SG_ 1207 PKC_VehParkMod "自车泊入方式";
CM_ SG_ 1207 PKC_ReqtPolicyInfo "请求策略信息";
CM_ SG_ 1207 PKC_RemParkModSel "RPA远程泊车模式选择";
CM_ SG_ 1207 PKC_ParkDirSel "泊出方向选择";
CM_ SG_ 1207 PKC_RpaRemDrvgReq "RPA遥控驾驶请求";
CM_ SG_ 1208 PKC_AppInterfceVersionM "手机SDK接口主版本号";
CM_ SG_ 1208 PKC_AppInterfceVersionS "手机SDK接口次版本号";
CM_ SG_ 204 ADS_EpbModReq_0x0CC "ADS电子驻车请求";
CM_ SG_ 204 ADS_EpbModena_0x0CC "ADS电子驻车请求使能";
CM_ SG_ 204 ADS_EpbModReqVld_0x0CC "ADS电子驻车请求有效";
CM_ SG_ 204 ADS_RWUena_0x0CC "动态减速请求使能";
CM_ SG_ 204 ADS_RWUVLD_0x0CC "动态减速请求有效";
CM_ SG_ 204 RollingCounter_0x0CC "Message counter for the message.";
CM_ SG_ 204 Checksum_0x0CC "CRC8, message checksum.";
CM_ SG_ 161 MCUF_ActualTorque "驱动电机反馈扭矩";
CM_ SG_ 161 MCUF_MotorSpdValid "驱动电机转速有效位";
CM_ SG_ 161 MCUF_MotorSpd "驱动电机转速";
CM_ SG_ 161 MCUF_MotorPower "驱动电机功率";
CM_ SG_ 161 MCUF_SelfheatingAllow "电机系统允许运行自加热";
CM_ SG_ 161 MCUF_SelfheatingMode "电机处于自加热模式";
CM_ SG_ 161 RollingCounter0A1 "Message counter for the message.";
CM_ SG_ 161 Checksum0A1 "CRC8, message checksum.";
CM_ SG_ 789 MCUF_Status_ActiveDischarge "indicate the status of the active discharge in MCU";
CM_ SG_ 789 MCUF_Fault_ActiveDischarge "indicate the fault status of the active discharge function";
CM_ SG_ 789 MCUF_Fault_PowerDerating "MCU limit the output power because of the internal fault";
CM_ SG_ 789 MCUF_FaultLamp_Req "request of the Fault Lamp in IC";
CM_ SG_ 789 MCUF_OBD_Lamp_Req "request OBC Lamp in IC";
CM_ SG_ 789 MCUF_PerInd_MaxPower "Performence Indication for the output pwer of motor:
1. the Value 100-200% discribe how many reserve  power the motor still have, it’s the relationship between current Power limitation and potential power
2. 100% means, no power reserve in the moter
3. 0-100% discribe the derating percent";
CM_ SG_ 789 MCUF_PerInd_MaxTorque "Performence Indication for the output toruqe of motor:
1. the Value 100-200% discribe how many reserve  power the motor still have, it’s the relationship between current torque limitation and potential torque
2. 100% means, no power reserve in the moter
3. 0-100% discribe the derating percent";
CM_ SG_ 789 MCUF_MotorStatus "驱动电机状态";
CM_ SG_ 789 MCUF_ToltalFaultNum "MCUF Toltal Fault Number.";
CM_ SG_ 789 MCUF_Fault_Code "MCU故障码";
CM_ SG_ 789 RollingCounter315 "Message counter for the message.";
CM_ SG_ 789 Checksum315 "CRC8, message checksum.";
CM_ SG_ 1045 MCUF_RTM_WarnComm "RTM WARNING: bus communication fault";
CM_ SG_ 1045 MCUF_RTM_OverTemp_EM "RTM Signal:  over-temp warning Motor";
CM_ SG_ 1045 MCUF_RTM_OverTemp_MCU "RTM Signal:  over-temp warning MCU";
CM_ SG_ 1045 MCUF_RTM_OverSpeed "RTM Signal:  overspeed warning of  the rear motor";
CM_ SG_ 1045 MCUF_RTM_OverCurrent "RTM Signal:  over current warning of  the rear motor";
CM_ SG_ 1045 MCUF_Vehicle_Type "MCUF_Vehicle_Type";
CM_ SG_ 1045 MCUF_HW_Version "MCU_HW_Version";
CM_ SG_ 1045 MCUF_Derating_OverTemp "MCU has limit the power because of over temperature";
CM_ SG_ 1045 MCUF_Efficiency "the system efficiency of the Motor";
CM_ SG_ 1045 MCUF_HV_Voltg_Free "indicate if there are still voltage at HV-System
阀值20v";
CM_ SG_ 1045 MCUF_SW_Minor_Version "MCUF_SW_Minor_Version";
CM_ SG_ 1045 MCUF_SW_Major_Version "MCUF_SW_Major_Version";
CM_ SG_ 1045 RollingCounter415 "Message counter for the message.";
CM_ SG_ 1045 Checksum415 "CRC8, message checksum.";
CM_ SG_ 166 MCUR_ActualTorque "驱动电机反馈扭矩";
CM_ SG_ 166 MCUR_MotorSpdValid "驱动电机转速有效位";
CM_ SG_ 166 MCUR_MotorSpd "驱动电机转速";
CM_ SG_ 166 MCUR_MotorPower "驱动电机功率";
CM_ SG_ 166 MCUR_SelfheatingAllow "电机系统允许运行自加热";
CM_ SG_ 166 MCUR_SelfheatingMode "电机处于自加热模式";
CM_ SG_ 166 RollingCounter0A6 "Message counter for the message.";
CM_ SG_ 166 Checksum0A6 "CRC8, message checksum.";
CM_ SG_ 790 MCUR_Status_ActiveDischarge "indicate the status of the active discharge in MCU";
CM_ SG_ 790 MCUR_Fault_ActiveDischarge "indicate the fault status of the active discharge function";
CM_ SG_ 790 MCUR_Fault_PowerDerating "MCU limit the output power because of the internal fault";
CM_ SG_ 790 MCUR_FaultLamp_Req "request of the Fault Lamp in IC";
CM_ SG_ 790 MCUR_OBD_Lamp_Req "request OBC Lamp in IC";
CM_ SG_ 790 MCUR_PerInd_MaxPower "Performence Indication for the output pwer of motor:
1. the Value 100-200% discribe how many reserve  power the motor still have, it’s the relationship between current Power limitation and potential power
2. 100% means, no power reserve in the moter
3. 0-100% discribe the derating percent";
CM_ SG_ 790 MCUR_PerInd_MaxTorque "Performence Indication for the output toruqe of motor:
1. the Value 100-200% discribe how many reserve  power the motor still have, it’s the relationship between current torque limitation and potential torque
2. 100% means, no power reserve in the moter
3. 0-100% discribe the derating percent";
CM_ SG_ 790 MCUR_MotorStatus "驱动电机状态";
CM_ SG_ 790 MCUR_ToltalFaultNum "MCUR Toltal Fault Number.";
CM_ SG_ 790 MCUR_Fault_Code "MCU故障码";
CM_ SG_ 790 RollingCounter316 "Message counter for the message.";
CM_ SG_ 790 Checksum316 "CRC8, message checksum.";
CM_ SG_ 1046 MCUR_RTM_WarnComm "RTM WARNING: bus communication fault";
CM_ SG_ 1046 MCUR_RTM_OverTemp_EM "RTM Signal:  over-temp warning Motor";
CM_ SG_ 1046 MCUR_RTM_OverTemp_MCU "RTM Signal:  over-temp warning MCU";
CM_ SG_ 1046 MCUR_RTM_OverSpeed "RTM Signal:  overspeed warning of  the rear motor";
CM_ SG_ 1046 MCUR_RTM_OverCurrent "RTM Signal:  over current warning of  the rear motor";
CM_ SG_ 1046 MCUR_Vehicle_Type "MCUR_Vehicle_Type";
CM_ SG_ 1046 MCUR_HW_Version "MCU_HW_Version";
CM_ SG_ 1046 MCUR_Derating_OverTemp "MCU has limit the power because of over temperature";
CM_ SG_ 1046 MCUR_Efficiency "the system efficiency of the Motor";
CM_ SG_ 1046 MCUR_HV_Voltg_Free "indicate if there are still voltage at HV-System
阀值20v";
CM_ SG_ 1046 MCUR_SW_Minor_Version "MCUR_SW_Minor_Version";
CM_ SG_ 1046 MCUR_SW_Major_Version "MCUR_SW_Major_Version";
CM_ SG_ 1046 RollingCounter416 "Message counter for the message.";
CM_ SG_ 1046 Checksum416 "CRC8, message checksum.";
CM_ SG_ 300 EPBS_FaultLamp "EPB 报警显示";
CM_ SG_ 300 EPBS_ParkingLamp "EPB状态指示灯";
CM_ SG_ 300 EPBS_TextDisplayOnIVI "epb text display on IVI.";
CM_ SG_ 300 EPBS_Sts "EPB状态";
CM_ SG_ 300 EPBS_IGNStatus "右侧KL15电状态（仅H56C适用）";
CM_ SG_ 300 EPBS_RollerBenchActive "右侧转毂模式（仅H56C适用）";
CM_ SG_ 300 EPBS_FailStatus "EPB故障状态";
CM_ SG_ 300 EPBS_SupplyVoltageRight "右侧供电电压（仅H56C适用）";
CM_ SG_ 300 EPB_SReqfailstatus "EPB响应外部请求的能力状态";
CM_ SG_ 300 EPBS_EcdActvSts "ECD激活状态（仅H56C适用））";
CM_ SG_ 300 EPBS_RwuAvl "动态减速接口可用（仅H56C适用）";
CM_ SG_ 300 EPBS_EpbAvl "EPB驻车接口可用状（仅H56C适用）";
CM_ SG_ 300 EPBS_ApplyReleaseRuqest "右侧EPB动作请求（仅H56C适用）";
CM_ SG_ 300 EPBS_MotorCurrentRight "右侧电机电流（仅H56C适用）";
CM_ SG_ 875 AC_WarmWindReq "暖风请求";
CM_ SG_ 875 AC_ambientTempValid "外温有效位";
CM_ SG_ 875 AC_Warmvalvestate "暖风电磁阀状态";
CM_ SG_ 875 AC_HVWH_Cabin_PowerReqLevel "乘员舱加热PTC功率请求等级";
CM_ SG_ 875 AC_EDC_PowerReqLevel "空调压缩机功率请求等级";
CM_ SG_ 875 AC_EDC_PowerReq "EDC功率请求";
CM_ SG_ 875 AC_EDC_Power "EDC实际功率";
CM_ SG_ 875 AC_HvThermSysSt "空调高压状态";
CM_ SG_ 875 AC_HVWH_Cabin_PowerReq "乘员舱PTC功率请求";
CM_ SG_ 875 AC_ambientTemp "外温";
CM_ SG_ 875 AC_HVWH_Cabin_Power "乘员舱PTC实际功率";
CM_ SG_ 875 AC_HVWH_Battery_PowerReq "电池PTC功率请求";
CM_ SG_ 875 AC_HVWH_Battery_PowerReqLevel "电池PTC功率请求等级";
CM_ SG_ 875 AC_HVWH_Battery_Power "电池PTC实际功率";
CM_ SG_ 934 AC_TM_FanSpeedReq "空调风扇转速请求";
CM_ SG_ 934 AC_HV_Req "高压上电请求";
CM_ SG_ 934 AC_Pump_CtrlStatus "暖风水泵占空比";
CM_ SG_ 934 AC_PTC_PumpFlowRate "暖风回路水泵流量";
CM_ SG_ 934 AC_CoolingFillReq "冷却液加注请求";
CM_ SG_ 934 AC_AcStsReq "TBD";
CM_ SG_ 934 AC_RrDefrostReq "后除霜请求";
CM_ SG_ 934 AC_HazardLightReq "背光调节请求";
CM_ SG_ 934 AC_CabinTemp "乘员舱实际温度";
CM_ SG_ 934 AC_TM_AgsDegReq "AGS开度请求";
CM_ SG_ 934 AC_Superheat "过热度";
CM_ SG_ 934 AC_SuperCool "过冷度";
CM_ SG_ 925 AC_FrEvapActualTemp "前蒸发器实际温度";
CM_ SG_ 925 AC_FrEvapProtectTemp "保护点前蒸发器实际温度";
CM_ SG_ 925 AC_RrEvapActualTemp "后蒸发器实际温度";
CM_ SG_ 925 AC_HighPresRefrigerantTemp "高压侧温度传感器";
CM_ SG_ 925 AC_HPLowPresRefrigerantTemp "热泵模式下低压侧温度";
CM_ SG_ 925 AC_BatLowPresRefrigerantTemp "电池冷却模式下低压侧温度";
CM_ SG_ 925 AC_HighPressure "High pressure.";
CM_ SG_ 925 AC_LowPressure "Low pressure.";
CM_ SG_ 757 AC_TM_Request "空调热管理请求";
CM_ SG_ 757 AC_TM_State "空调热管理状态";
CM_ SG_ 757 AC_chiller_EXV_StepReq "Chiller电子膨胀阀请求步数";
CM_ SG_ 757 AC_chiller_EXV_Step "Chiller电子膨胀阀实际步数";
CM_ SG_ 757 AC_OHX_EXV_StepReq "室外换热器电子膨胀阀请求步数";
CM_ SG_ 757 AC_OHX_EXV_Step "室外换热器电子膨胀阀实际步数";
CM_ SG_ 757 AC_EDC_SpeedReq "压缩机请求转速";
CM_ SG_ 757 AC_EDC_Speed "压缩机实际转速";
CM_ SG_ 759 AC_ELV_MFR_status "MFR电磁截止阀状态";
CM_ SG_ 759 AC_ELV_FR_EVAP_status "前蒸发器电磁截止阀状态";
CM_ SG_ 759 AC_ELV_RR_EVAP_status "后蒸发器电磁截止阀状态";
CM_ SG_ 759 AC_HVWH_Cabin_TempReq "乘员舱PTC请求出水温度";
CM_ SG_ 759 AC_HVWH_Cabin_temp "乘员舱PTC实际出水温度";
CM_ SG_ 759 AC_3WayValve_status "暖风回路三通阀2控制状态";
CM_ SG_ 759 AC_HVWH_Battery_TempReq "电池PTC请求出水温度";
CM_ SG_ 759 AC_HVWH_Battery_temp "电池PTC实际出水温度";
CM_ SG_ 759 AC_3WayValve_status_actual "暖风回路三通阀2实际状态";
CM_ SG_ 761 AC_FrOnOffSts "前空调ON/OFF状态";
CM_ SG_ 761 AC_RrOnOffSts "后空调ON/OFF状态";
CM_ SG_ 761 AC_DualSts "左右分区控制状态";
CM_ SG_ 761 AC_FrAutoSts "前自动状态";
CM_ SG_ 761 AC_RrAutoSts "后自动状态";
CM_ SG_ 761 AC_FrAcSts "A/C状态";
CM_ SG_ 761 AC_FrDefrostSts "前除霜状态";
CM_ SG_ 761 AC_FrModeSts "前送风模式";
CM_ SG_ 761 AC_RrModeSts "后送风模式";
CM_ SG_ 761 AC_RecircSts "空调循环状态信号";
CM_ SG_ 761 AC_FrblowerLv "前鼓风机风量档位";
CM_ SG_ 761 AC_RrblowerLv "后鼓风机风量档位";
CM_ SG_ 761 ac_AlldualSts "全车分区控制状态";
CM_ SG_ 761 AC_AnionGeneratorSts "负离子发生器状态";
CM_ SG_ 761 AC_AnionGeneratorOnOffSetRsp "负离子发生器自动开启状态反馈";
CM_ SG_ 761 AC_FrLeftSetTemp "前排左设置温度";
CM_ SG_ 761 AC_FrRightSetTemp "前排右设置温度";
CM_ SG_ 761 Racp_SsmSw "遮阳帘开/关";
CM_ SG_ 761 AC_RrSetTemp "后排设置温度";
CM_ SG_ 761 AC_ambientTemp_raw "外温原始值";
CM_ SG_ 761 AC_ambientTempValid_raw "外温原始值有效位";
CM_ SG_ 761 AC_HVWH_Cabin_HV_Voltage "PTC高压检测电压";
CM_ SG_ 733 AC_OBD_f000_DisPreSenor_SGOL "Discharge Pressure Sensor Short to GND or Open Load";
CM_ SG_ 733 AC_OBD_f001_DisPreSensor_OutRanLo "Discharge Pressure Sensor Out of Range Low";
CM_ SG_ 733 AC_OBD_f002_DisPreSensor_OutRanHi "Discharge Pressure Sensor Out of Range High";
CM_ SG_ 733 AC_OBD_f003_DisPreSensor_RatFau "Discharge Pressure Sensor Rationlity Fault";
CM_ SG_ 733 AC_OBD_f004_DisPreSensor_SB "压缩机入口压力短路到电源故障";
CM_ SG_ 733 AC_OBD_f005_SucPreSenor_SGOL "Suction Pressure Sensor Short to GND or Open Load";
CM_ SG_ 733 AC_OBD_f006_SucPreSensor_OutRanLo "Suction Pressure Sensor Out of Range Low";
CM_ SG_ 733 AC_OBD_f007_SucPreSensor_OutRanHi "Suction Pressure Sensor Out of Range High";
CM_ SG_ 733 AC_OBD_f008_SucPreSensor_RatFau "Suction Pressure Sensor Rationlity Fault";
CM_ SG_ 733 AC_OBD_f009_SucPreSensor_SB "压缩机出口压力短路到电源故障";
CM_ SG_ 733 AC_OBD_f010_ChillerTemSensor_SBOL "Chiller out refrigirant Temperature Sensor Short to Battery or Open Load";
CM_ SG_ 733 AC_OBD_f011_ChillerTemSensor_SG "Chiller out refrigirant Temperature Sensor Short to GND";
CM_ SG_ 733 AC_OBD_f012_ChillerTemSensor_OutRanLo "Chiller out refrigirant Temperature Sensor Out of Range Low";
CM_ SG_ 733 AC_OBD_f013_ChillerTemSensor_OutRanHi "Chiller out refrigirant Temperature Sensor Out of Range High";
CM_ SG_ 733 AC_OBD_f014_ChillerTemSensor_RatFau "Chiller 温度传感器合理性故障";
CM_ SG_ 733 AC_OBD_f015_INTFrRSensor_SGOL "INT Fr R sensor Short to GND or Open Load";
CM_ SG_ 733 AC_OBD_f016_INTFrRSensor_SB "INT Fr R sensor Short to Battery";
CM_ SG_ 733 AC_OBD_f017_INTFrRSensor_OutRanLo "INT Fr R sensor Out of Range Low";
CM_ SG_ 733 AC_OBD_f018_INTFrRSensor_OutRanHi "INT Fr R sensor Out of Range High";
CM_ SG_ 733 AC_OBD_f019_INTFrRSensor_RatFau "前蒸发器温度传感器合理性故障";
CM_ SG_ 733 AC_OBD_f020_INTRrRSensor_SGOL "INT Rr R sensor Short to GND or Open Load";
CM_ SG_ 733 AC_OBD_f021_INTRrRSensor_SB "INT Rr R sensor Short to Battery";
CM_ SG_ 733 AC_OBD_f022_INTRrRSensor_OutRanLo "INT Rr R sensor Out of Range Low";
CM_ SG_ 733 AC_OBD_f023_INTRrRSensor_OutRanHi "INT Rr R sensor Out of Range High";
CM_ SG_ 733 AC_OBD_f024_INTRrRSensor_RatFau "后蒸发器温度传感器合理性故障";
CM_ SG_ 733 AC_OBD_f025_EXVChiller_LostCom "EXV with Chiller Lost communication";
CM_ SG_ 733 AC_OBD_f026_EXVChiller_ResErr "EXV with Chiller Response Error";
CM_ SG_ 733 AC_OBD_f027_EXVChiller_ActErr "EXV with Chiller Actuator Error";
CM_ SG_ 733 AC_OBD_f028_EXVChiller_VolErr "EXV with chiller Voltage Error";
CM_ SG_ 733 AC_OBD_f029_EXVChiller_TemErr "EXV with chiller Temperature Error";
CM_ SG_ 733 AC_OBD_f030_Reserved "保留";
CM_ SG_ 733 AC_OBD_f031_Reserved "保留";
CM_ SG_ 734 AC_OBD_f032_Reserved "保留";
CM_ SG_ 734 AC_OBD_f033_Reserved "保留";
CM_ SG_ 734 AC_OBD_f034_HVWHforHC_LostCom "PTC1/HVWH_HC Lost Communication";
CM_ SG_ 734 AC_OBD_f035_HVWHforHC_OveVol "PTC1/HVWH_HC Over Voltage";
CM_ SG_ 734 AC_OBD_f036_HVWHforHC_UndVol "PTC1/HVWH_HC Under Voltage";
CM_ SG_ 734 AC_OBD_f037_HVWHforHC_BoiErr "PTC1/HVWH_HC Boiling Error";
CM_ SG_ 734 AC_OBD_f038_HVWHforHC_CirErr "PTC1/HVWH_HC Circuit Error";
CM_ SG_ 734 AC_OBD_f039_WaterPumpHC "Water pump at H/C loop failure";
CM_ SG_ 734 AC_OBD_f040_3WayValForBat_LosCom "3Valve2 for battery Lost Communication";
CM_ SG_ 734 AC_OBD_f041_3WayValForBat_ResErr "3Valve2 for battery Response Error";
CM_ SG_ 734 AC_OBD_f042_3WayValForBat_ActErr "3Valve2 for battery Actuator Error";
CM_ SG_ 734 AC_OBD_f043_3WayValForBat_VolErr "3Valve2 for battery Voltage Error";
CM_ SG_ 734 AC_OBD_f044_ECU_IntFau "ECU内部错误";
CM_ SG_ 734 AC_OBD_f045_AMBSensor_SBOL "AMB Sensor Short to Battery or Open Load";
CM_ SG_ 734 AC_OBD_f046_AMBSensor_SG "AMB Sensor Short to GND";
CM_ SG_ 734 AC_OBD_f047_AMBSensor_OutRanLo "AMB Sensor Out of Range Low";
CM_ SG_ 734 AC_OBD_f048_AMBSensor_OutRanHi "AMB Sensor Out of Range High";
CM_ SG_ 734 AC_OBD_f049_AMBSensor_RatFau "外温传感器合理性故障";
CM_ SG_ 734 AC_OBD_f050_UnderBatVol "AC undervoltage fault";
CM_ SG_ 734 AC_OBD_f051_OverBatVol "AC overvoltage fault";
CM_ SG_ 734 AC_OBD_f052_ComCANBusOff "Comfort CAN controller Bus Off";
CM_ SG_ 734 AC_OBD_f053_GW_NoCom "no communication of network with GW (PDCM)";
CM_ SG_ 734 AC_OBD_FaultClrsts "清除故障完成标志位";
CM_ SG_ 734 AC_EDC_HV_Voltage "压缩机直流电压";
CM_ SG_ 734 AC_HVWH_Bat_HV_Voltage "PTCB高压检测电压";
CM_ SG_ 731 AC_OBD_Comp_OverpPhaseCurrentError "EDC Over Phase Current Error
相电流过流故障";
CM_ SG_ 731 AC_OBD_Comp_TemperatureSensorError "EDC Temperature Sensor Error
内部温度传感器故障";
CM_ SG_ 731 AC_OBD_Comp_CurrentSamplingError "EDC Current Sampling Error
电流采样故障";
CM_ SG_ 731 AC_OBD_Comp_DriverError "EDC Driver Error
压缩机IGBT/IPM模块故障";
CM_ SG_ 731 AC_OBD_Comp_StartupError "EDC Start up Error
压缩机启动失败故障";
CM_ SG_ 731 AC_OBD_Comp_OvertemperatureError "EDC Overtemperature Error
压缩机过热故障";
CM_ SG_ 731 AC_OBD_Comp_ECU_InternalError "EDC ECU Internal Error
压缩机控制器内部故障";
CM_ SG_ 731 AC_OBD_Comp_StallError "EDC Stall Error
压缩机堵转故障";
CM_ SG_ 731 AC_OBD_Comp_Hv_UnderVoltageError "Comp_Hv Under Voltage Error
压缩机高压端欠电压故障";
CM_ SG_ 731 AC_OBD_Comp_Hv_OverVoltageError "EDC Hv OverVoltage Error
压缩机高压端过电压故障";
CM_ SG_ 731 AC_OBD_Comp_Lv_VoltageError "EDC Lv Voltage Error
压缩机低压端供电电压故障";
CM_ SG_ 731 AC_OBD_EDCStopError "EDC Stop Error";
CM_ SG_ 731 AC_OBD_PTC_BStopError "PTC_B (Battery) stop Error";
CM_ SG_ 731 AC_OBD_PTC_CStopError "PTC_C (Cabin)  stop";
CM_ SG_ 1238 ic_totalMileage "Total mileage.";
CM_ SG_ 1238 ic_lowSocIndication "Low SOC indication.";
CM_ SG_ 1238 ic_displayFail "Error in the display or display control unit.(ADAS Reruirment).";
CM_ SG_ 1238 ic_qDashACCFail "Error in the ACC message detected by the HMI, like timeout or alivecounter error.";
CM_ SG_ 1238 ic_totalMileageValid "Total mileage valid signal.";
CM_ SG_ 1238 ic_vehicleSpeedDispValid "IC displayed vehicle speed valid signal.";
CM_ SG_ 1238 ic_RemainingMileage "Remaining Mileage";
CM_ SG_ 1238 ic_vehicleSpeedDisp "IC displayed vehicle speed.";
CM_ SG_ 1238 RollingCounter4D6 "message rolling counter.";
CM_ SG_ 1238 Checksum4D6 "CRC8 checksum";
CM_ SG_ 1234 IVI_autoWiper "Working state of the wiper when the front wiper is auto.";
CM_ SG_ 1234 ivi_wcmROnOffSet "WCM ON/OFF set.(H56C)";
CM_ SG_ 1234 IVI_EetSceneModeSts "IVI情景模式状态信息（仅H56C）";
CM_ SG_ 1234 IVI_SceneModeExtenderSet "情景模式增程器使能(仅H56C)";
CM_ SG_ 1234 ivi_PowerHoldModeTime "离车不下电模式定时信号(仅H56C)";
CM_ SG_ 896 acu_warningLampSts "Warning lamp status.";
CM_ SG_ 896 acu_crashOutputStsValid "crash output statusvalid.";
CM_ SG_ 896 acu_driverSeatBeltSts "Driver seatbelt status.";
CM_ SG_ 896 acu_driverSeatBeltStsValid "Driver seatbelt status vailid.";
CM_ SG_ 896 acu_passengerSeatBeltSts "Passenger seatbelt status.";
CM_ SG_ 896 acu_passengerSeatBeltStsValid "Passenger seatbelt status valid.";
CM_ SG_ 896 acu_passengerAirbagSts "Passenger airbag status(closed or not)";
CM_ SG_ 896 acu_secondLeftSeatBeltSts "Left of second row seatbelt status.";
CM_ SG_ 896 acu_secondMiddleSeatBeltSts "Middle of second row seatbelt status.";
CM_ SG_ 896 acu_secondRightSeatBeltSts "Right of second row seatbelt status.";
CM_ SG_ 896 acu_passengerSts "Passenger seat is occupied or not.";
CM_ SG_ 896 acu_secondLeftSts "Left of second row seat is occupied not.";
CM_ SG_ 896 acu_secondMiddleSts "Middle of second row seat is occupied not.";
CM_ SG_ 896 acu_secondRightSts "Right of second row seat is occupied not.";
CM_ SG_ 896 acu_crashOutputSts "Crash output status.";
CM_ SG_ 896 RollingCounter380 "every message increments the counter.";
CM_ SG_ 896 Checksum380 "CRC8 checksum.";
CM_ SG_ 1041 BCM_FLTpmsSensorFailure_St "左前轮胎压传感器信号状态";
CM_ SG_ 1041 BCM_FRTpmsSensorFailure_St "右前轮胎压传感器信号状态";
CM_ SG_ 1041 BCM_FLTpmsWheellPressureWarn_St "左前轮胎压报警状态";
CM_ SG_ 1041 BCM_FRTpmsWheellPressureWarn_St "右前轮胎压报警状态";
CM_ SG_ 1041 BCM_FLTpmsWheelTempWarn_St "左前轮胎温报警状态";
CM_ SG_ 1041 BCM_FRTpmsWheelTempWarn_St "右前轮胎温报警状态";
CM_ SG_ 1041 BCM_FLTpmsBattle_St "左前轮胎压传感器电池状态";
CM_ SG_ 1041 BCM_FRTpmsBattle_St "右前轮胎压传感器电池状态";
CM_ SG_ 1041 BCM_FLTpmsRapidLeakWarn "左前快速漏气报警信号";
CM_ SG_ 1041 BCM_FRTpmsRapidLeakWarn "右前快速漏气报警信号";
CM_ SG_ 1041 BCM_FLTpmsWheellPressure "左前轮胎压";
CM_ SG_ 1041 BCM_FLTpmsWheelTemp "左前轮胎温";
CM_ SG_ 1041 BCM_FRTpmsWheellPressure "右前轮胎压";
CM_ SG_ 1041 BCM_FRTpmsWheelTemp "右前轮胎温";
CM_ SG_ 1057 BCM_RLTpmsSensorFailure_St "左后轮胎压传感器信号状态";
CM_ SG_ 1057 BCM_RRTpmsSensorFailure_St "右后轮胎压传感器信号状态";
CM_ SG_ 1057 BCM_RLTpmsWheellPressureWarn_St "左后轮胎压报警状态";
CM_ SG_ 1057 BCM_RRTpmsWheellPressureWarn_St "右后轮胎压报警状态";
CM_ SG_ 1057 BCM_RLTpmsWheelTempWarn_St "左后轮胎温报警状态";
CM_ SG_ 1057 BCM_RRTpmsWheelTempWarn_St "右后轮胎温报警状态";
CM_ SG_ 1057 BCM_RLTpmsBattle_St "左后轮胎压传感器电池状态";
CM_ SG_ 1057 BCM_RRTpmsBattle_St "右后轮胎压传感器电池状态";
CM_ SG_ 1057 BCM_RLTpmsRapidLeakWarn "左后快速漏气报警信号";
CM_ SG_ 1057 BCM_RRTpmsRapidLeakWarn "右后快速漏气报警信号";
CM_ SG_ 1057 BCM_RLTpmsWheellPressure "左后轮胎压";
CM_ SG_ 1057 BCM_RLTpmsWheelTemp "左后轮胎温";
CM_ SG_ 1057 BCM_RRTpmsWheellPressure "右后轮胎压";
CM_ SG_ 1057 BCM_RRTpmsWheelTemp "右后轮胎温";
CM_ SG_ 1239 IC_MaintenanceMileage "剩余保养里程";
CM_ SG_ 1239 ic_lastingtime "lasting time of current tripmeter.";
CM_ SG_ 1239 ic_mileageSincethelastcharge "mileage display since the last charge.";
CM_ SG_ 1239 ic_tripmeterThisMoment "tripmeter this moment.";
CM_ SG_ 1239 IC_MaintenanceReset "保养里程清零";
CM_ SG_ 1235 ic_totalMileageRev "Total mileage of REV.";
CM_ SG_ 1022 ivi_timeInfoSecond "Time informatioin:Second.";
CM_ SG_ 1022 ivi_timeInfoMinute "Time informatioin:Minute.";
CM_ SG_ 1022 ivi_timeInfoHour "Time informatioin：Hour.";
CM_ SG_ 1022 ivi_timeInfoDay "Time informatioin：Day.";
CM_ SG_ 1022 ivi_timeInfoMonth "Time informatioin：Month.";
CM_ SG_ 1022 ivi_timeInfoYear "Time informatioin:Year.";
CM_ SG_ 1022 ivi_timeValid "Time Valid.";
CM_ SG_ 117 ivi_hoodUnlockCtrl "Hood unlock control.";
CM_ SG_ 117 IVI_SOCmodeSet "动力模式；取消发送三帧有效信号后信号值发送0x0:no request";
CM_ SG_ 117 ivi_gloveBoxUnlockCtrl "glove box unlock control";
CM_ SG_ 117 IVI_EVonlymodereq_HW "强制纯电设置开关（华为）";
CM_ SG_ 117 ivi_v2vChrgOnOffSet "V2V charging turn ON or OFF set.";
CM_ SG_ 117 ivi_obcDschrgOnOffSet "OBC discharging turn ON or OFF set.";
CM_ SG_ 117 ivi_modememory "memory mode.";
CM_ SG_ 117 ivi_gunUnlockCtrlReq "Gun Unlock request from IVI";
CM_ SG_ 117 IVI_apaOnOffSet "APA on off switch";
CM_ SG_ 117 IVI_AVMOnOffSet "AVM on off switch";
CM_ SG_ 117 IVI_PDCOnOffSet "PDC on off switch";
CM_ SG_ 117 IVI_V2LMinSocSet "V2L minimum SOC set value";
CM_ SG_ 117 IVI_UserPrivacyModeSts "Privacy Mode Status";
CM_ SG_ 117 IVI_SelfHeatingAllow "ivi请求开启电池自加热功能";
CM_ SG_ 117 ivi_ExhibitionSet "车辆展车/运输模式选择
Exhibition mode set req
事件发生时，发送三帧有效信号后信号值发送0x0:no request";
CM_ SG_ 117 ivi_v2vChrgOptCurntSet "V2V charging output current set.";
CM_ SG_ 117 ivi_BatteryCondition "Battery Condition.";
CM_ SG_ 117 IVI_SREVSOCset "保电目标SOC设置";
CM_ SG_ 117 IVI_SREVSOCset_HW "保电目标SOC设置_华为";
CM_ SG_ 117 IVI_EVonlymodereq "强制纯电开关";
CM_ SG_ 117 ivi_lowVoltPowerCtrl "low Voltage Power Control.";
CM_ SG_ 165 ivi_MaxFuelConsumptionSW "Maximum fuel consumption switch control.";
CM_ SG_ 165 ivi_maxChargeCurrentSet "Maximum charge current set.";
CM_ SG_ 165 ivi_ChargeCancel "Cancel Charge.（实际发500ms有效值后回到No Request）";
CM_ SG_ 165 ivi_RegenModeSet "Energy recovery on off set.";
CM_ SG_ 165 ivi_MaxFuelConsumptionModeSW "Maximum fuel consumption mode switch control.";
CM_ SG_ 165 ivi_propModeSet "Propulsion mode set.";
CM_ SG_ 165 ivi_maxChrgSocSet "Maximum charge SOC set.（实际发500ms有效值后回到No Request）";
CM_ SG_ 165 ivi_startRevSOCSet "Start Recovery  SOC Limit Set.";
CM_ SG_ 165 ivi_ChargeEndTimeHalfDay "Charge End Time:Half Day.";
CM_ SG_ 165 ivi_ChargeStartTimeHalfDay "Charge Start Time:Half Day.";
CM_ SG_ 165 ivi_ChargeEndTimeHour "Charge End Time:Hour.";
CM_ SG_ 165 ivi_ChargeStartTimeHour "Charge Start Time:Hour.";
CM_ SG_ 165 ivi_chargeFormSet "Charge form set.";
CM_ SG_ 165 ivi_ChargeEndTimeMinute "Charge End Time:Minute.";
CM_ SG_ 165 ivi_ChargeStartTimeMinute "Charge Start Time:Minute.";
CM_ SG_ 165 ivi_ChargeEnable "充电开始使能（可开始立即充电+开始预约充电）";
CM_ SG_ 165 ivi_chargeSetValid "Slow charge set valid signal.";
CM_ SG_ 165 ivi_ResetCurrentTrip "Reset Current Trip.";
CM_ SG_ 165 ivi_ChargeEndTimeValid "Charge End Time Valid.";
CM_ SG_ 165 ivi_ChargeStartTimeValid "Charge Start Time Valid.";
CM_ SG_ 165 ivi_driveModeSet "Driving mode set.";
CM_ SG_ 476 ivi_centralLockCtrl "Central lock control.";
CM_ SG_ 476 ivi_fuelPortCapOpenCtrl "Fuel port cap open close control.";
CM_ SG_ 476 ivi_chrgPortCapOpenCtrl "Charging port cap open control.";
CM_ SG_ 476 ivi_antiTheftAlarmFormSet "anti Theft Alar mForm Set";
CM_ SG_ 476 ivi_approachingUnlockCtrl "approaching unlock control.";
CM_ SG_ 476 ivi_awayLockCtrl "away lock control.";
CM_ SG_ 476 ivi_parkAutoCloseDRLCtrl "驻车自动关闭日行灯控制信号";
CM_ SG_ 476 ivi_welcomeSetEnable "迎宾功能使能信号";
CM_ SG_ 476 ivi_welcomeOnOffSet "welcome On/Off set.";
CM_ SG_ 476 ivi_followMeHomeSet "Follow me home function set.";
CM_ SG_ 476 ivi_WiperMaintenanceCtrl "wipper maint  mode Control.";
CM_ SG_ 476 ivi_lockAutoCloseWinCtrl "lock Auto Close Window Control";
CM_ SG_ 476 IVI_Backlightadjust "Adjust the backlight";
CM_ SG_ 476 IVI_Sunroof_HorizontalControl "天窗开度控制命令";
CM_ SG_ 476 ivi_VehiclePowerOFF "Vehicle power off Request";
CM_ SG_ 476 ivi_sunroofGlassCmd "Sunroof  Glass control command";
CM_ SG_ 476 ivi_sunroofRollshadeCtrlSelect "ivi下发选择天窗还是遮阳帘的控制信号";
CM_ SG_ 476 ivi_tailgateCtrl "Tailgate control.";
CM_ SG_ 476 IVI_FLReadLightReq "IVI语音请求点亮主驾侧阅读灯阅读灯";
CM_ SG_ 476 IVI_FRReadLightReq "IVI语音请求点亮副驾侧阅读灯阅读灯";
CM_ SG_ 476 IVI_RLReadLightReq "IVI语音请求点亮二排左侧阅读灯阅读灯";
CM_ SG_ 476 IVI_RReadLightReq "IVI语音请求点亮二排右侧阅读灯阅读灯";
CM_ SG_ 476 IVI_ITLToplampReq "IVI语音请求点亮顶灯";
CM_ SG_ 476 ivi_languageSet "Language set.";
CM_ SG_ 476 ivi_unitSet "Length measurement unit set.";
CM_ SG_ 476 ivi_OutsideLockAlarmFormSet "车外解闭锁提醒方式设置信号";
CM_ SG_ 1240 ic_tripmeterA "IC tripmeter A.";
CM_ SG_ 1240 ic_maintenanceInd "Maintenance indication.";
CM_ SG_ 1240 ic_tripmeterB "IC tripmeter B.";
CM_ SG_ 1240 IC_ChargingPower "充电功率";
CM_ SG_ 1240 IC_ChargingSpeed "充电速度";
CM_ SG_ 290 IPB_wheelSpeedRL "Rear left wheel speed .";
CM_ SG_ 290 IPB_wheelSpeedRLValid "Rear left wheel speed front valid signal.";
CM_ SG_ 290 IPB_wheelSpeedRR "Rear right wheel speed.";
CM_ SG_ 290 IPB_wheelSpeedRRValid "Rear right wheel speed front valid signal.";
CM_ SG_ 290 RollingCounter122 "every message increments the counter.";
CM_ SG_ 290 Checksum122 "CRC8, checksum.";
CM_ SG_ 322 IPB_wheelSpeedFL "Front left wheel speed.";
CM_ SG_ 322 IPB_wheelSpeedFLValid "Front left wheel speed front valid signal.";
CM_ SG_ 322 IPB_wheelSpeedFR "Front right wheel speed.";
CM_ SG_ 322 IPB_wheelSpeedFRValid "Front right wheel speed front valid signal.";
CM_ SG_ 322 RollingCounter142 "every message increments the counter.";
CM_ SG_ 322 Checksum142 "CRC8, checksum.";
CM_ SG_ 160 IPB_vehicleSpeed "vehicle reference speed.";
CM_ SG_ 160 IPB_vehicleSpeedValid "vehicle reference speed valid signal.";
CM_ SG_ 160 IPB_absFault "ABS system has detected a failure which does not allow a reliable ABS regulation and is therefore switched off.";
CM_ SG_ 160 IPB_absActive "indicates  ABS intervention active.";
CM_ SG_ 160 IPB_vdcActive "VDC controller active: Oversteering brake intervention or Understeering brake intervention.";
CM_ SG_ 160 IPB_tcsActive "indicates  TCS intervention active，TCS will detect spinning wheels and request torque reduction/limitation.";
CM_ SG_ 160 IPB_avhModeWSts "AVH功能状态(H56C适用)";
CM_ SG_ 160 IPB_avhAvailable "HMI Responsible,CAN get degrateAVH statement from DSW and send out.";
CM_ SG_ 160 IPB_cdpActive "Indicate CDP Control Active";
CM_ SG_ 160 IPB_cdpAvailable "HMI Responsible,CAN get degrateCDP statement from DSW and send out.";
CM_ SG_ 160 IPB_hdcAvailable "HMI Responsible,CAN get degrateHDC statement from DSW and send out.";
CM_ SG_ 160 IPB_epbRequest "Request for controlling EPB";
CM_ SG_ 160 IPB_vehicleStandstill "Indicating whether the vehicle is standstill or not; Cannot be set until standstill is surely reached.";
CM_ SG_ 160 IPB_vehicleStandstillValid "Vehicle Standstill state valid signal.";
CM_ SG_ 160 IPB_ModeSts "brake pedal feeling mode";
CM_ SG_ 160 IPB_brakelightRequest "Indicate the request to light up brake light during emergent brake via EPB.
The request to illuminater brake light is needed by HHC,AVH,HDC,VLC,CDD also. This signal will be used not only for EPB emergency braking but also for all the above mentioned functions.
ESP请求点亮制动灯";
CM_ SG_ 160 IPB_hdcSts "indicates HDC control status.";
CM_ SG_ 160 IPB_hhcActive "Indicate HHC active signal";
CM_ SG_ 160 IPB_hhcAvailable "HMI Responsible, CAN get degrade HHC statement from DSW and send out.";
CM_ SG_ 160 IPB_ebdFault "ABS system has detected a heavy fault, which does not even allow a reliable electronic brake distribution and is therefore completely shut down.";
CM_ SG_ 160 IPB_ebd_active "EBD control active - Indication that ESP system (especially EBD module) currently performs a brake active";
CM_ SG_ 160 IPB_ESCoffSts "ESP OFF SW  close,ESP function passive(PATA)";
CM_ SG_ 160 IPB_escFault "VDC/TCS is switched off due to detected failure.";
CM_ SG_ 160 IPB_haz_active "Emergency brakes status signal.When the deceleration is too large, light the danger warning light to prompt the driver";
CM_ SG_ 160 IPB_hazErrorSt "The signal indicates whether or not theEmergencyBrake  is shutdown and function degrades due to fault .";
CM_ SG_ 160 IPB_hba_active "HBA controller active: The brake assist functions support the driver in case of an emergency or panic situation.";
CM_ SG_ 160 IPB_dtcActive "Drag torque control active.";
CM_ SG_ 160 IPB_esclampdisplay "esc lamp display for dashboad";
CM_ SG_ 160 IPB_BDWActive "BDW Active";
CM_ SG_ 160 IPB_HRBActive "HRB Active";
CM_ SG_ 160 RollingCounter0A0 "every message increments the counter.";
CM_ SG_ 160 Checksum0A0 "CRC8, message checksum.";
CM_ SG_ 626 IPB_sumOfEdgeFLWSS "Sum of the front left edges wheel speed status.";
CM_ SG_ 626 IPB_sumOfEdgeFRWSS "Sum of the front righ edges wheel speed status.";
CM_ SG_ 626 IPB_sumOfEdgeFLWSSValid "Sum of the front left edges wheel speed status Valid.";
CM_ SG_ 626 IPB_sumOfEdgeFRWSSValid "Sum of the front righ edges wheel speed status Valid.";
CM_ SG_ 626 IPB_wheelDirectionFLValid "Front left wheel moving direction.";
CM_ SG_ 626 IPB_wheelDirectionFRValid "Front right wheel moving direction.";
CM_ SG_ 626 IPB_wheelDirectionFL "Front left wheel moving direction.";
CM_ SG_ 626 IPB_wheelDirectionFR "Front right wheel moving direction.";
CM_ SG_ 626 IPB_vehicleDirection "vehicle moving direction base on wheel  moving direction";
CM_ SG_ 626 RollingCounter272 "every message increments the counter.";
CM_ SG_ 626 Checksum272 "CRC8, message checksum.";
CM_ SG_ 642 IPB_sumOfEdgeRLWSS "Sum of the rear left edges wheel speed status.";
CM_ SG_ 642 IPB_sumOfEdgeRRWSS "Sum of the rear righ edges wheel speed status.";
CM_ SG_ 642 IPB_sumOfEdgeRLWSSValid "Sum of the rear left edges wheel speed status Valid.";
CM_ SG_ 642 IPB_sumOfEdgeRRWSSValid "Sum of the rear righ edges wheel speed status Valid.";
CM_ SG_ 642 IPB_wheelDirectionRLValid "Rear left wheel moving direction.";
CM_ SG_ 642 IPB_wheelDirectionRRValid "Rear right wheel moving direction.";
CM_ SG_ 642 IPB_wheelDirectionRL "Rear left wheel moving direction.";
CM_ SG_ 642 IPB_wheelDirectionRR "Rear right wheel moving direction.";
CM_ SG_ 642 RollingCounter282 "every message increments the counter.";
CM_ SG_ 642 Checksum282 "CRC8, message checksum.";
CM_ SG_ 1274 gw_vin_frame "VIN";
CM_ SG_ 1274 gw_vin0 "VIN低字节";
CM_ SG_ 1274 gw_vin1 "VIN";
CM_ SG_ 1274 gw_vin2 "VIN";
CM_ SG_ 1274 gw_vin3 "VIN";
CM_ SG_ 1274 gw_vin4 "VIN";
CM_ SG_ 1274 gw_vin5 "VIN";
CM_ SG_ 1274 gw_vin6 "VIN高字节";
CM_ SG_ 1278 tbox_vehicleMode "the signal indicates the current vehicle state to active or dective functions";
CM_ SG_ 1278 TBOX_OTAEnergyCtl "OTA energy control";
CM_ SG_ 1278 TBOX_OTATimeSet "OTA time setting";
CM_ SG_ 1278 RollingCounter4FE "every message increments the counter.";
CM_ SG_ 1278 Checksum4FE "CRC8, message checksum.";
CM_ SG_ 126 tbox_reservationChargeMode "Reservation charge Mode(预约充电定时方式)";
CM_ SG_ 126 tbox_SysErSt "TBOX系统故障";
CM_ SG_ 126 TBOX_ChargeContinueSta "预约充电优先充电到目标电量设置状态(仅H56C适用)";
CM_ SG_ 126 TBOX_ChargeStart "开始充电(仅H56C适用)";
CM_ SG_ 126 tbox_chargeSetValid_Reserved "Slow charge set valid signal(Reserved).";
CM_ SG_ 126 tbox_MaxChargeCurrentSet "Maximum Charge Current Set.";
CM_ SG_ 126 tbox_ChargeFormSet "charge form set.";
CM_ SG_ 126 tbox_ChargeEndTimeHalfDay "Charge End Time:Half Day";
CM_ SG_ 126 tbox_ChargeEndTimeHour "Charge End Time:Hour.";
CM_ SG_ 126 tbox_remoteVehicleForbiddenStart "TBOX remote Vehicle Forbidden Start.";
CM_ SG_ 126 tbox_ChargeEndTimeMinute "Charge End Time:Minute";
CM_ SG_ 126 tbox_ChargeCancel "Cancel Charge.";
CM_ SG_ 126 tbox_ChargeEnable "Charge Enable .";
CM_ SG_ 126 tbox_ChargeStartTimeHalfDay "Charge Start Time:Half Day.";
CM_ SG_ 126 tbox_ChargeStartTimeHour "Charge Start Time:Hour.";
CM_ SG_ 126 tbox_EmergencyHvOffReq "Emergency high voltage Off Request.";
CM_ SG_ 126 tbox_eCallSts "eCall通话状态";
CM_ SG_ 126 tbox_ChargeStartTimeMinute "ChargeStartTimeMinute.";
CM_ SG_ 126 tbox_BatteryCondition_Reserved "Battery Condition(Reserved).";
CM_ SG_ 126 tbox_MaxChargeSOCSet "Maximum Charge SOC Set .";
CM_ SG_ 126 tbox_ChargeEndTimeValid "Charge End Time Valid.";
CM_ SG_ 126 tbox_ChargeStartTimeValid "Charge Start Time Valid.";
CM_ SG_ 126 tbox_remoteengStartCmd "允许远程启动发动机";
CM_ SG_ 126 SENTRY_VedioSwitchSet "哨兵视觉开关设置";
CM_ SG_ 126 tbox_ultrasocengStartCmd "APP发动机启动授权反馈";
CM_ SG_ 714 OBC_ACPlug_Status "OBC Charge Connect Status";
CM_ SG_ 714 OBC_CC_MaxCurrent "OBC Maximum Current Of Charge Connect";
CM_ SG_ 714 OBC_CC_Fault_Status "OBC Fault Status Of Charge Connect";
CM_ SG_ 714 OBC_CC_Resistance "OBC Charge Connect Status Resistance";
CM_ SG_ 714 OBC_S2_Status "OBC S2 Switch Status";
CM_ SG_ 714 OBC_CP_Duty "OBC Charge Pilot Duty";
CM_ SG_ 714 OBC_CP_Frequency "OBC Charge Pilot Frequency";
CM_ SG_ 714 OBC_CP_Fault_Status "OBC Fault Status Of Charge Pilot";
CM_ SG_ 714 OBC_CP_Status "OBC Charge Connect Status";
CM_ SG_ 714 OBC_Phase_Mode "OBC Phase Mode";
CM_ SG_ 714 RollingCounter2CA "every message increments the counter.";
CM_ SG_ 714 Checksum2CA "CRC8, checksum.";
CM_ SG_ 716 OBC_Frequency_AC "OBC Frequency Of AC Side";
CM_ SG_ 716 OBC_Max_Current_AC "OBC Maximum Current Of AC Side";
CM_ SG_ 716 OBC_AC_Current_L1 "OBC AC Side Current Of L1 Phase";
CM_ SG_ 716 OBC_AC_Current_L2 "OBC AC Side Current Of L2 Phase";
CM_ SG_ 716 OBC_AC_Current_L3 "OBC AC Side Current Of L3 Phase";
CM_ SG_ 716 RollingCounter2CC "every message increments the counter.";
CM_ SG_ 716 Checksum2CC "CRC8, checksum.";
CM_ SG_ 719 OBC_ActualCurrent_DC "OBC Current Of HV Side";
CM_ SG_ 719 OBC_ActualVoltage_DC "OBC Voltage Of HV Side";
CM_ SG_ 719 OBC_MaxCurrent_Output "the max output current of OBC, depends on the AC VOLTAGE, max AC current, OBC capacity, as well as the DC voltage";
CM_ SG_ 719 OBC_Efficiency "OBC Charging Efficiency";
CM_ SG_ 719 OBC_Derating "OBC Derating Power";
CM_ SG_ 719 OBC_AcChgEnergy "表示单次慢充充电累积电量";
CM_ SG_ 736 OBC_AC_PlugTemp_Status_L1 "OBC AC Side Temperature Sensor Status Of L1 Phase";
CM_ SG_ 736 OBC_AC_PlugTemp_Status_L2 "OBC AC Side Temperature Sensor Status Of L2 Phase";
CM_ SG_ 736 OBC_AC_PlugTemp_Status_L3 "OBC AC Side Temperature Sensor Status Of L3 Phase";
CM_ SG_ 736 OBC_AC_PlugTemp_Status_N "OBC AC Side Temperature Sensor Status Of N";
CM_ SG_ 736 OBC_AC_Voltage_L1 "OBC AC Side Voltage Of L1 Phase";
CM_ SG_ 736 OBC_AC_Voltage_L2 "OBC AC Side Voltage Of L2 Phase";
CM_ SG_ 736 OBC_AC_Voltage_L3 "OBC AC Side Voltage Of L3 Phase";
CM_ SG_ 736 OBC_Temperature_Internal "OBC Internal Maximum Temperature";
CM_ SG_ 736 RollingCounter2E0 "every message increments the counter.";
CM_ SG_ 736 Checksum2E0 "CRC8, checksum.";
CM_ SG_ 738 OBC_Coolant_Temperature "OBC Temperature Of Coolant";
CM_ SG_ 738 OBC_Status "OBC Status";
CM_ SG_ 738 OBC_PlugLock_Action "OBC PlugLock Action";
CM_ SG_ 738 OBC_PlugLock_Status "OBC PlugLock Status";
CM_ SG_ 738 OBC_Message_standard "OBC报文发送标准";
CM_ SG_ 738 OBC_HPC_Lock_Status "OBC ChargeCap Lock Status";
CM_ SG_ 738 OBC_Standard "OBC Standard";
CM_ SG_ 738 OBC_Fault_Code "OBC Fault code";
CM_ SG_ 738 OBC_Fault_Status "OBC Fault Status";
CM_ SG_ 738 OBC_OBD_Lamp_Req "OBC MIL indicator light.";
CM_ SG_ 738 RollingCounter2E2 "every message increments the counter.";
CM_ SG_ 738 Checksum2E2 "CRC8, checksum.";
CM_ SG_ 740 DCDC_Voltage_HV "DCDC Voltage of HV Side";
CM_ SG_ 740 DCDC_Current_HV "DCDC Current of HV Side";
CM_ SG_ 740 DCDC_Voltage_LV "DCDC Voltage of LV Side";
CM_ SG_ 740 DCDC_Current_LV "DCDC Current of LV Side";
CM_ SG_ 740 RollingCounter2E4 "every message increments the counter.";
CM_ SG_ 740 Checksum2E4 "CRC8, checksum.";
CM_ SG_ 865 OBC_AC_PlugTemp_L1 "OBC AC Side Temperature Of L1 Phase";
CM_ SG_ 865 OBC_AC_PlugTemp_L2 "OBC AC Side Temperature Of L2 Phase";
CM_ SG_ 865 OBC_AC_PlugTemp_L3 "OBC AC Side Temperature Of L3 Phase";
CM_ SG_ 865 OBC_AC_PlugTemp_N "OBC AC Side Temperature Of N";
CM_ SG_ 888 BMS_RtmWarn_PackCom "RTM-Signal: warning of  battery CAN communication fault";
CM_ SG_ 888 BMS_RtmWarn_PackOverCharge "RTM-Signal: warning of  battery over-charge";
CM_ SG_ 888 BMS_RtmWarn_SOCHigh "RTM-Signal: warning of  Excessively-high SOC";
CM_ SG_ 888 BMS_RtmWarn_SOCLow "RTM-Signal: warning of  Excessively-LOW SOC";
CM_ SG_ 888 BMS_RtmWarn_SOCSprung "RTM-Signal: warning of  SOC Jump";
CM_ SG_ 888 BMS_RtmWarn_TempCellDiff "RTM-Signal: warning of  temperature difference between cells is too high";
CM_ SG_ 888 BMS_RtmWarn_TempCellMax "RTM-Signal: warning of  MAX temperature of the cells is too high";
CM_ SG_ 888 BMS_RtmWarn_TempCellMin "RTM-Signal: warning of  MIN temperature of the cells is too low";
CM_ SG_ 888 BMS_RtmWarn_OverCurrent "RTM-Signal: warning of  over current";
CM_ SG_ 888 BMS_RtmWarn_UPackMax "RTM-Signal: warning of   Max_Voltage_of_battery";
CM_ SG_ 888 BMS_RtmWarn_UPackMin "RTM-Signal: warning of   Min_Voltage_of_battery";
CM_ SG_ 888 BMS_RtmWarn_UCellMax "RTM-Signal: warning of   Max_Voltage_of_cell";
CM_ SG_ 888 BMS_RtmWarn_UCellMin "RTM-Signal: warning of   Min_Voltage_of_cell";
CM_ SG_ 888 BMS_RtmWarn_UCellDiff "RTM-Signal: warning of a poor consistency of the cell";
CM_ SG_ 888 BMS_RTM_CellCnt "单体电池总数";
CM_ SG_ 888 BMS_RTM_ProbeTempCnt "电池包温度探针个数";
CM_ SG_ 889 BMS_Pack_SN_01 "Serial number of HV Battery, Byte 1, ASCII Code";
CM_ SG_ 889 BMS_Pack_SN_02 "Serial number of HV Battery, Byte 2, ASCII Code";
CM_ SG_ 889 BMS_Pack_SN_03 "Serial number of HV Battery, Byte 3, ASCII Code";
CM_ SG_ 889 BMS_Pack_SN_04 "Serial number of HV Battery, Byte 4, ASCII Code";
CM_ SG_ 889 BMS_Pack_SN_05 "Serial number of HV Battery, Byte 5, ASCII Code";
CM_ SG_ 889 BMS_Pack_SN_06 "Serial number of HV Battery, Byte 6, ASCII Code";
CM_ SG_ 889 BMS_Pack_SN_07 "Serial number of HV Battery, Byte 7, ASCII Code";
CM_ SG_ 889 BMS_Pack_SN_Index "Index of the Pack serial number";
CM_ SG_ 890 BMS_ChargeEnergy_Total "累计充电能量";
CM_ SG_ 890 BMS_ChargeCapacity_Total "累计充电容量";
CM_ SG_ 922 BMS_SW_Version_Vehicle "BMS_SW_Version_Vehicle";
CM_ SG_ 922 BMS_SW_Version_VehicleType "BMS_SW_Version_VehicleType";
CM_ SG_ 922 BMS_SW_Version_ReleaseType "BMS_SW_Version_ReleasedType";
CM_ SG_ 922 BMS_SW_Version_Major "BMS_SW_Version_Major";
CM_ SG_ 922 BMS_SW_Version_Minor "BMS_SW_Version_Minor";
CM_ SG_ 922 BMS_SW_Version_Patch "BMS_SW_Version_Patch";
CM_ SG_ 922 BMS_SW_Version_Test "BMS_SW_Test_Version";
CM_ SG_ 922 BMS_HW_Version "BMS_HW_Version";
CM_ SG_ 923 BMS_FaultCode_Internal "BMS内部故障码";
CM_ SG_ 923 BMS_AC_StopReason "AC充电停止原因";
CM_ SG_ 923 BMS_HeatingRate "电池加热速率";
CM_ SG_ 923 BMS_Capacity_Max "表示额定电池容量，100% BMS_SOC对应的电池容量，受SOH影响";
CM_ SG_ 927 BMS_ProbeTemp1 "探针1温度值";
CM_ SG_ 927 BMS_ProbeTemp2 "探针2温度值";
CM_ SG_ 927 BMS_ProbeTemp3 "探针3温度值";
CM_ SG_ 927 BMS_ProbeTemp4 "探针4温度值";
CM_ SG_ 927 BMS_ProbeTemp5 "探针5温度值";
CM_ SG_ 927 BMS_ProbeTemp6 "探针6温度值";
CM_ SG_ 927 BMS_ProbeTemp7 "探针7温度值";
CM_ SG_ 927 BMS_ProbeTemp8 "探针8温度值";
CM_ SG_ 928 BMS_ProbeTemp9 "探针9温度值";
CM_ SG_ 928 BMS_ProbeTemp10 "探针10温度值";
CM_ SG_ 928 BMS_ProbeTemp11 "探针11温度值";
CM_ SG_ 928 BMS_ProbeTemp12 "探针12温度值";
CM_ SG_ 928 BMS_ProbeTemp13 "探针13温度值";
CM_ SG_ 928 BMS_ProbeTemp14 "探针14温度值";
CM_ SG_ 928 BMS_ProbeTemp15 "探针15温度值";
CM_ SG_ 928 BMS_ProbeTemp16 "探针16温度值";
CM_ SG_ 930 BMS_ProbeTemp17 "探针17温度值";
CM_ SG_ 930 BMS_ProbeTemp18 "探针18温度值";
CM_ SG_ 930 BMS_ProbeTemp19 "探针19温度值";
CM_ SG_ 930 BMS_ProbeTemp20 "探针20温度值";
CM_ SG_ 930 BMS_ProbeTemp21 "探针21温度值";
CM_ SG_ 930 BMS_ProbeTemp22 "探针22温度值";
CM_ SG_ 930 BMS_ProbeTemp23 "探针23温度值";
CM_ SG_ 930 BMS_ProbeTemp24 "探针24温度值";
CM_ SG_ 931 BMS_ProbeTemp25 "探针25温度值";
CM_ SG_ 931 BMS_ProbeTemp26 "探针26温度值";
CM_ SG_ 931 BMS_ProbeTemp27 "探针27温度值";
CM_ SG_ 931 BMS_ProbeTemp28 "探针28温度值";
CM_ SG_ 931 BMS_ProbeTemp29 "探针29温度值";
CM_ SG_ 931 BMS_ProbeTemp30 "探针30温度值";

BA_DEF_ BO_  "NmMessage" ENUM "No","Yes";
BA_DEF_ BO_  "DiagState" ENUM  "No","Yes";
BA_DEF_ BO_  "GenMsgSendType" ENUM  "Cyclic","Event","IfActive","CE","CA","NoMsgSendType";
BA_DEF_ BO_  "GenMsgCycleTime" INT 0 0;
BA_DEF_ SG_  "GenSigSendType" ENUM  "Cyclic","OnChange","OnWrite","IfActive","OnChangeWithRepetition","OnWriteWithRepetition","IfActiveWithRepetition","NoSigSendType","OnChangeAndIfActive","OnChangeAndIfActiveWithRepetition","CA","CE","Event";
BA_DEF_ SG_  "GenSigStartValue" INT 0 0;
BA_DEF_ SG_  "GenSigInactiveValue" INT 0 0;
BA_DEF_ BO_  "GenMsgCycleTimeFast" INT 0 0;
BA_DEF_ BO_  "GenMsgNrOfRepetition" INT 0 0;
BA_DEF_ BO_  "GenMsgDelayTime" INT 0 0;
BA_DEF_ BO_  "CANFD_BRS" ENUM  "0","1";
BA_DEF_ BO_  "VFrameFormat" ENUM  "StandardCAN","ExtendedCAN","reserved","reserved","reserved","reserved","reserved","reserved","reserved","reserved","reserved","reserved","reserved","reserved","StandardCAN_FD","ExtendedCAN_FD";
BA_DEF_DEF_  "NmMessage" "No";
BA_DEF_DEF_  "DiagState" "No";
BA_DEF_DEF_  "GenMsgSendType" "Cyclic";
BA_DEF_DEF_  "GenMsgCycleTime" 0;
BA_DEF_DEF_  "GenSigSendType" "Cyclic";
BA_DEF_DEF_  "GenSigStartValue" 0;
BA_DEF_DEF_  "GenSigInactiveValue" 0;
BA_DEF_DEF_  "GenMsgCycleTimeFast" 0;
BA_DEF_DEF_  "GenMsgNrOfRepetition" 0;
BA_DEF_DEF_  "GenMsgDelayTime" 0;
BA_DEF_DEF_  "CANFD_BRS" "1";
BA_DEF_DEF_  "VFrameFormat" "StandardCAN_FD";
