VERSION ""

NS_ :

BS_:

BU_:

BO_ 1792 sensor_data_message2: 4 Vector__XXX
 SG_ temp : 0|32@1- (1,0) [-3.4E+038|3.4E+038] "°„C" Vector__XXX

BO_ 1791 sensor_data_message1: 8 Vector__XXX
 SG_ vol : 32|32@1- (1,0) [-2147483648|2147483647] "¶ÃV" Vector__XXX
 SG_ cur : 0|32@1- (1,0) [-3.4E+038|3.4E+038] "mA" Vector__XXX

BA_DEF_ SG_  "GenSigSendType" ENUM  "Cyclic","OnWrite","OnWriteWithRepetition","OnChange","OnChangeWithRepetition","IfActive","IfActiveWithRepetition","NoSigSendType";
BA_DEF_ BO_  "GenMsgSendType" ENUM  "Cyclic","not_used","not_used","not_used","not_used","Cyclic","not_used","IfActive","NoMsgSendType";
BA_DEF_  "DBName" STRING ;
BA_DEF_  "BusType" STRING ;
BA_DEF_DEF_  "GenSigSendType" "Cyclic";
BA_DEF_DEF_  "GenMsgSendType" "NoMsgSendType";
BA_DEF_DEF_  "DBName" "";
BA_DEF_DEF_  "BusType" "CAN";
BA_ "DBName" "cur_vol_v2";
SIG_VALTYPE_ 1792 temp : 1;
SIG_VALTYPE_ 1791 cur : 1;
