VERSION ""

NS_ :

BS_:

BU_: ECU PKE IP MCR

BO_ 288 ECU_RPM_UP60: 8 ECU
 SG_ EngineSpeed : 7|16@0+ (1,0) [0|20000] "rpm"  PKE,IP,MCR
 SG_ EngineSpeedSignalFailure : 31|1@0+ (1,0) [0|1] ""  PKE,IP,MCR

CM_ SG_ 288 EngineSpeedSignalFailure "0x0:正常 0x1:故障";
BA_DEF_ BO_ "GenMsgCycleTime" INT 0 65535;
BA_DEF_ BO_ "GenMsgSendType" ENUM "Cyclic","Event","CyclicIfActive","SpontanWithDelay","CyclicAndSpontan","CyclicAndEvent";
BA_DEF_DEF_ "GenMsgCycleTime" 0;
BA_DEF_DEF_ "GenMsgSendType" "Cyclic";
BA_ "GenMsgCycleTime" BO_ 288 20;
VAL_ 288 EngineSpeedSignalFailure 0 "正常" 1 "故障" ;
